## package/android-tools/Config.in
```kconfig
config LINGMO_PACKAGE_ANDROID_TOOLS
	bool "android-tools"
	# Technically, fastboot could build on noMMU systems. But
	# since we need at least one of the three sub-options enabled,
	# and adb/adbd can't be built on noMMU systems, and fastboot
	# has some complicated dependencies, we simply make the whole
	# package not available on noMMU platforms.
	depends on LINGMO_USE_MMU
	depends on LINGMO_TOOLCHAIN_HAS_THREADS
	select LINGMO_PACKAGE_ANDROID_TOOLS_ADBD if \
	      !LINGMO_PACKAGE_ANDROID_TOOLS_FASTBOOT && \
	      !LINGMO_PACKAGE_ANDROID_TOOLS_ADB
	help
	  This package contains the fastboot and adb utilities, that
	  can be used to interact with target devices using of these
	  protocols.

	  https://wiki.debian.org/AndroidTools#Original_android-tools_package

if LINGMO_PACKAGE_ANDROID_TOOLS

# We need kernel headers that support the __SANE_USERSPACE_TYPES__
# mechanism for 64 bits architectures, so that u64 gets defined as
# "unsigned long long" and not "unsigned long". We know that >= 3.16
# is needed for MIPS64 (kernel commit
# f4b3aa7cd9d32407670e67238c5ee752bb98f481) and >= 3.10 is needed for
# PowerPC64 (kernel commit
# 2c9c6ce0199a4d252e20c531cfdc9d24e39235c0). Without this, the build
# fails with a bad redefinition of u64 (the android-tools fastboot
# code defines it as "unsigned long long").
config LINGMO_PACKAGE_ANDROID_TOOLS_FASTBOOT_GOOD_KERNEL_HEADERS
	bool
	default y if LINGMO_TOOLCHAIN_HEADERS_AT_LEAST_3_10 && (LINGMO_powerpc64 || LINGMO_powerpc64le)
	default y if LINGMO_TOOLCHAIN_HEADERS_AT_LEAST_3_16 && (LINGMO_mips64 || LINGMO_mips64el)
	default y if !LINGMO_powerpc64 && !LINGMO_powerpc64le && !LINGMO_mips64 && !LINGMO_mips64el

config LINGMO_PACKAGE_ANDROID_TOOLS_FASTBOOT
	bool "fastboot"
	depends on LINGMO_TOOLCHAIN_HAS_THREADS # libselinux
	depends on !LINGMO_STATIC_LIBS # libselinux
	depends on LINGMO_TOOLCHAIN_GCC_AT_LEAST_5 # libselinux -> libsepol
	depends on LINGMO_PACKAGE_ANDROID_TOOLS_FASTBOOT_GOOD_KERNEL_HEADERS
	select LINGMO_PACKAGE_LIBSELINUX
	select LINGMO_PACKAGE_ZLIB
	help
	  This option will build and install the fastboot utility for
	  the target, which can be used to reflash other target devices
	  implementing the fastboot protocol.

comment "fastboot needs a toolchain w/ threads, dynamic library, gcc >= 5"
	depends on !LINGMO_TOOLCHAIN_HAS_THREADS || LINGMO_STATIC_LIBS || \
		!LINGMO_TOOLCHAIN_GCC_AT_LEAST_5

comment "fastboot needs headers >= 3.10 (PowerPC64), headers >= 3.16 (MIPS64)"
	depends on !LINGMO_arc
	depends on !LINGMO_PACKAGE_ANDROID_TOOLS_FASTBOOT_GOOD_KERNEL_HEADERS

config LINGMO_PACKAGE_ANDROID_TOOLS_ADB
	bool "adb"
	depends on LINGMO_USE_MMU # uses fork()
	select LINGMO_PACKAGE_OPENSSL
	select LINGMO_PACKAGE_ZLIB
	help
	  This option will build and install the adb utility for the
	  target, which can be used to interact with other target
	  devices implementing the ADB protocol.

config LINGMO_PACKAGE_ANDROID_TOOLS_ADBD
	bool "adbd"
	depends on LINGMO_USE_MMU # uses fork()
	select LINGMO_PACKAGE_OPENSSL
	select LINGMO_PACKAGE_ZLIB
	help
	  This option will build and install the adbd utility for the
	  target, which can be used to interact with a host machine
	  implementing the ADB protocol.

endif

comment "android-tools needs a toolchain w/ threads"
	depends on LINGMO_USE_MMU
	depends on !LINGMO_TOOLCHAIN_HAS_THREADS
```
