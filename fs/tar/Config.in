## package/18xx-ti-utils/Config.in
```kconfig
config LINGMO_PACKAGE_18XX_TI_UTILS
	bool "18xx-ti-utils"
	depends on LINGMO_TOOLCHAIN_HAS_THREADS # libnl
	select LINGMO_PACKAGE_LIBNL
	help
	  TI Wilink calibration utilities.

	  CONFIG_NL80211_TESTMODE must be enabled in the kernel
	  configuration for this package to work.

	  http://processors.wiki.ti.com/index.php/WL18xx_TX_Testing

comment "18xx-ti-utils needs a toolchain w/ threads"
	depends on !LINGMO_TOOLCHAIN_HAS_THREADS
```

## package/a10disp/Config.in
```kconfig
config LINGMO_PACKAGE_A10DISP
	bool "a10disp"
	depends on LINGMO_arm
	depends on LINGMO_LINUX_KERNEL
	help
	  Program to change the display mode of Allwinner ARM SOCs
	  running the linux-sunxi kernel (and not the mainline kernel.)

	  http://github.com/hglm/a10disp

comment "a10disp needs a Linux kernel to be built"
	depends on LINGMO_arm
	depends on !LINGMO_LINUX_KERNEL
```

## package/abootimg/Config.in
```kconfig
config LINGMO_PACKAGE_ABOOTIMG
	bool "abootimg"
	depends on LINGMO_USE_MMU	# libblkid
	select LINGMO_PACKAGE_UTIL_LINUX
	select LINGMO_PACKAGE_UTIL_LINUX_LIBBLKID
	help
	  Tool to manipulate Android Boot Images, either on files
	  or directly on /dev block devices.

	  https://gitlab.com/ajs124/abootimg
```

## package/abootimg/Config.in.host
```kconfig
config LINGMO_PACKAGE_HOST_ABOOTIMG
	bool "host abootimg"
	select LINGMO_PACKAGE_HOST_UTIL_LINUX
	help
	  Tool to manipulate Android Boot Images, either on files
	  or directly on /dev block devices.

	  https://github.com/ggrandou/abootimg
```

## package/ace/Config.in
```kconfig
config LINGMO_PACKAGE_ACE
	bool "ace"
	depends on LINGMO_TOOLCHAIN_USES_GLIBC
	depends on !LINGMO_STATIC_LIBS
	depends on LINGMO_INSTALL_LIBSTDCPP
	depends on LINGMO_TOOLCHAIN_GCC_AT_LEAST_4_9 # C++14
	help
	  The ADAPTIVE Communication Environment (ACE(TM))
	  An OO Network Programming Toolkit in C++.

	  http://www.dre.vanderbilt.edu/~schmidt/ACE.html

comment "ACE needs a glibc toolchain, dynamic library, C++, gcc >= 4.9"
	depends on !LINGMO_TOOLCHAIN_USES_GLIBC || LINGMO_STATIC_LIBS || \
		!LINGMO_INSTALL_LIBSTDCPP || \
		!LINGMO_TOOLCHAIN_GCC_AT_LEAST_4_9
```

## package/acpica/Config.in
```kconfig
config LINGMO_PACKAGE_ACPICA
	bool "acpica"
	depends on LINGMO_USE_WCHAR
	depends on LINGMO_TOOLCHAIN_HAS_THREADS
	help
	  The ACPI Component Architecture (ACPICA) project provides an
	  operating system (OS)-independent reference implementation
	  of the Advanced Configuration and Power Interface
	  Specification (ACPI).

	  https://www.acpica.org

comment "acpica needs a toolchain w/ threads, wchar"
	depends on !LINGMO_USE_WCHAR || !LINGMO_TOOLCHAIN_HAS_THREADS
```

## package/acpid/Config.in
```kconfig
config LINGMO_PACKAGE_ACPID
	bool "acpid"
	depends on LINGMO_USE_MMU # fork()
	help
	  Advanced Configuration and Power Interface event daemon.

	  Acpid is designed to notify user-space programs of ACPI
	  events, and allows you to configure specific actions for
	  specific events.

	  http://sourceforge.net/projects/acpid2/
```

## package/acpitool/Config.in
```kconfig
config LINGMO_PACKAGE_ACPITOOL
	bool "acpitool"
	depends on !LINGMO_STATIC_LIBS
	depends on LINGMO_TOOLCHAIN_HAS_THREADS
	depends on LINGMO_INSTALL_LIBSTDCPP
	help
	  A small, convenient command-line ACPI client with a lot of
	  features for Linux

	  http://acpitool.sourceforge.net

comment "acpitool needs a toolchain w/ threads, C++, dynamic library"
	depends on LINGMO_STATIC_LIBS || !LINGMO_TOOLCHAIN_HAS_THREADS \
		|| !LINGMO_INSTALL_LIBSTDCPP
```

## package/acsccid/Config.in
```kconfig
config LINGMO_PACKAGE_ACSCCID
	bool "acsccid"
	depends on LINGMO_TOOLCHAIN_HAS_THREADS # pcsc-lite, libusb
	depends on LINGMO_TOOLCHAIN_GCC_AT_LEAST_4_9 # libusb, pcsc-lite
	depends on LINGMO_USE_MMU # pcsc-lite
	depends on !LINGMO_STATIC_LIBS # pcsc-lite
	select LINGMO_PACKAGE_LIBICONV if !LINGMO_ENABLE_LOCALE
	select LINGMO_PACKAGE_PCSC_LITE
	# Even though there is a --disable-libusb option, it has in
	# fact no effect, and acsccid really requires libusb.
	select LINGMO_PACKAGE_LIBUSB
	help
	  acsccid is a PC/SC driver for Linux/Mac OS X and it supports
	  ACS CCID smart card readers.

	  http://acsccid.sourceforge.net/

comment "acsccid needs a toolchain w/ threads, dynamic library, gcc >= 4.9"
	depends on LINGMO_USE_MMU
	depends on !LINGMO_TOOLCHAIN_HAS_THREADS || LINGMO_STATIC_LIBS || \
		!LINGMO_TOOLCHAIN_GCC_AT_LEAST_4_9
```

## package/adwaita-icon-theme/Config.in
```kconfig
config LINGMO_PACKAGE_ADWAITA_ICON_THEME
	bool "adwaita icon theme"
	depends on LINGMO_PACKAGE_LIBGTK2 || LINGMO_PACKAGE_LIBGTK3
	# host-libgtk3 -> host-librsvg -> host-pango -> host-harfbuzz
	depends on LINGMO_HOST_GCC_AT_LEAST_4_9
	help
	  Adwaita icon theme

comment "adwaita icon theme needs host gcc >= 4.9"
	depends on !LINGMO_HOST_GCC_AT_LEAST_4_9
```

## package/agentpp/Config.in
```kconfig
config LINGMO_PACKAGE_AGENTPP
	bool "agent++"
	depends on LINGMO_INSTALL_LIBSTDCPP
	depends on LINGMO_TOOLCHAIN_HAS_THREADS # snmp++
	depends on !LINGMO_STATIC_LIBS # snmp++
	select LINGMO_PACKAGE_SNMPPP
	help
	  AGENT++ is a set of C++ classes which provides a complete
	  protocol engine and dispatch table for the development of
	  SNMP agents. AGENT++ is a multilingual API which supports
	  SNMPv1, SNMPv2c, and SNMPv3. It provides various C++ classes
	  implementing prototypes for scalar and table SNMP managed
	  objects that can be customized by derivation. Additional
	  classes support the development of proxy agents as well as
	  sending notifications.

	  SNMPv3 support is enabled if SNMP++ enables it.

	  https://www.agentpp.com/api/cpp/agent_pp.html

comment "agent++ needs a toolchain w/ threads, C++, dynamic library"
	depends on !LINGMO_INSTALL_LIBSTDCPP || !LINGMO_TOOLCHAIN_HAS_THREADS || \
		LINGMO_STATIC_LIBS
```

## package/aircrack-ng/Config.in
```kconfig
config LINGMO_PACKAGE_AIRCRACK_NG
	bool "aircrack-ng"
	depends on LINGMO_USE_MMU # uses fork()
	depends on LINGMO_TOOLCHAIN_HAS_THREADS
	depends on LINGMO_INSTALL_LIBSTDCPP
	depends on !LINGMO_STATIC_LIBS # dlfcn.h
	select LINGMO_PACKAGE_OPENSSL if !LINGMO_PACKAGE_LIBGCRYPT
	select LINGMO_PACKAGE_LIBOPENSSL_ENABLE_RC4 if LINGMO_PACKAGE_LIBOPENSSL
	help
	  A set of tools for auditing wireless networks

	  For complete functionality, also select ethtool, iw,
	  util-linux (utilities and rfkill), and wireless_tools.

	  http://www.aircrack-ng.org/

comment "aircrack-ng needs a toolchain w/ dynamic library, threads, C++"
	depends on LINGMO_USE_MMU
	depends on LINGMO_STATIC_LIBS || !LINGMO_TOOLCHAIN_HAS_THREADS \
		|| !LINGMO_INSTALL_LIBSTDCPP
```

## package/alfred/Config.in
```kconfig
config LINGMO_PACKAGE_ALFRED
	bool "alfred"
	depends on !LINGMO_STATIC_LIBS # dlopen()
	depends on LINGMO_TOOLCHAIN_HAS_THREADS # libnl
	select LINGMO_PACKAGE_LIBNL
	help
	  Alfred is a user space daemon for distributing arbitrary
	  local information over the mesh/network in a decentralized
	  fashion.

	  This data can be anything which appears to be useful -
	  originally designed to replace the batman-adv visualization
	  (vis), you may distribute hostnames, phone books,
	  administration information, DNS information, the local
	  weather forecast ...

	  https://www.open-mesh.org/projects/alfred/wiki

comment "alfred needs a toolchain w/ dynamic library, threads"
	depends on LINGMO_STATIC_LIBS || !LINGMO_TOOLCHAIN_HAS_THREADS
```

## package/alsa-plugins/Config.in
```kconfig
config LINGMO_PACKAGE_ALSA_PLUGINS
	bool "alsa-plugins"
	depends on LINGMO_PACKAGE_ALSA_LIB
	select LINGMO_PACKAGE_ALSA_LIB_HWDEP
	help
	  Advanced Linux Sound Architecture Plugins

	  http://www.alsa-project.org/
```

## package/alsa-utils/Config.in
```kconfig
comment "alsa-utils needs a toolchain w/ threads"
	depends on LINGMO_USE_MMU # fork
	depends on !LINGMO_TOOLCHAIN_HAS_THREADS

menuconfig LINGMO_PACKAGE_ALSA_UTILS
	bool "alsa-utils"
	depends on LINGMO_USE_MMU # fork
	depends on LINGMO_TOOLCHAIN_HAS_THREADS # alsa-lib
	select LINGMO_PACKAGE_ALSA_LIB
	help
	  This package contains the command line utilities for the ALSA
	  project.

	  http://www.alsa-project.org/

if LINGMO_PACKAGE_ALSA_UTILS

config LINGMO_PACKAGE_ALSA_UTILS_ALSACONF
	bool "alsaconf"

config LINGMO_PACKAGE_ALSA_UTILS_ACONNECT
	bool "aconnect"
	select LINGMO_PACKAGE_ALSA_LIB_SEQ

config LINGMO_PACKAGE_ALSA_UTILS_ALSACTL
	bool "alsactl"
	default y

config LINGMO_PACKAGE_ALSA_UTILS_ALSALOOP
	bool "alsaloop"

config LINGMO_PACKAGE_ALSA_UTILS_ALSAMIXER
	bool "alsamixer"
	default y
	depends on LINGMO_USE_WCHAR
	select LINGMO_PACKAGE_NCURSES
	select LINGMO_PACKAGE_ALSA_LIB_MIXER

comment "alsamixer needs a toolchain w/ wchar"
	depends on !LINGMO_USE_WCHAR

config LINGMO_PACKAGE_ALSA_UTILS_ALSAUCM
	bool "alsaucm"
	select LINGMO_PACKAGE_ALSA_LIB_UCM

config LINGMO_PACKAGE_ALSA_UTILS_ALSATPLG
	bool "alsatplg"
	depends on !LINGMO_STATIC_LIBS # dlfcn.h
	select LINGMO_PACKAGE_ALSA_LIB_TOPOLOGY

comment "alsatplg needs a toolchain w/ dynamic library"
	depends on LINGMO_STATIC_LIBS

config LINGMO_PACKAGE_ALSA_UTILS_AMIDI
	bool "amidi"
	select LINGMO_PACKAGE_ALSA_LIB_RAWMIDI

config LINGMO_PACKAGE_ALSA_UTILS_AMIXER
	bool "amixer"
	select LINGMO_PACKAGE_ALSA_LIB_MIXER

config LINGMO_PACKAGE_ALSA_UTILS_APLAY
	bool "aplay/arecord"
	select LINGMO_PACKAGE_ALSA_LIB_PCM

config LINGMO_PACKAGE_ALSA_UTILS_APLAYMIDI
	bool "aplaymidi"
	select LINGMO_PACKAGE_ALSA_LIB_SEQ

config LINGMO_PACKAGE_ALSA_UTILS_ARECORDMIDI
	bool "arecordmidi"
	select LINGMO_PACKAGE_ALSA_LIB_SEQ

config LINGMO_PACKAGE_ALSA_UTILS_ASEQDUMP
	bool "aseqdump"
	select LINGMO_PACKAGE_ALSA_LIB_SEQ

config LINGMO_PACKAGE_ALSA_UTILS_ASEQNET
	bool "aseqnet"
	select LINGMO_PACKAGE_ALSA_LIB_SEQ

config LINGMO_PACKAGE_ALSA_UTILS_BAT
	bool "bat"
	help
	  ALSABAT (ALSA Basic Audio Tester) is a simple command-line
	  utility intended to help automate audio driver and sound
	  server testing with little human interaction.

	  Note that analysis support in alsabat requires fftw single
	  precision.

config LINGMO_PACKAGE_ALSA_UTILS_IECSET
	bool "iecset"
	select LINGMO_PACKAGE_ALSA_LIB_PCM

config LINGMO_PACKAGE_ALSA_UTILS_SPEAKER_TEST
	bool "speaker-test"
	select LINGMO_PACKAGE_ALSA_LIB_PCM

endif
```

## package/alsamixergui/Config.in
```kconfig
config LINGMO_PACKAGE_ALSAMIXERGUI
	bool "alsamixergui"
	depends on LINGMO_PACKAGE_XORG7
	depends on LINGMO_INSTALL_LIBSTDCPP
	depends on LINGMO_USE_MMU # fltk fork()
	depends on LINGMO_TOOLCHAIN_HAS_THREADS # alsa-lib
	select LINGMO_PACKAGE_FLTK
	select LINGMO_PACKAGE_ALSA_LIB
	select LINGMO_PACKAGE_ALSA_LIB_PCM
	select LINGMO_PACKAGE_ALSA_LIB_MIXER
	help
	  A nice GUI mixer for Alsa using fltk

	  http://www.iua.upf.es/~mdeboer/projects/alsamixergui/

comment "alsamixergui needs a toolchain w/ C++, threads"
	depends on LINGMO_PACKAGE_XORG7 && LINGMO_USE_MMU
	depends on !LINGMO_INSTALL_LIBSTDCPP || !LINGMO_TOOLCHAIN_HAS_THREADS
```

## package/altera-stapl/Config.in
```kconfig
config LINGMO_PACKAGE_ALTERA_STAPL
	bool "altera-stapl"
	depends on LINGMO_TOOLCHAIN_HEADERS_AT_LEAST_4_8 # libgpiod
	select LINGMO_PACKAGE_LIBGPIOD
	help
	  Altera Jam STAPL Bytecode Player.

	  https://github.com/kontron/altera-stapl
```

## package/alure/Config.in
```kconfig
config LINGMO_PACKAGE_ALURE
	bool "alure"
	depends on LINGMO_PACKAGE_OPENAL_ARCH_SUPPORTS
	depends on LINGMO_TOOLCHAIN_GCC_AT_LEAST_4_9 # C++11
	depends on LINGMO_INSTALL_LIBSTDCPP
	depends on LINGMO_TOOLCHAIN_HAS_THREADS_NPTL # openal
	depends on LINGMO_USE_WCHAR # use wchar_t
	depends on !LINGMO_TOOLCHAIN_HAS_GCC_BUG_64735 # std::shared_future
	select LINGMO_PACKAGE_OPENAL
	help
	  Alure is a C++ 3D audio API. It uses OpenAL for audio
	  rendering, and provides common higher-level features such as
	  file loading and decoding, buffer caching, background
	  streaming, and source management for virtually unlimited
	  sound source handles.

	  https://kcat.strangesoft.net/alure.html

if LINGMO_PACKAGE_ALURE

config LINGMO_PACKAGE_ALURE_FLAC_DECODER
	bool "flac decoder"
	help
	  Enables the built-in FLAC decoder.

config LINGMO_PACKAGE_ALURE_MINIMP3_DECODER
	bool "minimp3 decoder"
	help
	  Enables the built-in minimp3 decoder.

config LINGMO_PACKAGE_ALURE_OPUS_DECODER
	bool "opus decoder"
	select LINGMO_PACKAGE_LIBOGG
	select LINGMO_PACKAGE_OPUS
	help
	  Enables the built-in libopusfile decoder.

config LINGMO_PACKAGE_ALURE_SNDFILE_DECODER
	bool "sndfile decoder"
	select LINGMO_PACKAGE_LIBSNDFILE
	help
	  Enables the built-in libsndfile decoder.

config LINGMO_PACKAGE_ALURE_VORBIS_DECODER
	bool "vorbis decoder"
	select LINGMO_PACKAGE_LIBOGG
	select LINGMO_PACKAGE_LIBVORBIS
	help
	  Enables the built-in libvorbis decoder.

endif

comment "alure needs a toolchain w/ C++, gcc >= 4.9, NPTL, wchar"
	depends on LINGMO_PACKAGE_OPENAL_ARCH_SUPPORTS
	depends on !LINGMO_INSTALL_LIBSTDCPP \
		|| !LINGMO_TOOLCHAIN_GCC_AT_LEAST_4_9 \
		|| !LINGMO_TOOLCHAIN_HAS_THREADS_NPTL || !LINGMO_USE_WCHAR

comment "alure needs a toolchain not affected by GCC bug 64735"
	depends on LINGMO_PACKAGE_OPENAL_ARCH_SUPPORTS
	depends on LINGMO_TOOLCHAIN_HAS_GCC_BUG_64735
```

## package/am33x-cm3/Config.in
```kconfig
config LINGMO_PACKAGE_AM33X_CM3
	bool "am33x-cm3"
	depends on LINGMO_arm # only relevant for TI am335x
	depends on LINGMO_BINFMT_ELF # assumes the compiler builds ELF file
	help
	  Cortex-M3 binary blob for suspend-resume on am335x

	  http://arago-project.org/git/projects/am33x-cm3.git
```

## package/amlogic-boot-fip/Config.in.host
```kconfig
config LINGMO_PACKAGE_HOST_AMLOGIC_BOOT_FIP
	bool "host amlogic-boot-fip"
	depends on LINGMO_HOSTARCH = "x86_64"
	help
	  Firmware Image Package (FIP) sources used to sign Amlogic
	  u-boot binaries in LibreELEC images

	  https://github.com/LibreELEC/amlogic-boot-fip

config LINGMO_PACKAGE_HOST_AMLOGIC_BOOT_FIP_DEVICE
	string "fip device"
	default "khadas-vim3"
	depends on LINGMO_PACKAGE_HOST_AMLOGIC_BOOT_FIP
	help
	  Device for which you want to use this package.
	  See the list of supported SoCs:
	  https://github.com/LibreELEC/amlogic-boot-fip
```
