## fs/tar/Config.in
```kconfig
config LINGMO_TARGET_ROOTFS_TAR
	bool "tar the root filesystem"
	default y
	help
	  Build a tar archive of the root filesystem

choice
	prompt "Compression method"
	default LINGMO_TARGET_ROOTFS_TAR_NONE
	depends on LINGMO_TARGET_ROOTFS_TAR
	help
	  Select compressor for tar archive of the root filesystem

config LINGMO_TARGET_ROOTFS_TAR_NONE
	bool "no compression"
	help
	  Do not compress the tarball.

config LINGMO_TARGET_ROOTFS_TAR_GZIP
	bool "gzip"
	help
	  Do compress the tarball with gzip.

config LINGMO_TARGET_ROOTFS_TAR_BZIP2
	bool "bzip2"
	help
	  Do compress the tarball with bzip2.

config LINGMO_TARGET_ROOTFS_TAR_LZ4
	bool "lz4"
	help
	  Do compress the tarball with lz4.

config LINGMO_TARGET_ROOTFS_TAR_LZMA
	bool "lzma"
	help
	  Do compress the tarball with lzma.

config LINGMO_TARGET_ROOTFS_TAR_LZO
	bool "lzo"
	help
	  Do compress the tarball with lzop.

config LINGMO_TARGET_ROOTFS_TAR_XZ
	bool "xz"
	help
	  Do compress the tarball with xz.

config LINGMO_TARGET_ROOTFS_TAR_ZSTD
	bool "zstd"
	help
	  Do compress the tarball with zstd.

endchoice

config LINGMO_TARGET_ROOTFS_TAR_OPTIONS
	string "other random options to pass to tar"
	default ""
	depends on LINGMO_TARGET_ROOTFS_TAR
	help
	  Any other flags you want to pass to tar
	  Refer to tar --help for details
```

## fs/ubifs/Config.in
```kconfig
config LINGMO_TARGET_ROOTFS_UBIFS
	bool "ubifs root filesystem"
	help
	  Build a ubifs root filesystem

if LINGMO_TARGET_ROOTFS_UBIFS

config LINGMO_TARGET_ROOTFS_UBIFS_LEBSIZE
	hex "logical eraseblock size"
	default 0x1f800
	help
	  Logical eraseblock (LEB) size. The value provided here is
	  passed to the -e/--leb-size option of mkfs.ubifs.

config LINGMO_TARGET_ROOTFS_UBIFS_MINIOSIZE
	hex "minimum I/O unit size"
	default 0x800
	help
	  Minimum I/O unit size. The value provided here is passed
	  to the -m/--min-io-size option of mkfs.ubifs/ubinize.

config LINGMO_TARGET_ROOTFS_UBIFS_MAXLEBCNT
	int "maximum logical eraseblock count"
	default 2048
	help
	  Maximum logical eraseblock (LEB) count. The value provided
	  here is passed to the -c/--max-leb-cnt option of mkfs.ubifs.

choice
	prompt "ubifs runtime compression"
	default LINGMO_TARGET_ROOTFS_UBIFS_RT_LZO
	help
	  Select which compression format to use at run-time within
	  the ubifs file system. The choice made here is passed to
	  the -x/--compr option of mkfs.ubifs

config LINGMO_TARGET_ROOTFS_UBIFS_RT_NONE
	bool "no compression"
	help
	  Don't use run-time compression.

config LINGMO_TARGET_ROOTFS_UBIFS_RT_ZLIB
	bool "gzip"
	help
	  Use zlib compression at run-time.

config LINGMO_TARGET_ROOTFS_UBIFS_RT_LZO
	bool "lzo"
	help
	  Use lzo compression at run-time.

endchoice

choice
	prompt "Compression method"
	default LINGMO_TARGET_ROOTFS_UBIFS_NONE
	help
	  Select which compression format to compress the final image
	  into.

config LINGMO_TARGET_ROOTFS_UBIFS_NONE
	bool "no compression"
	help
	  Do not compress the ubifs filesystem.

config LINGMO_TARGET_ROOTFS_UBIFS_GZIP
	bool "gzip"
	help
	  Do compress the ubifs filesystem with gzip.

config LINGMO_TARGET_ROOTFS_UBIFS_BZIP2
	bool "bzip2"
	help
	  Do compress the ubifs filesystem with bzip2.

config LINGMO_TARGET_ROOTFS_UBIFS_LZMA
	bool "lzma"
	help
	  Do compress the ubifs filesystem with lzma.

config LINGMO_TARGET_ROOTFS_UBIFS_LZO
	bool "lzo"
	help
	  Do compress the ubifs filesystem with lzop.

config LINGMO_TARGET_ROOTFS_UBIFS_XZ
	bool "xz"
	help
	  Do compress the ubifs filesystem with xz.

endchoice

config LINGMO_TARGET_ROOTFS_UBIFS_OPTS
	string "Additional mkfs.ubifs options"
	help
	  Any additional mkfs.ubifs options you may want to include.

endif # LINGMO_TARGET_ROOTFS_UBIFS
```

## fs/yaffs2/Config.in
```kconfig
config LINGMO_TARGET_ROOTFS_YAFFS2
	bool "yaffs2 root filesystem"
	help
	  Build a yaffs2 root filesystem
```
