## boot/grub2/Config.in
```kconfig
config LINGMO_TARGET_GRUB2_ARCH_SUPPORTS
	bool
	default y if LINGMO_i386
	default y if LINGMO_x86_64
	default y if LINGMO_arm
	default y if LINGMO_aarch64
	default y if LINGMO_RISCV_64
	depends on LINGMO_USE_MMU

config LINGMO_TARGET_GRUB2
	bool "grub2"
	depends on LINGMO_TARGET_GRUB2_ARCH_SUPPORTS
	depends on LINGMO_USE_WCHAR
	select LINGMO_TARGET_GRUB2_I386_PC if \
		!LINGMO_TARGET_GRUB2_HAS_PTF && \
		(LINGMO_i386 || LINGMO_x86_64)
	select LINGMO_TARGET_GRUB2_ARM_UBOOT if \
		!LINGMO_TARGET_GRUB2_HAS_PTF && \
		LINGMO_arm
	select LINGMO_TARGET_GRUB2_ARM64_EFI if LINGMO_aarch64
	help
	  GNU GRUB is a Multiboot boot loader. It was derived from
	  GRUB, the GRand Unified Bootloader, which was originally
	  designed and implemented by Erich Stefan Boleyn. GRUB 2 has
	  replaced what was formerly known as GRUB (i.e. version
	  0.9x), which has, in turn, become GRUB Legacy.

	  Amongst others, GRUB2 offers EFI support, which GRUB Legacy
	  doesn't provide.

	  The file boot/grub2/grub.cfg is used by default as the Grub
	  configuration file. It can be overridden using a rootfs
	  overlay or post-build script.

	  For additional notes on using Grub 2 with Buildroot, see
	  boot/grub2/readme.txt

	  http://www.gnu.org/software/grub/

if LINGMO_TARGET_GRUB2

config LINGMO_TARGET_GRUB2_HAS_LEGACY_BOOT
	bool

config LINGMO_TARGET_GRUB2_HAS_EFI_BOOT
	bool

config LINGMO_TARGET_GRUB2_HAS_PTF
	bool

config LINGMO_TARGET_GRUB2_I386_PC
	bool "i386-pc"
	depends on LINGMO_i386 || LINGMO_x86_64
	select LINGMO_TARGET_GRUB2_HAS_LEGACY_BOOT
	help
	  Select this option if the platform you're targetting is a
	  x86 or x86-64 legacy BIOS based platform.

config LINGMO_TARGET_GRUB2_I386_EFI
	bool "i386-efi"
	depends on LINGMO_i386 || LINGMO_x86_64
	select LINGMO_TARGET_GRUB2_HAS_PTF
	select LINGMO_TARGET_GRUB2_HAS_EFI_BOOT
	help
	  Select this option if the platform you're targetting has a
	  32 bits EFI BIOS. Note that some x86-64 platforms use a 32
	  bits EFI BIOS, and this option should be used in this case.

config LINGMO_TARGET_GRUB2_X86_64_EFI
	bool "x86-64-efi"
	depends on LINGMO_x86_64
	select LINGMO_TARGET_GRUB2_HAS_PTF
	select LINGMO_TARGET_GRUB2_HAS_EFI_BOOT
	help
	  Select this option if the platform you're targetting has a
	  64 bits EFI BIOS.

config LINGMO_TARGET_GRUB2_ARM_UBOOT
	bool "arm-uboot"
	depends on LINGMO_arm
	select LINGMO_TARGET_GRUB2_HAS_LEGACY_BOOT
	help
	  Select this option if the platform you're targetting is an
	  ARM u-boot platform, and you want to boot Grub 2 as an u-boot
	  compatible image.

config LINGMO_TARGET_GRUB2_ARM_EFI
	bool "arm-efi"
	depends on LINGMO_arm
	select LINGMO_TARGET_GRUB2_HAS_PTF
	select LINGMO_TARGET_GRUB2_HAS_EFI_BOOT
	help
	  Select this option if the platform you're targetting is an
	  ARM platform and you want to boot Grub 2 as an EFI
	  application.

config LINGMO_TARGET_GRUB2_ARM64_EFI
	bool "arm64-efi"
	depends on LINGMO_aarch64
	select LINGMO_TARGET_GRUB2_HAS_EFI_BOOT
	help
	  Select this option if the platform you're targetting is an
	  Aarch64 platform and you want to boot Grub 2 as an EFI
	  application.

config LINGMO_TARGET_GRUB2_RISCV64_EFI
	bool "riscv64-efi"
	depends on LINGMO_RISCV_64
	select LINGMO_TARGET_GRUB2_HAS_EFI_BOOT
	help
	  Select this option if the platform you're targetting is a
	  64bit RISC-V platform and you want to boot Grub 2 as an EFI
	  application.

if LINGMO_TARGET_GRUB2_HAS_LEGACY_BOOT

comment "Options for the x86 legacy BIOS or ARM U-Boot support"

config LINGMO_TARGET_GRUB2_BOOT_PARTITION
	string "boot partition"
	default "hd0,msdos1"
	help
	  Specify the partition where the /boot/grub/grub.cfg file is
	  located. Use 'hd0,msdos1' for the first partition of the
	  first disk if using a legacy partition table, or 'hd0,gpt1'
	  if using GPT partition table.

config LINGMO_TARGET_GRUB2_BUILTIN_MODULES_PC
	string "builtin modules"
	default LINGMO_TARGET_GRUB2_BUILTIN_MODULES if LINGMO_TARGET_GRUB2_BUILTIN_MODULES != "" # legacy
	default "boot linux ext2 fat squash4 part_msdos part_gpt normal biosdisk" if LINGMO_TARGET_GRUB2_I386_PC
	default "linux ext2 fat part_msdos normal" if LINGMO_TARGET_GRUB2_ARM_UBOOT

config LINGMO_TARGET_GRUB2_BUILTIN_CONFIG_PC
	string "builtin config"
	default LINGMO_TARGET_GRUB2_BUILTIN_CONFIG if LINGMO_TARGET_GRUB2_BUILTIN_CONFIG != "" # legacy
	help
	  Path to a Grub 2 configuration file that will be embedded
	  into the Grub image itself. This allows to set the root
	  device and other configuration parameters, but however menu
	  entries cannot be described in this embedded configuration.

endif # LINGMO_TARGET_GRUB2_HAS_LEGACY_BOOT

if LINGMO_TARGET_GRUB2_HAS_EFI_BOOT

comment "Options for the EFI BIOS or ARM EFI support"

config LINGMO_TARGET_GRUB2_BUILTIN_MODULES_EFI
	string "builtin modules"
	default LINGMO_TARGET_GRUB2_BUILTIN_MODULES if LINGMO_TARGET_GRUB2_BUILTIN_MODULES != "" # legacy
	default "boot linux ext2 fat squash4 part_msdos part_gpt normal efi_gop"

config LINGMO_TARGET_GRUB2_BUILTIN_CONFIG_EFI
	string "builtin config"
	default LINGMO_TARGET_GRUB2_BUILTIN_CONFIG if LINGMO_TARGET_GRUB2_BUILTIN_CONFIG != "" # legacy
	help
	  Path to a Grub 2 configuration file that will be embedded
	  into the Grub image itself. This allows to set the root
	  device and other configuration parameters, but however menu
	  entries cannot be described in this embedded configuration.

endif # LINGMO_TARGET_GRUB2_HAS_EFI_BOOT

config LINGMO_TARGET_GRUB2_INSTALL_TOOLS
	bool "install tools"
	help
	  Install support tools to interact with GNU GRUB Multiboot
	  boot loader.

	  This will also install the Grub 2 loadable modules to the
	  target.

endif # LINGMO_TARGET_GRUB2

comment "grub2 needs a toolchain w/ wchar"
	depends on LINGMO_TARGET_GRUB2_ARCH_SUPPORTS
	depends on !LINGMO_USE_WCHAR
```

## boot/mxs-bootlets/Config.in
```kconfig
config LINGMO_TARGET_MXS_BOOTLETS
	bool "mxs-bootlets"
	depends on LINGMO_arm
	depends on LINGMO_TARGET_BAREBOX || LINGMO_LINUX_KERNEL || \
		LINGMO_TARGET_UBOOT
	help
	  Stage1 bootloaders for Freescale iMX23/iMX28 SoCs

if LINGMO_TARGET_MXS_BOOTLETS

choice
	prompt "Source"
	default LINGMO_TARGET_MXS_BOOTLETS_FREESCALE
	help
	  Select the location of the bootlets you want to use

config LINGMO_TARGET_MXS_BOOTLETS_FREESCALE
	bool "Freescale 10.12.01 version"

config LINGMO_TARGET_MXS_BOOTLETS_CUSTOM_TARBALL
	bool "Custom tarball"

config LINGMO_TARGET_MXS_BOOTLETS_CUSTOM_GIT
	bool "Custom Git repository"

endchoice

config LINGMO_TARGET_MXS_BOOTLETS_CUSTOM_TARBALL_URL
	string "URL of custom bootlets tarball"
	depends on LINGMO_TARGET_MXS_BOOTLETS_CUSTOM_TARBALL

if LINGMO_TARGET_MXS_BOOTLETS_CUSTOM_GIT

config LINGMO_TARGET_MXS_BOOTLETS_CUSTOM_GIT_URL
	string "URL of custom Git repository"

config LINGMO_TARGET_MXS_BOOTLETS_CUSTOM_GIT_VERSION
	string "Custom Git version"

endif

choice
	prompt "Bootstream"
	help
	  Select which bootstream to generate

config LINGMO_TARGET_MXS_BOOTLETS_BAREBOX
	bool "Barebox Bootloader"
	depends on LINGMO_TARGET_BAREBOX

config LINGMO_TARGET_MXS_BOOTLETS_LINUX
	bool "Linux Kernel"
	depends on LINGMO_LINUX_KERNEL

config LINGMO_TARGET_MXS_BOOTLETS_UBOOT
	bool "U-boot bootloader"
	depends on LINGMO_TARGET_UBOOT

endchoice

config LINGMO_TARGET_MXS_BOOTLETS_HAS_IVT
	bool "HAB Support"
	help
	  Enable this option if you are building bootlets
	  for the iMX28 platform that needs to include instructions
	  for the secure boot mechanism present on these SoCs

choice
	prompt "Board"
	help
	  Select the board to build the bootlets for

config LINGMO_TARGET_MXS_BOOTLETS_STMP37xx
	bool "Sigmatel ST-MP3-7xx Board"

config LINGMO_TARGET_MXS_BOOTLETS_STMP378x
	bool "Sigmatel ST-MP3-78x Board"

config LINGMO_TARGET_MXS_BOOTLETS_IMX28EVK
	bool "Freescale iMX28 EVK Board"

config LINGMO_TARGET_MXS_BOOTLETS_CUSTOM_BOARD
	bool "Custom board"
endchoice

config LINGMO_TARGET_MXS_BOOTLETS_CUSTOM_BOARD_NAME
	string "Custom board name"
	depends on LINGMO_TARGET_MXS_BOOTLETS_CUSTOM_BOARD
	help
	  Name of the board to build the bootlets for

endif
```

## boot/optee-os/Config.in
```kconfig
config LINGMO_TARGET_OPTEE_OS
	bool "optee_os"
	depends on LINGMO_ARM_CPU_ARMV8A || LINGMO_ARM_CPU_ARMV7A
	help
	  OP-TEE OS provides the secure world boot image and the trust
	  application development kit of the OP-TEE project. OP-TEE OS
	  also provides generic trusted application one can embedded
	  into its system.

	  http://github.com/OP-TEE/optee_os

if LINGMO_TARGET_OPTEE_OS

choice
	prompt "OP-TEE OS version"
	default LINGMO_TARGET_OPTEE_OS_LATEST if LINGMO_PACKAGE_HOST_RUSTC_ARCH_SUPPORTS
	help
	  Select the version of OP-TEE OS you want to use

config LINGMO_TARGET_OPTEE_OS_LATEST
	bool "4.0.0"
	depends on LINGMO_PACKAGE_HOST_RUSTC_ARCH_SUPPORTS
	select LINGMO_TARGET_OPTEE_OS_NEEDS_PYTHON_CRYPTOGRAPHY
	help
	  Use the latest release tag from the OP-TEE OS official Git
	  repository.

config LINGMO_TARGET_OPTEE_OS_CUSTOM_TARBALL
	bool "Custom tarball"
	help
	  This option allows to specify a URL pointing to an OP-TEE OS
	  source tarball. This URL can use any protocol recognized by
	  Buildroot, like http://, ftp://, file:// or scp://.

	  When pointing to a local tarball using file://, you may want
	  to use a make variable like $(TOPDIR) to reference the root of
	  the Buildroot tree.

config LINGMO_TARGET_OPTEE_OS_CUSTOM_GIT
	bool "Custom Git repository"
	help
	  Use a custom version fetched from a Git repository.

endchoice

if LINGMO_TARGET_OPTEE_OS_CUSTOM_TARBALL

config LINGMO_TARGET_OPTEE_OS_CUSTOM_TARBALL_LOCATION
	string "URL of custom OP-TEE OS tarball"

endif

if LINGMO_TARGET_OPTEE_OS_CUSTOM_GIT

config LINGMO_TARGET_OPTEE_OS_CUSTOM_REPO_URL
	string "URL of custom repository"
	depends on LINGMO_TARGET_OPTEE_OS_CUSTOM_GIT
	help
	  Specific location of the reference source tree Git
	  repository.

config LINGMO_TARGET_OPTEE_OS_CUSTOM_REPO_VERSION
	string "Custom repository version"
	depends on LINGMO_TARGET_OPTEE_OS_CUSTOM_GIT
	help
	  Revision to use in the typical format used by Git, i.e a
	  SHA1 or a tag.

endif

config LINGMO_TARGET_OPTEE_OS_VERSION
	string
	default "4.0.0"		if LINGMO_TARGET_OPTEE_OS_LATEST
	default "custom"	if LINGMO_TARGET_OPTEE_OS_CUSTOM_TARBALL
	default LINGMO_TARGET_OPTEE_OS_CUSTOM_REPO_VERSION \
				if LINGMO_TARGET_OPTEE_OS_CUSTOM_GIT

config LINGMO_TARGET_OPTEE_OS_NEEDS_DTC
	bool "OP-TEE OS needs dtc"
	select LINGMO_PACKAGE_HOST_DTC
	help
	  Select this option if your OP-TEE OS platform configuration
	  requires the Device Tree compiler to be available.

config LINGMO_TARGET_OPTEE_OS_NEEDS_PYTHON_CRYPTOGRAPHY
	bool "OP-TEE OS needs host-python-cryptography"
	depends on LINGMO_PACKAGE_HOST_RUSTC_ARCH_SUPPORTS
	help
	  OP-TEE OS version below 3.16 used python-pycryptodomex
	  package in python scripts. Newer version uses
	  python-cryptography. Select this option if optee-os needs
	  python-cryptography to be built.

config LINGMO_TARGET_OPTEE_OS_CORE
	bool "Build core"
	default y
	help
	  This option will build and install the OP-TEE core
	  boot images.

config LINGMO_TARGET_OPTEE_OS_SDK
	bool "Build TA devkit"
	default y
	help
	  This option will build and install the OP-TEE development
	  kit for building OP-TEE trusted application images. It is
	  installed in the staging directory /lib/optee.

config LINGMO_TARGET_OPTEE_OS_SERVICES
	bool "Build service TAs and libs"
	default y
	select LINGMO_TARGET_OPTEE_OS_CORE
	help
	  This option installs the service trusted applications and
	  trusted shared libraries built from OP-TEE OS source tree.
	  These are installed in target /lib/optee_armtz directory
	  as other trusted applications. At runtime OP-TEE OS can
	  load these from this non-secure filesystem/directory into
	  the secure world for execution.

config LINGMO_TARGET_OPTEE_OS_PLATFORM
	string "Target platform (mandatory)"
	help
	  Value for the mandated PLATFORM build directive provided to
	  OP-TEE OS.

config LINGMO_TARGET_OPTEE_OS_PLATFORM_FLAVOR
	string "Target platform flavor (optional)"
	help
	  Value for the optional PLATFORM_FLAVOR build directive
	  provided to OP-TEE OS.

config LINGMO_TARGET_OPTEE_OS_CUSTOM_DTS_PATH
	string "Device Tree Source file paths"
	help
	  Space-separated list of paths to device tree source files
	  that will be copied to core/arch/arm/dts/ before starting
	  the build.

	  To use this device tree source file, the OP-TEE OS
	  configuration must refer to it with the
	  CFG_EMBED_DTB_SOURCE_FILE option and no platform flavor
	  needs to be specified.

config LINGMO_TARGET_OPTEE_OS_ADDITIONAL_VARIABLES
	string "Additional build variables"
	help
	  Additional parameters for the OP-TEE OS build
	  E.g. 'CFG_TEE_CORE_LOG_LEVEL=3 CFG_UNWIND=y'

config LINGMO_TARGET_OPTEE_OS_CORE_IMAGES
	string "Binary boot images"
	default "tee.bin tee-*_v2.bin"
	help
	  Names of generated image files that are installed in the
	  output images/ directory.

endif # LINGMO_TARGET_OPTEE_OS
```

## boot/shim/Config.in
```kconfig
config LINGMO_PACKAGE_SHIM_ARCH_SUPPORTS
	bool
	default y if LINGMO_aarch64
	default y if LINGMO_arm
	default y if LINGMO_i386
	default y if LINGMO_x86_64
	# it includes gnu-efi
	depends on LINGMO_PACKAGE_GNU_EFI_ARCH_SUPPORTS

config LINGMO_TARGET_SHIM
	bool "shim"
	depends on LINGMO_PACKAGE_SHIM_ARCH_SUPPORTS
	help
	  Boot loader to chain-load signed boot loaders under Secure
	  Boot.

	  This package provides a minimalist boot loader which allows
	  verifying signatures of other UEFI binaries against either
	  the Secure Boot DB/DBX or against a built-in signature
	  database.  Its purpose is to allow a small,
	  infrequently-changing binary to be signed by the UEFI CA,
	  while allowing an OS distributor to revision their main
	  bootloader independently of the CA.

	  https://github.com/rhboot/shim
```

## boot/syslinux/Config.in
```kconfig
config LINGMO_TARGET_SYSLINUX
	bool "syslinux"
	depends on LINGMO_i386 || LINGMO_x86_64
	# Make sure at least one of the flavors is installed
	select LINGMO_TARGET_SYSLINUX_ISOLINUX \
		if !LINGMO_TARGET_SYSLINUX_PXELINUX && \
		   !LINGMO_TARGET_SYSLINUX_MBR && \
		   !LINGMO_TARGET_SYSLINUX_EFI
	select LINGMO_PACKAGE_UTIL_LINUX
	select LINGMO_PACKAGE_UTIL_LINUX_LIBUUID
	help
	  The syslinux bootloader for x86 systems.
	  This includes: syslinux, pxelinux, extlinux.

	  http://syslinux.org

if LINGMO_TARGET_SYSLINUX

config LINGMO_TARGET_SYSLINUX_LEGACY_BIOS
	bool

config LINGMO_TARGET_SYSLINUX_ISOLINUX
	bool "install isolinux"
	select LINGMO_TARGET_SYSLINUX_LEGACY_BIOS
	help
	  Install the legacy-BIOS 'isolinux' image, to boot off
	  optical media (CDROM, DVD.)

config LINGMO_TARGET_SYSLINUX_PXELINUX
	bool "install pxelinux"
	select LINGMO_TARGET_SYSLINUX_LEGACY_BIOS
	help
	  Install the legacy-BIOS 'pxelinux' image, to boot off
	  the network using PXE.

config LINGMO_TARGET_SYSLINUX_MBR
	bool "install mbr"
	select LINGMO_TARGET_SYSLINUX_LEGACY_BIOS
	help
	  Install the legacy-BIOS 'mbr' image, to boot off a
	  local MBR-partition (e.g. prepared with 'extlinux'
	  or 'syslinux').

config LINGMO_TARGET_SYSLINUX_EFI
	bool "install efi"
	depends on LINGMO_PACKAGE_GNU_EFI_ARCH_SUPPORTS
	select LINGMO_PACKAGE_GNU_EFI
	help
	  Install the 'efi' image, to boot from an EFI environment.

if LINGMO_TARGET_SYSLINUX_LEGACY_BIOS

config LINGMO_TARGET_SYSLINUX_C32
	string "modules to install"
	help
	  Enter a space-separated list of .c32 modules to install.
	  Leave empty to install no module.

endif # LINGMO_TARGET_SYSLINUX_LEGACY_BIOS

endif # LINGMO_TARGET_SYSLINUX
```
