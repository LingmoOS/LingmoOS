## boot/at91bootstrap3/Config.in
```kconfig
config LINGMO_TARGET_AT91BOOTSTRAP3
	bool "AT91 Bootstrap 3+"
	depends on LINGMO_arm926t || LINGMO_cortex_a5 || LINGMO_cortex_a7
	help
	  AT91Bootstrap is a first level bootloader for the Atmel AT91
	  devices. It integrates algorithms for:
	  - Device initialization such as clock configuration, PIO
	    settings...
	  - Peripheral drivers such as PIO, PMC or SDRAMC...
	  - Physical media algorithm such as DataFlash, NandFlash, NOR
	    Flash...

	  https://www.at91.com/linux4sam/bin/view/Linux4SAM/AT91Bootstrap

if LINGMO_TARGET_AT91BOOTSTRAP3

choice

	prompt "AT91 Bootstrap 3+ version"

config LINGMO_TARGET_AT91BOOTSTRAP3_LATEST_VERSION
	bool "4.0.0"

config LINGMO_TARGET_AT91BOOTSTRAP3_LATEST_VERSION_3X
	bool "3.10.3"

config LINGMO_TARGET_AT91BOOTSTRAP3_CUSTOM_GIT
	bool "Custom Git repository"
	help
	  This option allows Buildroot to get the AT91 Bootstrap 3
	  source code from a Git repository.

config LINGMO_TARGET_AT91BOOTSTRAP3_CUSTOM_SVN
	bool "Custom SVN repository"
	help
	  This option allows Buildroot to get the AT91 Bootstrap 3
	  source code from a Subversion repository

config LINGMO_TARGET_AT91BOOTSTRAP3_CUSTOM_TARBALL
	bool "Custom tarball"

endchoice

config LINGMO_TARGET_AT91BOOTSTRAP3_CUSTOM_TARBALL_LOCATION
	string "URL of custom AT91Bootstrap tarball"
	depends on LINGMO_TARGET_AT91BOOTSTRAP3_CUSTOM_TARBALL

if LINGMO_TARGET_AT91BOOTSTRAP3_CUSTOM_GIT || LINGMO_TARGET_AT91BOOTSTRAP3_CUSTOM_SVN

config LINGMO_TARGET_AT91BOOTSTRAP3_CUSTOM_REPO_URL
	string "URL of custom repository"

config LINGMO_TARGET_AT91BOOTSTRAP3_CUSTOM_REPO_VERSION
	string "Custom repository version"
	help
	  Revision to use in the typical format used by Git or SVN
	  E.G. a sha id, a tag, branch, ..

endif

config LINGMO_TARGET_AT91BOOTSTRAP3_VERSION
	string
	default "v4.0.0" if LINGMO_TARGET_AT91BOOTSTRAP3_LATEST_VERSION
	default "v3.10.3" if LINGMO_TARGET_AT91BOOTSTRAP3_LATEST_VERSION_3X
	default LINGMO_TARGET_AT91BOOTSTRAP3_CUSTOM_REPO_VERSION \
		if LINGMO_TARGET_AT91BOOTSTRAP3_CUSTOM_GIT || LINGMO_TARGET_AT91BOOTSTRAP3_CUSTOM_SVN
	default "custom"	if LINGMO_TARGET_AT91BOOTSTRAP3_CUSTOM_TARBALL

config LINGMO_TARGET_AT91BOOTSTRAP3_CUSTOM_PATCH_DIR
	string "custom patch dir"
	help
	  If your board requires custom patches, add the path to the
	  directory containing the patches here. The patches must be
	  named at91bootstrap3-<something>.patch.

	  Most users may leave this empty

#
# Configuration selection
#

choice
	prompt "AT91 Bootstrap 3 configuration"
	default LINGMO_TARGET_AT91BOOTSTRAP3_USE_DEFCONFIG

config LINGMO_TARGET_AT91BOOTSTRAP3_USE_DEFCONFIG
	bool "Using a defconfig"

config LINGMO_TARGET_AT91BOOTSTRAP3_USE_CUSTOM_CONFIG
	bool "Using a custom config file"

endchoice

config LINGMO_TARGET_AT91BOOTSTRAP3_DEFCONFIG
	string "Defconfig name"
	depends on LINGMO_TARGET_AT91BOOTSTRAP3_USE_DEFCONFIG
	help
	  Name of the at91bootstrap3 defconfig file to use, without the
	  trailing _defconfig.  The defconfig is located at
	  board/<processor>/<board>_defconfig in the at91bootstrap3
	  tree.

config LINGMO_TARGET_AT91BOOTSTRAP3_CUSTOM_CONFIG_FILE
	string "Configuration file path"
	depends on LINGMO_TARGET_AT91BOOTSTRAP3_USE_CUSTOM_CONFIG
	help
	  Path to the at91bootstrap3 configuration file

config LINGMO_TARGET_AT91BOOTSTRAP3_NEEDS_PYTHON3
	bool "needs host-python3"
	help
	  Enable this option if the at91bootstrap build process needs
	  Python 3.x to be available on the host. This is needed in
	  some at91bootstrap configurations to use NAND/PMECC Python
	  scripts.

endif # LINGMO_TARGET_AT91BOOTSTRAP3
```

## boot/at91dataflashboot/Config.in
```kconfig
config LINGMO_TARGET_AT91DATAFLASHBOOT
	bool "AT91 DataFlashBoot"
	depends on LINGMO_arm && LINGMO_arm926t
```

## boot/barebox/Config.in
```kconfig
config LINGMO_TARGET_BAREBOX
	bool "Barebox"
	help
	  The Barebox bootloader, formerly known as U-Boot v2.

	  http://www.barebox.org

if LINGMO_TARGET_BAREBOX
choice
	prompt "version"
	help
	  Select the specific Barebox version you want to use

config LINGMO_TARGET_BAREBOX_LATEST_VERSION
	bool "2022.12.0"

config LINGMO_TARGET_BAREBOX_CUSTOM_VERSION
	bool "Custom version"
	help
	  This option allows to use a specific official versions

config LINGMO_TARGET_BAREBOX_CUSTOM_TARBALL
	bool "Custom tarball"

config LINGMO_TARGET_BAREBOX_CUSTOM_GIT
	bool "Custom Git repository"

endchoice

config LINGMO_TARGET_BAREBOX_CUSTOM_VERSION_VALUE
	string "Barebox version"
	depends on LINGMO_TARGET_BAREBOX_CUSTOM_VERSION

if LINGMO_TARGET_BAREBOX_CUSTOM_TARBALL

config LINGMO_TARGET_BAREBOX_CUSTOM_TARBALL_LOCATION
	string "URL of custom Barebox tarball"

endif

config LINGMO_TARGET_BAREBOX_VERSION
	string
	default "2022.12.0"	if LINGMO_TARGET_BAREBOX_LATEST_VERSION
	default LINGMO_TARGET_BAREBOX_CUSTOM_VERSION_VALUE if LINGMO_TARGET_BAREBOX_CUSTOM_VERSION
	default "custom"	if LINGMO_TARGET_BAREBOX_CUSTOM_TARBALL
	default LINGMO_TARGET_BAREBOX_CUSTOM_GIT_VERSION if LINGMO_TARGET_BAREBOX_CUSTOM_GIT

config LINGMO_TARGET_BAREBOX_CUSTOM_PATCH_DIR
	string "custom patch dir"
	help
	  If your board requires custom patches, add the path to the
	  directory containing the patches here. The patches must be
	  named barebox-<version>-<something>.patch.

	  Most users may leave this empty

config LINGMO_TARGET_BAREBOX_NEEDS_OPENSSL
	bool "Barebox needs OpenSSL"
	help
	  Select this option if your Barebox board configuration
	  requires OpenSSL to be available on the host.

config LINGMO_TARGET_BAREBOX_NEEDS_LIBUSB
	bool "Barebox needs LibUSB"
	help
	  Select this option if your Barebox board configuration
	  requires libUSB to be available on the host.

if LINGMO_TARGET_BAREBOX_CUSTOM_GIT

config LINGMO_TARGET_BAREBOX_CUSTOM_GIT_REPO_URL
	string "URL of custom Git repository"

config LINGMO_TARGET_BAREBOX_CUSTOM_GIT_VERSION
	string "Custom Git version"

endif

source "boot/barebox/barebox/Config.in"

menuconfig LINGMO_TARGET_BAREBOX_AUX
	bool "Build barebox with an auxiliary config"
	help
	  Build barebox with an auxiliary configuration.

	  Useful for building an SPL (Secondary Program Loader) in
	  addition to the traditional TPL (Tertiary Program Loader),
	  such as the X-Loader or MLO for Texas Instruments
	  processors.

if LINGMO_TARGET_BAREBOX_AUX

source "boot/barebox/barebox-aux/Config.in"

endif

endif
```

## boot/beaglev-ddrinit/Config.in
```kconfig
config LINGMO_TARGET_BEAGLEV_DDRINIT
	bool "beaglev-ddrinit"
	depends on LINGMO_riscv
	depends on LINGMO_HOSTARCH = "x86_64" # host-riscv64-elf-toolchain
	help
	  This package builds the DDRinit firmware used on the BeagleV
	  platform.

	  https://github.com/starfive-tech/beagle_ddrinit
```

## boot/beaglev-secondboot/Config.in
```kconfig
config LINGMO_TARGET_BEAGLEV_SECONDBOOT
	bool "beaglev-secondboot"
	depends on LINGMO_riscv
	depends on LINGMO_HOSTARCH = "x86_64" # host-riscv64-elf-toolchain
	help
	  This package builds the SecondBoot firmware used on the
	  BeagleV platform.

	  https://github.com/starfive-tech/beagle_secondBoot
```

## boot/edk2/Config.in
```kconfig
config LINGMO_TARGET_EDK2_ARCH_SUPPORTS
	bool
	default y if LINGMO_aarch64
	default y if LINGMO_i386
	default y if LINGMO_RISCV_64
	default y if LINGMO_x86_64

config LINGMO_TARGET_EDK2
	bool "EDK2"
	depends on LINGMO_TARGET_EDK2_ARCH_SUPPORTS
	depends on LINGMO_TOOLCHAIN_GCC_AT_LEAST_5
	select LINGMO_PACKAGE_EDK2_PLATFORMS
	help
	  EDK II is a modern, feature-rich, cross-platform firmware
	  development environment for the UEFI and PI specifications.

	  https://github.com/tianocore/tianocore.github.io/wiki/EDK-II

if LINGMO_TARGET_EDK2

choice
	prompt "Platform"
	default LINGMO_TARGET_EDK2_PLATFORM_OVMF_I386 if LINGMO_i386
	default LINGMO_TARGET_EDK2_PLATFORM_OVMF_RISCV if LINGMO_RISCV_64
	default LINGMO_TARGET_EDK2_PLATFORM_OVMF_X64 if LINGMO_x86_64
	default LINGMO_TARGET_EDK2_PLATFORM_ARM_VIRT_QEMU if LINGMO_aarch64

config LINGMO_TARGET_EDK2_PLATFORM_OVMF_I386
	bool "i386"
	depends on LINGMO_i386 || LINGMO_x86_64
	help
	  Platform configuration for a generic i386 target.
	  This platform will boot from flash address 0x0.
	  It should therefore be used as the first bootloader.

config LINGMO_TARGET_EDK2_PLATFORM_OVMF_RISCV
	bool "RISC-V"
	depends on LINGMO_RISCV_64
	help
	  Platform configuration for RISC-V QEMU targeting the Virt
	  machine. This platform will only boot from flash address
	  0x0. It should therefore be used as the first bootloader.

config LINGMO_TARGET_EDK2_PLATFORM_OVMF_X64
	bool "x86-64"
	depends on LINGMO_x86_64
	help
	  Platform configuration for a generic x86-64 target.
	  This platform will boot from flash address 0x0.
	  It should therefore be used as the first bootloader.

config LINGMO_TARGET_EDK2_PLATFORM_ARM_VIRT_QEMU
	bool "ARM Virt Qemu (flash)"
	depends on LINGMO_aarch64
	help
	  Platform configuration for QEMU targeting the Virt machine.
	  This platform will only boot from flash address 0x0.
	  It should therefore be used as the first bootloader.

config LINGMO_TARGET_EDK2_PLATFORM_ARM_VIRT_QEMU_KERNEL
	bool "ARM Virt Qemu (kernel)"
	depends on LINGMO_aarch64
	help
	  Platform configuration for QEMU targeting the Virt machine.
	  This platform can boot from either flash address 0x0 or via
	  the Linux boot protocol. It can therefore be loaded by a
	  previous bootloader like ARM Trusted Firmware or OP-TEE.

config LINGMO_TARGET_EDK2_PLATFORM_ARM_SGI575
	bool "ARM SGI-575"
	depends on LINGMO_aarch64
	help
	  Platform configuration for ARM SGI-575 on ARM's
	  Fixed Virtual Platform (FVP).

config LINGMO_TARGET_EDK2_PLATFORM_ARM_VEXPRESS_FVP_AARCH64
	bool "ARM VExpress FVP Aarch64"
	depends on LINGMO_aarch64
	help
	  Platform configuration for ARM Versatile Express targeting
	  the Aarch64 Fixed Virtual Platform (FVP).

config LINGMO_TARGET_EDK2_PLATFORM_SOCIONEXT_DEVELOPERBOX
	bool "Socionext DeveloperBox"
	depends on LINGMO_aarch64
	depends on LINGMO_TARGET_ARM_TRUSTED_FIRMWARE
	depends on !LINGMO_TARGET_ARM_TRUSTED_FIRMWARE_EDK2_AS_BL33
	select LINGMO_PACKAGE_HOST_DTC
	select LINGMO_TARGET_ARM_TRUSTED_FIRMWARE_FIP
	help
	  Platform configuration for Socionext SynQuacer DeveloperBox
	  (SC2A11).

comment "Socionext DeveloperBox depends on ATF not using EDK2 as BL33"
	depends on LINGMO_TARGET_ARM_TRUSTED_FIRMWARE_EDK2_AS_BL33

config LINGMO_TARGET_EDK2_PLATFORM_SOLIDRUN_ARMADA80X0MCBIN
	bool "SolidRun MacchiatoBin"
	depends on LINGMO_aarch64
	depends on LINGMO_TARGET_ARM_TRUSTED_FIRMWARE
	select LINGMO_PACKAGE_EDK2_NON_OSI
	select LINGMO_PACKAGE_HOST_DTC
	select LINGMO_TARGET_ARM_TRUSTED_FIRMWARE_FIP
	help
	  Platform configuration for the SolidRun MacchiatoBin.

config LINGMO_TARGET_EDK2_PLATFORM_QEMU_SBSA
	bool "QEMU SBSA"
	depends on LINGMO_aarch64
	depends on LINGMO_TARGET_ARM_TRUSTED_FIRMWARE
	depends on !LINGMO_TARGET_ARM_TRUSTED_FIRMWARE_EDK2_AS_BL33
	help
	  Platform configuration for QEMU targeting the SBSA reference
	  machine.

comment "QEMU SBSA depends on ATF not using EDK2 as BL33"
	depends on LINGMO_TARGET_ARM_TRUSTED_FIRMWARE_EDK2_AS_BL33

endchoice

config LINGMO_TARGET_EDK2_OVMF_DEBUG_ON_SERIAL
	bool "OVMF Debug on Serial"
	depends on LINGMO_ENABLE_DEBUG
	depends on LINGMO_TARGET_EDK2_PLATFORM_OVMF_I386 || \
		LINGMO_TARGET_EDK2_PLATFORM_OVMF_X64
	help
	  When EDK2 OVMF is built with debug, messages are printed to
	  IO port 0x402. Those messages are not shown in the normal
	  Qemu emulated serial port. Enabling this option will print
	  debug messages on the emulated serial port, potentially
	  mixing messages with UEFI serial console output.

	  See OVMF README:
	  https://github.com/tianocore/edk2/blob/master/OvmfPkg/README

config LINGMO_TARGET_EDK2_FD_NAME
	string
	default "OVMF" if LINGMO_TARGET_EDK2_PLATFORM_OVMF_I386
	default "OVMF" if LINGMO_TARGET_EDK2_PLATFORM_OVMF_X64
	default "QEMU_EFI" if LINGMO_TARGET_EDK2_PLATFORM_ARM_VIRT_QEMU
	default "QEMU_EFI" if LINGMO_TARGET_EDK2_PLATFORM_ARM_VIRT_QEMU_KERNEL
	default "BL33_AP_UEFI" if LINGMO_TARGET_EDK2_PLATFORM_ARM_SGI575
	default "FVP_AARCH64_EFI" if LINGMO_TARGET_EDK2_PLATFORM_ARM_VEXPRESS_FVP_AARCH64
	default "FVP_AARCH64_EFI" if LINGMO_TARGET_EDK2_PLATFORM_SOCIONEXT_DEVELOPERBOX
	default "ARMADA_EFI" if LINGMO_TARGET_EDK2_PLATFORM_SOLIDRUN_ARMADA80X0MCBIN

endif

comment "EDK2 needs a toolchain w/ gcc >= 5"
	depends on !LINGMO_TOOLCHAIN_GCC_AT_LEAST_5
```
