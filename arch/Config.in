## boot/ti-k3-image-gen/Config.in
```kconfig
config LINGMO_TARGET_TI_K3_IMAGE_GEN
	bool "ti-k3-image-gen"
	depends on LINGMO_TARGET_TI_K3_R5_LOADER
	select LINGMO_TARGET_TI_K3_BOOT_FIRMWARE
	# We need FIT support in uboot-tools, which is why we select a
	# host package
	select LINGMO_PACKAGE_HOST_UBOOT_TOOLS
	select LINGMO_PACKAGE_HOST_UBOOT_TOOLS_FIT_SUPPORT
	help
	  Use TI's k3-image-gen to build a separate bare metal boot
	  binary from a separate SPL that is running on the R5 core.

	  https://git.ti.com/cgit/k3-image-gen/k3-image-gen/

if LINGMO_TARGET_TI_K3_IMAGE_GEN
choice
	prompt "SoC family"

config LINGMO_TARGET_TI_K3_IMAGE_GEN_SOC_AM62AX
	bool "am62ax"

config LINGMO_TARGET_TI_K3_IMAGE_GEN_SOC_AM62X
	bool "am62x"

config LINGMO_TARGET_TI_K3_IMAGE_GEN_SOC_AM64X
	bool "am64x"

config LINGMO_TARGET_TI_K3_IMAGE_GEN_SOC_AM65X
	bool "am65x"

endchoice

choice
	prompt "Security type"
	help
	  The target SoC security type option for image gen.  Valid
	  options are "gp" for General Purpose devices, "hs-fs" for
	  High Security - Field Securable devices, or "hs" for High
	  Security - Security Enforcing devices.  Note for all High
	  Security device variants the TI_SECURE_DEV_PKG environmental
	  variable must be defined at build time pointing to a valid
	  core-secdev-k3 folder location, otherwise the build will
	  fail, see
	  https://git.ti.com/cgit/security-development-tools/core-secdev-k3

config LINGMO_TARGET_TI_K3_IMAGE_GEN_SECTYPE_GP
	bool "gp"

config LINGMO_TARGET_TI_K3_IMAGE_GEN_SECTYPE_HS_FS
	bool "hs-fs"

config LINGMO_TARGET_TI_K3_IMAGE_GEN_SECTYPE_HS
	bool "hs"

endchoice

config LINGMO_TARGET_TI_K3_IMAGE_GEN_SOC
	string
	default "am62ax" if LINGMO_TARGET_TI_K3_IMAGE_GEN_SOC_AM62AX
	default "am62x"  if LINGMO_TARGET_TI_K3_IMAGE_GEN_SOC_AM62X
	default "am64x"  if LINGMO_TARGET_TI_K3_IMAGE_GEN_SOC_AM64X
	default "am65x"  if LINGMO_TARGET_TI_K3_IMAGE_GEN_SOC_AM65X

config LINGMO_TARGET_TI_K3_IMAGE_GEN_FW_TYPE
	string
	default "ti-fs"  if LINGMO_TARGET_TI_K3_IMAGE_GEN_SOC_AM62AX
	default "ti-fs"  if LINGMO_TARGET_TI_K3_IMAGE_GEN_SOC_AM62X
	default "ti-sci" if LINGMO_TARGET_TI_K3_IMAGE_GEN_SOC_AM64X
	default "ti-sci" if LINGMO_TARGET_TI_K3_IMAGE_GEN_SOC_AM65X

config LINGMO_TARGET_TI_K3_IMAGE_GEN_SECTYPE
	string
	default "gp"    if LINGMO_TARGET_TI_K3_IMAGE_GEN_SECTYPE_GP
	default "hs-fs" if LINGMO_TARGET_TI_K3_IMAGE_GEN_SECTYPE_HS_FS
	default "hs"    if LINGMO_TARGET_TI_K3_IMAGE_GEN_SECTYPE_HS

endif
```

## boot/ti-k3-r5-loader/Config.in
```kconfig
config LINGMO_TARGET_TI_K3_R5_LOADER
	bool "ti-k3-r5-loader"
	depends on LINGMO_aarch64
	help
	  Separate U-Boot SPL build for R5 core on TI's K3 processors.
	  Usually used to build tiboot3.bin with k3-image-gen.

if LINGMO_TARGET_TI_K3_R5_LOADER

choice
	prompt "U-Boot Version"
	help
	  Select the specific U-Boot version you want to use to build
	  the initial SPL running on the R5 core. Note that for most
	  use cases you will want to use the exact same version/source
	  here as it is used to build the main U-Boot package.

config LINGMO_TARGET_TI_K3_R5_LOADER_LATEST_VERSION
	bool "2022.10"

config LINGMO_TARGET_TI_K3_R5_LOADER_CUSTOM_VERSION
	bool "Custom version"
	help
	  This option allows to use a specific official versions

config LINGMO_TARGET_TI_K3_R5_LOADER_CUSTOM_TARBALL
	bool "Custom tarball"

config LINGMO_TARGET_TI_K3_R5_LOADER_CUSTOM_GIT
	bool "Custom Git repository"

config LINGMO_TARGET_TI_K3_R5_LOADER_CUSTOM_HG
	bool "Custom Mercurial repository"

config LINGMO_TARGET_TI_K3_R5_LOADER_CUSTOM_SVN
	bool "Custom Subversion repository"

endchoice

config LINGMO_TARGET_TI_K3_R5_LOADER_CUSTOM_VERSION_VALUE
	string "U-Boot version"
	depends on LINGMO_TARGET_TI_K3_R5_LOADER_CUSTOM_VERSION

config LINGMO_TARGET_TI_K3_R5_LOADER_CUSTOM_TARBALL_LOCATION
	string "URL of custom U-Boot tarball"
	depends on LINGMO_TARGET_TI_K3_R5_LOADER_CUSTOM_TARBALL

if LINGMO_TARGET_TI_K3_R5_LOADER_CUSTOM_GIT || LINGMO_TARGET_TI_K3_R5_LOADER_CUSTOM_HG || LINGMO_TARGET_TI_K3_R5_LOADER_CUSTOM_SVN

config LINGMO_TARGET_TI_K3_R5_LOADER_CUSTOM_REPO_URL
	string "URL of custom repository"

config LINGMO_TARGET_TI_K3_R5_LOADER_CUSTOM_REPO_VERSION
	string "Custom repository version"
	help
	  Revision to use in the typical format used by
	  Git/Mercurial/Subversion E.G. a sha id, a tag, branch, ..

endif

config LINGMO_TARGET_TI_K3_R5_LOADER_VERSION
	string
	default "2022.10"	if LINGMO_TARGET_TI_K3_R5_LOADER_LATEST_VERSION
	default LINGMO_TARGET_TI_K3_R5_LOADER_CUSTOM_VERSION_VALUE \
		if LINGMO_TARGET_TI_K3_R5_LOADER_CUSTOM_VERSION
	default "custom"	if LINGMO_TARGET_TI_K3_R5_LOADER_CUSTOM_TARBALL
	default LINGMO_TARGET_TI_K3_R5_LOADER_CUSTOM_REPO_VERSION \
		if LINGMO_TARGET_TI_K3_R5_LOADER_CUSTOM_GIT || \
		   LINGMO_TARGET_TI_K3_R5_LOADER_CUSTOM_HG  || \
		   LINGMO_TARGET_TI_K3_R5_LOADER_CUSTOM_SVN
choice
	prompt "U-Boot Configuration"
	default LINGMO_TARGET_TI_K3_R5_LOADER_USE_DEFCONFIG

config LINGMO_TARGET_TI_K3_R5_LOADER_USE_DEFCONFIG
	bool "Using an in-tree board defconfig file"

config LINGMO_TARGET_TI_K3_R5_LOADER_USE_CUSTOM_CONFIG
	bool "Using a custom board (def)config file"

endchoice

config LINGMO_TARGET_TI_K3_R5_LOADER_BOARD_DEFCONFIG
	string "Board defconfig"
	depends on LINGMO_TARGET_TI_K3_R5_LOADER_USE_DEFCONFIG
	help
	  Name of the board for which TI K3 R5 Loader should be
	  built, without the _defconfig suffix.

config LINGMO_TARGET_TI_K3_R5_LOADER_CUSTOM_CONFIG_FILE
	string "Configuration file path"
	depends on LINGMO_TARGET_TI_K3_R5_LOADER_USE_CUSTOM_CONFIG
	help
	  Path to the TI K3 R5 Loader configuration file.

endif
```
