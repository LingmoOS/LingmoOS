## arch/Config.in
```kconfig
menu "Target options"

config LINGMO_ARCH_IS_64
	bool

config LINGMO_KERNEL_64_USERLAND_32
	bool

config LINGMO_SOFT_FLOAT
	bool

config LINGMO_USE_MMU
	bool

choice
	prompt "Target Architecture"
	default LINGMO_i386
	help
	  Select the target architecture family to build for.

config LINGMO_arcle
	bool "ARC (little endian)"
	select LINGMO_USE_MMU
	help
	  Synopsys' DesignWare ARC Processor Cores are a family of
	  32-bit CPUs that can be used from deeply embedded to high
	  performance host applications. Little endian.

config LINGMO_arceb
	bool "ARC (big endian)"
	select LINGMO_USE_MMU
	help
	  Synopsys' DesignWare ARC Processor Cores are a family of
	  32-bit CPUs that can be used from deeply embedded to high
	  performance host applications. Big endian.

config LINGMO_arm
	bool "ARM (little endian)"
	# MMU support is set by the subarchitecture file, arch/Config.in.arm
	help
	  ARM is a 32-bit reduced instruction set computer (RISC)
	  instruction set architecture (ISA) developed by ARM Holdings.
	  Little endian.
	  http://www.arm.com/
	  http://en.wikipedia.org/wiki/ARM

config LINGMO_armeb
	bool "ARM (big endian)"
	select LINGMO_USE_MMU
	help
	  ARM is a 32-bit reduced instruction set computer (RISC)
	  instruction set architecture (ISA) developed by ARM Holdings.
	  Big endian.
	  http://www.arm.com/
	  http://en.wikipedia.org/wiki/ARM

config LINGMO_aarch64
	bool "AArch64 (little endian)"
	select LINGMO_ARCH_IS_64
	help
	  Aarch64 is a 64-bit architecture developed by ARM Holdings.
	  http://www.arm.com/products/processors/instruction-set-architectures/armv8-architecture.php
	  http://en.wikipedia.org/wiki/ARM

config LINGMO_aarch64_be
	bool "AArch64 (big endian)"
	select LINGMO_ARCH_IS_64
	help
	  Aarch64 is a 64-bit architecture developed by ARM Holdings.
	  http://www.arm.com/products/processors/instruction-set-architectures/armv8-architecture.php
	  http://en.wikipedia.org/wiki/ARM

config LINGMO_i386
	bool "i386"
	select LINGMO_USE_MMU
	help
	  Intel i386 architecture compatible microprocessor
	  http://en.wikipedia.org/wiki/I386

config LINGMO_m68k
	bool "m68k"
	# MMU support is set by the subarchitecture file, arch/Config.in.m68k
	help
	  Motorola 68000 family microprocessor
	  http://en.wikipedia.org/wiki/M68k

config LINGMO_microblazeel
	bool "Microblaze AXI (little endian)"
	select LINGMO_USE_MMU
	help
	  Soft processor core designed for Xilinx FPGAs from Xilinx. AXI
	  bus based architecture (little endian)
	  http://www.xilinx.com
	  http://en.wikipedia.org/wiki/Microblaze

config LINGMO_microblazebe
	bool "Microblaze non-AXI (big endian)"
	select LINGMO_USE_MMU
	help
	  Soft processor core designed for Xilinx FPGAs from Xilinx. PLB
	  bus based architecture (non-AXI, big endian)
	  http://www.xilinx.com
	  http://en.wikipedia.org/wiki/Microblaze

config LINGMO_mips
	bool "MIPS (big endian)"
	select LINGMO_USE_MMU
	help
	  MIPS is a RISC microprocessor from MIPS Technologies. Big
	  endian.
	  http://www.mips.com/
	  http://en.wikipedia.org/wiki/MIPS_Technologies

config LINGMO_mipsel
	bool "MIPS (little endian)"
	select LINGMO_USE_MMU
	help
	  MIPS is a RISC microprocessor from MIPS Technologies. Little
	  endian.
	  http://www.mips.com/
	  http://en.wikipedia.org/wiki/MIPS_Technologies

config LINGMO_mips64
	bool "MIPS64 (big endian)"
	select LINGMO_ARCH_IS_64
	select LINGMO_USE_MMU
	help
	  MIPS is a RISC microprocessor from MIPS Technologies. Big
	  endian.
	  http://www.mips.com/
	  http://en.wikipedia.org/wiki/MIPS_Technologies

config LINGMO_mips64el
	bool "MIPS64 (little endian)"
	select LINGMO_ARCH_IS_64
	select LINGMO_USE_MMU
	help
	  MIPS is a RISC microprocessor from MIPS Technologies. Little
	  endian.
	  http://www.mips.com/
	  http://en.wikipedia.org/wiki/MIPS_Technologies

config LINGMO_nios2
	bool "Nios II"
	select LINGMO_USE_MMU
	help
	  Nios II is a soft core processor from Altera Corporation.
	  http://www.altera.com/
	  http://en.wikipedia.org/wiki/Nios_II

config LINGMO_or1k
	bool "OpenRISC"
	select LINGMO_USE_MMU
	help
	  OpenRISC is a free and open processor for embedded system.
	  http://openrisc.io

config LINGMO_powerpc
	bool "PowerPC"
	select LINGMO_USE_MMU
	help
	  PowerPC is a RISC architecture created by Apple-IBM-Motorola
	  alliance. Big endian.
	  http://www.power.org/
	  http://en.wikipedia.org/wiki/Powerpc

config LINGMO_powerpc64
	bool "PowerPC64 (big endian)"
	select LINGMO_ARCH_IS_64
	select LINGMO_USE_MMU
	help
	  PowerPC is a RISC architecture created by Apple-IBM-Motorola
	  alliance. Big endian.
	  http://www.power.org/
	  http://en.wikipedia.org/wiki/Powerpc

config LINGMO_powerpc64le
	bool "PowerPC64 (little endian)"
	select LINGMO_ARCH_IS_64
	select LINGMO_USE_MMU
	help
	  PowerPC is a RISC architecture created by Apple-IBM-Motorola
	  alliance. Little endian.
	  http://www.power.org/
	  http://en.wikipedia.org/wiki/Powerpc

config LINGMO_riscv
	bool "RISCV"
	select LINGMO_ARCH_NEEDS_GCC_AT_LEAST_7
	help
	  RISC-V is an open, free Instruction Set Architecture created
	  by the UC Berkeley Architecture Research group and supported
	  and promoted by RISC-V Foundation.
	  https://riscv.org/
	  https://en.wikipedia.org/wiki/RISC-V

config LINGMO_s390x
	bool "s390x"
	select LINGMO_ARCH_IS_64
	select LINGMO_USE_MMU
	help
	  s390x is a big-endian architecture made by IBM.
	  http://www.ibm.com/
	  http://en.wikipedia.org/wiki/IBM_System/390

config LINGMO_sh
	bool "SuperH"
	select LINGMO_USE_MMU
	help
	  SuperH (or SH) is a 32-bit reduced instruction set computer
	  (RISC) instruction set architecture (ISA) developed by
	  Hitachi.
	  http://www.hitachi.com/
	  http://en.wikipedia.org/wiki/SuperH

config LINGMO_sparc
	bool "SPARC"
	select LINGMO_USE_MMU
	# uClibc-ng broken on sparc due to recent gcc changes
	# that need to be reverted since gcc 8.4, 9.3 and 10.1.
	# https://gcc.gnu.org/bugzilla/show_bug.cgi?id=98784
	# gcc <= 10.x has been removed from Buildroot.
	select LINGMO_ARCH_HAS_NO_TOOLCHAIN_BUILDROOT
	help
	  SPARC (from Scalable Processor Architecture) is a RISC
	  instruction set architecture (ISA) developed by Sun
	  Microsystems.
	  http://www.oracle.com/sun
	  http://en.wikipedia.org/wiki/Sparc

config LINGMO_sparc64
	bool "SPARC64"
	select LINGMO_ARCH_IS_64
	select LINGMO_USE_MMU
	help
	  SPARC (from Scalable Processor Architecture) is a RISC
	  instruction set architecture (ISA) developed by Sun
	  Microsystems.
	  http://www.oracle.com/sun
	  http://en.wikipedia.org/wiki/Sparc

config LINGMO_x86_64
	bool "x86_64"
	select LINGMO_ARCH_IS_64
	select LINGMO_USE_MMU
	help
	  x86-64 is an extension of the x86 instruction set (Intel i386
	  architecture compatible microprocessor).
	  http://en.wikipedia.org/wiki/X86_64

config LINGMO_xtensa
	bool "Xtensa"
	# MMU support is set by the subarchitecture file, arch/Config.in.xtensa
	help
	  Xtensa is a Tensilica processor IP architecture.
	  http://en.wikipedia.org/wiki/Xtensa
	  http://www.tensilica.com/

endchoice

# For some architectures or specific cores, our internal toolchain
# backend is not suitable (like, missing support in upstream gcc, or
# no ChipCo fork exists...)
config LINGMO_ARCH_HAS_NO_TOOLCHAIN_BUILDROOT
	bool

config LINGMO_ARCH_HAS_TOOLCHAIN_BUILDROOT
	bool
	default y if !LINGMO_ARCH_HAS_NO_TOOLCHAIN_BUILDROOT

# The following symbols are selected by the individual
# Config.in.$ARCH files
config LINGMO_ARCH_NEEDS_GCC_AT_LEAST_4_8
	bool

config LINGMO_ARCH_NEEDS_GCC_AT_LEAST_4_9
	bool
	select LINGMO_ARCH_NEEDS_GCC_AT_LEAST_4_8

config LINGMO_ARCH_NEEDS_GCC_AT_LEAST_5
	bool
	select LINGMO_ARCH_NEEDS_GCC_AT_LEAST_4_9

config LINGMO_ARCH_NEEDS_GCC_AT_LEAST_6
	bool
	select LINGMO_ARCH_NEEDS_GCC_AT_LEAST_5

config LINGMO_ARCH_NEEDS_GCC_AT_LEAST_7
	bool
	select LINGMO_ARCH_NEEDS_GCC_AT_LEAST_6

config LINGMO_ARCH_NEEDS_GCC_AT_LEAST_8
	bool
	select LINGMO_ARCH_NEEDS_GCC_AT_LEAST_7

config LINGMO_ARCH_NEEDS_GCC_AT_LEAST_9
	bool
	select LINGMO_ARCH_NEEDS_GCC_AT_LEAST_8

config LINGMO_ARCH_NEEDS_GCC_AT_LEAST_10
	bool
	select LINGMO_ARCH_NEEDS_GCC_AT_LEAST_9

config LINGMO_ARCH_NEEDS_GCC_AT_LEAST_11
	bool
	select LINGMO_ARCH_NEEDS_GCC_AT_LEAST_10

config LINGMO_ARCH_NEEDS_GCC_AT_LEAST_12
	bool
	select LINGMO_ARCH_NEEDS_GCC_AT_LEAST_11

config LINGMO_ARCH_NEEDS_GCC_AT_LEAST_13
	bool
	select LINGMO_ARCH_NEEDS_GCC_AT_LEAST_12

config LINGMO_ARCH_NEEDS_GCC_AT_LEAST_14
	bool
	select LINGMO_ARCH_NEEDS_GCC_AT_LEAST_13

# The following string values are defined by the individual
# Config.in.$ARCH files
config LINGMO_ARCH
	string

config LINGMO_NORMALIZED_ARCH
	string

config LINGMO_ENDIAN
	string

config LINGMO_GCC_TARGET_ARCH
	string

config LINGMO_GCC_TARGET_ABI
	string

config LINGMO_GCC_TARGET_NAN
	string

config LINGMO_GCC_TARGET_FP32_MODE
	string

config LINGMO_GCC_TARGET_CPU
	string

# The value of this option will be passed as --with-fpu=<value> when
# building gcc (internal backend) or -mfpu=<value> in the toolchain
# wrapper (external toolchain)
config LINGMO_GCC_TARGET_FPU
	string

# The value of this option will be passed as --with-float=<value> when
# building gcc (internal backend) or -mfloat-abi=<value> in the toolchain
# wrapper (external toolchain)
config LINGMO_GCC_TARGET_FLOAT_ABI
	string

# The value of this option will be passed as --with-mode=<value> when
# building gcc (internal backend) or -m<value> in the toolchain
# wrapper (external toolchain)
config LINGMO_GCC_TARGET_MODE
	string

# Must be selected by binary formats that support shared libraries.
config LINGMO_BINFMT_SUPPORTS_SHARED
	bool

# Must match the name of the architecture from readelf point of view,
# i.e the "Machine:" field of readelf output. See get_machine_name()
# in binutils/readelf.c for the list of possible values.
config LINGMO_READELF_ARCH_NAME
	string

if LINGMO_arcle || LINGMO_arceb
source "arch/Config.in.arc"
endif

if LINGMO_arm || LINGMO_armeb || LINGMO_aarch64 || LINGMO_aarch64_be
source "arch/Config.in.arm"
endif

if LINGMO_m68k
source "arch/Config.in.m68k"
endif

if LINGMO_microblazeel || LINGMO_microblazebe
source "arch/Config.in.microblaze"
endif

if LINGMO_mips || LINGMO_mips64 || LINGMO_mipsel || LINGMO_mips64el
source "arch/Config.in.mips"
endif

if LINGMO_nios2
source "arch/Config.in.nios2"
endif

if LINGMO_or1k
source "arch/Config.in.or1k"
endif

if LINGMO_powerpc || LINGMO_powerpc64 || LINGMO_powerpc64le
source "arch/Config.in.powerpc"
endif

if LINGMO_riscv
source "arch/Config.in.riscv"
endif

if LINGMO_s390x
source "arch/Config.in.s390x"
endif

if LINGMO_sh
source "arch/Config.in.sh"
endif

if LINGMO_sparc || LINGMO_sparc64
source "arch/Config.in.sparc"
endif

if LINGMO_i386 || LINGMO_x86_64
source "arch/Config.in.x86"
endif

if LINGMO_xtensa
source "arch/Config.in.xtensa"
endif

# Set up target binary format
choice
	prompt "Target Binary Format"
	default LINGMO_BINFMT_ELF if LINGMO_USE_MMU
	default LINGMO_BINFMT_FLAT

config LINGMO_BINFMT_ELF
	bool "ELF"
	depends on LINGMO_USE_MMU
	select LINGMO_BINFMT_SUPPORTS_SHARED
	help
	  ELF (Executable and Linkable Format) is a format for libraries
	  and executables used across different architectures and
	  operating systems.

config LINGMO_BINFMT_FLAT
	bool "FLAT"
	depends on !LINGMO_USE_MMU
	help
	  FLAT binary is a relatively simple and lightweight executable
	  format based on the original a.out format. It is widely used
	  in environment where no MMU is available.

endchoice

# Set up flat binary type
choice
	prompt "FLAT Binary type"
	default LINGMO_BINFMT_FLAT_ONE
	depends on LINGMO_BINFMT_FLAT

config LINGMO_BINFMT_FLAT_ONE
	bool "One memory region"
	help
	  All segments are linked into one memory region.

config LINGMO_BINFMT_FLAT_SHARED
	bool "Shared binary"
	depends on LINGMO_m68k
	# Even though this really generates shared binaries, there is no libdl
	# and dlopen() cannot be used. So packages that require shared
	# libraries cannot be built. Therefore, we don't select
	# LINGMO_BINFMT_SUPPORTS_SHARED and therefore force LINGMO_STATIC_LIBS.
	# Although this adds -static to the compilation, that's not a problem
	# because the -mid-shared-library option overrides it.
	help
	  Allow to load and link indiviual FLAT binaries at run time.

endchoice

endmenu # Target options
```

## boot/at91bootstrap/Config.in
```kconfig
config LINGMO_TARGET_AT91BOOTSTRAP
	bool "AT91 Bootstrap"
	depends on LINGMO_arm926t
	help
	  AT91Bootstrap is a first level bootloader for the Atmel AT91
	  devices. It integrates algorithms for:
	  - Device initialization such as clock configuration, PIO
	    settings...
	  - Peripheral drivers such as PIO, PMC or SDRAMC...
	  - Physical media algorithm such as DataFlash, NandFlash, NOR
	    Flash...

if	LINGMO_TARGET_AT91BOOTSTRAP

config LINGMO_TARGET_AT91BOOTSTRAP_CUSTOM_PATCH_DIR
	string "custom patch dir"
	help
	  If your board requires custom patches, add the path to the
	  directory containing the patches here. The patches must be
	  named at91bootstrap-<version>-<something>.patch.

	  Most users may leave this empty

config LINGMO_TARGET_AT91BOOTSTRAP_BOARD
	string "Bootstrap board"
	default ""
	help
	  This is used to do a make <board>_config

choice
	prompt "Boot Memory"
	default LINGMO_TARGET_AT91BOOTSTRAP_DATAFLASH
	help
	  Select Chip for which AT91 bootstrap should be built

config LINGMO_TARGET_AT91BOOTSTRAP_DATAFLASH
	bool "Data Flash"

config LINGMO_TARGET_AT91BOOTSTRAP_NANDFLASH
	bool "NAND Flash"

endchoice

config LINGMO_TARGET_AT91BOOTSTRAP_MEMORY
	string
	default	"dataflash"	if	LINGMO_TARGET_AT91BOOTSTRAP_DATAFLASH
	default	"nandflash"	if	LINGMO_TARGET_AT91BOOTSTRAP_NANDFLASH

endif
```
