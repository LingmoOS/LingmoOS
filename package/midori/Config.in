## package/mongodb/Config.in
```kconfig
# from https://docs.mongodb.com/manual/installation/#supported-platforms
config LINGMO_PACKAGE_MONGODB_ARCH_SUPPORTS
	bool
	# ARM needs LDREX/STREX, so ARMv6+
	default y if LINGMO_arm && !LINGMO_ARM_CPU_ARMV4 && !LINGMO_ARM_CPU_ARMV5
	default y if LINGMO_aarch64 || LINGMO_x86_64
	depends on LINGMO_TOOLCHAIN_SUPPORTS_ALWAYS_LOCKFREE_ATOMIC_INTS # boost-filesystem

config LINGMO_PACKAGE_MONGODB
	bool "mongodb"
	depends on LINGMO_PACKAGE_MONGODB_ARCH_SUPPORTS
	depends on LINGMO_TOOLCHAIN_USES_GLIBC # needs glibc malloc_usable_size
	depends on LINGMO_USE_WCHAR
	depends on LINGMO_TOOLCHAIN_HAS_THREADS
	depends on LINGMO_INSTALL_LIBSTDCPP
	depends on LINGMO_TOOLCHAIN_GCC_AT_LEAST_7 # C++17
	select LINGMO_PACKAGE_BOOST
	select LINGMO_PACKAGE_BOOST_FILESYSTEM
	select LINGMO_PACKAGE_BOOST_IOSTREAMS
	select LINGMO_PACKAGE_BOOST_PROGRAM_OPTIONS
	select LINGMO_PACKAGE_BOOST_SYSTEM
	select LINGMO_PACKAGE_PCRE
	select LINGMO_PACKAGE_PCRE_UTF # runtime
	select LINGMO_PACKAGE_SNAPPY
	select LINGMO_PACKAGE_SQLITE
	select LINGMO_PACKAGE_YAML_CPP
	select LINGMO_PACKAGE_ZLIB
	help
	  MongoDB is a cross-platform document-oriented database
	  (NoSQL).

	  It uses JSON-like documents with dynamic schemas (BSON),
	  making the integration of data in certain types of
	  applications easier and faster.

	  https://www.mongodb.org/

comment "mongodb needs a glibc toolchain w/ wchar, threads, C++, gcc >= 7"
	depends on !LINGMO_USE_WCHAR || !LINGMO_TOOLCHAIN_HAS_THREADS || \
		!LINGMO_INSTALL_LIBSTDCPP || !LINGMO_TOOLCHAIN_USES_GLIBC || \
		!LINGMO_TOOLCHAIN_GCC_AT_LEAST_7
	depends on LINGMO_PACKAGE_MONGODB_ARCH_SUPPORTS
```

## package/mongoose/Config.in
```kconfig
config LINGMO_PACKAGE_MONGOOSE
	bool "mongoose"
	depends on LINGMO_TOOLCHAIN_HAS_THREADS
	depends on LINGMO_USE_MMU # fork()
	help
	  Mongoose is an embedded networking library, which can turn
	  anything into a web server

	  https://github.com/cesanta/mongoose

comment "mongoose needs a toolchain w/ threads"
	depends on LINGMO_USE_MMU
	depends on !LINGMO_TOOLCHAIN_HAS_THREADS
```

## package/mongrel2/Config.in
```kconfig
# mongrel2 uses {get,make,swap}context() functions, which are
# available in glibc for all architectures and in uClibc only for a
# subset of the architectures
config LINGMO_PACKAGE_MONGREL2_LIBC_SUPPORTS
	bool
	default y if LINGMO_TOOLCHAIN_USES_GLIBC
	default y if LINGMO_TOOLCHAIN_USES_UCLIBC && \
		(LINGMO_arm || LINGMO_armeb || LINGMO_i386 || LINGMO_mips || LINGMO_mipsel || LINGMO_mips64 || LINGMO_mips64el || LINGMO_sparc || LINGMO_x86_64)

comment "mongrel2 needs a uClibc or glibc toolchain w/ C++, threads, dynamic library"
	depends on !LINGMO_INSTALL_LIBSTDCPP || \
		!LINGMO_TOOLCHAIN_HAS_THREADS || LINGMO_STATIC_LIBS || \
		!LINGMO_PACKAGE_MONGREL2_LIBC_SUPPORTS

config LINGMO_PACKAGE_MONGREL2
	bool "mongrel2"
	depends on LINGMO_INSTALL_LIBSTDCPP # zeromq
	depends on LINGMO_TOOLCHAIN_HAS_THREADS # zeromq
	depends on !LINGMO_STATIC_LIBS # uses dlopen()
	depends on LINGMO_PACKAGE_MONGREL2_LIBC_SUPPORTS
	select LINGMO_PACKAGE_MBEDTLS
	select LINGMO_PACKAGE_SQLITE
	select LINGMO_PACKAGE_ZEROMQ
	help
	  Mongrel2 is an application, language, and network architecture
	  agnostic web server that focuses on web applications using
	  modern browser technologies.

	  Mongrel2 supports 17 languages and platforms, HTTP, Flash
	  sockets, WebSockets, Long Polling, and many ways to deploy
	  and hack on it.

	  http://www.mongrel2.org
```

## package/monit/Config.in
```kconfig
config LINGMO_PACKAGE_MONIT
	bool "monit"
	depends on LINGMO_TOOLCHAIN_HAS_THREADS
	depends on LINGMO_USE_MMU # fork()
	help
	  Monit is a free open source utility for managing and
	  monitoring, processes, programs, files, directories and
	  filesystems on a UNIX system. Monit conducts automatic
	  maintenance and repair and can execute meaningful causal
	  actions in error situations.

	  http://mmonit.com/monit/

comment "monit needs a toolchain w/ threads"
	depends on LINGMO_USE_MMU
	depends on !LINGMO_TOOLCHAIN_HAS_THREADS
```

## package/mono/Config.in
```kconfig
config LINGMO_PACKAGE_HOST_MONO_ARCH_SUPPORTS
	bool
	default y if LINGMO_HOSTARCH = "x86_64"
	default y if LINGMO_HOSTARCH = "x86"

config LINGMO_PACKAGE_MONO_ARCH_SUPPORTS
	bool
	default y if (LINGMO_aarch64 || LINGMO_arm || LINGMO_armeb || \
		      LINGMO_i386 || LINGMO_powerpc || LINGMO_x86_64)
	depends on LINGMO_PACKAGE_HOST_MONO_ARCH_SUPPORTS
	depends on LINGMO_PACKAGE_LIBATOMIC_OPS_ARCH_SUPPORTS

config LINGMO_PACKAGE_MONO
	bool "mono"
	depends on LINGMO_PACKAGE_MONO_ARCH_SUPPORTS
	depends on LINGMO_INSTALL_LIBSTDCPP
	depends on LINGMO_TOOLCHAIN_HAS_THREADS_NPTL # pthread_getattr_np()
	depends on !LINGMO_STATIC_LIBS
	select LINGMO_PACKAGE_LIBATOMIC_OPS
	help
	  An open source, cross-platform, implementation of C#
	  and the CLR that is binary compatible with Microsoft.NET.

	  http://download.mono-project.com/sources/mono/

comment "mono needs a toolchain w/ C++, NPTL, dynamic library"
	depends on LINGMO_PACKAGE_MONO_ARCH_SUPPORTS
	depends on !LINGMO_INSTALL_LIBSTDCPP || \
		!LINGMO_TOOLCHAIN_HAS_THREADS_NPTL || LINGMO_STATIC_LIBS
```

## package/mosh/Config.in
```kconfig
comment "mosh needs a toolchain w/ C++, threads, dynamic library, wchar, gcc >= 4.8"
	depends on !LINGMO_TOOLCHAIN_HAS_THREADS || !LINGMO_INSTALL_LIBSTDCPP \
		|| LINGMO_STATIC_LIBS || !LINGMO_USE_WCHAR \
		|| !LINGMO_TOOLCHAIN_GCC_AT_LEAST_4_8
	depends on LINGMO_PACKAGE_PROTOBUF_ARCH_SUPPORTS

config LINGMO_PACKAGE_MOSH
	bool "mosh"
	depends on LINGMO_PACKAGE_PROTOBUF_ARCH_SUPPORTS
	depends on LINGMO_INSTALL_LIBSTDCPP # protobuf
	depends on LINGMO_TOOLCHAIN_HAS_THREADS # protobuf
	depends on LINGMO_TOOLCHAIN_GCC_AT_LEAST_4_8 # protobuf
	depends on !LINGMO_STATIC_LIBS # protobuf
	depends on LINGMO_USE_WCHAR
	select LINGMO_PACKAGE_PROTOBUF
	select LINGMO_PACKAGE_NCURSES
	select LINGMO_PACKAGE_NETTLE if !LINGMO_PACKAGE_OPENSSL
	select LINGMO_PACKAGE_ZLIB
	# runtime dependency
	select LINGMO_PACKAGE_OPENSSH if !LINGMO_PACKAGE_DROPBEAR_CLIENT
	help
	  Remote terminal application that supports intermittent
	  connectivity, allows roaming, and provides speculative local
	  echo and line editing of user keystrokes.

	  Mosh requires that the remote machine has a locale setting
	  matching the one on the client.

	  When using mosh with dropbear on a remote machine, the
	  client needs mosh with a version above 1.3.0 and the
	  --no-ssh-pty option needs to be passed when starting the
	  connection.

	  https://mosh.org
```

## package/mosquitto/Config.in
```kconfig
config LINGMO_PACKAGE_MOSQUITTO
	bool "mosquitto"
	help
	  Eclipse Mosquitto is an open source (EPL/EDL licensed) message
	  broker that implements the MQTT protocol versions 5.0, 3.1.1
	  and 3.1. Mosquitto is lightweight and is suitable for use on
	  all devices from low power single board computers to full
	  servers.

	  The MQTT protocol provides a lightweight method of carrying
	  out messaging using a publish/subscribe model. This makes it
	  suitable for Internet of Things messaging such as with low
	  power sensors or mobile devices such as phones,
	  embedded computers or microcontrollers.

	  The Mosquitto project also provides a C library for
	  implementing MQTT clients, and the very popular mosquitto_pub
	  and mosquitto_sub command line MQTT clients.

	  https://mosquitto.org/

config LINGMO_PACKAGE_MOSQUITTO_BROKER
	bool "install the mosquitto broker"
	default y
	depends on LINGMO_USE_MMU # fork()
	depends on !LINGMO_STATIC_LIBS # include <dlfcn.h>
	depends on LINGMO_PACKAGE_MOSQUITTO
	select LINGMO_PACKAGE_LIBWEBSOCKETS_EXT_POLL if LINGMO_PACKAGE_LIBWEBSOCKETS
	help
	  Build and install the mosquitto broker onto target.

comment "mosquitto broker needs a toolchain w/ dynamic library"
	depends on LINGMO_USE_MMU
	depends on LINGMO_STATIC_LIBS
	depends on LINGMO_PACKAGE_MOSQUITTO
```
