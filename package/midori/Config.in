## package/midori/Config.in
```kconfig
config LINGMO_PACKAGE_MIDORI_ARCH_SUPPORTS
	bool
	default y
	depends on LINGMO_USE_MMU
	depends on LINGMO_PACKAGE_HOST_RUSTC_ARCH_SUPPORTS
	depends on LINGMO_PACKAGE_GOBJECT_INTROSPECTION_ARCH_SUPPORTS
	depends on LINGMO_PACKAGE_LIBGPG_ERROR_ARCH_SUPPORTS # gcr -> libgcrypt -> libgpg-error
	depends on LINGMO_PACKAGE_WEBKITGTK_ARCH_SUPPORTS
	depends on !LINGMO_BINFMT_FLAT # webkitgtk -> icu

comment "midori needs a glibc toolchain w/ C++, wchar, threads, dynamic library, gcc >= 7, host gcc >= 8"
	depends on LINGMO_PACKAGE_MIDORI_ARCH_SUPPORTS
	depends on !LINGMO_INSTALL_LIBSTDCPP || \
		!LINGMO_TOOLCHAIN_GCC_AT_LEAST_7 || \
		!LINGMO_HOST_GCC_AT_LEAST_8 || \
		!LINGMO_TOOLCHAIN_USES_GLIBC || !LINGMO_TOOLCHAIN_HAS_THREADS || \
		LINGMO_STATIC_LIBS || !LINGMO_USE_WCHAR

comment "midori needs libgtk3 w/ X11 or wayland backend"
	depends on LINGMO_PACKAGE_MIDORI_ARCH_SUPPORTS
	depends on !LINGMO_PACKAGE_LIBGTK3_X11 && \
		!LINGMO_PACKAGE_LIBGTK3_WAYLAND

config LINGMO_PACKAGE_MIDORI
	bool "midori"
	depends on LINGMO_PACKAGE_MIDORI_ARCH_SUPPORTS
	depends on !LINGMO_STATIC_LIBS # webkitgtk
	depends on LINGMO_INSTALL_LIBSTDCPP # webkitgtk
	depends on LINGMO_HOST_GCC_AT_LEAST_8 # gobject-introspection
	depends on LINGMO_TOOLCHAIN_GCC_AT_LEAST_7 # webkitgtk
	depends on LINGMO_TOOLCHAIN_USES_GLIBC # webkitgtk
	depends on LINGMO_TOOLCHAIN_HAS_THREADS # libglib2
	depends on LINGMO_TOOLCHAIN_HAS_SYNC_4 # libgtk3
	depends on LINGMO_USE_WCHAR # granite, gcr, libsoup, libpeas, gobject-introspection
	depends on LINGMO_PACKAGE_LIBGTK3
	depends on LINGMO_PACKAGE_LIBGTK3_X11 || LINGMO_PACKAGE_LIBGTK3_WAYLAND
	select LINGMO_PACKAGE_GCR
	select LINGMO_PACKAGE_GRANITE
	select LINGMO_PACKAGE_JSON_GLIB
	select LINGMO_PACKAGE_LIBARCHIVE
	select LINGMO_PACKAGE_LIBPEAS
	select LINGMO_PACKAGE_LIBPEAS_WIDGETS
	select LINGMO_PACKAGE_LIBSOUP
	select LINGMO_PACKAGE_LIBXML2
	select LINGMO_PACKAGE_PYTHON3 # gobject-introspection
	select LINGMO_PACKAGE_SQLITE
	select LINGMO_PACKAGE_WEBKITGTK
	select LINGMO_PACKAGE_LIBICONV if !LINGMO_ENABLE_LOCALE
	help
	  Midori is a lightweight web browser based on WebKit

	  https://github.com/midori-browser/core
```

## package/mimic/Config.in
```kconfig
comment "mimic needs a toolchain w/ wchar"
	depends on !LINGMO_USE_WCHAR

config LINGMO_PACKAGE_MIMIC
	bool "mimic"
	depends on LINGMO_USE_WCHAR
	help
	  Mimic is a fast, lightweight Text-to-speech engine developed
	  by Mycroft A.I. and VocaliD, based on Carnegie Mellon
	  University's Flite (Festival-Lite) software. Mimic takes in
	  text and reads it out loud to create a high quality voice.

	  https://github.com/MycroftAI/mimic

if LINGMO_PACKAGE_MIMIC

choice
	prompt "audio backend"
	default LINGMO_PACKAGE_MIMIC_AUDIO_BACKEND_NONE

config LINGMO_PACKAGE_MIMIC_AUDIO_BACKEND_NONE
	bool "none"
	help
	  With no backend, mimic will only be able to produce .wav
	  files.

config LINGMO_PACKAGE_MIMIC_AUDIO_BACKEND_ALSA
	bool "alsa"
	depends on LINGMO_PACKAGE_ALSA_LIB

config LINGMO_PACKAGE_MIMIC_AUDIO_BACKEND_PORTAUDIO
	bool "alsa via portaudio"
	depends on LINGMO_PACKAGE_PORTAUDIO

config LINGMO_PACKAGE_MIMIC_AUDIO_BACKEND_PULSEAUDIO
	bool "pulseaudio"
	depends on LINGMO_PACKAGE_PULSEAUDIO

endchoice

endif # LINGMO_PACKAGE_MIMIC
```

## package/minetest-game/Config.in
```kconfig
config LINGMO_PACKAGE_MINETEST_GAME
	bool "minetest-game"
	depends on LINGMO_PACKAGE_MINETEST
	help
	  The main subgame for the Minetest engine.

	  https://github.com/minetest/minetest_game
```

## package/minetest/Config.in
```kconfig
config LINGMO_PACKAGE_MINETEST
	bool "minetest"
	depends on LINGMO_INSTALL_LIBSTDCPP # irrlichtMt (bundled)
	depends on LINGMO_TOOLCHAIN_GCC_AT_LEAST_5 # C++11
	depends on LINGMO_TOOLCHAIN_HAS_THREADS
	depends on LINGMO_PACKAGE_XORG7 # irrlichtMt (bundled)
	depends on LINGMO_PACKAGE_HAS_LIBGL # irrlichtMt (bundled)
	depends on LINGMO_PACKAGE_LUAJIT
	select LINGMO_PACKAGE_GMP
	select LINGMO_PACKAGE_JSONCPP
	select LINGMO_PACKAGE_SQLITE
	select LINGMO_PACKAGE_ZLIB
	select LINGMO_PACKAGE_ZSTD
	# At least one option must be enabled
	select LINGMO_PACKAGE_MINETEST_CLIENT if !LINGMO_PACKAGE_MINETEST_SERVER
	help
	  Minetest is a near-infinite-world block sandbox game and a
	  game engine, inspired by InfiniMiner, Minecraft, and the
	  like.

	  http://www.minetest.net

if LINGMO_PACKAGE_MINETEST

config LINGMO_PACKAGE_MINETEST_CLIENT
	bool "minetest client"
	select LINGMO_PACKAGE_BZIP2
	select LINGMO_PACKAGE_FREETYPE
	select LINGMO_PACKAGE_LIBPNG
	select LINGMO_PACKAGE_JPEG
	select LINGMO_PACKAGE_XLIB_LIBXI
	help
	  Build Minetest client.

config LINGMO_PACKAGE_MINETEST_SERVER
	bool "minetest server"
	help
	  Build Minetest server.

config LINGMO_PACKAGE_MINETEST_SOUND
	bool "enable sound"
	depends on LINGMO_PACKAGE_MINETEST_CLIENT
	depends on LINGMO_PACKAGE_OPENAL_ARCH_SUPPORTS
	depends on LINGMO_TOOLCHAIN_HAS_THREADS_NPTL # openal
	select LINGMO_PACKAGE_LIBVORBIS
	select LINGMO_PACKAGE_OPENAL

comment "sound support needs a toolchain w/ threads NPTL"
	depends on LINGMO_PACKAGE_MINETEST_CLIENT
	depends on LINGMO_PACKAGE_OPENAL_ARCH_SUPPORTS
	depends on !LINGMO_TOOLCHAIN_HAS_THREADS_NPTL

endif

comment "minetest needs a toolchain w/ C++, gcc >= 5.1, threads"
	depends on LINGMO_PACKAGE_LUAJIT_ARCH_SUPPORTS
	depends on !LINGMO_INSTALL_LIBSTDCPP \
		|| !LINGMO_TOOLCHAIN_GCC_AT_LEAST_5 \
		|| !LINGMO_TOOLCHAIN_HAS_THREADS

comment "minetest needs X11 and an OpenGL provider"
	depends on (LINGMO_INSTALL_LIBSTDCPP \
		&& LINGMO_TOOLCHAIN_GCC_AT_LEAST_5 \
		&& LINGMO_TOOLCHAIN_HAS_THREADS)
	depends on !LINGMO_PACKAGE_HAS_LIBGL || !LINGMO_PACKAGE_XORG7
```

## package/minicom/Config.in
```kconfig
config LINGMO_PACKAGE_MINICOM
	bool "minicom"
	depends on LINGMO_USE_WCHAR
	depends on LINGMO_USE_MMU # fork
	select LINGMO_PACKAGE_LIBICONV if !LINGMO_ENABLE_LOCALE
	select LINGMO_PACKAGE_NCURSES
	help
	  Minicom is a menu driven communications program. It emulates
	  ANSI and VT102 terminals. It has a dialing directory and auto
	  zmodem download.

	  https://salsa.debian.org/minicom-team/minicom

comment "minicom needs a toolchain w/ wchar"
	depends on LINGMO_USE_MMU
	depends on !LINGMO_USE_WCHAR
```

## package/minidlna/Config.in
```kconfig
config LINGMO_PACKAGE_MINIDLNA
	bool "minidlna"
	depends on !LINGMO_STATIC_LIBS
	depends on LINGMO_USE_WCHAR # flac
	depends on LINGMO_USE_MMU # fork
	depends on LINGMO_TOOLCHAIN_HAS_THREADS
	depends on LINGMO_PACKAGE_FFMPEG_ARCH_SUPPORTS
	select LINGMO_PACKAGE_FFMPEG
	select LINGMO_PACKAGE_FLAC
	select LINGMO_PACKAGE_LIBVORBIS # selects libogg
	select LINGMO_PACKAGE_LIBOGG
	select LINGMO_PACKAGE_LIBID3TAG # selects zlib
	select LINGMO_PACKAGE_LIBEXIF
	select LINGMO_PACKAGE_JPEG
	select LINGMO_PACKAGE_SQLITE
	help
	  MiniDLNA (aka ReadyDLNA) is server software with the aim of
	  being fully compliant with DLNA/UPnP-AV clients.

	  http://minidlna.sourceforge.net/

comment "minidlna needs a toolchain w/ dynamic library, threads, wchar"
	depends on LINGMO_USE_MMU
	depends on LINGMO_PACKAGE_FFMPEG_ARCH_SUPPORTS
	depends on !LINGMO_TOOLCHAIN_HAS_THREADS || !LINGMO_USE_WCHAR || \
		LINGMO_STATIC_LIBS
```

## package/minimodem/Config.in
```kconfig
config LINGMO_PACKAGE_MINIMODEM
	bool "minimodem"
	select LINGMO_PACKAGE_FFTW
	select LINGMO_PACKAGE_FFTW_SINGLE
	select LINGMO_PACKAGE_LIBSNDFILE if !LINGMO_PACKAGE_ALSA_LIB_PCM && !LINGMO_PACKAGE_PULSEAUDIO
	help
	  Minimodem is a command-line program which decodes (or
	  generates) audio modem tones at any specified baud rate,
	  using various framing protocols. It acts a general-purpose
	  software FSK modem, and includes support for various
	  standard FSK protocols such as Bell103, Bell202, RTTY,
	  TTY/TDD NOAA SAME, and Caller-ID.

	  http://www.whence.com/minimodem/
```

## package/minisign/Config.in
```kconfig
config LINGMO_PACKAGE_MINISIGN
	bool "minisign"
	depends on LINGMO_TOOLCHAIN_HAS_THREADS
	select LINGMO_PACKAGE_LIBSODIUM
	select LINGMO_PACKAGE_LIBSODIUM_FULL
	help
	  Minisign is a dead simple tool to sign files and verify
	  signatures.

	  https://github.com/jedisct1/minisign

comment "minisign needs a toolchain w/ threads"
	depends on !LINGMO_TOOLCHAIN_HAS_THREADS
```

## package/minissdpd/Config.in
```kconfig
config LINGMO_PACKAGE_MINISSDPD
	bool "minissdpd"
	depends on LINGMO_USE_MMU # fork()
	select LINGMO_PACKAGE_LIBNFNETLINK
	help
	  SSDP managing daemon. Designed to work with miniupnpc,
	  miniupnpd, minidlna, etc.

	  http://miniupnp.free.fr/
```

## package/miraclecast/Config.in
```kconfig
config LINGMO_PACKAGE_MIRACLECAST
	bool "miraclecast"
	depends on LINGMO_PACKAGE_SYSTEMD
	depends on LINGMO_TOOLCHAIN_USES_GLIBC
	depends on LINGMO_USE_WCHAR # glib2
	depends on LINGMO_TOOLCHAIN_HAS_THREADS # glib2
	depends on LINGMO_USE_MMU # glib2
	select LINGMO_PACKAGE_LIBGLIB2
	select LINGMO_PACKAGE_GSTREAMER1
	select LINGMO_PACKAGE_READLINE
	help
	  The MiracleCast project provides software to connect external
	  monitors to your system via Wifi. It is compatible to the
	  Wifi-Display specification also known as Miracast. MiracleCast
	  implements the Display-Source as well as Display-Sink side.

	  https://github.com/albfan/miraclecast

comment "miraclecast needs systemd and a glibc toolchain w/ threads and wchar"
	depends on LINGMO_USE_MMU
	depends on !LINGMO_TOOLCHAIN_USES_GLIBC || !LINGMO_USE_WCHAR \
		|| !LINGMO_TOOLCHAIN_HAS_THREADS || !LINGMO_PACKAGE_SYSTEMD
```

## package/mjpegtools/Config.in
```kconfig
config LINGMO_PACKAGE_MJPEGTOOLS
	bool "mjpegtools"
	depends on LINGMO_USE_MMU # fork
	depends on LINGMO_INSTALL_LIBSTDCPP
	depends on LINGMO_TOOLCHAIN_HAS_THREADS
	select LINGMO_PACKAGE_JPEG
	help
	  The mjpegtools programs are a set of tools
	  that can do recording of videos and playback,
	  simple cut-and-paste editing and the MPEG
	  compression of audio and video under Linux.

	  http://mjpeg.sourceforge.net

config LINGMO_PACKAGE_MJPEGTOOLS_SIMD_SUPPORT
	bool
	default y if LINGMO_X86_CPU_HAS_MMX
	default y if LINGMO_POWERPC_CPU_HAS_ALTIVEC

comment "mjpegtools needs a toolchain w/ C++, threads"
	depends on LINGMO_USE_MMU
	depends on !LINGMO_INSTALL_LIBSTDCPP || !LINGMO_TOOLCHAIN_HAS_THREADS
```

## package/mjpg-streamer/Config.in
```kconfig
config LINGMO_PACKAGE_MJPG_STREAMER
	bool "mjpg-streamer"
	depends on LINGMO_TOOLCHAIN_HEADERS_AT_LEAST_3_16 # V4L2_EVENT_SOURCE_CHANGE
	depends on LINGMO_TOOLCHAIN_HAS_THREADS
	depends on LINGMO_USE_MMU # fork()
	depends on !LINGMO_STATIC_LIBS # plugins need dlopen()
	select LINGMO_PACKAGE_JPEG
	help
	  MJPG-streamer takes JPGs from Linux-UVC compatible webcams,
	  filesystem or other input plugins and streams them as
	  M-JPEG via HTTP to webbrowsers, VLC and other software.

	  https://github.com/jacksonliam/mjpg-streamer

comment "mjpg-streamer needs a toolchain w/ threads, headers >= 3.16, dynamic library"
	depends on LINGMO_USE_MMU
	depends on !LINGMO_TOOLCHAIN_HAS_THREADS || \
		!LINGMO_TOOLCHAIN_HEADERS_AT_LEAST_3_16 || LINGMO_STATIC_LIBS
```

## package/moarvm/Config.in
```kconfig
config LINGMO_PACKAGE_MOARVM
	bool "moarvm"
	depends on LINGMO_TOOLCHAIN_HAS_THREADS_NPTL # libuv
	depends on !LINGMO_STATIC_LIBS # libuv
	depends on LINGMO_USE_MMU # libuv
	depends on LINGMO_PACKAGE_LIBATOMIC_OPS_ARCH_SUPPORTS # libatomic_ops
	depends on LINGMO_TOOLCHAIN_HAS_SYNC_4 # libuv
	depends on LINGMO_TOOLCHAIN_GCC_AT_LEAST_4_9 # libuv
	select LINGMO_PACKAGE_LIBUV
	select LINGMO_PACKAGE_LIBTOMMATH
	select LINGMO_PACKAGE_LIBATOMIC_OPS
	# dyncall does not work on riscv
	select LINGMO_PACKAGE_LIBFFI if LINGMO_riscv
	select LINGMO_PACKAGE_ZSTD
	help
	  Short for "Metamodel On A Runtime", MoarVM is a virtual
	  machine built especially for Rakudo Perl 6 and the NQP
	  Compiler Toolchain.

	  http://moarvm.com

comment "moarvm needs a toolchain w/ NPTL, dynamic library, gcc >= 4.9"
	depends on !LINGMO_TOOLCHAIN_HAS_THREADS_NPTL || LINGMO_STATIC_LIBS \
		|| !LINGMO_TOOLCHAIN_GCC_AT_LEAST_4_9
	depends on LINGMO_USE_MMU
	depends on LINGMO_PACKAGE_LIBATOMIC_OPS_ARCH_SUPPORTS
	depends on LINGMO_TOOLCHAIN_HAS_SYNC_4
```

## package/moby-buildkit/Config.in
```kconfig
config LINGMO_PACKAGE_MOBY_BUILDKIT
	bool "moby-buildkit"
	depends on LINGMO_PACKAGE_HOST_GO_TARGET_ARCH_SUPPORTS
	depends on LINGMO_PACKAGE_HOST_GO_TARGET_CGO_LINKING_SUPPORTS
	depends on LINGMO_TOOLCHAIN_HAS_THREADS
	depends on !LINGMO_TOOLCHAIN_USES_UCLIBC
	depends on LINGMO_USE_MMU
	select LINGMO_PACKAGE_CGROUPFS_MOUNT if !LINGMO_PACKAGE_SYSTEMD # runtime dependency
	help
	  BuildKit is a toolkit for converting source code to build
	  artifacts in an efficient, expressive and repeatable manner.

	  https://github.com/moby/buildkit

comment "moby-buildkit needs a glibc or musl toolchain w/ threads"
	depends on LINGMO_PACKAGE_HOST_GO_TARGET_ARCH_SUPPORTS
	depends on LINGMO_PACKAGE_HOST_GO_TARGET_CGO_LINKING_SUPPORTS
	depends on !LINGMO_TOOLCHAIN_HAS_THREADS || LINGMO_TOOLCHAIN_USES_UCLIBC
	depends on LINGMO_USE_MMU
```

## package/modem-manager/Config.in
```kconfig
config LINGMO_PACKAGE_MODEM_MANAGER
	bool "modem-manager"
	depends on LINGMO_USE_WCHAR # libglib2 and gnutls
	depends on LINGMO_TOOLCHAIN_HAS_THREADS # dbus, libglib2
	depends on LINGMO_USE_MMU # dbus
	depends on !LINGMO_STATIC_LIBS
	select LINGMO_PACKAGE_DBUS
	select LINGMO_PACKAGE_LIBGLIB2
	select LINGMO_PACKAGE_LIBGUDEV if LINGMO_PACKAGE_HAS_UDEV
	help
	  ModemManager is a DBus-activated daemon which controls mobile
	  broadband (2G/3G/4G) devices and connections.

	  http://www.freedesktop.org/wiki/Software/ModemManager/

if LINGMO_PACKAGE_MODEM_MANAGER

config LINGMO_PACKAGE_MODEM_MANAGER_LIBMBIM
	bool "MBIM support"
	select LINGMO_PACKAGE_LIBMBIM
	help
	  This option enables support for MBIM protocol

config LINGMO_PACKAGE_MODEM_MANAGER_LIBQMI
	bool "QMI support"
	select LINGMO_PACKAGE_LIBQMI
	help
	  This option enables support for QMI protocol

config LINGMO_PACKAGE_MODEM_MANAGER_LIBQRTR
	bool "QRTR support"
	depends on LINGMO_TOOLCHAIN_HEADERS_AT_LEAST_4_15 # libqrtr-glib
	select LINGMO_PACKAGE_LIBQRTR_GLIB
	select LINGMO_PACKAGE_MODEM_MANAGER_LIBQMI
	help
	  This option enables support for QRTR protocol

comment "QRTR support needs a toolchain w/ headers >= 4.15"
	depends on !LINGMO_TOOLCHAIN_HEADERS_AT_LEAST_4_15

endif

comment "modemmanager needs a toolchain w/ wchar, threads, dynamic library"
	depends on !LINGMO_USE_WCHAR || !LINGMO_TOOLCHAIN_HAS_THREADS || \
		LINGMO_STATIC_LIBS
	depends on LINGMO_USE_MMU
```

## package/modplugtools/Config.in
```kconfig
config LINGMO_PACKAGE_MODPLUGTOOLS
	bool "modplugtools"
	depends on LINGMO_INSTALL_LIBSTDCPP # libmodplug
	select LINGMO_PACKAGE_LIBAO
	select LINGMO_PACKAGE_LIBMODPLUG
	help
	  This installs the 'modplug123' command line tool to play
	  music files in the tracker formats supported by libmodplug:
	  MOD, S3M, XM etc.  Audio output is handled by libao.

	  http://modplug-xmms.sourceforge.net/

comment "modplugtools needs a toolchain w/ C++"
	depends on !LINGMO_INSTALL_LIBSTDCPP
```

## package/modsecurity2/Config.in
```kconfig
config LINGMO_PACKAGE_MODSECURITY2
	bool "modsecurity2"
	depends on LINGMO_PACKAGE_APACHE
	select LINGMO_PACKAGE_LIBXML2
	select LINGMO_PACKAGE_PCRE2
	help
	  ModSecurity is an open source, cross-platform web application
	  firewall (WAF) module. Known as the "Swiss Army Knife" of
	  WAFs, it enables web application defenders to gain visibility
	  into HTTP(S) traffic and provides a power rules language and
	  API to implement advanced protections.

	  https://github.com/SpiderLabs/ModSecurity
```
