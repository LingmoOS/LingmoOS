## package/libhtp/Config.in
```kconfig
config LINGMO_PACKAGE_LIBHTP
	bool "libhtp"
	select LINGMO_PACKAGE_LIBICONV if !LINGMO_ENABLE_LOCALE
	select LINGMO_PACKAGE_ZLIB
	help
	  LibHTP is a security-aware parser for the HTTP protocol and
	  the related bits and pieces.

	  https://github.com/OISF/libhtp
```

## package/libhttpserver/Config.in
```kconfig
config LINGMO_PACKAGE_LIBHTTPSERVER
	bool "libhttpserver"
	depends on LINGMO_TOOLCHAIN_GCC_AT_LEAST_7 # C++17
	depends on LINGMO_INSTALL_LIBSTDCPP
	depends on LINGMO_TOOLCHAIN_HAS_THREADS
	select LINGMO_PACKAGE_LIBMICROHTTPD
	help
	  libhttpserver is a C++ library for building high performance
	  RESTfuls web servers. libhttpserver is built upon
	  libmicrohttpd to provide a simple API for developers to
	  create HTTP services in C++.

	  https://github.com/etr/libhttpserver

comment "libhttpserver needs a toolchain w/ C++, threads, gcc >= 7"
	depends on !LINGMO_INSTALL_LIBSTDCPP || !LINGMO_TOOLCHAIN_HAS_THREADS || \
		!LINGMO_TOOLCHAIN_GCC_AT_LEAST_7
```

## package/libical/Config.in
```kconfig
config LINGMO_PACKAGE_LIBICAL
	bool "libical"
	depends on LINGMO_INSTALL_LIBSTDCPP
	depends on !LINGMO_STATIC_LIBS
	depends on LINGMO_USE_WCHAR
	select LINGMO_TARGET_TZ_INFO
	help
	  libical is an Open Source (MPL/LGPL) implementation of the
	  IETF's iCalendar Calendaring and Scheduling protocols.

	  http://libical.github.io/libical

comment "libical needs a toolchain w/ C++, dynamic library, wchar"
	depends on !LINGMO_INSTALL_LIBSTDCPP || !LINGMO_USE_WCHAR || \
		LINGMO_STATIC_LIBS
```

## package/libiconv/Config.in
```kconfig
config LINGMO_PACKAGE_LIBICONV
	bool "libiconv"
	depends on !LINGMO_ENABLE_LOCALE
	help
	  unicode conversion library

	  http://ftp.gnu.org/pub/gnu/libiconv

if LINGMO_PACKAGE_LIBICONV

config LINGMO_PACKAGE_LIBICONV_EXTRA_ENCODINGS
	bool "extra encodings"
	help
	  Provide support for a few extra encodings:

	  European languages
	    CP{437,737,775,852,853,855,857,858,860,861,863,865,869,1125}
	  Semitic languages
	    CP864
	  Japanese
	    EUC-JISX0213, Shift_JISX0213, ISO-2022-JP-3
	  Chinese
	    BIG5-2003 (experimental)
	  Turkmen
	    TDS565
	  Platform specifics
	    ATARIST, RISCOS-LATIN1

endif
```

## package/libidn/Config.in
```kconfig
config LINGMO_PACKAGE_LIBIDN
	bool "libidn"
	help
	  Libidn's purpose is to encode and decode internationalized
	  domain names.

	  http://www.gnu.org/software/libidn/

if LINGMO_PACKAGE_LIBIDN

config LINGMO_PACKAGE_LIBIDN_BINARY
	bool "idn binary"
	help
	  Install idn command line tool

endif
```

## package/libiec61850/Config.in
```kconfig
config LINGMO_PACKAGE_LIBIEC61850
	bool "libiec61850"
	depends on LINGMO_INSTALL_LIBSTDCPP
	depends on LINGMO_TOOLCHAIN_HAS_THREADS
	depends on !LINGMO_STATIC_LIBS
	help
	  IEC 61850 is an international standard for
	  communication systems in Substation Automation Systems
	  (SAS) and management of Decentralized Energy Resources
	  (DER). It is seen as one of the communication standards
	  of the emerging Smart Grid.

	  The project libIEC61850 provides a server and client
	  library for the IEC 61850/MMS, IEC 61850/GOOSE and IEC
	  61850-9-2/Sampled Values communication protocols
	  written in C. It is available under the GPLv3 license.

	  http://libiec61850.com

comment "libiec61850 needs a toolchain w/ C++, threads, dynamic library"
	depends on !LINGMO_INSTALL_LIBSTDCPP || !LINGMO_TOOLCHAIN_HAS_THREADS || LINGMO_STATIC_LIBS
```

## package/libiio/Config.in
```kconfig
config LINGMO_PACKAGE_LIBIIO
	bool "libiio"
	select LINGMO_PACKAGE_LIBIIO_LOCAL_BACKEND if !LINGMO_PACKAGE_LIBIIO_XML_BACKEND
	help
	  Libiio is a library to ease the development of software
	  interfacing Linux Industrial I/O (IIO) devices.

	  http://wiki.analog.com/resources/tools-software/linux-software/libiio

if LINGMO_PACKAGE_LIBIIO

config LINGMO_PACKAGE_LIBIIO_LOCAL_BACKEND
	bool "Local backend"
	default y
	help
	  Enable the local backend of the library.

config LINGMO_PACKAGE_LIBIIO_XML_BACKEND
	bool "XML backend"
	default y
	select LINGMO_PACKAGE_LIBXML2
	help
	  Enable the XML backend of the library.

config LINGMO_PACKAGE_LIBIIO_NETWORK_BACKEND
	bool "Network backend"
	default y
	select LINGMO_PACKAGE_LIBIIO_XML_BACKEND
	help
	  Enable the network backend of the library.

config LINGMO_PACKAGE_LIBIIO_USB_BACKEND
	bool "USB backend"
	default y
	depends on LINGMO_TOOLCHAIN_HAS_THREADS # libusb
	depends on LINGMO_TOOLCHAIN_GCC_AT_LEAST_4_9 # libusb
	select LINGMO_PACKAGE_LIBIIO_XML_BACKEND
	select LINGMO_PACKAGE_LIBUSB
	help
	  Enable the USB backend of the library.

comment "The USB backend needs a toolchain w/ threads, gcc >= 4.9"
	depends on !LINGMO_TOOLCHAIN_HAS_THREADS || \
		!LINGMO_TOOLCHAIN_GCC_AT_LEAST_4_9

config LINGMO_PACKAGE_LIBIIO_SERIAL_BACKEND
	bool "Serial backend"
	default y
	select LINGMO_PACKAGE_LIBIIO_XML_BACKEND
	select LINGMO_PACKAGE_LIBSERIALPORT
	help
	  Enable the serial backend of the library.

config LINGMO_PACKAGE_LIBIIO_IIOD
	bool "IIO Daemon"
	default y
	depends on LINGMO_TOOLCHAIN_HAS_THREADS
	select LINGMO_PACKAGE_LIBIIO_LOCAL_BACKEND
	help
	  Install the IIO Daemon.

config LINGMO_PACKAGE_LIBIIO_IIOD_USBD
	bool "USB support in the IIO Daemon (FunctionFS)"
	depends on LINGMO_PACKAGE_LIBIIO_IIOD
	depends on LINGMO_TOOLCHAIN_HEADERS_AT_LEAST_3_18 # usb_functionfs_descs_head_v2
	select LINGMO_PACKAGE_LIBAIO
	help
	  Add support for USB through FunctionFS with IIOD.

comment "USB support in the IIO Daemon requires headers >= 3.18"
	depends on LINGMO_PACKAGE_LIBIIO_IIOD
	depends on !LINGMO_TOOLCHAIN_HEADERS_AT_LEAST_3_18

comment "IIO Daemon needs a toolchain w/ threads"
	depends on !LINGMO_TOOLCHAIN_HAS_THREADS

config LINGMO_PACKAGE_LIBIIO_TESTS
	bool "Install test programs"
	depends on LINGMO_TOOLCHAIN_HAS_THREADS
	help
	  Install the test programs (iio_info, iio_genxml, iio_readdev).

comment "IIO test programs need a toolchain w/ threads"
	depends on !LINGMO_TOOLCHAIN_HAS_THREADS

config LINGMO_PACKAGE_LIBIIO_BINDINGS_CSHARP
	bool "Install C# bindings"
	depends on LINGMO_PACKAGE_MONO
	help
	  Install the C# bindings.

config LINGMO_PACKAGE_LIBIIO_BINDINGS_PYTHON
	bool "Install Python bindings"
	depends on LINGMO_PACKAGE_PYTHON3
	help
	  Install the Python bindings.

endif
```

## package/libimxvpuapi/Config.in
```kconfig
comment "libimxvpuapi needs an i.MX platform with VPU support"
	depends on LINGMO_arm
	depends on !LINGMO_PACKAGE_FREESCALE_IMX_HAS_VPU

config LINGMO_PACKAGE_LIBIMXVPUAPI
	bool "libimxvpuapi"
	depends on LINGMO_arm # Only relevant for i.MX
	depends on LINGMO_PACKAGE_FREESCALE_IMX_HAS_VPU
	select LINGMO_PACKAGE_IMX_VPU
	help
	  This library provides an API for using the iMX6 VPU video
	  engine. It is an alternative to Freescale's VPU
	  wrapper. Both the wrapper and this library are layered on
	  top of imx-vpu, the low-level iMX6 VPU interface.

	  https://github.com/Freescale/libimxvpuapi
```

## package/libiqrf/Config.in
```kconfig
config LINGMO_PACKAGE_LIBIQRF
	bool "libiqrf"
	depends on LINGMO_TOOLCHAIN_HAS_THREADS # libusb
	depends on LINGMO_TOOLCHAIN_GCC_AT_LEAST_4_9 # libusb
	select LINGMO_PACKAGE_LIBUSB
	help
	  This library implement specific protocol
	  which is used for communicating with iqrf devices
	  (http://iqrf.org) over usb. For usb access is used
	  libusb library.

	  https://github.com/nandra/libiqrf

comment "libiqrf needs a toolchain w/ threads, gcc >= 4.9"
	depends on !LINGMO_TOOLCHAIN_HAS_THREADS || \
		!LINGMO_TOOLCHAIN_GCC_AT_LEAST_4_9
```

## package/libjxl/Config.in
```kconfig
config LINGMO_PACKAGE_LIBJXL
	bool "libjxl"
	depends on LINGMO_TOOLCHAIN_GCC_AT_LEAST_7 # highway
	depends on LINGMO_TOOLCHAIN_HAS_ATOMIC # highway
	depends on LINGMO_TOOLCHAIN_HAS_THREADS
	depends on LINGMO_INSTALL_LIBSTDCPP # highway
	# libjxl fail to link statically due to libatomic issue
	depends on !LINGMO_STATIC_LIBS
	depends on !LINGMO_TOOLCHAIN_HAS_GCC_BUG_81426
	select LINGMO_HOST_CMAKE_AT_LEAST_3_19
	select LINGMO_PACKAGE_BROTLI
	select LINGMO_PACKAGE_HIGHWAY
	select LINGMO_PACKAGE_LCMS2
	help
	  libjxl is the reference implementation of JPEG XL (encoder
	  and decoder).

	  https://github.com/libjxl/libjxl

comment "libjxl needs a toolchain with C++, threads, gcc >= 7, dynamic library"
	depends on LINGMO_TOOLCHAIN_HAS_ATOMIC
	depends on !LINGMO_TOOLCHAIN_HAS_GCC_BUG_81426
	depends on !LINGMO_TOOLCHAIN_GCC_AT_LEAST_7 || \
		!LINGMO_INSTALL_LIBSTDCPP || \
		!LINGMO_TOOLCHAIN_HAS_THREADS || \
		LINGMO_STATIC_LIBS
```

## package/libkcapi/Config.in
```kconfig
config LINGMO_PACKAGE_LIBKCAPI
	bool "libkcapi"
	depends on LINGMO_TOOLCHAIN_HAS_SYNC_4
	help
	  Linux Kernel Crypto API userspace interface library

	  http://www.chronox.de/libkcapi.html

if LINGMO_PACKAGE_LIBKCAPI

config LINGMO_PACKAGE_LIBKCAPI_ASYM
	bool "build asymmetric ciphers library"
	help
	  Using this library requires the Linux kernel to be patched
	  with libkcapi Linux kernel patches found in libkcapi
	  kernel-patches/ directory.

config LINGMO_PACKAGE_LIBKCAPI_DGSTAPP
	bool "build dgst application"

config LINGMO_PACKAGE_LIBKCAPI_ENCAPP
	bool "build enc application"

config LINGMO_PACKAGE_LIBKCAPI_HASHER
	bool "build hasher application"
	depends on !LINGMO_STATIC_LIBS # dlfcn.h

comment "hasher application needs a toolchain w/ dynamic library"
	depends on LINGMO_STATIC_LIBS

config LINGMO_PACKAGE_LIBKCAPI_KPP
	bool "build KPP library"
	help
	  Using this library requires the Linux kernel to be patched
	  with libkcapi Linux kernel patches found in libkcapi
	  kernel-patches/ directory.

config LINGMO_PACKAGE_LIBKCAPI_RNGAPP
	bool "build rng read application"

config LINGMO_PACKAGE_LIBKCAPI_SPEED
	bool "build speed-test program"

config LINGMO_PACKAGE_LIBKCAPI_TEST
	bool "build test program"
	depends on LINGMO_USE_MMU # fork()

endif
```

## package/libkrb5/Config.in
```kconfig
config LINGMO_PACKAGE_LIBKRB5
	bool "libkrb5"
	# needs fork()
	depends on LINGMO_USE_MMU
	depends on !LINGMO_STATIC_LIBS
	select LINGMO_PACKAGE_LIBOPENSSL_ENABLE_DES if LINGMO_PACKAGE_LIBOPENSSL
	select LINGMO_PACKAGE_LIBOPENSSL_ENABLE_MD4 if LINGMO_PACKAGE_LIBOPENSSL
	select LINGMO_PACKAGE_LIBOPENSSL_ENABLE_RC4 if LINGMO_PACKAGE_LIBOPENSSL
	help
	  Kerberos is a system for authenticating users and services
	  on a network. Kerberos is a trusted third-party service.
	  That means that there is a third party (the Kerberos server)
	  that is trusted by all the entities on the network (users
	  and services, usually called "principals"). This is the MIT
	  reference implementation of Kerberos V5.

	  https://web.mit.edu/kerberos/

comment "libkrb5 needs a toolchain w/ dynamic library"
	depends on LINGMO_USE_MMU
	depends on LINGMO_STATIC_LIBS
```

## package/libks/Config.in
```kconfig
config LINGMO_PACKAGE_LIBKS
	bool "libks"
	depends on LINGMO_INSTALL_LIBSTDCPP
	depends on !LINGMO_STATIC_LIBS # dlfcn.h
	depends on LINGMO_TOOLCHAIN_HAS_THREADS_NPTL # pthread_setname_np()
	select LINGMO_PACKAGE_OPENSSL
	select LINGMO_PACKAGE_UTIL_LINUX
	select LINGMO_PACKAGE_UTIL_LINUX_LIBUUID
	help
	  Foundational support for signalwire C products

	  https://github.com/signalwire/libks

comment "libks needs a toolchain w/ C++, NPTL, dynamic library"
	depends on LINGMO_STATIC_LIBS || !LINGMO_INSTALL_LIBSTDCPP \
		|| !LINGMO_TOOLCHAIN_HAS_THREADS_NPTL
```

## package/libksba/Config.in
```kconfig
config LINGMO_PACKAGE_LIBKSBA
	bool "libksba"
	depends on LINGMO_PACKAGE_LIBGPG_ERROR_ARCH_SUPPORTS # libgpg-error
	select LINGMO_PACKAGE_LIBGPG_ERROR
	help
	  CMS and X.509 library

	  https://www.gnupg.org/related_software/libksba/
```

## package/libldns/Config.in
```kconfig
config LINGMO_PACKAGE_LIBLDNS
	bool "libldns"
	select LINGMO_PACKAGE_OPENSSL
	help
	  The goal of ldns is to simplify DNS programming, it supports
	  recent RFCs like the DNSSEC documents, and allows developers
	  to easily create software conforming to current RFCs, and
	  experimental software for current Internet Drafts.

	  http://www.nlnetlabs.nl/projects/ldns
```

## package/liblinear/Config.in
```kconfig
config LINGMO_PACKAGE_LIBLINEAR
	bool "liblinear"
	depends on LINGMO_INSTALL_LIBSTDCPP
	help
	  liblinear is a linear classifier for data with millions of
	  instances and features.

	  http://www.csie.ntu.edu.tw/~cjlin/liblinear/

comment "liblinear needs a toolchain w/ C++"
	depends on !LINGMO_INSTALL_LIBSTDCPP
```

## package/libllcp/Config.in
```kconfig
config LINGMO_PACKAGE_LIBLLCP
	bool "libllcp"
	depends on LINGMO_TOOLCHAIN_HAS_THREADS
	select LINGMO_PACKAGE_LIBNFC
	help
	  Library extending libnfc with support for Logical Link Control
	  Protocol.

	  https://github.com/nfc-tools/libllcp

comment "libllcp needs a toolchain w/ threads"
	depends on !LINGMO_TOOLCHAIN_HAS_THREADS
```

## package/liblo/Config.in
```kconfig
config LINGMO_PACKAGE_LIBLO
	bool "liblo"
	depends on LINGMO_TOOLCHAIN_HAS_THREADS
	help
	  liblo is an implementation of the Open Sound Control
	  protocol for POSIX systems

	  http://liblo.sourceforge.net/

comment "liblo needs a toolchain w/ threads"
	depends on !LINGMO_TOOLCHAIN_HAS_THREADS
```

## package/liblockfile/Config.in
```kconfig
config LINGMO_PACKAGE_LIBLOCKFILE
	bool "liblockfile"
	depends on LINGMO_USE_MMU # fork()
	help
	  NFS-safe locking library.

	  https://github.com/miquels/liblockfile
```

## package/libloki/Config.in
```kconfig
config LINGMO_PACKAGE_LIBLOKI
	bool "libloki"
	depends on LINGMO_INSTALL_LIBSTDCPP
	depends on LINGMO_TOOLCHAIN_HAS_THREADS
	help
	  A C++ library of designs, containing flexible
	  implementations of common design patterns and idioms.

	  http://sourceforge.net/projects/loki-lib

comment "libloki needs a toolchain w/ C++, threads"
	depends on !LINGMO_INSTALL_LIBSTDCPP || !LINGMO_TOOLCHAIN_HAS_THREADS
```

## package/libmad/Config.in
```kconfig
config LINGMO_PACKAGE_LIBMAD
	bool "libmad"
	help
	  High-quality MPEG audio decoder. All computations are
	  performed with fixed-point integer arithmetic, making it ideal
	  for systems without a floating-point unit.

	  http://www.underbit.com/products/mad/

if LINGMO_PACKAGE_LIBMAD

choice
	prompt "Speed vs. accuracy"
	default LINGMO_PACKAGE_LIBMAD_OPTIMIZATION_DEFAULT

config LINGMO_PACKAGE_LIBMAD_OPTIMIZATION_DEFAULT
	bool "Default"
	help
	  Keep optimizations balanced between speed and accuracy.

config LINGMO_PACKAGE_LIBMAD_OPTIMIZATION_SPEED
	bool "Optimize for speed over accuracy"
	help
	  Compromise accuracy for speed.

config LINGMO_PACKAGE_LIBMAD_OPTIMIZATION_ACCURACY
	bool "Optimize for accuracy over speed"
	help
	  Compromise speed for accuracy.

endchoice

config LINGMO_PACKAGE_LIBMAD_SSO
	bool "Subband synthesis optimization"
	help
	  Use the subband synthesis optimization, with reduced accuracy.

config LINGMO_PACKAGE_LIBMAD_ASO
	bool "Architecture-specific optimizations"
	default y
	# arm optimization needs classic arm instructions support
	depends on !(LINGMO_arm && !LINGMO_ARM_CPU_HAS_ARM)
	help
	  Use certain architecture-specific optimizations.

config LINGMO_PACKAGE_LIBMAD_STRICT_ISO
	bool "Strict ISO/IEC interpretations"
	help
	  Use strict ISO/IEC interpretations.

endif
```

## package/libmanette/Config.in
```kconfig
config LINGMO_PACKAGE_LIBMANETTE
	bool "libmanette"
	depends on LINGMO_USE_MMU # libglib2
	depends on LINGMO_USE_WCHAR # libglib2 -> gettext
	depends on LINGMO_TOOLCHAIN_HAS_THREADS # libglib2
	depends on LINGMO_TOOLCHAIN_HEADERS_AT_LEAST_4_16
	select LINGMO_PACKAGE_LIBEVDEV
	select LINGMO_PACKAGE_LIBGLIB2
	help
	  GObject library which provides access to game controllers.

	  https://gitlab.gnome.org/GNOME/libmanette

comment "libmanette needs a toolchain w/ wchar, threads, headers >= 4.16"
	depends on LINGMO_USE_MMU
	depends on !LINGMO_USE_WCHAR || !LINGMO_TOOLCHAIN_HAS_THREADS || \
		!LINGMO_TOOLCHAIN_HEADERS_AT_LEAST_4_16
```
