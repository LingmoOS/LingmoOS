## package/libmatroska/Config.in
```kconfig
config LINGMO_PACKAGE_LIBMATROSKA
	bool "libmatroska"
	depends on LINGMO_INSTALL_LIBSTDCPP
	depends on LINGMO_USE_WCHAR
	depends on LINGMO_TOOLCHAIN_GCC_AT_LEAST_4_9 # C++14
	select LINGMO_PACKAGE_LIBEBML
	help
	  Extensible open standard audio/video container format access
	  library.

	  http://matroska.org

comment "libmatroska needs a toolchain w/ C++, wchar, gcc >= 4.9"
	depends on !LINGMO_INSTALL_LIBSTDCPP || !LINGMO_USE_WCHAR || \
		!LINGMO_TOOLCHAIN_GCC_AT_LEAST_4_9
```

## package/libmbim/Config.in
```kconfig
config LINGMO_PACKAGE_LIBMBIM
	bool "libmbim"
	depends on LINGMO_USE_WCHAR # libglib2
	depends on LINGMO_TOOLCHAIN_HAS_THREADS # libglib2
	depends on LINGMO_USE_MMU # libglib2
	select LINGMO_PACKAGE_LIBGLIB2
	help
	  libmbim is a glib-based library for talking to WWAN modems and
	  devices which speak the Mobile Interface Broadband Model
	  (MBIM) protocol.

	  http://www.freedesktop.org/wiki/Software/libmbim/

comment "libmbim needs a toolchain w/ wchar, threads"
	depends on LINGMO_USE_MMU
	depends on !LINGMO_USE_WCHAR || !LINGMO_TOOLCHAIN_HAS_THREADS
```

## package/libmediaart/Config.in
```kconfig
comment "libmediaart needs a toolchain w/ wchar, threads"
	depends on LINGMO_USE_MMU
	depends on !LINGMO_USE_WCHAR || !LINGMO_TOOLCHAIN_HAS_THREADS

config LINGMO_PACKAGE_LIBMEDIAART
	bool "libmediaart"
	depends on LINGMO_USE_MMU # glib2
	depends on LINGMO_USE_WCHAR # glib2
	depends on LINGMO_TOOLCHAIN_HAS_THREADS # glib2
	select LINGMO_PACKAGE_LIBGLIB2
	help
	  Library tasked with managing, extracting and handling media
	  art caches

	  https://github.com/GNOME/libmediaart

if LINGMO_PACKAGE_LIBMEDIAART

choice
	prompt "media art backend"
	default LINGMO_PACKAGE_LIBMEDIAART_BACKEND_GDK_PIXBUF

config LINGMO_PACKAGE_LIBMEDIAART_BACKEND_GDK_PIXBUF
	bool "gdk-pixbuf"
	select LINGMO_PACKAGE_GDK_PIXBUF

config LINGMO_PACKAGE_LIBMEDIAART_BACKEND_QT
	bool "Qt"
	depends on LINGMO_PACKAGE_QT5
	select LINGMO_PACKAGE_QT5BASE_GUI

comment "Qt backend depends on Qt5"
	depends on !LINGMO_PACKAGE_QT5

endchoice

endif # LINGMO_PACKAGE_LIBMEDIAART
```
