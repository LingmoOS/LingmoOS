## package/perl-crypt-cbc/Config.in
```kconfig
config LINGMO_PACKAGE_PERL_CRYPT_CBC
	bool "perl-crypt-cbc"
	help
	  Encrypt Data with Cipher Block Chaining Mode.

	  https://metacpan.org/release/Crypt-CBC
```

## package/perl-crypt-openssl-aes/Config.in
```kconfig
config LINGMO_PACKAGE_PERL_CRYPT_OPENSSL_AES
	bool "perl-crypt-openssl-aes"
	depends on !LINGMO_STATIC_LIBS
	select LINGMO_PACKAGE_OPENSSL
	help
	  A Perl wrapper around OpenSSL's AES library.

	  https://metacpan.org/release/Crypt-OpenSSL-AES

comment "perl-crypt-openssl-aes needs a toolchain w/ dynamic library"
	depends on LINGMO_STATIC_LIBS
```

## package/perl-crypt-openssl-random/Config.in
```kconfig
config LINGMO_PACKAGE_PERL_CRYPT_OPENSSL_RANDOM
	bool "perl-crypt-openssl-random"
	depends on !LINGMO_STATIC_LIBS
	select LINGMO_PACKAGE_OPENSSL
	help
	  OpenSSL/LibreSSL pseudo-random number generator access.

	  https://metacpan.org/release/Crypt-OpenSSL-Random

comment "perl-crypt-openssl-random needs a toolchain w/ dynamic library"
	depends on LINGMO_STATIC_LIBS
```

## package/perl-crypt-openssl-rsa/Config.in
```kconfig
config LINGMO_PACKAGE_PERL_CRYPT_OPENSSL_RSA
	bool "perl-crypt-openssl-rsa"
	depends on !LINGMO_STATIC_LIBS
	select LINGMO_PACKAGE_OPENSSL
	select LINGMO_PACKAGE_PERL_CRYPT_OPENSSL_RANDOM # runtime
	select LINGMO_PACKAGE_LIBOPENSSL_ENABLE_RMD160 if LINGMO_PACKAGE_LIBOPENSSL
	help
	  RSA encoding and decoding, using the openSSL libraries.

	  http://github.com/toddr/Crypt-OpenSSL-RSA

comment "perl-crypt-openssl-rsa needs a toolchain w/ dynamic library"
	depends on LINGMO_STATIC_LIBS
```

## package/perl-data-optlist/Config.in
```kconfig
config LINGMO_PACKAGE_PERL_DATA_OPTLIST
	bool "perl-data-optlist"
	depends on !LINGMO_STATIC_LIBS
	select LINGMO_PACKAGE_PERL_PARAMS_UTIL # runtime
	select LINGMO_PACKAGE_PERL_SUB_INSTALL # runtime
	help
	  parse and validate simple name/value option pairs.

	  https://github.com/rjbs/Data-OptList

comment "perl-data-optlist needs a toolchain w/ dynamic library"
	depends on LINGMO_STATIC_LIBS
```

## package/perl-dbd-mysql/Config.in
```kconfig
config LINGMO_PACKAGE_PERL_DBD_MYSQL
	bool "perl-dbd-mysql"
	depends on !LINGMO_STATIC_LIBS
	depends on LINGMO_INSTALL_LIBSTDCPP # mysql
	depends on LINGMO_USE_MMU # mysql
	depends on LINGMO_TOOLCHAIN_HAS_THREADS # mysql
	select LINGMO_PACKAGE_MARIADB
	select LINGMO_PACKAGE_PERL_DBI # runtime
	help
	  A MySQL driver for the Perl5 Database Interface (DBI).

	  http://dbi.perl.org/

comment "perl-dbd-mysql needs a toolchain w/ dynamic library, C++, threads"
	depends on LINGMO_USE_MMU
	depends on LINGMO_STATIC_LIBS || !LINGMO_INSTALL_LIBSTDCPP || \
		!LINGMO_TOOLCHAIN_HAS_THREADS
```

## package/perl-dbi/Config.in
```kconfig
config LINGMO_PACKAGE_PERL_DBI
	bool "perl-dbi"
	depends on !LINGMO_STATIC_LIBS
	help
	  Database independent interface for Perl.

	  http://dbi.perl.org/

comment "perl-dbi needs a toolchain w/ dynamic library"
	depends on LINGMO_STATIC_LIBS
```

## package/perl-devel-cycle/Config.in
```kconfig
config LINGMO_PACKAGE_PERL_DEVEL_CYCLE
	bool "perl-devel-cycle"
	help
	  Find memory cycles in objects.

	  https://metacpan.org/release/Devel-Cycle
```

## package/perl-devel-globaldestruction/Config.in
```kconfig
config LINGMO_PACKAGE_PERL_DEVEL_GLOBALDESTRUCTION
	bool "perl-devel-globaldestruction"
	select LINGMO_PACKAGE_PERL_SUB_EXPORTER_PROGRESSIVE # runtime
	help
	  Provides function returning the equivalent of
	  ${^GLOBAL_PHASE} eq 'DESTRUCT' for older perls.

	  https://metacpan.org/release/Devel-GlobalDestruction
```

## package/perl-devel-size/Config.in
```kconfig
config LINGMO_PACKAGE_PERL_DEVEL_SIZE
	bool "perl-devel-size"
	depends on !LINGMO_STATIC_LIBS
	help
	  Perl extension for finding the memory usage of Perl
	  variables.

	  https://metacpan.org/release/Devel-Size

comment "perl-devel-size needs a toolchain w/ dynamic library"
	depends on LINGMO_STATIC_LIBS
```

## package/perl-device-serialport/Config.in
```kconfig
config LINGMO_PACKAGE_PERL_DEVICE_SERIALPORT
	bool "perl-device-serialport"
	depends on !LINGMO_STATIC_LIBS
	help
	  Linux/POSIX emulation of Win32::SerialPort functions.

	  https://metacpan.org/release/Device-SerialPort

comment "perl-device-serialport needs a toolchain w/ dynamic library"
	depends on LINGMO_STATIC_LIBS
```

## package/perl-digest-sha1/Config.in
```kconfig
config LINGMO_PACKAGE_PERL_DIGEST_SHA1
	bool "perl-digest-sha1"
	depends on !LINGMO_STATIC_LIBS
	help
	  Perl interface to the SHA-1 algorithm.

	  https://metacpan.org/release/Digest-SHA1

comment "perl-digest-sha1 needs a toolchain w/ dynamic library"
	depends on LINGMO_STATIC_LIBS
```

## package/perl-dist-checkconflicts/Config.in
```kconfig
config LINGMO_PACKAGE_PERL_DIST_CHECKCONFLICTS
	bool "perl-dist-checkconflicts"
	select LINGMO_PACKAGE_PERL_MODULE_RUNTIME # runtime
	help
	  declare version conflicts for your dist.

	  http://metacpan.org/release/Dist-CheckConflicts
```

## package/perl-encode-detect/Config.in
```kconfig
config LINGMO_PACKAGE_PERL_ENCODE_DETECT
	bool "perl-encode-detect"
	depends on LINGMO_INSTALL_LIBSTDCPP
	depends on !LINGMO_STATIC_LIBS
	help
	  An Encode::Encoding subclass that detects the encoding of
	  data.

	  https://metacpan.org/release/Encode-Detect

comment "perl-encode-detect needs a toolchain w/ C++, dynamic library"
	depends on LINGMO_STATIC_LIBS || !LINGMO_INSTALL_LIBSTDCPP
```

## package/perl-encode-locale/Config.in
```kconfig
config LINGMO_PACKAGE_PERL_ENCODE_LOCALE
	bool "perl-encode-locale"
	help
	  Determine the locale encoding.

	  https://metacpan.org/release/Encode-Locale
```

## package/perl-file-util/Config.in
```kconfig
config LINGMO_PACKAGE_PERL_FILE_UTIL
	bool "perl-file-util"
	help
	  Easy, versatile, portable file handling.

	  https://github.com/tommybutler/file-util/wiki
```

## package/perl-gd/Config.in
```kconfig
config LINGMO_PACKAGE_PERL_GD
	bool "perl-gd"
	depends on !LINGMO_STATIC_LIBS
	select LINGMO_PACKAGE_ZLIB
	select LINGMO_PACKAGE_GD
	help
	  Perl interface to the libgd graphics library.

	  https://metacpan.org/release/GD

comment "perl-gd needs a toolchain w/ dynamic library"
	depends on LINGMO_STATIC_LIBS
```

## package/perl-gdgraph/Config.in
```kconfig
config LINGMO_PACKAGE_PERL_GDGRAPH
	bool "perl-gdgraph"
	depends on !LINGMO_STATIC_LIBS
	select LINGMO_PACKAGE_PERL_GD # runtime
	select LINGMO_PACKAGE_PERL_GDTEXTUTIL # runtime
	help
	  Produces charts with GD.

	  https://metacpan.org/release/GDGraph

comment "perl-gdgraph needs a toolchain w/ dynamic library"
	depends on LINGMO_STATIC_LIBS
```

## package/perl-html-parser/Config.in
```kconfig
config LINGMO_PACKAGE_PERL_HTML_PARSER
	bool "perl-html-parser"
	depends on !LINGMO_STATIC_LIBS
	select LINGMO_PACKAGE_PERL_HTML_TAGSET # runtime
	select LINGMO_PACKAGE_PERL_HTTP_MESSAGE # runtime
	select LINGMO_PACKAGE_PERL_URI # runtime
	help
	  HTML parser class.

	  https://github.com/libwww-perl/HTML-Parser

comment "perl-html-parser needs a toolchain w/ dynamic library"
	depends on LINGMO_STATIC_LIBS
```

## package/perl-http-cookies/Config.in
```kconfig
config LINGMO_PACKAGE_PERL_HTTP_COOKIES
	bool "perl-http-cookies"
	depends on !LINGMO_STATIC_LIBS # perl-http-message -> perl-clone
	select LINGMO_PACKAGE_PERL_HTTP_DATE # runtime
	select LINGMO_PACKAGE_PERL_HTTP_MESSAGE # runtime
	help
	  HTTP cookie jars.

	  https://github.com/libwww-perl/HTTP-Cookies

comment "perl-http-cookies needs a toolchain w/ dynamic library"
	depends on LINGMO_STATIC_LIBS
```

## package/perl-http-daemon/Config.in
```kconfig
config LINGMO_PACKAGE_PERL_HTTP_DAEMON
	bool "perl-http-daemon"
	depends on !LINGMO_STATIC_LIBS # perl-http-message -> perl-clone
	select LINGMO_PACKAGE_PERL_HTTP_DATE # runtime
	select LINGMO_PACKAGE_PERL_HTTP_MESSAGE # runtime
	select LINGMO_PACKAGE_PERL_LWP_MEDIATYPES # runtime
	help
	  A simple http server class.

	  https://github.com/libwww-perl/HTTP-Daemon

comment "perl-http-daemon needs a toolchain w/ dynamic library"
	depends on LINGMO_STATIC_LIBS
```

## package/perl-http-headers-fast/Config.in
```kconfig
config LINGMO_PACKAGE_PERL_HTTP_HEADERS_FAST
	bool "perl-http-headers-fast"
	select LINGMO_PACKAGE_PERL_HTTP_DATE # runtime
	help
	  faster implementation of HTTP::Headers.

	  https://github.com/tokuhirom/HTTP-Headers-Fast
```

## package/perl-http-message/Config.in
```kconfig
config LINGMO_PACKAGE_PERL_HTTP_MESSAGE
	bool "perl-http-message"
	depends on !LINGMO_STATIC_LIBS # perl-clone
	select LINGMO_PACKAGE_PERL_CLONE # runtime
	select LINGMO_PACKAGE_PERL_ENCODE_LOCALE # runtime
	select LINGMO_PACKAGE_PERL_HTTP_DATE # runtime
	select LINGMO_PACKAGE_PERL_IO_HTML # runtime
	select LINGMO_PACKAGE_PERL_LWP_MEDIATYPES # runtime
	select LINGMO_PACKAGE_PERL_URI # runtime
	help
	  HTTP style message (base class).

	  https://github.com/libwww-perl/HTTP-Message

comment "perl-http-message needs a toolchain w/ dynamic library"
	depends on LINGMO_STATIC_LIBS
```

## package/perl-http-negotiate/Config.in
```kconfig
config LINGMO_PACKAGE_PERL_HTTP_NEGOTIATE
	bool "perl-http-negotiate"
	depends on !LINGMO_STATIC_LIBS # perl-http-message -> perl-clone
	select LINGMO_PACKAGE_PERL_HTTP_MESSAGE # runtime
	help
	  choose a variant to serve.

	  https://metacpan.org/release/HTTP-Negotiate

comment "perl-http-negotiate needs a toolchain w/ dynamic library"
	depends on LINGMO_STATIC_LIBS
```

## package/perl-i18n/Config.in
```kconfig
config LINGMO_PACKAGE_PERL_I18N
	bool "perl-i18n"
	select LINGMO_PACKAGE_PERL_LOCALE_MAKETEXT_LEXICON # runtime
	help
	  Perl Internationalization Pragma.

	  https://metacpan.org/release/i18n
```
