## package/gstreamer1/gst1-plugins-ugly/Config.in
```kconfig
menuconfig LINGMO_PACKAGE_GST1_PLUGINS_UGLY
	bool "gst1-plugins-ugly"
	select LINGMO_PACKAGE_GST1_PLUGINS_BASE
	help
	  A set of well-supported plug-ins for GStreamer, but might pose
	  problems for distributors.

	  https://gstreamer.freedesktop.org/

if LINGMO_PACKAGE_GST1_PLUGINS_UGLY

comment "dependency-less plugins"

config LINGMO_PACKAGE_GST1_PLUGINS_UGLY_PLUGIN_ASFDEMUX
	bool "asfdemux"
	help
	  Demuxes and muxes audio and video in Microsofts ASF format

config LINGMO_PACKAGE_GST1_PLUGINS_UGLY_PLUGIN_DVDLPCMDEC
	bool "dvdlpcmdec"
	help
	  Decode DVD LPCM frames into standard PCM

config LINGMO_PACKAGE_GST1_PLUGINS_UGLY_PLUGIN_DVDSUB
	bool "dvdsub"
	help
	  DVD subtitle parser and decoder

config LINGMO_PACKAGE_GST1_PLUGINS_UGLY_PLUGIN_REALMEDIA
	bool "realmedia"
	help
	  RealMedia support plugins

comment "plugins with external dependencies (there may be more available)"

config LINGMO_PACKAGE_GST1_PLUGINS_UGLY_PLUGIN_DVDREAD
	bool "dvdread"
	select LINGMO_PACKAGE_LIBDVDREAD
	help
	  Access a DVD with dvdread

config LINGMO_PACKAGE_GST1_PLUGINS_UGLY_PLUGIN_MPEG2DEC
	bool "mpeg2dec"
	select LINGMO_PACKAGE_LIBMPEG2
	help
	  LibMpeg2 decoder

config LINGMO_PACKAGE_GST1_PLUGINS_UGLY_PLUGIN_X264
	bool "x264"
	select LINGMO_PACKAGE_X264
	help
	  x264 encoder

# Note: to get descriptions use the following.
# # find . -name 'plugin-*.xml' | xargs grep -m 1 description
endif
```

## package/gstreamer1/gst1-python/Config.in
```kconfig
config LINGMO_PACKAGE_GST1_PYTHON
	bool "gst1-python"
	depends on LINGMO_USE_MMU # libglib2, gobject-introspection
	depends on LINGMO_PACKAGE_GOBJECT_INTROSPECTION_ARCH_SUPPORTS # gobject-introspection
	depends on LINGMO_HOST_GCC_AT_LEAST_8 # gobject-introspection -> host-qemu
	depends on LINGMO_TOOLCHAIN_GCC_AT_LEAST_4_9 # gobject-introspection
	depends on LINGMO_TOOLCHAIN_USES_GLIBC # gobject-introspection
	depends on LINGMO_PACKAGE_PYTHON3 # gobject-introspection
	select LINGMO_PACKAGE_GOBJECT_INTROSPECTION
	select LINGMO_PACKAGE_GST1_PLUGINS_BASE
	select LINGMO_PACKAGE_LIBGLIB2
	select LINGMO_PACKAGE_PYTHON_GOBJECT
	help
	  GStreamer python overrides for the gobject-introspection-based
	  pygst bindings.

	  https://gstreamer.freedesktop.org/modules/gst-python.html

comment "gst1-python needs python3"
	depends on !LINGMO_PACKAGE_PYTHON3

comment "gst1-python needs a glibc toolchain, gcc >= 4.9, host gcc >= 8"
	depends on LINGMO_USE_MMU
	depends on LINGMO_PACKAGE_GOBJECT_INTROSPECTION_ARCH_SUPPORTS
	depends on !LINGMO_TOOLCHAIN_USES_GLIBC || \
		!LINGMO_TOOLCHAIN_GCC_AT_LEAST_4_9 || !LINGMO_HOST_GCC_AT_LEAST_8
```

## package/gstreamer1/gst1-rtsp-server/Config.in
```kconfig
config LINGMO_PACKAGE_GST1_RTSP_SERVER
	bool "gst1-rtsp-server"
	select LINGMO_PACKAGE_GST1_PLUGINS_BASE
	select LINGMO_PACKAGE_GST1_PLUGINS_BASE_PLUGIN_APP # runtime
	select LINGMO_PACKAGE_GST1_PLUGINS_GOOD
	select LINGMO_PACKAGE_GST1_PLUGINS_GOOD_PLUGIN_RTP # runtime
	select LINGMO_PACKAGE_GST1_PLUGINS_GOOD_PLUGIN_RTPMANAGER # runtime
	select LINGMO_PACKAGE_GST1_PLUGINS_GOOD_PLUGIN_UDP # runtime
	help
	  RTSP server library based on GStreamer.

	  https://gstreamer.freedesktop.org/
```

## package/gstreamer1/gst1-vaapi/Config.in
```kconfig
config LINGMO_PACKAGE_GST1_VAAPI
	bool "gst1-vaapi"
	depends on !LINGMO_STATIC_LIBS # dlopen(), libva
	depends on LINGMO_TOOLCHAIN_HAS_THREADS # libva, libdrm
	depends on LINGMO_INSTALL_LIBSTDCPP # gst1-plugins-bad
	depends on LINGMO_PACKAGE_HAS_UDEV
	select LINGMO_PACKAGE_LIBVA
	select LINGMO_PACKAGE_LIBDRM
	select LINGMO_PACKAGE_GST1_PLUGINS_BASE
	select LINGMO_PACKAGE_GST1_PLUGINS_BAD # gstreamer-codecparsers
	select LINGMO_PACKAGE_WAYLAND_PROTOCOLS if LINGMO_PACKAGE_WAYLAND
	select LINGMO_PACKAGE_XLIB_LIBX11 if LINGMO_PACKAGE_XORG7
	select LINGMO_PACKAGE_XLIB_LIBXRANDR if LINGMO_PACKAGE_XORG7
	help
	  gstreamer-vaapi consists in a collection of VA-API based
	  plugins for GStreamer and helper libraries.

	  vaapi<CODEC>dec is used to decode JPEG, MPEG-2, MPEG-4:2,
	  H.264 AVC, H.264 MVC, VP8, VC-1, WMV3, HEVC videos to VA
	  surfaces, depending on the actual value of <CODEC> and the
	  underlying hardware capabilities.  This plugin is also able
	  to implicitly download the decoded surface to raw YUV
	  buffers.

	  vaapi<CODEC>enc is used to encode into MPEG-2, H.264 AVC,
	  H.264 MVC, JPEG, VP8, HEVC videos, depending on the actual
	  value of <CODEC> (mpeg2, h264, etc.) and the hardware
	  capabilities. By default, raw format bitstreams are
	  generated, so the result may be piped to a muxer, e.g. qtmux
	  for MP4 containers.

	  vaapipostproc is used to filter VA surfaces, for
	  e.g. scaling, deinterlacing (bob, motion-adaptive,
	  motion-compensated), noise reduction or sharpening. This
	  plugin is also used to upload raw YUV pixels into VA
	  surfaces.

	  vaapisink is used to render VA surfaces to an X11 or Wayland
	  display. This plugin also features a "headless" mode (DRM)
	  more suited to remote transcode scenarios, with faster
	  throughput.

	  https://cgit.freedesktop.org/gstreamer/gstreamer-vaapi

if LINGMO_PACKAGE_GST1_VAAPI

config LINGMO_PACKAGE_GST1_VAAPI_ENCODERS
	bool "enable encoders"

endif

comment "gst1-vaapi needs udev /dev management and a toolchain w/ threads, dynamic library, C++"
	depends on !LINGMO_TOOLCHAIN_HAS_THREADS || LINGMO_STATIC_LIBS || \
		!LINGMO_PACKAGE_HAS_UDEV || !LINGMO_INSTALL_LIBSTDCPP
```

## package/gstreamer1/gstd/Config.in
```kconfig
config LINGMO_PACKAGE_GSTD
	bool "gstd"
	depends on LINGMO_USE_WCHAR # libglib2 -> gettext, libedit, libsoup
	depends on LINGMO_TOOLCHAIN_HAS_THREADS # libglib2, libsoup
	depends on LINGMO_USE_MMU # libdaemon, libedit, libglib2
	select LINGMO_PACKAGE_GSTREAMER1_GST_DEBUG # gst_debug_bin_to_dot_data
	select LINGMO_PACKAGE_JANSSON
	select LINGMO_PACKAGE_JSON_GLIB
	select LINGMO_PACKAGE_LIBDAEMON
	select LINGMO_PACKAGE_LIBEDIT
	select LINGMO_PACKAGE_LIBGLIB2
	select LINGMO_PACKAGE_LIBSOUP
	help
	  GStreamer Daemon, also called gstd, is a GStreamer framework
	  for controlling audio and video streaming using an
	  InterProcess Communication protocol.

	  https://developer.ridgerun.com/wiki/index.php?title=GStreamer_Daemon
```

## package/gstreamer1/gstreamer1-editing-services/Config.in
```kconfig
config LINGMO_PACKAGE_GSTREAMER1_EDITING_SERVICES
	bool "gstreamer1-editing-services"
	select LINGMO_PACKAGE_LIBXML2
	select LINGMO_PACKAGE_GST1_PLUGINS_BASE
	select LINGMO_PACKAGE_GST1_PLUGINS_GOOD
	select LINGMO_PACKAGE_GST1_PLUGINS_BASE_PLUGIN_AUDIOCONVERT # runtime
	select LINGMO_PACKAGE_GST1_PLUGINS_BASE_PLUGIN_AUDIOMIXER # runtime
	select LINGMO_PACKAGE_GST1_PLUGINS_BASE_PLUGIN_AUDIORESAMPLE # runtime
	select LINGMO_PACKAGE_GST1_PLUGINS_BASE_PLUGIN_VIDEOCONVERTSCALE # runtime
	select LINGMO_PACKAGE_GST1_PLUGINS_BASE_PLUGIN_VIDEOTESTSRC # runtime
	select LINGMO_PACKAGE_GST1_PLUGINS_BASE_PLUGIN_VOLUME # runtime
	select LINGMO_PACKAGE_GST1_PLUGINS_GOOD_PLUGIN_IMAGEFREEZE # runtime
	help
	  GStreamer Editing Services is a high-level library for
	  facilitating the creation of audio/video non-linear editors.

	  https://gstreamer.freedesktop.org
```

## package/gstreamer1/gstreamer1/Config.in
```kconfig
comment "gstreamer 1.x needs a toolchain w/ wchar, threads"
	depends on LINGMO_USE_MMU
	depends on !LINGMO_USE_WCHAR || !LINGMO_TOOLCHAIN_HAS_THREADS

config LINGMO_PACKAGE_GSTREAMER1
	bool "gstreamer 1.x"
	depends on LINGMO_USE_WCHAR # glib2
	depends on LINGMO_TOOLCHAIN_HAS_THREADS # glib2
	depends on LINGMO_USE_MMU # glib2
	select LINGMO_PACKAGE_LIBGLIB2
	help
	  GStreamer is an open source multimedia framework. This 1.x
	  version of Gstreamer is incompatible with Gstreamer 0.10.x.

	  https://gstreamer.freedesktop.org/

if LINGMO_PACKAGE_GSTREAMER1

config LINGMO_PACKAGE_GSTREAMER1_CHECK
	bool "enable unit test libraries"
	help
	  Enable building unit test libraries for gstreamer.

config LINGMO_PACKAGE_GSTREAMER1_PARSE
	bool "enable command-line parser"
	default y
	help
	  Enable command line parser for gstreamer. This may increase
	  the CPU overhead by a small amount.

config LINGMO_PACKAGE_GSTREAMER1_TRACE
	bool "enable tracing subsystem"
	default y
	help
	  Enable the tracing subsystem within gstreamer. This may
	  increase CPU overhead by a small amount.

config LINGMO_PACKAGE_GSTREAMER1_GST_DEBUG
	bool "enable gst-debug trace support"
	default y
	help
	  Enable support for the gst-debug tracing functionality in
	  gstreamer.  This has limited CPU overhead, but does increase
	  the rootfs size somewhat.

config LINGMO_PACKAGE_GSTREAMER1_PLUGIN_REGISTRY
	bool "enable plugin registry"
	default y
	help
	  Enable support for the GStreamer plugin registry. This may
	  increase the launch-time for a GStreamer application.

config LINGMO_PACKAGE_GSTREAMER1_INSTALL_TOOLS
	bool "install tools"
	default y
	help
	  Install the gst-inspect, gst-launch, gst-stats and
	  gst-typefind tools. This will take up additional space on
	  the target.

endif
```

## package/gtk2-engines/Config.in
```kconfig
config LINGMO_PACKAGE_GTK2_ENGINES
	bool "gtk engines"
	depends on LINGMO_PACKAGE_LIBGTK2
	help
	  A collection of basic theme engines for GTK+.
```

## package/gtkmm3/Config.in
```kconfig
comment "gtkmm3 needs libgtk3 and a toolchain w/ C++, wchar, threads, gcc >= 4.9"
	depends on LINGMO_USE_MMU
	depends on LINGMO_TOOLCHAIN_HAS_SYNC_4
	depends on !LINGMO_TOOLCHAIN_GCC_AT_LEAST_4_9 || !LINGMO_USE_WCHAR \
		|| !LINGMO_INSTALL_LIBSTDCPP || !LINGMO_PACKAGE_LIBGTK3 \
		|| !LINGMO_TOOLCHAIN_HAS_THREADS

config LINGMO_PACKAGE_GTKMM3
	bool "gtkmm3"
	# Broken on existing external/internal nios2 toolchains,
	# revisit when they are upgraded with at least Binutils >= 2.26
	# and GCC >= 5.3.
	# https://sourceware.org/bugzilla/show_bug.cgi?id=19405
	depends on !LINGMO_nios2
	depends on LINGMO_TOOLCHAIN_HAS_SYNC_4 # pangomm, libgtk3 -> pango -> harfbuzz
	depends on LINGMO_INSTALL_LIBSTDCPP # glibmm, libpangomm -> glibmm/pango
	depends on LINGMO_TOOLCHAIN_GCC_AT_LEAST_4_9 # C++11
	depends on LINGMO_TOOLCHAIN_HAS_THREADS # *mm/libgtk3 -> libglib2
	depends on LINGMO_USE_MMU # *mm/libgtk3 -> libglib2
	depends on LINGMO_USE_WCHAR # *mm/libgtk3 -> libglib2
	depends on LINGMO_PACKAGE_LIBGTK3
	select LINGMO_PACKAGE_ATKMM2_28
	select LINGMO_PACKAGE_CAIROMM1_14
	select LINGMO_PACKAGE_GLIBMM2_66
	select LINGMO_PACKAGE_LIBSIGC2
	select LINGMO_PACKAGE_PANGOMM2_46
	help
	  The gtkmm3 package is a set of C++ bindings for GTK 3.

	  http://www.gtkmm.org/
```

## package/gtksourceview/Config.in
```kconfig
config LINGMO_PACKAGE_GTKSOURCEVIEW
	bool "gtksourceview"
	depends on LINGMO_PACKAGE_LIBGTK3
	select LINGMO_PACKAGE_LIBXML2
	help
	  GtkSourceView is a portable C library that extends the
	  standard GTK+ framework for multiline text editing with
	  support for configurable syntax highlighting, unlimited
	  undo/redo, search and replace, a completion framework,
	  printing and other features typical of a source code editor.

	  https://projects.gnome.org/gtksourceview
```

## package/guile/Config.in
```kconfig
config LINGMO_PACKAGE_GUILE
	bool "guile"
	depends on LINGMO_USE_MMU # bdwgc
	depends on !LINGMO_TOOLCHAIN_USES_MUSL # no strtol_l
	depends on LINGMO_TOOLCHAIN_HAS_THREADS
	depends on LINGMO_PACKAGE_LIBATOMIC_OPS_ARCH_SUPPORTS # bdwgc
	depends on LINGMO_USE_WCHAR # libunistring
	depends on !LINGMO_STATIC_LIBS
	select LINGMO_PACKAGE_LIBUNISTRING
	select LINGMO_PACKAGE_LIBFFI
	select LINGMO_PACKAGE_GMP
	select LINGMO_PACKAGE_BDWGC
	select LINGMO_PACKAGE_LIBICONV if !LINGMO_ENABLE_LOCALE
	help
	  Guile is an interpreter and compiler for the Scheme
	  programming language, a clean and elegant dialect of Lisp.

	  http://www.gnu.org/software/guile

comment "guile needs a uClibc or glibc toolchain w/ threads, wchar, dynamic library"
	depends on LINGMO_PACKAGE_LIBATOMIC_OPS_ARCH_SUPPORTS
	depends on LINGMO_USE_MMU
	depends on !LINGMO_TOOLCHAIN_HAS_THREADS || !LINGMO_USE_WCHAR || \
		LINGMO_STATIC_LIBS || LINGMO_TOOLCHAIN_USES_MUSL
```

## package/gupnp-av/Config.in
```kconfig
config LINGMO_PACKAGE_GUPNP_AV
	bool "gupnp-av"
	depends on LINGMO_USE_WCHAR # glib2, gupnp
	depends on LINGMO_TOOLCHAIN_HAS_THREADS # glib2, gupnp
	depends on LINGMO_USE_MMU # glib2, gupnp
	select LINGMO_PACKAGE_LIBGLIB2
	select LINGMO_PACKAGE_GUPNP
	select LINGMO_PACKAGE_LIBXML2
	help
	  GUPnP-AV is a collection of helpers for building AV
	  (audio/video) applications using GUPnP.

	  http://www.gupnp.org/

comment "gupnp-av needs a toolchain w/ wchar, threads"
	depends on LINGMO_USE_MMU
	depends on !LINGMO_USE_WCHAR || !LINGMO_TOOLCHAIN_HAS_THREADS
```

## package/gupnp-dlna/Config.in
```kconfig
config LINGMO_PACKAGE_GUPNP_DLNA
	bool "gupnp-dlna"
	depends on LINGMO_USE_WCHAR # glib2
	depends on LINGMO_TOOLCHAIN_HAS_THREADS # glib2
	depends on LINGMO_USE_MMU # glib2
	select LINGMO_PACKAGE_LIBGLIB2
	select LINGMO_PACKAGE_LIBXML2
	help
	  GUPnP DLNA is a small utility library that aims to ease the
	  DLNA-related tasks such as media profile guessing, transcoding
	  to a given profile, etc.

	  http://www.gupnp.org/

comment "gupnp-dlna needs a toolchain w/ wchar, threads"
	depends on LINGMO_USE_MMU
	depends on !LINGMO_USE_WCHAR || !LINGMO_TOOLCHAIN_HAS_THREADS
```

## package/gupnp/Config.in
```kconfig
config LINGMO_PACKAGE_GUPNP
	bool "gupnp"
	depends on LINGMO_USE_WCHAR # glib2, gssdp
	depends on LINGMO_TOOLCHAIN_HAS_THREADS # glib2, gssdp
	depends on LINGMO_USE_MMU # glib2, gssdp
	select LINGMO_PACKAGE_LIBGLIB2
	select LINGMO_PACKAGE_GSSDP
	select LINGMO_PACKAGE_LIBXML2
	select LINGMO_PACKAGE_UTIL_LINUX
	select LINGMO_PACKAGE_UTIL_LINUX_LIBUUID
	help
	  GUPnP implements the UPnP specification: resource announcement
	  and discovery, description, control, event notification, and
	  presentation.

	  http://www.gupnp.org/

comment "gupnp needs a toolchain w/ wchar, threads"
	depends on LINGMO_USE_MMU
	depends on !LINGMO_USE_WCHAR || !LINGMO_TOOLCHAIN_HAS_THREADS
```

## package/gutenprint/Config.in
```kconfig
config LINGMO_PACKAGE_GUTENPRINT
	bool "gutenprint"
	depends on LINGMO_INSTALL_LIBSTDCPP
	depends on LINGMO_PACKAGE_CUPS
	select LINGMO_PACKAGE_LIBICONV if !LINGMO_ENABLE_LOCALE
	help
	  Gutenprint, formerly named Gimp-Print, is a suite of printer
	  drivers that may be used with most common UNIX print spooling
	  systems, including CUPS, lpr, LPRng, or others

	  http://gimp-print.sourceforge.net/

comment "gutenprint needs a toolchain w/ C++"
	depends on LINGMO_PACKAGE_CUPS
	depends on !LINGMO_INSTALL_LIBSTDCPP
```

## package/gvfs/Config.in
```kconfig
config LINGMO_PACKAGE_GVFS
	bool "gvfs"
	depends on LINGMO_USE_WCHAR # glib2
	depends on LINGMO_USE_MMU # dbus, glib2
	depends on LINGMO_TOOLCHAIN_HAS_THREADS # dbus, glib2
	depends on !LINGMO_STATIC_LIBS
	select LINGMO_PACKAGE_GSETTINGS_DESKTOP_SCHEMAS
	select LINGMO_PACKAGE_LIBGLIB2
	select LINGMO_PACKAGE_DBUS
	select LINGMO_PACKAGE_SHARED_MIME_INFO
	help
	  gvfs is a userspace virtual filesystem where mount runs as a
	  separate processes which you talk to via D-Bus. It also
	  contains a gio module that seamlessly adds gvfs support to
	  all applications using the gio API. It also supports exposing
	  the gvfs mounts to non-gio applications using fuse.

	  https://wiki.gnome.org/action/show/Projects/gvfs

comment "gvfs needs a toolchain w/ wchar, threads, dynamic library"
	depends on LINGMO_USE_MMU
	depends on !LINGMO_USE_WCHAR || !LINGMO_TOOLCHAIN_HAS_THREADS || \
		LINGMO_STATIC_LIBS
```

## package/gzip/Config.in
```kconfig
config LINGMO_PACKAGE_GZIP
	bool "gzip"
	depends on LINGMO_USE_WCHAR
	depends on LINGMO_PACKAGE_BUSYBOX_SHOW_OTHERS
	help
	  Standard GNU compressor. Provides things like gzip,
	  gunzip, gzcat, etc...

	  http://www.gnu.org/software/gzip/gzip.html

comment "gzip needs a toolchain w/ wchar"
	depends on !LINGMO_USE_WCHAR
	depends on LINGMO_PACKAGE_BUSYBOX_SHOW_OTHERS
```
