## package/hackrf/Config.in
```kconfig
config LINGMO_PACKAGE_HACKRF
	bool "hackrf"
	depends on !LINGMO_STATIC_LIBS
	depends on LINGMO_TOOLCHAIN_HAS_THREADS
	depends on LINGMO_TOOLCHAIN_GCC_AT_LEAST_4_9 # libusb
	select LINGMO_PACKAGE_FFTW
	select LINGMO_PACKAGE_FFTW_SINGLE
	select LINGMO_PACKAGE_LIBUSB
	help
	  Library and tools for accessing HackRF SDR boards.

	  https://hackrf.readthedocs.io

comment "hackrf needs a toolchain w/ threads, dynamic library, gcc >= 4.9"
	depends on LINGMO_STATIC_LIBS || !LINGMO_TOOLCHAIN_HAS_THREADS || \
		!LINGMO_TOOLCHAIN_GCC_AT_LEAST_4_9
```

## package/haproxy/Config.in
```kconfig
config LINGMO_PACKAGE_HAPROXY_ARCH_SUPPORTS
	bool
	default y
	# src/proto_http.c:6330:1: internal compiler error: Segmentation fault
	depends on !LINGMO_nios2
	# https://gcc.gnu.org/bugzilla/show_bug.cgi?id=60040
	depends on !(LINGMO_sh4 && !LINGMO_TOOLCHAIN_GCC_AT_LEAST_7)

config LINGMO_PACKAGE_HAPROXY
	bool "haproxy"
	depends on LINGMO_PACKAGE_HAPROXY_ARCH_SUPPORTS
	depends on LINGMO_USE_MMU # fork()
	depends on LINGMO_TOOLCHAIN_HAS_SYNC_1 && LINGMO_TOOLCHAIN_HAS_SYNC_4
	help
	  HAProxy is a free, very fast and reliable solution offering
	  high availability, load balancing, and proxying for TCP and
	  HTTP-based applications.

	  http://www.haproxy.org
```

## package/harfbuzz/Config.in
```kconfig
config LINGMO_PACKAGE_HARFBUZZ
	bool "harfbuzz"
	depends on LINGMO_INSTALL_LIBSTDCPP
	depends on LINGMO_TOOLCHAIN_HAS_SYNC_4
	depends on LINGMO_TOOLCHAIN_GCC_AT_LEAST_4_9
	help
	  HarfBuzz is an OpenType text shaping engine

	  https://harfbuzz.github.io/

	  Harfbuzz can make optional use of cairo, freetype,
	  glib2 and icu packages if they are selected.

comment "harfbuzz needs a toolchain w/ C++, gcc >= 4.9"
	depends on LINGMO_TOOLCHAIN_HAS_SYNC_4
	depends on !LINGMO_INSTALL_LIBSTDCPP || \
		!LINGMO_TOOLCHAIN_GCC_AT_LEAST_4_9
```

## package/haserl/Config.in
```kconfig
config LINGMO_PACKAGE_HASERL
	bool "haserl"
	depends on LINGMO_USE_MMU # fork()
	help
	  Haserl is a small cgi wrapper that enables shell scripts to be
	  embedded into html documents. It is intended for environments
	  where something like PHP is too big.

	  http://haserl.sourceforge.net/

config LINGMO_PACKAGE_HASERL_WITH_LUA
	bool "Lua support"
	depends on LINGMO_PACKAGE_HASERL
	depends on LINGMO_PACKAGE_LUA
	help
	  Enable Lua support for haserl
```

## package/haveged/Config.in
```kconfig
config LINGMO_PACKAGE_HAVEGED
	bool "haveged"
	depends on LINGMO_USE_MMU # fork()
	help
	  The haveged project is an attempt to provide an easy-to-use,
	  unpredictable random number generator based upon an adaptation
	  of the HAVEGE algorithm.

	  http://www.issihosts.com/haveged/
```

## package/hawktracer/Config.in
```kconfig
config LINGMO_PACKAGE_HAWKTRACER
	bool "hawktracer"
	depends on LINGMO_INSTALL_LIBSTDCPP
	depends on LINGMO_TOOLCHAIN_GCC_AT_LEAST_4_8 # C++11
	help
	  HawkTracer is a highly portable, low-overhead, configurable
	  profiling tool built in Amazon Video for getting performance
	  metrics from low-end devices.

	  https://hawktracer.github.io/

if LINGMO_PACKAGE_HAWKTRACER

config LINGMO_PACKAGE_HAWKTRACER_TCP_LISTENER
	bool "TCP listener"
	default y
	depends on LINGMO_TOOLCHAIN_HAS_THREADS

comment "TCP listener needs a toolchain w/ threads"
	depends on !LINGMO_TOOLCHAIN_HAS_THREADS

endif

comment "hawktracer needs a toolchain w/ C++, gcc >= 4.8"
	depends on !LINGMO_INSTALL_LIBSTDCPP || !LINGMO_TOOLCHAIN_GCC_AT_LEAST_4_8
```

## package/hddtemp/Config.in
```kconfig
config LINGMO_PACKAGE_HDDTEMP
	bool "hddtemp"
	depends on LINGMO_USE_MMU # fork()
	depends on !LINGMO_STATIC_LIBS
	select LINGMO_PACKAGE_LIBEXECINFO if !LINGMO_TOOLCHAIN_USES_GLIBC
	select LINGMO_PACKAGE_LIBICONV if !LINGMO_ENABLE_LOCALE
	help
	  hddtemp is a small utility that gives you the temperature of
	  your hard drive by reading S.M.A.R.T. informations, for drives
	  that support this feature.

	  https://github.com/vitlav/hddtemp
	  http://www.guzu.net/linux/hddtemp.php

comment "hddtemp needs dynamic library"
	depends on LINGMO_USE_MMU
	depends on LINGMO_STATIC_LIBS
```

## package/hdparm/Config.in
```kconfig
config LINGMO_PACKAGE_HDPARM
	bool "hdparm"
	depends on LINGMO_PACKAGE_BUSYBOX_SHOW_OTHERS
	help
	  hdparm - get/set ATA/SATA drive parameters under Linux

	  https://sourceforge.net/projects/hdparm/
```
