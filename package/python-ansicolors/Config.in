## package/python-ansicolors/Config.in
```kconfig
config LINGMO_PACKAGE_PYTHON_ANSICOLORS
	bool "python-ansicolors"
	help
	  ANSI colors for Python.

	  http://github.com/jonathaneunice/colors/
```

## package/python-anyio/Config.in
```kconfig
config LINGMO_PACKAGE_PYTHON_ANYIO
	bool "python-anyio"
	select LINGMO_PACKAGE_PYTHON_IDNA # runtime
	select LINGMO_PACKAGE_PYTHON_SNIFFIO # runtime
	help
	  High level compatibility layer for multiple asynchronous
	  event loop implementations.

	  https://github.com/agronholm/anyio
```

## package/python-argon2-cffi-bindings/Config.in
```kconfig
config LINGMO_PACKAGE_PYTHON_ARGON2_CFFI_BINDINGS
	bool "python-argon2-cffi-bindings"
	depends on LINGMO_USE_MMU # libargon2
	depends on !LINGMO_STATIC_LIBS # libargon2
	select LINGMO_PACKAGE_PYTHON_CFFI # runtime
	select LINGMO_PACKAGE_LIBARGON2
	help
	  Low-level CFFI bindings for Argon2.

	  https://github.com/hynek/argon2-cffi-bindings
```

## package/python-argon2-cffi/Config.in
```kconfig
config LINGMO_PACKAGE_PYTHON_ARGON2_CFFI
	bool "python-argon2-cffi"
	depends on LINGMO_USE_MMU # python-argon2-cffi-bindings
	depends on !LINGMO_STATIC_LIBS # python-argon2-cffi-bindings
	select LINGMO_PACKAGE_PYTHON_ARGON2_CFFI_BINDINGS # runtime
	help
	  The secure Argon2 password hashing algorithm.

	  https://argon2-cffi.readthedocs.io/
```

## package/python-arrow/Config.in
```kconfig
config LINGMO_PACKAGE_PYTHON_ARROW
	bool "python-arrow"
	select LINGMO_PACKAGE_PYTHON_DATEUTIL # runtime
	select LINGMO_PACKAGE_PYTHON_TYPES_PYTHON_DATEUTIL # runtime
	help
	  Better dates and times for Python.

	  https://github.com/crsmithdev/arrow/
```

## package/python-asttokens/Config.in
```kconfig
config LINGMO_PACKAGE_PYTHON_ASTTOKENS
	bool "python-asttokens"
	select LINGMO_PACKAGE_PYTHON_SIX # runtime
	help
	  Annotate AST trees with source code positions.

	  https://github.com/gristlabs/asttokens
```

## package/python-async-lru/Config.in
```kconfig
config LINGMO_PACKAGE_PYTHON_ASYNC_LRU
	bool "python-async-lru"
	help
	  Simple lru_cache for asyncio.

	  https://github.com/aio-libs/async_lru
```

## package/python-asyncssh/Config.in
```kconfig
config LINGMO_PACKAGE_PYTHON_ASYNCSSH
	bool "python-asyncssh"
	depends on LINGMO_PACKAGE_HOST_RUSTC_TARGET_ARCH_SUPPORTS # python-cryptography
	select LINGMO_PACKAGE_PYTHON_CRYPTOGRAPHY # runtime
	select LINGMO_PACKAGE_PYTHON_TYPING_EXTENSIONS # runtime
	help
	  AsyncSSH: Asynchronous SSHv2 client and server library.

	  http://asyncssh.timeheart.net
```

## package/python-augeas/Config.in
```kconfig
config LINGMO_PACKAGE_PYTHON_AUGEAS
	bool "python-augeas"
	depends on !LINGMO_arc
	depends on LINGMO_USE_WCHAR
	select LINGMO_PACKAGE_AUGEAS
	select LINGMO_PACKAGE_PYTHON_CFFI # runtime
	help
	  Pure python bindings for Augeas.

	  https://github.com/hercules-team/python-augeas

comment "python-augeas needs a toolchain w/ wchar"
	depends on !LINGMO_arc
	depends on !LINGMO_USE_WCHAR
```

## package/python-autobahn/Config.in
```kconfig
config LINGMO_PACKAGE_PYTHON_AUTOBAHN
	bool "python-autobahn"
	depends on LINGMO_PACKAGE_HOST_RUSTC_TARGET_ARCH_SUPPORTS # python-cryptography
	select LINGMO_PACKAGE_PYTHON_CFFI # runtime
	select LINGMO_PACKAGE_PYTHON_CRYPTOGRAPHY # runtime
	select LINGMO_PACKAGE_PYTHON_HYPERLINK # runtime
	select LINGMO_PACKAGE_PYTHON_TXAIO # runtime
	help
	  WebSocket client and server library, WAMP real-time
	  framework.

	  https://pypi.python.org/pypi/autobahn

if LINGMO_PACKAGE_PYTHON_AUTOBAHN

config LINGMO_PACKAGE_PYTHON_AUTOBAHN_ACCELERATE
	bool "C-based WebSocket acceleration"
	select LINGMO_PACKAGE_PYTHON_WSACCEL # runtime

config LINGMO_PACKAGE_PYTHON_AUTOBAHN_COMPRESS
	bool "Non-standard WebSocket compression support"
	depends on LINGMO_INSTALL_LIBSTDCPP # python-snappy -> snappy
	select LINGMO_PACKAGE_PYTHON_SNAPPY # runtime

comment "Non-standard WebSocket compression needs a toolchain w/ C++"
	depends on !LINGMO_INSTALL_LIBSTDCPP

config LINGMO_PACKAGE_PYTHON_AUTOBAHN_ENCRYPTION
	bool "TLS and WAMP-cryptosign encryption/authentication support"
	depends on LINGMO_PACKAGE_HOST_RUSTC_TARGET_ARCH_SUPPORTS # python-pyopenssl -> python-cryptography
	select LINGMO_PACKAGE_PYTHON_PYNACL # runtime
	select LINGMO_PACKAGE_PYTHON_PYOPENSSL # runtime
	select LINGMO_PACKAGE_PYTHON_QRCODE # runtime
	select LINGMO_PACKAGE_PYTHON_QRCODE_SVG # runtime
	select LINGMO_PACKAGE_PYTHON_PYTRIE # runtime
	select LINGMO_PACKAGE_PYTHON_SERVICE_IDENTITY # runtime

config LINGMO_PACKAGE_PYTHON_AUTOBAHN_SCRAM
	bool "WAMP-SCRAM authentication support"
	select LINGMO_PACKAGE_PYTHON_ARGON2_CFFI # runtime
	select LINGMO_PACKAGE_PYTHON_PASSLIB # runtime

config LINGMO_PACKAGE_PYTHON_AUTOBAHN_SERIALIZATION
	bool "Accelerated JSON, MessagePack, CBOR, UBJSON, and FlatBuffers serialization support"
	depends on LINGMO_INSTALL_LIBSTDCPP # python-ujson
	select LINGMO_PACKAGE_PYTHON_CBOR2 # runtime
	select LINGMO_PACKAGE_PYTHON_FLATBUFFERS # runtime
	select LINGMO_PACKAGE_PYTHON_MSGPACK # runtime
	select LINGMO_PACKAGE_PYTHON_UBJSON # runtime
	select LINGMO_PACKAGE_PYTHON_UJSON # runtime

comment "Accelerated JSON, MessagePack, CBOR, UBJSON, and FlatBuffers serialization needs a toolchain w/ C++"
	depends on !LINGMO_INSTALL_LIBSTDCPP

config LINGMO_PACKAGE_PYTHON_AUTOBAHN_TWISTED
	bool "Twisted support"
	select LINGMO_PACKAGE_PYTHON_ATTRS # runtime
	select LINGMO_PACKAGE_PYTHON_TWISTED # runtime
	select LINGMO_PACKAGE_PYTHON_ZOPE_INTERFACE # runtime

endif
```

## package/python-automat/Config.in
```kconfig
config LINGMO_PACKAGE_PYTHON_AUTOMAT
	bool "python-automat"
	select LINGMO_PACKAGE_PYTHON_ATTRS # runtime
	select LINGMO_PACKAGE_PYTHON_SIX # runtime
	help
	  Self-service finite-state machines for the programmer on the
	  go.

	  https://github.com/glyph/Automat
```

## package/python-babel/Config.in
```kconfig
config LINGMO_PACKAGE_PYTHON_BABEL
	bool "python-babel"
	select LINGMO_PACKAGE_PYTHON_PYTZ # runtime
	help
	  A collection of tools for internationalizing Python
	  applications.

	  http://babel.pocoo.org/en/latest/
```

## package/python-bcrypt/Config.in
```kconfig
config LINGMO_PACKAGE_PYTHON_BCRYPT
	bool "python-bcrypt"
	depends on LINGMO_PACKAGE_HOST_RUSTC_TARGET_ARCH_SUPPORTS
	help
	  Modern password hashing for your software and your servers.

	  https://github.com/pyca/bcrypt/
```

## package/python-bitstring/Config.in
```kconfig
config LINGMO_PACKAGE_PYTHON_BITSTRING
	bool "python-bitstring"
	select LINGMO_PACKAGE_PYTHON_BITARRAY # runtime
	select LINGMO_PACKAGE_PYTHON3_ZLIB # runtime
	help
	  Simple construction, analysis and modification of binary data.

	  https://github.com/scott-griffiths/bitstring
```

## package/python-bleak/Config.in
```kconfig
config LINGMO_PACKAGE_PYTHON_BLEAK
	bool "python-bleak"
	select LINGMO_PACKAGE_PYTHON_ASYNC_TIMEOUT # runtime
	select LINGMO_PACKAGE_PYTHON_DBUS_FAST # runtime
	help
	  Bluetooth Low Energy platform Agnostic Klient.

	  https://github.com/hbldh/bleak
```

## package/python-blinker/Config.in
```kconfig
config LINGMO_PACKAGE_PYTHON_BLINKER
	bool "python-blinker"
	help
	  Fast, simple object-to-object and broadcast signaling.

	  https://blinker.readthedocs.io
```

## package/python-bluezero/Config.in
```kconfig
config LINGMO_PACKAGE_PYTHON_BLUEZERO
	bool "python-bluezero"
	depends on LINGMO_PACKAGE_GOBJECT_INTROSPECTION_ARCH_SUPPORTS # python-gobject -> gobject-introspection
	depends on LINGMO_TOOLCHAIN_GCC_AT_LEAST_4_9 # python-gobject -> gobject-introspection
	depends on LINGMO_HOST_GCC_AT_LEAST_8 # python-gobject -> gobject-introspection -> host-qemu
	depends on LINGMO_TOOLCHAIN_USES_GLIBC # python-gobject -> gobject-introspection
	select LINGMO_PACKAGE_DBUS # runtime
	select LINGMO_PACKAGE_DBUS_PYTHON # runtime
	select LINGMO_PACKAGE_PYTHON_GOBJECT # runtime
	help
	  Python library for Bluetooth Low Energy (BLE) on Linux.

	  https://github.com/ukBaz/python-bluezero

comment "python-bluezero needs a glibc toolchain, gcc >= 4.9, host gcc >= 8"
	depends on LINGMO_PACKAGE_GOBJECT_INTROSPECTION_ARCH_SUPPORTS
	depends on !LINGMO_TOOLCHAIN_USES_GLIBC || \
		!LINGMO_TOOLCHAIN_GCC_AT_LEAST_4_9 || \
		!LINGMO_HOST_GCC_AT_LEAST_8
```

## package/python-boto3/Config.in
```kconfig
config LINGMO_PACKAGE_PYTHON_BOTO3
	bool "python-boto3"
	select LINGMO_PACKAGE_PYTHON_BOTOCORE # runtime
	select LINGMO_PACKAGE_PYTHON_JMESPATH # runtime
	select LINGMO_PACKAGE_PYTHON_S3TRANSFER # runtime
	help
	  The AWS SDK for Python.

	  https://github.com/boto/boto3
```

## package/python-botocore/Config.in
```kconfig
config LINGMO_PACKAGE_PYTHON_BOTOCORE
	bool "python-botocore"
	select LINGMO_PACKAGE_PYTHON_DATEUTIL # runtime
	select LINGMO_PACKAGE_PYTHON_JMESPATH # runtime
	select LINGMO_PACKAGE_PYTHON_URLLIB3 # runtime
	select LINGMO_PACKAGE_PYTHON3_PYEXPAT # runtime
	select LINGMO_PACKAGE_PYTHON3_SSL # runtime
	help
	  Low-level, data-driven core of boto 3.

	  https://github.com/boto/botocore
```

## package/python-brotli/Config.in
```kconfig
config LINGMO_PACKAGE_PYTHON_BROTLI
	bool "python-brotli"
	help
	  Python bindings for the Brotli compression library.

	  https://github.com/google/brotli
```

## package/python-bsdiff4/Config.in
```kconfig
config LINGMO_PACKAGE_PYTHON_BSDIFF4
	bool "python-bsdiff4"
	select LINGMO_PACKAGE_PYTHON3_BZIP2 # runtime
	help
	  binary diff and patch using the BSDIFF4-format.

	  https://github.com/ilanschnell/bsdiff4
```

## package/python-can/Config.in
```kconfig
config LINGMO_PACKAGE_PYTHON_CAN
	bool "python-can"
	select LINGMO_PACKAGE_PYTHON3_SQLITE # runtime
	select LINGMO_PACKAGE_PYTHON_MSGPACK # runtime
	select LINGMO_PACKAGE_PYTHON_PACKAGING # runtime
	select LINGMO_PACKAGE_PYTHON_TYPING_EXTENSIONS # runtime
	select LINGMO_PACKAGE_PYTHON_WRAPT # runtime
	select LINGMO_PACKAGE_PYTHON3_ZLIB
	help
	  This module provides controller area network support for
	  Python.

	  https://github.com/hardbyte/python-can
```

## package/python-cbor/Config.in
```kconfig
config LINGMO_PACKAGE_PYTHON_CBOR
	bool "python-cbor"
	help
	  RFC 7049 - Concise Binary Object Representation.

	  https://pypi.python.org/pypi/cbor
```

## package/python-cchardet/Config.in
```kconfig
config LINGMO_PACKAGE_PYTHON_CCHARDET
	bool "python-cchardet"
	depends on LINGMO_INSTALL_LIBSTDCPP
	help
	  cChardet is high speed universal character encoding
	  detector.

	  https://github.com/PyYoshi/cChardet

comment "python-cchardet needs a toolchain w/ C++"
	depends on !LINGMO_INSTALL_LIBSTDCPP
```

## package/python-channels-redis/Config.in
```kconfig
config LINGMO_PACKAGE_PYTHON_CHANNELS_REDIS
	bool "python-channels-redis"
	# python-channels -> python-daphne -> python-autobahn -> python-cryptography
	depends on LINGMO_PACKAGE_HOST_RUSTC_TARGET_ARCH_SUPPORTS
	select LINGMO_PACKAGE_PYTHON_ASGIREF # runtime
	select LINGMO_PACKAGE_PYTHON_CHANNELS # runtime
	select LINGMO_PACKAGE_PYTHON_MSGPACK # runtime
	select LINGMO_PACKAGE_PYTHON_REDIS # runtime
	help
	  A Django Channels channel layer that uses Redis as its
	  backing store, and supports both a single-server and
	  sharded configurations, as well as group support.

	  http://github.com/django/channels_redis/
```
