## package/mrp/Config.in
```kconfig
config LINGMO_PACKAGE_MRP
	bool "mrp"
	depends on LINGMO_TOOLCHAIN_HAS_THREADS
	depends on LINGMO_TOOLCHAIN_HEADERS_AT_LEAST_5_0
	select LINGMO_PACKAGE_LIBEV
	select LINGMO_PACKAGE_LIBMNL
	select LINGMO_PACKAGE_LIBNL
	select LINGMO_PACKAGE_CFM
	help
	  This is the userspace application that configures the kernel
	  to run MRP protocol. The userspace application is made of 2
	  applications, one daemon and a client.

	  https://github.com/microchip-ung/mrp

comment "mrp needs a toolchain w/ threads, kernel headers >= 5.0"
	depends on !LINGMO_TOOLCHAIN_HAS_THREADS \
		|| !LINGMO_TOOLCHAIN_HEADERS_AT_LEAST_5_0
```

## package/msgpack/Config.in
```kconfig
config LINGMO_PACKAGE_MSGPACK
	bool "msgpack"
	depends on LINGMO_INSTALL_LIBSTDCPP
	depends on LINGMO_TOOLCHAIN_HAS_SYNC_4
	help
	  MessagePack is an efficient binary serialization format.

	  It lets you exchange data among multiple languages like JSON
	  but it's faster and smaller.

	  http://msgpack.org/

comment "msgpack needs a toolchain w/ C++"
	depends on !LINGMO_INSTALL_LIBSTDCPP
	depends on LINGMO_TOOLCHAIN_HAS_SYNC_4
```

## package/mtd/Config.in
```kconfig
config LINGMO_PACKAGE_MTD
	bool "mtd, jffs2 and ubi/ubifs tools"
	help
	  Build mtd, jffs2 and ubi/ubifs tools

	  http://www.linux-mtd.infradead.org/

if LINGMO_PACKAGE_MTD

# The two hidden options below match mtd configure script options
# --enable-jffs and --enable-ubifs

config LINGMO_PACKAGE_MTD_JFFS_UTILS
	bool
	select LINGMO_PACKAGE_LZO
	select LINGMO_PACKAGE_ZLIB

config LINGMO_PACKAGE_MTD_UBIFS_UTILS
	bool
	select LINGMO_PACKAGE_LZO
	select LINGMO_PACKAGE_UTIL_LINUX
	select LINGMO_PACKAGE_UTIL_LINUX_LIBUUID
	select LINGMO_PACKAGE_ZLIB

comment "MTD tools selection"

config LINGMO_PACKAGE_MTD_DOCFDISK
	bool "docfdisk"

config LINGMO_PACKAGE_MTD_DOC_LOADBIOS
	bool "doc_loadbios"

config LINGMO_PACKAGE_MTD_FLASHCP
	bool "flashcp"
	default y

config LINGMO_PACKAGE_MTD_FLASH_ERASE
	bool "flash_erase"
	default y

config LINGMO_PACKAGE_MTD_FLASH_LOCK
	bool "flash_lock"
	default y

config LINGMO_PACKAGE_MTD_FLASH_OTP_DUMP
	bool "flash_otp_dump"

config LINGMO_PACKAGE_MTD_FLASH_OTP_INFO
	bool "flash_otp_info"

config LINGMO_PACKAGE_MTD_FLASH_OTP_LOCK
	bool "flash_otp_lock"

config LINGMO_PACKAGE_MTD_FLASH_OTP_WRITE
	bool "flash_otp_write"

config LINGMO_PACKAGE_MTD_FLASH_OTP_ERASE
	bool "flash_otp_erase"

config LINGMO_PACKAGE_MTD_FLASH_UNLOCK
	bool "flash_unlock"
	default y

config LINGMO_PACKAGE_MTD_FTL_CHECK
	bool "ftl_check"

config LINGMO_PACKAGE_MTD_FTL_FORMAT
	bool "ftl_format"

config LINGMO_PACKAGE_MTD_JFFS2DUMP
	bool "jffs2dump"
	select LINGMO_PACKAGE_MTD_JFFS_UTILS

config LINGMO_PACKAGE_MTD_LSMTD
	bool "lsmtd"

config LINGMO_PACKAGE_MTD_MKFSJFFS2
	bool "mkfs.jffs2"
	select LINGMO_PACKAGE_MTD_JFFS_UTILS

config LINGMO_PACKAGE_MTD_MKFSUBIFS
	bool "mkfs.ubifs"
	select LINGMO_PACKAGE_MTD_UBIFS_UTILS

config LINGMO_PACKAGE_MTD_MTD_DEBUG
	bool "mtd_debug"
	default y

config LINGMO_PACKAGE_MTD_MTDPART
	bool "mtdpart"

config LINGMO_PACKAGE_MTD_NANDDUMP
	bool "nanddump"
	default y

config LINGMO_PACKAGE_MTD_NANDTEST
	bool "nandtest"
	default y

config LINGMO_PACKAGE_MTD_NANDWRITE
	bool "nandwrite"
	default y

config LINGMO_PACKAGE_MTD_NANDFLIPBITS
	bool "nandflipbits"

config LINGMO_PACKAGE_MTD_NFTLDUMP
	bool "nftldump"

config LINGMO_PACKAGE_MTD_NFTL_FORMAT
	bool "nftl_format"

config LINGMO_PACKAGE_MTD_RECV_IMAGE
	bool "recv_image"

config LINGMO_PACKAGE_MTD_RFDDUMP
	bool "rfddump"

config LINGMO_PACKAGE_MTD_RFDFORMAT
	bool "rfdformat"

config LINGMO_PACKAGE_MTD_SERVE_IMAGE
	bool "serve_image"

config LINGMO_PACKAGE_MTD_SUMTOOL
	bool "sumtool"
	select LINGMO_PACKAGE_MTD_JFFS_UTILS

config LINGMO_PACKAGE_MTD_MTDINFO
	bool "mtdinfo"
	default y

config LINGMO_PACKAGE_MTD_UBIATTACH
	bool "ubiattach"
	default y

config LINGMO_PACKAGE_MTD_UBICRC32
	bool "ubicrc32"
	default y

config LINGMO_PACKAGE_MTD_UBIDETACH
	bool "ubidetach"
	default y

config LINGMO_PACKAGE_MTD_UBIFORMAT
	bool "ubiformat"
	default y

config LINGMO_PACKAGE_MTD_UBIHEALTHD
	bool "ubihealthd"
	default y
	depends on LINGMO_TOOLCHAIN_HEADERS_AT_LEAST_3_17 # getrandom()

comment "ubihealthd needs a toolchain w/ headers >= 3.17"
	depends on !LINGMO_TOOLCHAIN_HEADERS_AT_LEAST_3_17

config LINGMO_PACKAGE_MTD_UBIMKVOL
	bool "ubimkvol"
	default y

config LINGMO_PACKAGE_MTD_UBINFO
	bool "ubinfo"
	default y

config LINGMO_PACKAGE_MTD_UBINIZE
	bool "ubinize"
	default y

config LINGMO_PACKAGE_MTD_UBIRENAME
	bool "ubirename"
	default y

config LINGMO_PACKAGE_MTD_UBIRMVOL
	bool "ubirmvol"
	default y

config LINGMO_PACKAGE_MTD_UBIRSVOL
	bool "ubirsvol"
	default y

config LINGMO_PACKAGE_MTD_UBIUPDATEVOL
	bool "ubiupdatevol"
	default y

config LINGMO_PACKAGE_MTD_UBIBLOCK
	bool "ubiblock"
	default y

config LINGMO_PACKAGE_MTD_TESTS
	bool "MTD test tools"
	depends on LINGMO_USE_MMU # fork() in fstests
	depends on LINGMO_TOOLCHAIN_HAS_THREADS
	help
	  Build and install tools for testing MTD devices and drivers.

if LINGMO_PACKAGE_MTD_TESTS

config LINGMO_PACKAGE_MTD_FLASH_READTEST
	bool "flash_readtest"

config LINGMO_PACKAGE_MTD_FLASH_SPEED
	bool "flash_speed"

config LINGMO_PACKAGE_MTD_FLASH_STRESS
	bool "flash_stress"

config LINGMO_PACKAGE_MTD_FLASH_TORTURE
	bool "flash_torture"

config LINGMO_PACKAGE_MTD_INTEGCK
	bool "integck"

config LINGMO_PACKAGE_MTD_NANDBITERRS
	bool "nandbiterrs"

config LINGMO_PACKAGE_MTD_NANDPAGETEST
	bool "nandpagetest"

config LINGMO_PACKAGE_MTD_NANDSUBPAGETEST
	bool "nandsubpagetest"

endif

comment "MTD test tools need a toolchain w/ threads"
	depends on LINGMO_USE_MMU
	depends on !LINGMO_TOOLCHAIN_HAS_THREADS

endif
```

## package/multicat/Config.in
```kconfig
config LINGMO_PACKAGE_MULTICAT
	bool "multicat"
	depends on LINGMO_TOOLCHAIN_HAS_THREADS
	select LINGMO_PACKAGE_BITSTREAM
	help
	  Simple and efficient multicast and transport stream
	  manipulation.

	  http://www.videolan.org/projects/multicat.html

comment "multicat needs a toolchain w/ threads"
	depends on !LINGMO_TOOLCHAIN_HAS_THREADS
```

## package/multipath-tools/Config.in
```kconfig
comment "multipath-tools needs udev and a toolchain w/ threads, dynamic library, C++"
	depends on LINGMO_USE_MMU
	depends on LINGMO_TOOLCHAIN_HAS_SYNC_4
	depends on LINGMO_PACKAGE_LIBURCU_ARCH_SUPPORTS
	depends on !LINGMO_TOOLCHAIN_HAS_THREADS || LINGMO_STATIC_LIBS || \
		!LINGMO_PACKAGE_HAS_UDEV || !LINGMO_INSTALL_LIBSTDCPP

config LINGMO_PACKAGE_MULTIPATH_TOOLS
	bool "multipath-tools"
	depends on !LINGMO_STATIC_LIBS
	depends on LINGMO_USE_MMU
	depends on LINGMO_TOOLCHAIN_HAS_THREADS
	depends on LINGMO_TOOLCHAIN_HAS_SYNC_4
	depends on LINGMO_PACKAGE_LIBURCU_ARCH_SUPPORTS
	depends on LINGMO_PACKAGE_HAS_UDEV
	depends on LINGMO_INSTALL_LIBSTDCPP # liburcu
	select LINGMO_PACKAGE_JSON_C
	select LINGMO_PACKAGE_LIBURCU
	select LINGMO_PACKAGE_LIBAIO
	select LINGMO_PACKAGE_LVM2
	select LINGMO_PACKAGE_LVM2_STANDARD_INSTALL
	select LINGMO_PACKAGE_READLINE
	select LINGMO_PACKAGE_UTIL_LINUX
	select LINGMO_PACKAGE_UTIL_LINUX_LIBS
	select LINGMO_PACKAGE_UTIL_LINUX_LIBMOUNT
	help
	  This package provides the following binaries to drive
	  the Device Mapper multipathing driver:
	    * multipath - Device mapper target autoconfig.
	    * multipathd - Multipath daemon.
	    * mpathpersist - Manages SCSI persistent reservations on
	      dm multipath devices.
	    * kpartx - Create device maps from partition tables.

	  https://github.com/openSUSE/multipath-tools
```

## package/mupdf/Config.in
```kconfig
config LINGMO_PACKAGE_MUPDF
	bool "mupdf"
	depends on LINGMO_INSTALL_LIBSTDCPP # harfbuzz
	depends on LINGMO_TOOLCHAIN_HAS_SYNC_4 # harfbuzz
	depends on LINGMO_TOOLCHAIN_GCC_AT_LEAST_4_9 # harfbuzz
	depends on LINGMO_PACKAGE_XORG7
	select LINGMO_PACKAGE_FREETYPE
	select LINGMO_PACKAGE_GUMBO_PARSER
	select LINGMO_PACKAGE_HARFBUZZ
	select LINGMO_PACKAGE_JBIG2DEC
	select LINGMO_PACKAGE_JPEG
	select LINGMO_PACKAGE_LCMS2
	select LINGMO_PACKAGE_OPENJPEG
	select LINGMO_PACKAGE_XLIB_LIBX11
	select LINGMO_PACKAGE_ZLIB
	help
	  MuPDF is a lightweight PDF, XPS, and E-book viewer.

	  https://www.mupdf.com/index.html

comment "mupdf needs a toolchain w/ C++, gcc >= 4.9"
	depends on LINGMO_TOOLCHAIN_HAS_SYNC_4
	depends on !LINGMO_INSTALL_LIBSTDCPP || \
		!LINGMO_TOOLCHAIN_GCC_AT_LEAST_4_9
```

## package/murata-cyw-fw/Config.in
```kconfig
config LINGMO_PACKAGE_MURATA_CYW_FW
	bool "murata-cyw-fw"
	help
	  Murata Wireless firmware, NVRAM and Bluetooth HCD patch files.

	  https://github.com/murata-wireless/cyw-fmac-fw
	  https://github.com/murata-wireless/cyw-fmac-nvram
	  https://github.com/murata-wireless/cyw-bt-patch

if LINGMO_PACKAGE_MURATA_CYW_FW

config LINGMO_PACKAGE_MURATA_CYW_FW_CYW43012
	bool "CYW43012 (1LV)"
	help
	  Murata Wireless CYW43012 (1LV) module firmware files.

config LINGMO_PACKAGE_MURATA_CYW_FW_CYW43340
	bool "CYW43340/CYW43341 (1BW)"
	help
	  Murata Wireless CYW43340/CYW43341 (1BW) module firmware files.

config LINGMO_PACKAGE_MURATA_CYW_FW_CYW43362
	bool "CYW43362 (SN8000)"
	help
	  Murata Wireless CYW43362 (SN8000) module firmware files.

config LINGMO_PACKAGE_MURATA_CYW_FW_CYW4339
	bool "CYW4339 (1CK/ZP)"
	help
	  Murata Wireless CYW4339 (1CK/ZP) module firmware files.

choice
	prompt "CYW4339 module" if LINGMO_PACKAGE_MURATA_CYW_FW_CYW4339

config LINGMO_PACKAGE_MURATA_CYW_FW_CYW4339_1CK
	bool "1CK"

config LINGMO_PACKAGE_MURATA_CYW_FW_CYW4339_ZP
	bool "ZP"

endchoice

config LINGMO_PACKAGE_MURATA_CYW_FW_CYW43430
	bool "CYW43430/CYW4343W/CYW43364 (1DX/1FX/1LN)"
	help
	  Murata Wireless CYW43430/CYW4343W/CYW43364 (1DX/1FX/1LN)
	  module firmware files.

choice
	prompt "CYW43430/CYW4343W/CYW43364 module" if LINGMO_PACKAGE_MURATA_CYW_FW_CYW43430

config LINGMO_PACKAGE_MURATA_CYW_FW_CYW43430_1DX
	bool "1DX"

config LINGMO_PACKAGE_MURATA_CYW_FW_CYW43430_1FX
	bool "1FX"

config LINGMO_PACKAGE_MURATA_CYW_FW_CYW43430_1LN
	bool "1LN"

endchoice

config LINGMO_PACKAGE_MURATA_CYW_FW_CYW43455
	bool "CYW43455 (1HK/1LC/1MW)"
	help
	  Murata Wireless CYW43455 (1HK/1LC/1MW) module firmware files.

choice
	prompt "CYW43455 module" if LINGMO_PACKAGE_MURATA_CYW_FW_CYW43455

config LINGMO_PACKAGE_MURATA_CYW_FW_CYW43455_1HK
	bool "1HK"

config LINGMO_PACKAGE_MURATA_CYW_FW_CYW43455_1LC
	bool "1LC"

config LINGMO_PACKAGE_MURATA_CYW_FW_CYW43455_1MW
	bool "1MW"

endchoice

config LINGMO_PACKAGE_MURATA_CYW_FW_CYW4354
	bool "CYW4354 (1BB)"
	help
	  Murata Wireless CYW4354 (1BB) module firmware files.

config LINGMO_PACKAGE_MURATA_CYW_FW_CYW4356
	bool "CYW4356 (1CX)"
	help
	  Murata Wireless CYW4356 (1CX) module firmware files.

config LINGMO_PACKAGE_MURATA_CYW_FW_CYW4359
	bool "CYW4359 (1FD)"
	help
	  Murata Wireless CYW4359 (1FD) module firmware files.

endif
```

## package/musepack/Config.in
```kconfig
config LINGMO_PACKAGE_MUSEPACK
	bool "musepack"
	select LINGMO_PACKAGE_LIBCUEFILE
	select LINGMO_PACKAGE_LIBREPLAYGAIN
	help
	  Musepack is an audio compression format with a strong
	  emphasis on high quality. It's not lossless, but it is
	  designed for transparency, so that you won't be able to hear
	  differences between the original wave file and the much
	  smaller MPC file.

	  http://www.musepack.net/
```

## package/musl/Config.in
```kconfig
config LINGMO_PACKAGE_MUSL_ARCH_SUPPORTS
	bool
	default y if LINGMO_aarch64
	default y if LINGMO_aarch64_be
	default y if LINGMO_arm
	default y if LINGMO_armeb
	default y if LINGMO_i386
	default y if LINGMO_m68k_m68k
	default y if LINGMO_microblaze
	default y if LINGMO_mips
	default y if LINGMO_mipsel
	default y if LINGMO_mips64
	default y if LINGMO_mips64el
	default y if LINGMO_or1k
	default y if LINGMO_powerpc
	default y if LINGMO_powerpc64
	default y if LINGMO_powerpc64le
	default y if LINGMO_RISCV_64
	default y if LINGMO_s390x
	default y if LINGMO_sh
	default y if LINGMO_x86_64
	depends on !LINGMO_POWERPC_CPU_HAS_SPE # not supported, build breaks
	depends on !(LINGMO_powerpc64 || LINGMO_powerpc64le) || LINGMO_POWERPC_CPU_HAS_ALTIVEC
	# sh2 nommu is supported by musl, but we don't have support
	# for it in Buildroot.
	depends on LINGMO_USE_MMU

config LINGMO_PACKAGE_MUSL_SUPPORTS
	bool
	default y if LINGMO_PACKAGE_MUSL_ARCH_SUPPORTS

config LINGMO_PACKAGE_MUSL
	bool
	default y
	depends on LINGMO_TOOLCHAIN_USES_MUSL
	select LINGMO_PACKAGE_LINUX_HEADERS
	# SSP broken on i386/ppc: http://www.openwall.com/lists/musl/2016/12/04/2
	select LINGMO_TOOLCHAIN_HAS_SSP if LINGMO_PACKAGE_HOST_BINUTILS_SUPPORTS_CFI \
		&& !(LINGMO_i386 || LINGMO_powerpc)
	# Compatibility headers: cdefs.h, queue.h
	select LINGMO_PACKAGE_MUSL_COMPAT_HEADERS
	help
	  http://musl.libc.org/
```

## package/mutt/Config.in
```kconfig
config LINGMO_PACKAGE_MUTT
	bool "mutt"
	depends on LINGMO_USE_WCHAR
	depends on LINGMO_USE_MMU # fork()
	select LINGMO_PACKAGE_NCURSES
	help
	  Mutt is a sophisticated text-based Mail User Agent (MUA)

	  http://www.mutt.org/

if LINGMO_PACKAGE_MUTT

config LINGMO_PACKAGE_MUTT_IMAP
	bool "imap"
	help
	  IMAP support

config LINGMO_PACKAGE_MUTT_POP3
	bool "pop3"
	help
	  POP3 support

endif # LINGMO_PACKAGE_MUTT

comment "mutt needs a toolchain w/ wchar"
	depends on LINGMO_USE_MMU
	depends on !LINGMO_USE_WCHAR
```

## package/nano/Config.in
```kconfig
config LINGMO_PACKAGE_NANO
	bool "nano"
	depends on LINGMO_USE_WCHAR
	# full version uses fork()
	select LINGMO_PACKAGE_NANO_TINY if !LINGMO_USE_MMU
	select LINGMO_PACKAGE_NCURSES
	help
	  A nice ncurses-based editor. Started out as a clone of pico.
	  Great editor for new users.

	  https://www.nano-editor.org/

if LINGMO_PACKAGE_NANO

config LINGMO_PACKAGE_NANO_TINY
	bool "optimize for size"
	default y
	help
	  Disable all features for the sake of size.

endif

comment "nano needs a toolchain w/ wchar"
	depends on !LINGMO_USE_WCHAR
```

## package/nanomsg/Config.in
```kconfig
config LINGMO_PACKAGE_NANOMSG
	bool "nanomsg"
	depends on LINGMO_TOOLCHAIN_HAS_THREADS
	help
	  nanomsg is a socket library that provides several common
	  communication patterns. It aims to make the networking layer
	  fast, scalable, and easy to use. Implemented in C, it works
	  on a wide range of operating systems with no further
	  dependencies.

	  http://nanomsg.org/

if LINGMO_PACKAGE_NANOMSG

config LINGMO_PACKAGE_NANOMSG_TOOLS
	bool "Build nanomsg tools"
	help
	  Build nanomsg tools

endif

comment "nanomsg needs a toolchain w/ threads"
	depends on !LINGMO_TOOLCHAIN_HAS_THREADS
```

## package/nbd/Config.in
```kconfig
config LINGMO_PACKAGE_NBD
	bool "nbd"
	depends on LINGMO_USE_WCHAR
	depends on LINGMO_TOOLCHAIN_HAS_THREADS
	depends on LINGMO_USE_MMU
	select LINGMO_PACKAGE_LIBGLIB2
	help
	  NBD is a set of utilities to configure network block devices,
	  allowing access to remote block devices over TCP/IP network.

	  http://nbd.sf.net/

if LINGMO_PACKAGE_NBD

config LINGMO_PACKAGE_NBD_CLIENT
	bool "nbd client"
	default y
	help
	  The client part of NBD.

config LINGMO_PACKAGE_NBD_SERVER
	bool "nbd server"
	help
	  The server part of NBD.

config LINGMO_PACKAGE_NBD_TRDUMP
	bool "nbd trdump"
	help
	  Utility to dump server logs in human-readable form.

endif

comment "nbd needs a toolchain w/ wchar, threads"
	depends on LINGMO_USE_MMU
	depends on !LINGMO_USE_WCHAR || !LINGMO_TOOLCHAIN_HAS_THREADS
```

## package/ncdu/Config.in
```kconfig
config LINGMO_PACKAGE_NCDU
	bool "ncdu"
	depends on LINGMO_USE_MMU # system()
	select LINGMO_PACKAGE_NCURSES
	help
	  ncdu is a disk usage analyzer with an ncurses interface

	  http://dev.yorhel.nl/ncdu
```
