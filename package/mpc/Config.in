## package/ncftp/Config.in
```kconfig
config LINGMO_PACKAGE_NCFTP
	bool "ncftp"
	# fork()
	depends on LINGMO_USE_MMU
	help
	  NcFTP Client (also known as just NcFTP) is a set of FREE
	  application programs implementing the File Transfer Protocol
	  (FTP).

	  https://www.ncftp.com/ncftp/

if LINGMO_PACKAGE_NCFTP

config LINGMO_PACKAGE_NCFTP_GET
	bool "ncftpget"
	default y

config LINGMO_PACKAGE_NCFTP_PUT
	bool "ncftpput"
	default y

config LINGMO_PACKAGE_NCFTP_LS
	bool "ncftpls"
	default y

config LINGMO_PACKAGE_NCFTP_BATCH
	bool "ncftpbatch/ncftpspooler"
	default y

config LINGMO_PACKAGE_NCFTP_BOOKMARKS
	bool "ncftpbookmarks"
	select LINGMO_PACKAGE_NCURSES

endif
```

## package/ncmpc/Config.in
```kconfig
config LINGMO_PACKAGE_NCMPC
	bool "ncmpc"
	depends on LINGMO_USE_MMU # fork()
	depends on LINGMO_INSTALL_LIBSTDCPP
	depends on LINGMO_USE_WCHAR
	depends on LINGMO_TOOLCHAIN_HAS_THREADS
	depends on LINGMO_TOOLCHAIN_GCC_AT_LEAST_10 # C++20
	select LINGMO_PACKAGE_LIBMPDCLIENT
	select LINGMO_PACKAGE_NCURSES
	help
	  ncmpc is a fully featured MPD client, which runs in a terminal
	  (using ncurses). Its goal is to provide a keyboard oriented
	  and consistent interface to MPD, without wasting resources.

	  http://www.musicpd.org/clients/ncmpc/

comment "ncmpc needs a toolchain w/ C++, wchar, threads, gcc >= 10"
	depends on LINGMO_USE_MMU
	depends on !LINGMO_INSTALL_LIBSTDCPP || !LINGMO_USE_WCHAR || \
		!LINGMO_TOOLCHAIN_HAS_THREADS || \
		!LINGMO_TOOLCHAIN_GCC_AT_LEAST_10
```

## package/ndisc6/Config.in
```kconfig
config LINGMO_PACKAGE_NDISC6
	bool "ndisc6 tools"
	depends on LINGMO_USE_MMU # fork()
	depends on LINGMO_TOOLCHAIN_GCC_AT_LEAST_4_7 # c11
	help
	  NDisc6 is a small collection of useful tools for IPv6
	  networking

	  http://www.remlab.net/ndisc6/

if LINGMO_PACKAGE_NDISC6

config LINGMO_PACKAGE_NDISC6_NAME2ADDR
	bool "name2addr"
	help
	  name2addr perform DNS lookups from scripts.

config LINGMO_PACKAGE_NDISC6_NDISC6
	bool "ndisc6"
	help
	  ndisc6 performs ICMPv6 Neighbor Discovery in userland.

config LINGMO_PACKAGE_NDISC6_RDISC6
	bool "rdisc6"
	help
	  rdisc6 performs ICMPv6 Router Discovery in userland.

config LINGMO_PACKAGE_NDISC6_RDNSSD
	bool "rdnssd"
	help
	  IPv6 Recursive DNS Server discovery Daemon.

config LINGMO_PACKAGE_NDISC6_RLTRACEROUTE6
	bool "rltraceroute6"
	help
	  rltraceroute6 is an IPv6 traceroute implementation.

config LINGMO_PACKAGE_NDISC6_TCPTRACEROUTE6
	bool "tcptraceroute6"
	help
	  tcptraceroute6 is an TCP/IPv6 traceroute implementation.

config LINGMO_PACKAGE_NDISC6_TCPSPRAY
	bool "tcpspray"
	help
	  TCP/IP bandwidth measurement tool (Discard and Echo client).

endif

comment "ndisc6 needs a toolchain w/ gcc >= 4.7"
	depends on LINGMO_USE_MMU
	depends on !LINGMO_TOOLCHAIN_GCC_AT_LEAST_4_7
```

## package/ne10/Config.in
```kconfig
config LINGMO_PACKAGE_NE10_ARCH_SUPPORTS
	bool
	default y if LINGMO_aarch64
	default y if LINGMO_arm && (LINGMO_ARM_FPU_NEON || LINGMO_ARM_FPU_NEON_VFPV4)

config LINGMO_PACKAGE_NE10
	bool "ne10"
	depends on LINGMO_PACKAGE_NE10_ARCH_SUPPORTS
	help
	  The Ne10 project has been set up to provide a set of common,
	  useful functions which have been heavily optimized for the
	  ARM and AArch64 Architecture and provide consistent well
	  tested behavior that can be easily incorporated into
	  applications. C interfaces to the functions are provided for
	  both assembler and NEON implementations.

	  http://projectne10.github.io/Ne10/
```
