## package/matchbox-lib/Config.in
```kconfig
config LINGMO_PACKAGE_MATCHBOX_LIB
	bool "matchbox-lib"
	select LINGMO_PACKAGE_XLIB_LIBXEXT
	help
	  Matchbox common functionality library.

	  http://git.yoctoproject.org/cgit/cgit.cgi/libmatchbox
```

## package/matchbox-startup-monitor/Config.in
```kconfig
config LINGMO_PACKAGE_MATCHBOX_STARTUP_MONITOR
	bool "matchbox-startup-monitor"
	select LINGMO_PACKAGE_MATCHBOX_LIB
	select LINGMO_PACKAGE_STARTUP_NOTIFICATION
	help
	  Matchbox Panel Startup Monitor Applet.

	  http://git.yoctoproject.org/cgit.cgi/mb-applet-startup-monitor/
```

## package/matio/Config.in
```kconfig
config LINGMO_PACKAGE_MATIO
	bool "matio"
	select LINGMO_PACKAGE_ZLIB
	help
	  matio is an C library for reading and writing MATLAB MAT
	  files.

	  https://sourceforge.net/projects/matio
```

## package/mawk/Config.in
```kconfig
config LINGMO_PACKAGE_MAWK
	bool "mawk"
	help
	  Interpreter for the AWK Programming Language.

	  http://invisible-island.net/mawk/mawk.html
```

## package/mbpfan/Config.in
```kconfig
config LINGMO_PACKAGE_MBPFAN
	bool "mbpfan"
	depends on LINGMO_USE_MMU
	help
	  Mbpfan is a daemon for MacBook laptops which monitors the
	  CPU temperature with the coretemp module, and sets the fan
	  speeds with the applesmc module.

	  https://github.com/linux-on-mac/mbpfan
```

## package/mbpoll/Config.in
```kconfig
config LINGMO_PACKAGE_MBPOLL
	bool "mbpoll"
	select LINGMO_PACKAGE_LIBMODBUS
	help
	  mbpoll is a command line utility to communicate with ModBus
	  slave (RTU or TCP).

	  https://github.com/epsilonrt/mbpoll
```

## package/mbuffer/Config.in
```kconfig
config LINGMO_PACKAGE_MBUFFER
	bool "mbuffer"
	depends on !LINGMO_STATIC_LIBS # dlopen()
	depends on LINGMO_TOOLCHAIN_HAS_THREADS
	help
	  mbuffer is a tool for buffering data streams with a large set
	  of unique features.

	  http://www.maier-komor.de/mbuffer.html

comment "mbuffer needs a toolchain w/ dynamic library, threads"
	depends on LINGMO_STATIC_LIBS || !LINGMO_TOOLCHAIN_HAS_THREADS
```

## package/mc/Config.in
```kconfig
config LINGMO_PACKAGE_MC
	bool "mc"
	depends on LINGMO_USE_WCHAR # libglib2
	depends on LINGMO_TOOLCHAIN_HAS_THREADS # libglib2
	depends on LINGMO_USE_MMU # libglib2, slang
	select LINGMO_PACKAGE_LIBGLIB2
	# mc prefers slang, but can use ncurses too
	select LINGMO_PACKAGE_SLANG if !LINGMO_PACKAGE_NCURSES
	select LINGMO_PACKAGE_NCURSES_WCHAR if LINGMO_PACKAGE_NCURSES
	help
	  GNU Midnight Commander is a visual file manager, licensed
	  under GNU General Public License. It can use either SLang
	  (preferred) or ncurses for screen handling; if neither is
	  enabled SLang will be automatically chosen.

	  https://www.midnight-commander.org

comment "mc needs a toolchain w/ threads, wchar"
	depends on !LINGMO_TOOLCHAIN_HAS_THREADS || !LINGMO_USE_WCHAR
	depends on LINGMO_USE_MMU
```

## package/mcelog/Config.in
```kconfig
config LINGMO_PACKAGE_MCELOG
	bool "mcelog"
	depends on LINGMO_i386 || LINGMO_x86_64
	depends on LINGMO_USE_MMU # fork()
	help
	  mcelog processes machine checks (in particular memory and
	  CPU hardware errors) on modern x86 Linux systems.

	  http://www.mcelog.org/
```

## package/mdadm/Config.in
```kconfig
config LINGMO_PACKAGE_MDADM
	bool "mdadm"
	depends on !LINGMO_STATIC_LIBS # dlfcn.h
	depends on LINGMO_USE_MMU # fork()
	help
	  Utility for managing Linux Software RAID arrays.

	  https://raid.wiki.kernel.org/index.php/A_guide_to_mdadm

comment "mdadm needs a toolchain w/ dynamic library"
	depends on LINGMO_STATIC_LIBS
	depends on LINGMO_USE_MMU
```

## package/mdevd/Config.in
```kconfig
config LINGMO_PACKAGE_MDEVD
	bool "mdevd"
	depends on LINGMO_USE_MMU # skalibs
	select LINGMO_PACKAGE_SKALIBS
	help
	  mdevd is a small daemon managing kernel hotplug events,
	  similarly to udevd.

	  http://skarnet.org/software/mdevd/
```

## package/mdio-tools/Config.in
```kconfig
comment "mdio-tools needs a Linux kernel to be built"
	depends on LINGMO_USE_MMU
	depends on !LINGMO_LINUX_KERNEL

comment "mdio-tools needs a toolchain w/ headers >= 5.1"
	depends on LINGMO_USE_MMU
	depends on LINGMO_LINUX_KERNEL
	depends on !LINGMO_TOOLCHAIN_HEADERS_AT_LEAST_5_1

config LINGMO_PACKAGE_MDIO_TOOLS
	bool "mdio-tools"
	depends on LINGMO_USE_MMU # fork()
	depends on LINGMO_LINUX_KERNEL
	depends on LINGMO_TOOLCHAIN_HEADERS_AT_LEAST_5_1
	select LINGMO_PACKAGE_LIBMNL
	help
	  Low-level debug tools for MDIO devices.

	  https://github.com/wkz/mdio-tools
```

## package/mdnsd/Config.in
```kconfig
config LINGMO_PACKAGE_MDNSD
	bool "mdnsd"
	depends on LINGMO_USE_MMU # fork()
	help
	  Small mDNS-SD daemon for advertising services and device
	  discovery, similar to Avahi and Bonjour.

	  By default, mdnsd runs on all interfaces that support
	  multicast.  It reads services to announce from
	  /etc/mdns.d/*.service, a few common services are included
	  below.  To override the defaults, e.g., path to services,
	  TTL of multicast frames, or the default interface, set
	  MDNSD_ARGS in /etc/default/mdnsd

	  Note: currently no NSS integration with GLIBC.

	  https://github.com/troglobit/mdnsd

if LINGMO_PACKAGE_MDNSD

config LINGMO_PACKAGE_MDNSD_MQUERY
	bool "mquery"
	help
	  Scan a LAN for mDNS capable devices, or query specific
	  records, similar to the mdns-scan tool.  Useful for
	  verifying multicast connectivity or locating neighbors with
	  link-local address.

comment "Services to advertise"

config LINGMO_PACKAGE_MDNSD_FTP_SERVICE
	bool "FTP service"

config LINGMO_PACKAGE_MDNSD_HTTP_SERVICE
	bool "HTTP service"

config LINGMO_PACKAGE_MDNSD_IPP_SERVICE
	bool "IPP service"

config LINGMO_PACKAGE_MDNSD_PRINTER_SERVICE
	bool "Printer service"

config LINGMO_PACKAGE_MDNSD_SSH_SERVICE
	bool "SSH service"
	default y if LINGMO_PACKAGE_DROPBEAR
	default y if LINGMO_PACKAGE_OPENSSH
	default y if LINGMO_PACKAGE_LIBSSH_SERVER

endif
```

## package/mediastreamer/Config.in
```kconfig
config LINGMO_PACKAGE_MEDIASTREAMER
	bool "mediastreamer"
	depends on LINGMO_INSTALL_LIBSTDCPP
	depends on !LINGMO_STATIC_LIBS
	depends on LINGMO_TOOLCHAIN_HAS_THREADS # ortp
	depends on !LINGMO_TOOLCHAIN_HAS_GCC_BUG_64735 # ortp
	depends on LINGMO_TOOLCHAIN_GCC_AT_LEAST_5 # C++14
	select LINGMO_PACKAGE_ALSA_LIB_MIXER if LINGMO_PACKAGE_ALSA_LIB
	select LINGMO_PACKAGE_ALSA_LIB_PCM if LINGMO_PACKAGE_ALSA_LIB
	select LINGMO_PACKAGE_MBEDTLS
	select LINGMO_PACKAGE_ORTP
	help
	  Mediastreamer is a powerful and lightweighted streaming
	  engine specialized for voice/video telephony applications.

	  It is the library that is responsible for all the receiving
	  and sending of multimedia streams in linphone, including
	  voice/video capture, encoding and decoding, and rendering.

	  http://www.linphone.org/technical-corner/mediastreamer2

comment "mediastreamer needs a toolchain w/ threads, C++, dynamic library, gcc >= 5"
	depends on !LINGMO_INSTALL_LIBSTDCPP || \
		!LINGMO_TOOLCHAIN_HAS_THREADS || LINGMO_STATIC_LIBS || \
		!LINGMO_TOOLCHAIN_GCC_AT_LEAST_5

comment "mediastreamer needs a toolchain not affected by GCC bug 64735"
	depends on LINGMO_TOOLCHAIN_HAS_GCC_BUG_64735
```

## package/memcached/Config.in
```kconfig
config LINGMO_PACKAGE_MEMCACHED
	bool "memcached"
	depends on LINGMO_TOOLCHAIN_HAS_THREADS
	depends on LINGMO_USE_MMU # fork()
	select LINGMO_PACKAGE_LIBEVENT
	help
	  Memcached is an in-memory key-value store for small chunks
	  of arbitrary data (strings, objects) from results of
	  database calls, API calls, or page rendering.

	  http://www.memcached.org/

comment "memcached needs a toolchain w/ threads"
	depends on !LINGMO_TOOLCHAIN_HAS_THREADS
	depends on LINGMO_USE_MMU
```

## package/memtester/Config.in
```kconfig
config LINGMO_PACKAGE_MEMTESTER
	bool "memtester"
	help
	  A userspace utility for testing the memory subsystem for
	  faults.

	  http://pyropus.ca/software/memtester/
```

## package/mender-connect/Config.in
```kconfig
config LINGMO_PACKAGE_MENDER_CONNECT
	bool "mender-connect"
	depends on LINGMO_PACKAGE_HOST_GO_TARGET_ARCH_SUPPORTS
	depends on LINGMO_PACKAGE_HOST_GO_TARGET_CGO_LINKING_SUPPORTS
	depends on LINGMO_TOOLCHAIN_HAS_THREADS # libglib2, mender
	depends on LINGMO_USE_WCHAR # libglib2 -> gettext
	depends on LINGMO_USE_MMU # dbus -> fork()
	select LINGMO_PACKAGE_DBUS # runtime
	select LINGMO_PACKAGE_LIBGLIB2
	select LINGMO_PACKAGE_MENDER # runtime
	select LINGMO_PACKAGE_OPENSSL
	help
	  mender-connect is a daemon responsible for handling
	  bidirectional (websocket) communication with the Mender
	  server. The daemon is responsible for implementing a range of
	  troubleshooting features to the device as well as several
	  enhancement to the mender-client.

	  Mender Connect is loosely coupled with the Mender Client. The
	  main information passed between mender-client and
	  mender-connect is the device authorization status. Since only
	  accepted devices can interact with the Mender Server, the
	  Mender Client passes over DBus the authorization token which
	  Mender Connect uses to establish a Websocket connection to the
	  server.

	  https://github.com/mendersoftware/mender-connect

comment "mender-connect needs a toolchain w/ threads, wchar"
	depends on LINGMO_PACKAGE_HOST_GO_TARGET_ARCH_SUPPORTS
	depends on LINGMO_PACKAGE_HOST_GO_TARGET_CGO_LINKING_SUPPORTS
	depends on LINGMO_USE_MMU
	depends on !LINGMO_TOOLCHAIN_HAS_THREADS || !LINGMO_USE_WCHAR
```

## package/menu-cache/Config.in
```kconfig
config LINGMO_PACKAGE_MENU_CACHE
	bool "menu-cache"
	depends on LINGMO_USE_WCHAR # libglib2
	depends on LINGMO_TOOLCHAIN_HAS_THREADS # libglib2
	depends on LINGMO_USE_MMU # libglib2
	select LINGMO_PACKAGE_LIBGLIB2
	select LINGMO_PACKAGE_LIBFM_EXTRA
	help
	  Small library from LXDE project used for application menu
	  integration

	  http://wiki.lxde.org/

comment "menu-cache needs a toolchain w/ wchar, threads"
	depends on LINGMO_USE_MMU
	depends on !LINGMO_USE_WCHAR || !LINGMO_TOOLCHAIN_HAS_THREADS
```

## package/mesa3d-demos/Config.in
```kconfig
config LINGMO_PACKAGE_MESA3D_DEMOS
	bool "mesa3d-demos"
	depends on LINGMO_INSTALL_LIBSTDCPP
	depends on LINGMO_PACKAGE_HAS_LIBGL || LINGMO_PACKAGE_HAS_LIBGLES \
		|| LINGMO_PACKAGE_HAS_LIBEGL || LINGMO_PACKAGE_HAS_LIBOPENVG
	select LINGMO_PACKAGE_LIBGLEW if LINGMO_PACKAGE_XORG7 && LINGMO_PACKAGE_HAS_LIBGL
	select LINGMO_PACKAGE_LIBGLU if LINGMO_PACKAGE_XORG7 && LINGMO_PACKAGE_HAS_LIBGL
	select LINGMO_PACKAGE_XLIB_LIBX11 if LINGMO_PACKAGE_XORG7 && LINGMO_PACKAGE_HAS_LIBGL
	select LINGMO_PACKAGE_XLIB_LIBXEXT if LINGMO_PACKAGE_XORG7 && LINGMO_PACKAGE_HAS_LIBGL
	select LINGMO_PACKAGE_LIBXKBCOMMON if LINGMO_PACKAGE_WAYLAND
	help
	  OpenGL demos from the Mesa 3D project.

	  http://mesa3d.org

comment "mesa3d-demos needs a toolchain with C++"
	depends on !LINGMO_INSTALL_LIBSTDCPP
	depends on LINGMO_PACKAGE_HAS_LIBGL || LINGMO_PACKAGE_HAS_LIBGLES \
		|| LINGMO_PACKAGE_HAS_LIBEGL || LINGMO_PACKAGE_HAS_LIBOPENVG
```

## package/mesa3d-headers/Config.in
```kconfig
config LINGMO_PACKAGE_MESA3D_HEADERS
	bool "mh"
	help
	  Mesa 3D, an open-source implementation of the OpenGL
	  specification.

	  This package only installs headers needed by other packages.

	  http://mesa3d.org
```
