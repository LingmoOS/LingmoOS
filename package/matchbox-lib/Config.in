## package/mesa3d/Config.in
```kconfig
menuconfig LINGMO_PACKAGE_MESA3D
	bool "mesa3d"
	depends on LINGMO_INSTALL_LIBSTDCPP
	depends on !LINGMO_STATIC_LIBS
	depends on LINGMO_TOOLCHAIN_HAS_SYNC_1
	depends on LINGMO_TOOLCHAIN_HAS_THREADS_NPTL
	depends on LINGMO_TOOLCHAIN_GCC_AT_LEAST_8
	select LINGMO_PACKAGE_EXPAT
	select LINGMO_PACKAGE_LIBDRM
	select LINGMO_PACKAGE_WAYLAND_PROTOCOLS if LINGMO_PACKAGE_WAYLAND
	select LINGMO_PACKAGE_ZLIB
	help
	  Mesa 3D, an open-source implementation of the OpenGL
	  specification.

	  http://mesa3d.org

if LINGMO_PACKAGE_MESA3D

# Some Gallium driver needs libelf when built with LLVM support
config LINGMO_PACKAGE_MESA3D_NEEDS_ELFUTILS
	bool

config LINGMO_PACKAGE_MESA3D_LLVM
	bool "llvm support"
	depends on LINGMO_PACKAGE_LLVM_ARCH_SUPPORTS
	depends on LINGMO_TOOLCHAIN_GCC_AT_LEAST_7
	depends on LINGMO_TOOLCHAIN_HAS_THREADS
	depends on LINGMO_INSTALL_LIBSTDCPP
	depends on !LINGMO_TOOLCHAIN_HAS_GCC_BUG_64735 # std::shared_future
	depends on !LINGMO_STATIC_LIBS
	depends on LINGMO_USE_WCHAR # std::wstring
	depends on LINGMO_HOST_GCC_AT_LEAST_7 # host-llvm
	select LINGMO_PACKAGE_LLVM

comment "llvm support needs a toolchain w/ wchar, threads, C++, gcc >= 7, dynamic library, host gcc >= 7"
	depends on LINGMO_PACKAGE_LLVM_ARCH_SUPPORTS
	depends on !LINGMO_TOOLCHAIN_HAS_THREADS || !LINGMO_INSTALL_LIBSTDCPP || \
		!LINGMO_TOOLCHAIN_GCC_AT_LEAST_7 \
		|| LINGMO_STATIC_LIBS || !LINGMO_USE_WCHAR \
		|| !LINGMO_HOST_GCC_AT_LEAST_7

comment "llvm support needs a toolchain not affected by GCC bug 64735"
	depends on LINGMO_PACKAGE_LLVM_ARCH_SUPPORTS
	depends on LINGMO_TOOLCHAIN_HAS_GCC_BUG_64735

# clang and libclc dependencies are satisfied by
# LINGMO_PACKAGE_MESA3D_LLVM
config LINGMO_PACKAGE_MESA3D_OPENCL
	bool "OpenCL support"
	depends on LINGMO_PACKAGE_MESA3D_LLVM
	depends on LINGMO_PACKAGE_MESA3D_GALLIUM_DRIVER_R600 || \
		LINGMO_PACKAGE_MESA3D_GALLIUM_DRIVER_RADEONSI
	select LINGMO_PACKAGE_LLVM_RTTI
	select LINGMO_PACKAGE_CLANG
	select LINGMO_PACKAGE_LIBCLC
	select LINGMO_PACKAGE_HAS_LIBOPENCL

# inform the .mk file of gallium or vulkan driver selection
config LINGMO_PACKAGE_MESA3D_GALLIUM_DRIVER
	bool
	select LINGMO_PACKAGE_MESA3D_DRIVER

config LINGMO_PACKAGE_MESA3D_VULKAN_DRIVER
	bool
	select LINGMO_PACKAGE_MESA3D_DRIVER

config LINGMO_PACKAGE_MESA3D_DRIVER
	bool
	select LINGMO_PACKAGE_XLIB_LIBXSHMFENCE if LINGMO_PACKAGE_XORG7

# Gallium xa state tracker.
# Quote from mesa3d meson.build: "XA state tracker requires at least
# one of the following gallium drivers: nouveau, freedreno, i915, svga.
config LINGMO_PACKAGE_MESA3D_NEEDS_XA
	bool

# OpenGL GLX and Gallium VDPAU both needs X11
config LINGMO_PACKAGE_MESA3D_NEEDS_X11
	bool
	depends on LINGMO_PACKAGE_XORG7
	select LINGMO_PACKAGE_LIBXCB
	select LINGMO_PACKAGE_XLIB_LIBX11
	select LINGMO_PACKAGE_XLIB_LIBXDAMAGE
	select LINGMO_PACKAGE_XLIB_LIBXEXT
	select LINGMO_PACKAGE_XLIB_LIBXFIXES
	select LINGMO_PACKAGE_XLIB_LIBXRANDR
	select LINGMO_PACKAGE_XLIB_LIBXXF86VM
	select LINGMO_PACKAGE_XORGPROTO

comment "Gallium drivers"

config LINGMO_PACKAGE_MESA3D_GALLIUM_DRIVER_CROCUS
	bool "Gallium crocus driver"
	depends on LINGMO_i386 || LINGMO_x86_64
	select LINGMO_PACKAGE_MESA3D_GALLIUM_DRIVER
	help
	  Mesa driver for gen4-7 Intel GPUs.

config LINGMO_PACKAGE_MESA3D_GALLIUM_DRIVER_ETNAVIV
	bool "Gallium Etnaviv driver"
	depends on (LINGMO_TOOLCHAIN_HAS_SYNC_4 && !LINGMO_RISCV_32) || !LINGMO_PACKAGE_XORG7 # libxshmfence
	select LINGMO_PACKAGE_MESA3D_GALLIUM_DRIVER
	select LINGMO_PACKAGE_LIBDRM_ETNAVIV
	help
	  Mesa driver for Vivante GPUs.

config LINGMO_PACKAGE_MESA3D_GALLIUM_DRIVER_FREEDRENO
	bool "Gallium freedreno driver"
	depends on LINGMO_arm || LINGMO_aarch64 || LINGMO_aarch64_be # libdrm-freedreno
	# libdrm's freedreno option depends on LIBDRM_HAS_ATOMIC. Propagating
	# that dependency here causes a circular dependency that Kconfig
	# can't see is just spurious. However, that dependency is about
	# the toolchain having sync4 primitives, which is always a given
	# for arm/aarch64.
	select LINGMO_PACKAGE_MESA3D_GALLIUM_DRIVER
	select LINGMO_PACKAGE_LIBDRM_FREEDRENO
	help
	  Mesa driver for Freedreno GPUs.

config LINGMO_PACKAGE_MESA3D_GALLIUM_DRIVER_I915
	bool "Gallium i915 driver"
	depends on LINGMO_i386 || LINGMO_x86_64
	select LINGMO_PACKAGE_MESA3D_GALLIUM_DRIVER
	select LINGMO_PACKAGE_LIBDRM_INTEL
	help
	  Support for i915-based Intel GPUs.

config LINGMO_PACKAGE_MESA3D_GALLIUM_DRIVER_IRIS
	bool "Gallium iris driver"
	depends on LINGMO_i386 || LINGMO_x86_64
	select LINGMO_PACKAGE_MESA3D_GALLIUM_DRIVER
	help
	  Mesa driver for iris-based Intel GPUs.

config LINGMO_PACKAGE_MESA3D_GALLIUM_DRIVER_LIMA
	bool "Gallium lima driver"
	depends on (LINGMO_TOOLCHAIN_HAS_SYNC_4 && !LINGMO_RISCV_32) || !LINGMO_PACKAGE_XORG7 # libxshmfence
	select LINGMO_PACKAGE_MESA3D_GALLIUM_DRIVER
	help
	  Mesa driver for ARM Mali Utgard GPUs.

config LINGMO_PACKAGE_MESA3D_GALLIUM_DRIVER_NOUVEAU
	bool "Gallium nouveau driver"
	select LINGMO_PACKAGE_MESA3D_GALLIUM_DRIVER
	select LINGMO_PACKAGE_LIBDRM_NOUVEAU
	select LINGMO_PACKAGE_MESA3D_NEEDS_XA
	select LINGMO_PACKAGE_LLVM_RTTI if LINGMO_PACKAGE_MESA3D_LLVM
	help
	  Supports all Nvidia GPUs.

config LINGMO_PACKAGE_MESA3D_GALLIUM_DRIVER_PANFROST
	bool "Gallium panfrost driver"
	depends on (LINGMO_TOOLCHAIN_HAS_SYNC_4 && !LINGMO_RISCV_32) || !LINGMO_PACKAGE_XORG7 # libxshmfence
	select LINGMO_PACKAGE_MESA3D_GALLIUM_DRIVER
	help
	  Mesa driver for ARM Mali Midgard and Bifrost GPUs.

config LINGMO_PACKAGE_MESA3D_GALLIUM_DRIVER_R300
	bool "Gallium Radeon R300 driver"
	depends on LINGMO_i386 || LINGMO_x86_64
	# lbdrm's radeon option depends on LIBDRM_HAS_ATOMIC. Propagating
	# that dependency here causes a circular dependency that Kconfig
	# can't see is just spurious. However, that dependency is about
	# the toolchain having sync4 primitives, which is always a given
	# for x86.
	select LINGMO_PACKAGE_MESA3D_GALLIUM_DRIVER
	select LINGMO_PACKAGE_LIBDRM_RADEON
	help
	  Driver for ATI/AMD Radeon R300/R400/R500 GPUs.

config LINGMO_PACKAGE_MESA3D_GALLIUM_DRIVER_R600
	bool "Gallium Radeon R600 driver"
	depends on LINGMO_i386 || LINGMO_x86_64
	depends on !LINGMO_PACKAGE_MESA3D_LLVM || \
		(LINGMO_PACKAGE_MESA3D_LLVM && (LINGMO_TOOLCHAIN_USES_UCLIBC || \
			LINGMO_TOOLCHAIN_USES_GLIBC)) # elfutils
	select LINGMO_PACKAGE_MESA3D_GALLIUM_DRIVER
	select LINGMO_PACKAGE_LIBDRM_RADEON
	select LINGMO_PACKAGE_LLVM_AMDGPU if LINGMO_PACKAGE_MESA3D_LLVM
	select LINGMO_PACKAGE_ELFUTILS if LINGMO_PACKAGE_MESA3D_LLVM
	select LINGMO_PACKAGE_MESA3D_NEEDS_ELFUTILS if LINGMO_PACKAGE_MESA3D_LLVM
	help
	  Driver for ATI/AMD Radeon R600/R700/HD5000/HD6000 GPUs.

# R600 needs libelf when Mesa3D is built with LLVM support
# musl is not currently compatible with elfutils
comment "R600 driver needs a uClibc or glibc toolchain when llvm is enabled"
	depends on LINGMO_PACKAGE_MESA3D_LLVM
	depends on !(LINGMO_TOOLCHAIN_USES_UCLIBC || LINGMO_TOOLCHAIN_USES_GLIBC)

config LINGMO_PACKAGE_MESA3D_GALLIUM_DRIVER_RADEONSI
	bool "Gallium Radeon SI driver"
	depends on LINGMO_USE_MMU # libdrm
	depends on LINGMO_i386 || LINGMO_x86_64
	depends on LINGMO_PACKAGE_MESA3D_LLVM
	select LINGMO_PACKAGE_MESA3D_GALLIUM_DRIVER
	select LINGMO_PACKAGE_LIBDRM_AMDGPU
	select LINGMO_PACKAGE_LIBDRM_RADEON
	select LINGMO_PACKAGE_LLVM_AMDGPU
	select LINGMO_PACKAGE_ELFUTILS
	select LINGMO_PACKAGE_MESA3D_NEEDS_ELFUTILS
	help
	  Driver for ATI/AMD Radeon HD7000/HD8000/Rx200 GPUs.

config LINGMO_PACKAGE_MESA3D_GALLIUM_DRIVER_SVGA
	bool "Gallium vmware svga driver"
	depends on LINGMO_i386 || LINGMO_x86_64
	select LINGMO_PACKAGE_MESA3D_GALLIUM_DRIVER
	select LINGMO_PACKAGE_LIBDRM_VMWGFX
	select LINGMO_PACKAGE_MESA3D_NEEDS_XA
	help
	  This is a virtual GPU driver for VMWare virtual machines.

config LINGMO_PACKAGE_MESA3D_GALLIUM_DRIVER_SWRAST
	bool "Gallium swrast driver"
	select LINGMO_PACKAGE_MESA3D_GALLIUM_DRIVER
	help
	  This is a software opengl implementation using the Gallium3D
	  infrastructure.

config LINGMO_PACKAGE_MESA3D_GALLIUM_DRIVER_TEGRA
	bool "Gallium tegra driver"
	select LINGMO_PACKAGE_MESA3D_GALLIUM_DRIVER
	select LINGMO_PACKAGE_MESA3D_GALLIUM_DRIVER_NOUVEAU
	select LINGMO_PACKAGE_LIBDRM_NOUVEAU
	select LINGMO_PACKAGE_MESA3D_NEEDS_XA
	help
	  Adds support for Nvidia Tegra GPUs, requires nouveau.

config LINGMO_PACKAGE_MESA3D_GALLIUM_DRIVER_V3D
	bool "Gallium v3d driver"
	depends on (LINGMO_arm && LINGMO_ARM_CPU_HAS_NEON) || LINGMO_aarch64
	depends on LINGMO_TOOLCHAIN_HAS_SYNC_4 || !LINGMO_PACKAGE_XORG7 # libxshmfence
	select LINGMO_PACKAGE_MESA3D_GALLIUM_DRIVER
	select LINGMO_PACKAGE_MESA3D_GALLIUM_DRIVER_VC4 # runtime
	select LINGMO_PACKAGE_MESA3D_OPENGL_EGL
	help
	  Driver for Broadcom VC6 (rpi4) GPUs (needs vc4).

	  It requires a kernel 4.18+ with DRM V3D support enabled:

	  - CONFIG_DRM_V3D
	  - CONFIG_DRM_VC4

config LINGMO_PACKAGE_MESA3D_GALLIUM_DRIVER_VC4
	bool "Gallium vc4 driver"
	depends on (LINGMO_arm && LINGMO_ARM_CPU_HAS_NEON) || LINGMO_aarch64
	depends on LINGMO_TOOLCHAIN_HAS_SYNC_4 || !LINGMO_PACKAGE_XORG7 # libxshmfence
	select LINGMO_PACKAGE_MESA3D_GALLIUM_DRIVER
	select LINGMO_PACKAGE_LIBDRM_VC4
	select LINGMO_PACKAGE_MESA3D_OPENGL_EGL
	help
	  Driver for Broadcom VC4 (rpi2/3) GPUs.
	  It requires a vanilla 4.5+ kernel with drm vc4 (open) support.

config LINGMO_PACKAGE_MESA3D_GALLIUM_DRIVER_VIRGL
	bool "Gallium virgl driver"
	select LINGMO_PACKAGE_MESA3D_GALLIUM_DRIVER
	select LINGMO_PACKAGE_MESA3D_OPENGL_EGL
	help
	  virgl is the 3D acceleration backend for the virtio-gpu
	  shipping with qemu.

config LINGMO_PACKAGE_MESA3D_VDPAU
	bool "Gallium VDPAU state tracker"
	depends on LINGMO_PACKAGE_XORG7
	depends on LINGMO_PACKAGE_MESA3D_GALLIUM_DRIVER_NOUVEAU \
		|| LINGMO_PACKAGE_MESA3D_GALLIUM_DRIVER_R600 \
		|| LINGMO_PACKAGE_MESA3D_GALLIUM_DRIVER_RADEONSI
	select LINGMO_PACKAGE_MESA3D_NEEDS_X11
	select LINGMO_PACKAGE_LIBVDPAU
	help
	  VDPAU state tracker (needs r300, r600, radeonsi or nouveau
	  gallium drivers).

comment "Gallium VDPAU state tracker needs X.org and gallium drivers r600, radeonsi or nouveau"
	depends on !LINGMO_PACKAGE_XORG7 || \
		!(LINGMO_PACKAGE_MESA3D_GALLIUM_DRIVER_NOUVEAU \
		|| LINGMO_PACKAGE_MESA3D_GALLIUM_DRIVER_R600 \
		|| LINGMO_PACKAGE_MESA3D_GALLIUM_DRIVER_RADEONSI)

comment "Vulkan drivers"

config LINGMO_PACKAGE_MESA3D_VULKAN_DRIVER_BROADCOM
	bool "Vulkan broadcom driver"
	depends on LINGMO_arm || LINGMO_aarch64
	depends on LINGMO_TOOLCHAIN_HAS_SYNC_4 # dri3/libxshmfence
	select LINGMO_PACKAGE_MESA3D_VULKAN_DRIVER
	help
	  Vulkan broadcom driver.

config LINGMO_PACKAGE_MESA3D_VULKAN_DRIVER_INTEL
	bool "Vulkan Intel driver"
	depends on LINGMO_i386 || LINGMO_x86_64
	depends on LINGMO_TOOLCHAIN_HAS_SYNC_4 || !LINGMO_PACKAGE_XORG7 # libxshmfence
	depends on LINGMO_TOOLCHAIN_HEADERS_AT_LEAST_3_17 # memfd.h
	depends on LINGMO_TOOLCHAIN_USES_GLIBC # ifunc, static_assert
	select LINGMO_PACKAGE_MESA3D_VULKAN_DRIVER
	help
	  Vulkan driver for Intel hardware from Ivy Bridge onward.

comment "intel vulkan needs a glibc toolchain w/ headers >= 3.17"
	depends on LINGMO_i386 || LINGMO_x86_64
	depends on LINGMO_TOOLCHAIN_HAS_SYNC_4 || !LINGMO_PACKAGE_XORG7
	depends on !LINGMO_TOOLCHAIN_HEADERS_AT_LEAST_3_17 || \
		!LINGMO_TOOLCHAIN_USES_GLIBC

config LINGMO_PACKAGE_MESA3D_VULKAN_DRIVER_SWRAST
	bool "Vulkan swrast driver"
	depends on LINGMO_PACKAGE_MESA3D_LLVM
	select LINGMO_PACKAGE_MESA3D_GALLIUM_DRIVER_SWRAST
	select LINGMO_PACKAGE_MESA3D_VULKAN_DRIVER
	help
	  Vulkan swrast driver.

comment "Off-screen Rendering"

config LINGMO_PACKAGE_MESA3D_OSMESA_GALLIUM
	bool "OSMesa (Gallium) library"
	select LINGMO_PACKAGE_MESA3D_GALLIUM_DRIVER_SWRAST
	help
	  The OSMesa API provides functions for off-screen rendering.

if LINGMO_PACKAGE_MESA3D_DRIVER

comment "OpenGL API Support"

config LINGMO_PACKAGE_MESA3D_GBM
	bool "gbm"
	depends on LINGMO_PACKAGE_MESA3D_GALLIUM_DRIVER && \
		LINGMO_PACKAGE_MESA3D_OPENGL_EGL
	select LINGMO_PACKAGE_HAS_LIBGBM
	select LINGMO_PACKAGE_LIBGBM_HAS_FEATURE_FORMAT_MODIFIER_PLANE_COUNT
	select LINGMO_PACKAGE_LIBGBM_HAS_FEATURE_DMA_BUF
	help
	  Enable Generic Buffer Management (gbm)

comment "gbm support needs a gallium driver w/ EGL support."
	depends on !(LINGMO_PACKAGE_MESA3D_GALLIUM_DRIVER && LINGMO_PACKAGE_MESA3D_OPENGL_EGL)

config LINGMO_PACKAGE_MESA3D_OPENGL_GLX
	bool "OpenGL GLX"
	depends on LINGMO_PACKAGE_XORG7
	select LINGMO_PACKAGE_HAS_LIBGL if !LINGMO_PACKAGE_LIBGLVND
	select LINGMO_PACKAGE_LIBGLVND_DISPATCH_GL if LINGMO_PACKAGE_LIBGLVND
	select LINGMO_PACKAGE_MESA3D_NEEDS_X11
	help
	  Enable GLX graphic acceleration (OpenGL + X11).

comment "OpenGL GLX support needs X11"
	depends on !LINGMO_PACKAGE_XORG7

config LINGMO_PACKAGE_MESA3D_OPENGL_EGL
	bool "OpenGL EGL"
	depends on LINGMO_PACKAGE_MESA3D_GALLIUM_DRIVER
	select LINGMO_PACKAGE_HAS_LIBEGL if !LINGMO_PACKAGE_LIBGLVND
	select LINGMO_PACKAGE_LIBGLVND_DISPATCH_EGL if LINGMO_PACKAGE_LIBGLVND
	select LINGMO_PACKAGE_HAS_LIBEGL_WAYLAND
	select LINGMO_PACKAGE_MESA3D_GBM
	help
	  Use the Khronos EGL APIs. EGL is a window manager for OpenGL
	  applications similar to GLX, for X, and WGL, for Windows.

config LINGMO_PACKAGE_MESA3D_OPENGL_ES
	bool "OpenGL ES"
	select LINGMO_PACKAGE_HAS_LIBGLES if !LINGMO_PACKAGE_LIBGLVND
	select LINGMO_PACKAGE_LIBGLVND_DISPATCH_GLES if LINGMO_PACKAGE_LIBGLVND
	help
	  Use the Khronos OpenGL ES APIs. This is commonly used on
	  embedded systems and represents a subset of the OpenGL API.

endif # LINGMO_PACKAGE_MESA3D_DRIVER

config LINGMO_PACKAGE_PROVIDES_LIBGBM
	default "mesa3d" if LINGMO_PACKAGE_MESA3D_GBM

config LINGMO_PACKAGE_PROVIDES_LIBGL
	default "mesa3d" if LINGMO_PACKAGE_MESA3D_OPENGL_GLX && !LINGMO_PACKAGE_LIBGLVND

config LINGMO_PACKAGE_PROVIDES_LIBEGL
	default "mesa3d" if LINGMO_PACKAGE_MESA3D_OPENGL_EGL && !LINGMO_PACKAGE_LIBGLVND

config LINGMO_PACKAGE_PROVIDES_LIBGLES
	default "mesa3d" if LINGMO_PACKAGE_MESA3D_OPENGL_ES && !LINGMO_PACKAGE_LIBGLVND

config LINGMO_PACKAGE_PROVIDES_LIBOPENCL
	default "mesa3d" if LINGMO_PACKAGE_MESA3D_OPENCL

endif # LINGMO_PACKAGE_MESA3D

comment "mesa3d needs a toolchain w/ gcc >=8, C++, NPTL, dynamic library"
	depends on !LINGMO_INSTALL_LIBSTDCPP || !LINGMO_TOOLCHAIN_HAS_THREADS_NPTL || \
		LINGMO_STATIC_LIBS || !LINGMO_TOOLCHAIN_GCC_AT_LEAST_8
	depends on LINGMO_TOOLCHAIN_HAS_SYNC_1
```

## package/metacity/Config.in
```kconfig
config LINGMO_PACKAGE_METACITY
	bool "metacity"
	depends on LINGMO_PACKAGE_LIBGTK2
	depends on LINGMO_PACKAGE_XORG7
	select LINGMO_PACKAGE_XLIB_LIBX11
	# Metacity configure.ac pretends it can be built without
	# Composite, but in reality, it doesn't build.
	select LINGMO_PACKAGE_XLIB_LIBXCOMPOSITE
	select LINGMO_PACKAGE_XLIB_LIBXFIXES
	select LINGMO_PACKAGE_XLIB_LIBXRENDER
	select LINGMO_PACKAGE_XLIB_LIBXDAMAGE
	# We do not directly depend on Xft, but they are needed to get
	# Xft support in Pango, which we require.
	select LINGMO_PACKAGE_XLIB_LIBXFT
	help
	  Metacity is a window manager for the X Window System.

	  https://wiki.gnome.org/Projects/Metacity
```

## package/mfgtools/Config.in.host
```kconfig
config LINGMO_PACKAGE_HOST_MFGTOOLS
	bool "host mfgtools"
	depends on LINGMO_arm
	depends on LINGMO_HOST_GCC_AT_LEAST_4_9 # host-libusb
	help
	  This package contains the Freescale manufacturing tool.
	  It is designed to program firmware to i.MX boards during
	  production. The communication is done over USB using the
	  Freescale UTP protocol.

	  https://github.com/NXPmicro/mfgtools

comment "host mfgtools needs a toolchain w/ host gcc >= 4.9"
	depends on LINGMO_arm
	depends on !LINGMO_HOST_GCC_AT_LEAST_4_9
```

## package/mfoc/Config.in
```kconfig
config LINGMO_PACKAGE_MFOC
	bool "mfoc"
	select LINGMO_PACKAGE_LIBNFC
	help
	  Mifare Classic Offline Cracker

	  https://github.com/nfc-tools/mfoc
```
