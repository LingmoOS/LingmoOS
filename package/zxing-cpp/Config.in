## package/zxing-cpp/Config.in
```kconfig
comment "zxing-cpp needs a toolchain w/ C++, wchar, dynamic library, threads"
	depends on !LINGMO_INSTALL_LIBSTDCPP || !LINGMO_USE_WCHAR || \
		LINGMO_STATIC_LIBS || !LINGMO_TOOLCHAIN_HAS_THREADS

config LINGMO_PACKAGE_ZXING_CPP
	bool "zxing-cpp"
	depends on !LINGMO_STATIC_LIBS
	depends on LINGMO_USE_WCHAR
	depends on LINGMO_INSTALL_LIBSTDCPP
	depends on LINGMO_TOOLCHAIN_HAS_THREADS
	select LINGMO_PACKAGE_STB
	select LINGMO_PACKAGE_PYTHON_PYBIND if LINGMO_PACKAGE_PYTHON3
	help
	  ZXing-cpp (pronounced "zebra crossing") is an open-source,
	  multi-format 1D/2D barcode image processing library
	  implemented in Java, with ports to other languages. This
	  compiles the C++ port.

	  https://github.com/zxing-cpp/zxing-cpp
```

## package/zynaddsubfx/Config.in
```kconfig
config LINGMO_PACKAGE_ZYNADDSUBFX
	bool "zynaddsubfx"
	depends on LINGMO_INSTALL_LIBSTDCPP
	depends on LINGMO_TOOLCHAIN_GCC_AT_LEAST_4_9 # C++11
	depends on LINGMO_TOOLCHAIN_HAS_THREADS # liblo
	select LINGMO_PACKAGE_FFTW
	select LINGMO_PACKAGE_FFTW_SINGLE
	select LINGMO_PACKAGE_LIBLO
	select LINGMO_PACKAGE_MXML
	select LINGMO_PACKAGE_ZLIB
	help
	  ZynAddSubFX is a fully featured open source software
	  synthesizer capable of making a countless number of
	  instruments, from some common heard from expensive hardware
	  to interesting sounds that you'll boost to an amazing
	  universe of sounds.

	  Note: this Buildroot package does not include the graphical
	  user interface. It is meant to be executed as a headless
	  daemon to be controlled with MIDI events or network OSC
	  (Open Sound Control) events. OSC events can be generated
	  from an external system with the ZynAddSubFX external GUI
	  program zynaddsubfx-ext-gui.

	  https://zynaddsubfx.sourceforge.io/

comment "zynaddsubfx needs a toolchain w/ C++11 and threads"
	depends on !LINGMO_INSTALL_LIBSTDCPP || \
		!LINGMO_TOOLCHAIN_GCC_AT_LEAST_4_9 || \
		!LINGMO_TOOLCHAIN_HAS_THREADS
```

## package/zyre/Config.in
```kconfig
config LINGMO_PACKAGE_ZYRE
	bool "zyre"
	depends on LINGMO_INSTALL_LIBSTDCPP # zeromq
	depends on LINGMO_TOOLCHAIN_HAS_THREADS # zeromq
	depends on LINGMO_USE_MMU # czmq
	select LINGMO_PACKAGE_CZMQ
	select LINGMO_PACKAGE_ZEROMQ
	help
	  An open-source framework for proximity-based peer-to-peer
	  applications.

	  http://zyre.org

comment "zyre needs a toolchain w/ C++, threads"
	depends on LINGMO_USE_MMU
	depends on !(LINGMO_INSTALL_LIBSTDCPP && LINGMO_TOOLCHAIN_HAS_THREADS)
```

## support/testing/tests/package/br2-external/openjdk/package/openjdk-hello-world/Config.in
```kconfig
config LINGMO_PACKAGE_OPENJDK_HELLO_WORLD
	bool "openjdk hello world"
	depends on LINGMO_PACKAGE_OPENJDK
	help
	  Simple class for testing openjdk
```

## support/testing/tests/package/br2-external/openjdk/package/openjdk-jni-test/Config.in
```kconfig
config LINGMO_PACKAGE_OPENJDK_JNI_TEST
	bool "openjdk JNI test"
	depends on LINGMO_PACKAGE_OPENJDK
	help
	  Tests openjdk JNI support
```

## support/testing/tests/package/br2-external/polkit/package/polkit-rules-test/Config.in
```kconfig
config LINGMO_PACKAGE_POLKIT_RULES_TEST
	bool "polkit rules test"
	depends on LINGMO_PACKAGE_POLKIT
	help
	  Simple test to ensure polkit is loading and enforcing rules
	  correctly.
```

## support/testing/tests/package/br2-external/python-pybind/package/python-pybind-example/Config.in
```kconfig
config LINGMO_PACKAGE_PYTHON_PYBIND_EXAMPLE
	bool "python-pybind-example"
	depends on LINGMO_PACKAGE_PYTHON3
	select LINGMO_PACKAGE_PYTHON_PYBIND
	help
	  This test creates a cpp macro later used on target in python
```
