## toolchain/toolchain-bare-metal-buildroot/Config.in
```kconfig
if LINGMO_TOOLCHAIN_BARE_METAL_BUILDROOT

config LINGMO_TOOLCHAIN_BARE_METAL_BUILDROOT_ARCH
	string "architecture tuple"
	help
	  This option allows to define the architecture tuple for the
	  bare-metal toolchain.

source "package/newlib-bare-metal/Config.in"

endif # LINGMO_TOOLCHAIN_BARE_METAL_BUILDROOT
```

## toolchain/toolchain-external/toolchain-external-arm-arm/Config.in
```kconfig
comment "Arm toolchains available for Cortex-A with NEON + EABIhf"
	depends on LINGMO_arm
	depends on !LINGMO_ARM_CPU_ARMV7A || !LINGMO_ARM_EABIHF || !LINGMO_ARM_CPU_HAS_NEON

config LINGMO_TOOLCHAIN_EXTERNAL_ARM_ARM
	bool "Arm ARM 13.2.rel1"
	depends on LINGMO_arm
	depends on LINGMO_ARM_CPU_ARMV7A || LINGMO_ARM_CPU_ARMV8A
	depends on LINGMO_ARM_CPU_HAS_NEON
	depends on LINGMO_HOSTARCH = "x86_64" || LINGMO_HOSTARCH = "aarch64"
	depends on LINGMO_ARM_EABIHF
	depends on !LINGMO_ARCH_NEEDS_GCC_AT_LEAST_13
	select LINGMO_TOOLCHAIN_EXTERNAL_GLIBC
	select LINGMO_TOOLCHAIN_HAS_SSP
	select LINGMO_INSTALL_LIBSTDCPP
	select LINGMO_TOOLCHAIN_HEADERS_AT_LEAST_4_20
	select LINGMO_TOOLCHAIN_GCC_AT_LEAST_13
	select LINGMO_TOOLCHAIN_HAS_FORTRAN
	select LINGMO_TOOLCHAIN_HAS_OPENMP
	help
	  Arm toolchain for the ARM architecture. It uses GCC 13.2,
	  GDB 13, glibc 2.38, Binutils 2.41. It generates code
	  that runs on all Cortex-A profile devices. The code
	  generated uses the hard floating point calling convention,
	  and uses the NEON FPU instructions.

	  This is the same toolchain that was previously distributed by
	  Linaro.

	  https://developer.arm.com/open-source/gnu-toolchain
```

## toolchain/toolchain-external/toolchain-external-codesourcery-mips/Config.in
```kconfig
config LINGMO_TOOLCHAIN_EXTERNAL_CODESOURCERY_MIPS
	bool "Sourcery CodeBench MIPS 2016.05"
	depends on LINGMO_mips || LINGMO_mipsel || LINGMO_mips64 || LINGMO_mips64el
	depends on LINGMO_MIPS_CPU_MIPS32R2 || LINGMO_MIPS_CPU_MIPS64R2
	depends on !LINGMO_ARCH_NEEDS_GCC_AT_LEAST_6
	# Unsupported MIPS cores
	depends on !LINGMO_mips_interaptiv
	depends on LINGMO_HOSTARCH = "x86_64" || LINGMO_HOSTARCH = "x86"
	depends on !LINGMO_MIPS_NABI32
	select LINGMO_TOOLCHAIN_EXTERNAL_GLIBC
	select LINGMO_TOOLCHAIN_HAS_SSP
	select LINGMO_TOOLCHAIN_HAS_NATIVE_RPC
	select LINGMO_TOOLCHAIN_HAS_OPENMP
	select LINGMO_INSTALL_LIBSTDCPP
	select LINGMO_HOSTARCH_NEEDS_IA32_LIBS
	select LINGMO_TOOLCHAIN_HEADERS_AT_LEAST_4_4
	select LINGMO_TOOLCHAIN_GCC_AT_LEAST_5
	help
	  Sourcery CodeBench toolchain for the MIPS architecture, from
	  Mentor Graphics. It uses gcc 5.3, binutils 2.25.51, glibc
	  2.23, uClibc 0.9.30 and gdb 7.10.50, kernel headers 4.4.1. It
	  has support for the following variants:
	    - MIPS32r2 - Big-Endian, 2008 NaN, O32
	      Select MIPS (big endian) core
	      Disable LINGMO_SOFT_FLOAT
	      Set LINGMO_TARGET_OPTIMIZATION to -mnan=2008
	    - MIPS32r2 - Big-Endian, O32
	      Select MIPS (big endian) core
	      Disable LINGMO_SOFT_FLOAT
	    - MIPS32r2 - Big-Endian, O32, MIPS16
	      Select MIPS (big endian) core
	      Disable LINGMO_SOFT_FLOAT
	      Set LINGMO_TARGET_OPTIMIZATION to -mips16
	    - MIPS32r2 - Big-Endian, Soft-Float, O32
	      Select MIPS (big endian) core
	      Select LINGMO_SOFT_FLOAT
	    - MIPS32r2 - Big-Endian, Soft-Float, O32, MIPS16
	      Select MIPS (big endian) core
	      Select LINGMO_SOFT_FLOAT
	      Set LINGMO_TARGET_OPTIMIZATION to -mips16
	    - MIPS32r2 - Little-Endian, 2008 NaN, O32
	      Select MIPS (little endian) core
	      Disable LINGMO_SOFT_FLOAT
	      Set LINGMO_TARGET_OPTIMIZATION to -mnan=2008
	    - MIPS32r2 - Little-Endian, O32
	      Select MIPS (little endian) core
	      Disable LINGMO_SOFT_FLOAT
	    - MIPS32r2 - Little-Endian, O32, MIPS16
	      Select MIPS (little endian) core
	      Disable LINGMO_SOFT_FLOAT
	      Set LINGMO_TARGET_OPTIMIZATION to -mips16
	    - MIPS32r2 - Little-Endian, Soft-Float, O32
	      Select MIPS (little endian) core
	      Select LINGMO_SOFT_FLOAT
	    - MIPS32r2 - Little-Endian, Soft-Float, O32, MIPS16
	      Select MIPS (little endian) core
	      Select LINGMO_SOFT_FLOAT
	      Set LINGMO_TARGET_OPTIMIZATION to -mips16
	    - MIPS32r2 - Little-Endian, Soft-Float, O32, microMIPS
	      Select MIPS (little endian) core
	      Select LINGMO_SOFT_FLOAT
	      Set LINGMO_TARGET_OPTIMIZATION to -mmicromips
	    - MIPS32r2 - uClibc, Big-Endian, 2008 NaN, O32
	      Not usable in Buildroot yet.
	    - MIPS32r2 - uClibc, Big-Endian, O32
	      Not usable in Buildroot yet.
	    - MIPS32r2 - uClibc, Big-Endian, Soft-Float, O32
	      Not usable in Buildroot yet.
	    - MIPS32r2 - uClibc, Little-Endian, 2008 NaN, O32
	      Not usable in Buildroot yet.
	    - MIPS32r2 - uClibc, Little-Endian, O32
	      Not usable in Buildroot yet.
	    - MIPS32r2 - uClibc, Little-Endian, Soft-Float, O32
	      Not usable in Buildroot yet.
	    - MIPS64r2 - Big-Endian, N64
	      Select MIPS64 (big endian) core
	      Select the n64 ABI
	      Disable LINGMO_SOFT_FLOAT
	    - MIPS64r2 - Big-Endian, Soft-Float, N64
	      Select MIPS64 (big endian) core
	      Select the n64 ABI
	      Select LINGMO_SOFT_FLOAT
	    - MIPS64r2 - Little-Endian, N64
	      Select MIPS64 (little endian) core
	      Select the n64 ABI
	      Disable LINGMO_SOFT_FLOAT
	    - MIPS64r2 - Little-Endian, Soft-Float, N64
	      Select MIPS64 (little endian) core
	      Select the n64 ABI
	      Select LINGMO_SOFT_FLOAT

comment "Sourcery CodeBench toolchains are only available for MIPS/MIPS64 o32 and n64"
	depends on !LINGMO_ARCH_NEEDS_GCC_AT_LEAST_6
	depends on LINGMO_MIPS_NABI32
```

## toolchain/toolchain-external/toolchain-external-codesourcery-niosII/Config.in
```kconfig
config LINGMO_TOOLCHAIN_EXTERNAL_CODESOURCERY_NIOSII
	bool "Sourcery CodeBench Nios-II 2018.05"
	depends on LINGMO_nios2
	depends on !LINGMO_ARCH_NEEDS_GCC_AT_LEAST_8
	depends on LINGMO_HOSTARCH = "x86_64" || LINGMO_HOSTARCH = "x86"
	select LINGMO_TOOLCHAIN_EXTERNAL_GLIBC
	select LINGMO_TOOLCHAIN_HAS_SSP
	select LINGMO_TOOLCHAIN_HAS_NATIVE_RPC
	select LINGMO_INSTALL_LIBSTDCPP
	select LINGMO_HOSTARCH_NEEDS_IA32_LIBS
	select LINGMO_TOOLCHAIN_HEADERS_AT_LEAST_4_15
	select LINGMO_TOOLCHAIN_GCC_AT_LEAST_7
	help
	  Sourcery CodeBench toolchain for the Nios-II architecture,
	  from Mentor Graphics. It uses gcc 7.3, binutils 2.28,
	  glibc 2.27, gdb 8.0.1 and kernel headers 4.15.5.
```

## toolchain/toolchain-external/toolchain-external-linaro-aarch64-be/Config.in
```kconfig
config LINGMO_TOOLCHAIN_EXTERNAL_LINARO_AARCH64_BE
	bool "Linaro AArch64 BE 2018.05"
	depends on LINGMO_aarch64_be
	depends on LINGMO_HOSTARCH = "x86_64" || LINGMO_HOSTARCH = "x86"
	depends on !LINGMO_ARCH_NEEDS_GCC_AT_LEAST_8
	select LINGMO_TOOLCHAIN_EXTERNAL_GLIBC
	select LINGMO_TOOLCHAIN_HAS_SSP
	select LINGMO_INSTALL_LIBSTDCPP
	select LINGMO_TOOLCHAIN_HAS_NATIVE_RPC
	select LINGMO_TOOLCHAIN_HEADERS_AT_LEAST_4_10
	select LINGMO_TOOLCHAIN_GCC_AT_LEAST_7
	select LINGMO_TOOLCHAIN_HAS_FORTRAN
	select LINGMO_TOOLCHAIN_HAS_OPENMP
	help
	  Toolchain for the AArch64 Big Endian architecture, from
	  http://www.linaro.org/engineering/armv8/
```

## toolchain/toolchain-external/toolchain-external-linaro-armeb/Config.in
```kconfig
comment "Linaro toolchains available for Cortex-A + EABIhf"
	depends on LINGMO_armeb
	depends on !LINGMO_ARM_CPU_ARMV7A || !LINGMO_ARM_EABIHF

config LINGMO_TOOLCHAIN_EXTERNAL_LINARO_ARMEB
	bool "Linaro armeb 2018.05"
	depends on LINGMO_armeb
	depends on LINGMO_ARM_CPU_ARMV7A || LINGMO_ARM_CPU_ARMV8A
	depends on LINGMO_HOSTARCH = "x86_64" || LINGMO_HOSTARCH = "x86"
	depends on LINGMO_ARM_EABIHF
	depends on !LINGMO_ARCH_NEEDS_GCC_AT_LEAST_8
	select LINGMO_TOOLCHAIN_EXTERNAL_GLIBC
	select LINGMO_TOOLCHAIN_HAS_SSP
	select LINGMO_TOOLCHAIN_HAS_NATIVE_RPC
	select LINGMO_TOOLCHAIN_HAS_OPENMP
	select LINGMO_INSTALL_LIBSTDCPP
	select LINGMO_TOOLCHAIN_HEADERS_AT_LEAST_4_10
	select LINGMO_TOOLCHAIN_GCC_AT_LEAST_7
	help
	  Linaro toolchain for the ARM big endian architecture. It
	  uses Linaro GCC 2018.05 (based on gcc 7.3.1), Linaro GDB
	  2018.05 (based on GDB 8.1), glibc 2.25, Binutils 2018.05
	  (based on 2.28). It generates code that runs on all Cortex-A
	  profile devices, but tuned for the Cortex-A9. The code
	  generated is Thumb 2, with the hard floating point calling
	  convention, and uses the VFPv3-D16 FPU instructions.
```

## toolchain/toolchain-external/toolchain-external-synopsys-arc/Config.in
```kconfig
config LINGMO_TOOLCHAIN_EXTERNAL_SYNOPSYS_ARC
	bool "Synopsys ARC 2019.09 toolchain"
	depends on LINGMO_arc
	depends on LINGMO_HOSTARCH = "x86_64"
	depends on !LINGMO_ARCH_NEEDS_GCC_AT_LEAST_10
	select LINGMO_TOOLCHAIN_EXTERNAL_UCLIBC
	select LINGMO_INSTALL_LIBSTDCPP
	select LINGMO_USE_WCHAR
	select LINGMO_TOOLCHAIN_HAS_THREADS
	select LINGMO_TOOLCHAIN_HAS_THREADS_NPTL
	select LINGMO_TOOLCHAIN_HAS_THREADS_DEBUG
	select LINGMO_TOOLCHAIN_HAS_SSP
	select LINGMO_TOOLCHAIN_HEADERS_AT_LEAST_4_15
	select LINGMO_TOOLCHAIN_GCC_AT_LEAST_9
	help
	  Toolchain for the ARC cores, from
	  https://github.com/foss-for-synopsys-dwc-arc-processors/toolchain/releases
```
