## package/valgrind/Config.in
```kconfig
config LINGMO_PACKAGE_VALGRIND_ARCH_SUPPORTS
	bool
	default y if LINGMO_aarch64
	default y if LINGMO_ARM_CPU_ARMV7A
	default y if LINGMO_mips || LINGMO_mipsel || LINGMO_mips64 || LINGMO_mips64el
	default y if LINGMO_i386 || LINGMO_x86_64
	default y if LINGMO_powerpc || LINGMO_powerpc64 || LINGMO_powerpc64le
	depends on !LINGMO_MIPS_SOFT_FLOAT

comment "valgrind needs a toolchain w/ dynamic library, threads"
	depends on LINGMO_PACKAGE_VALGRIND_ARCH_SUPPORTS
	depends on LINGMO_STATIC_LIBS || !LINGMO_TOOLCHAIN_HAS_THREADS

config LINGMO_PACKAGE_VALGRIND
	bool "valgrind"
	depends on LINGMO_PACKAGE_VALGRIND_ARCH_SUPPORTS
	depends on !LINGMO_STATIC_LIBS
	depends on LINGMO_TOOLCHAIN_HAS_THREADS
	help
	  Tool for debugging and profiling Linux programs.

	  http://valgrind.org/

if LINGMO_PACKAGE_VALGRIND

config LINGMO_PACKAGE_VALGRIND_MEMCHECK
	bool "Memcheck: a memory error detector"
	default y
	help
	  This option allows to install the Memcheck tool

config LINGMO_PACKAGE_VALGRIND_CACHEGRIND
	bool "Cachegrind: a cache and branch-prediction profiler"
	default y
	help
	  This option allows to install the Cachegrind tool

config LINGMO_PACKAGE_VALGRIND_CALLGRIND
	bool "Callgrind: a call-graph generating cache and branch prediction profiler"
	default y
	help
	  This option allows to install the Callgrind tool

config LINGMO_PACKAGE_VALGRIND_HELGRIND
	bool "Helgrind: a thread error detector"
	default y
	help
	  This option allows to install the Helgrind tool

config LINGMO_PACKAGE_VALGRIND_DRD
	bool "DRD: a thread error detector"
	default y
	help
	  This option allows to install the DRD tool

config LINGMO_PACKAGE_VALGRIND_MASSIF
	bool "Massif: a heap profiler"
	default y
	help
	  This option allows to install the Massif tool

config LINGMO_PACKAGE_VALGRIND_DHAT
	bool "DHAT: a dynamic heap analysis tool"
	default y
	help
	  This option allows to install the DHAT tool

config LINGMO_PACKAGE_VALGRIND_SGCHECK
	bool "SGCheck: an experimental stack and global array overrun detector"
	help
	  This option allows to install the SGCheck tool

config LINGMO_PACKAGE_VALGRIND_BBV
	bool "BBV: an experimental basic block vector generation tool"
	help
	  This option allows to install the BBV tool

config LINGMO_PACKAGE_VALGRIND_LACKEY
	bool "Lackey: an example tool"
	help
	  This option allows to install the Lackey tool

config LINGMO_PACKAGE_VALGRIND_NULGRIND
	bool "Nulgrind: the minimal Valgrind tool"
	help
	  This option allows to install the Nulgrind tool

endif
```

## package/valijson/Config.in
```kconfig
config LINGMO_PACKAGE_VALIJSON
	bool "valijson"
	depends on LINGMO_INSTALL_LIBSTDCPP
	help
	  Valijson is a header-only JSON Schema Validation library for
	  C++. Valijson provides a simple validation API that allows
	  you load JSON Schemas, and validate documents loaded by one
	  of several supported parser libraries like boost, jsoncpp,
	  rapidjson and picoJSON.

	  https://github.com/tristanpenman/valijson

comment "valijson needs a toolchain w/ C++"
	depends on !LINGMO_INSTALL_LIBSTDCPP
```

## package/vboot-utils/Config.in.host
```kconfig
config LINGMO_PACKAGE_HOST_VBOOT_UTILS
	bool "host vboot utils"
	select LINGMO_PACKAGE_HOST_UTIL_LINUX
	help
	  Chromium OS verified boot utilities: futility and cgpt.

	  https://www.chromium.org/chromium-os/chromiumos-design-docs/verified-boot
```

## package/vde2/Config.in
```kconfig
config LINGMO_PACKAGE_VDE2
	bool "vde2"
	depends on LINGMO_USE_MMU # fork()
	depends on !LINGMO_STATIC_LIBS # dlopen()
	help
	  VDE is an ethernet compliant virtual network that can be
	  spawned over a set of physical computers over the Internet.
	  VDE is part of the virtualsquare project.

	  https://github.com/virtualsquare/vde-2/

comment "vde2 needs a toolchain w/ dynamic library"
	depends on LINGMO_USE_MMU
	depends on LINGMO_STATIC_LIBS
```

## package/vdr/Config.in
```kconfig
config LINGMO_PACKAGE_VDR
	bool "vdr"
	depends on LINGMO_INSTALL_LIBSTDCPP
	depends on !LINGMO_STATIC_LIBS
	depends on LINGMO_TOOLCHAIN_HAS_THREADS_NPTL
	depends on LINGMO_TOOLCHAIN_HEADERS_AT_LEAST_3_9
	depends on LINGMO_USE_MMU # fork()
	depends on LINGMO_USE_WCHAR
	select LINGMO_PACKAGE_FONTCONFIG
	select LINGMO_PACKAGE_FREETYPE
	select LINGMO_PACKAGE_JPEG
	select LINGMO_PACKAGE_LIBCAP
	select LINGMO_PACKAGE_LIBEXECINFO if !LINGMO_TOOLCHAIN_USES_GLIBC
	help
	  This project describes how to build your own digital
	  satellite receiver and Video Disk Recorder.

	  http://www.tvdr.de

comment "vdr needs a toolchain w/ C++, dynamic library, NPTL, wchar, headers >= 3.9"
	depends on LINGMO_USE_MMU
	depends on !LINGMO_INSTALL_LIBSTDCPP || LINGMO_STATIC_LIBS || \
		!LINGMO_TOOLCHAIN_HAS_THREADS_NPTL || \
		!LINGMO_USE_WCHAR || \
		!LINGMO_TOOLCHAIN_HEADERS_AT_LEAST_3_9
```

## package/versal-firmware/Config.in
```kconfig
config LINGMO_PACKAGE_VERSAL_FIRMWARE
	bool "versal-firmware"
	depends on LINGMO_aarch64
	help
	  Pre-built firmware files for Xilinx Versal boards.

	  https://github.com/Xilinx/soc-prebuilt-firmware

if LINGMO_PACKAGE_VERSAL_FIRMWARE

config LINGMO_PACKAGE_VERSAL_FIRMWARE_VERSION
	string "firmware version"
	default "xilinx_v2023.1"
	help
	  Release version of Versal firmware.

config LINGMO_PACKAGE_VERSAL_FIRMWARE_BOARD
	string "board name"
	default "vck190"
	help
	  Name of Versal target board.
	  Used for installing the appropriate firmware.

endif # LINGMO_PACKAGE_VERSAL_FIRMWARE
```

## package/vim/Config.in
```kconfig
config LINGMO_PACKAGE_VIM
	bool "vim"
	depends on LINGMO_USE_MMU # uses fork()
	depends on LINGMO_USE_WCHAR
	depends on LINGMO_PACKAGE_BUSYBOX_SHOW_OTHERS
	select LINGMO_PACKAGE_NCURSES
	help
	  VIM Text editor

	  http://www.vim.org/

if LINGMO_PACKAGE_VIM

config LINGMO_PACKAGE_VIM_RUNTIME
	bool "install runtime"
	default y
	help
	  Install VIM runtime (syntax highlighing + macros).
	  This option adds about 11MB of data to /usr/share/

endif

comment "vim needs a toolchain w/ wchar"
	depends on !LINGMO_USE_WCHAR
	depends on LINGMO_USE_MMU
	depends on LINGMO_PACKAGE_BUSYBOX_SHOW_OTHERS
```

## package/vlc/Config.in
```kconfig
config LINGMO_PACKAGE_VLC
	bool "vlc"
	depends on !LINGMO_RISCV_32
	depends on LINGMO_USE_MMU # fork()
	depends on LINGMO_INSTALL_LIBSTDCPP
	depends on !LINGMO_STATIC_LIBS
	depends on LINGMO_USE_WCHAR
	depends on LINGMO_TOOLCHAIN_GCC_AT_LEAST_4_9 # C++11
	depends on LINGMO_TOOLCHAIN_HAS_THREADS
	depends on LINGMO_TOOLCHAIN_HEADERS_AT_LEAST_3_7
	select LINGMO_PACKAGE_LIBVORBIS if LINGMO_PACKAGE_OPUS
	select LINGMO_PACKAGE_VLC_OPENCV3_BACKEND if LINGMO_PACKAGE_OPENCV3
	select LINGMO_PACKAGE_ZLIB if LINGMO_PACKAGE_TAGLIB
	help
	  VLC is a free and open source cross-platform multimedia player
	  and framework that plays most multimedia files as well as DVD,
	  Audio CD, VCD, and various streaming protocols.

	  http://www.videolan.org/vlc/

config LINGMO_PACKAGE_VLC_OPENCV3_BACKEND
	bool
	select LINGMO_PACKAGE_OPENCV3_LIB_IMGPROC
	select LINGMO_PACKAGE_OPENCV3_LIB_OBJDETECT

comment "vlc needs a toolchain w/ C++, dynamic library, wchar, threads, gcc >= 4.9, headers >= 3.7"
	depends on !LINGMO_RISCV_32
	depends on LINGMO_USE_MMU
	depends on !LINGMO_INSTALL_LIBSTDCPP || LINGMO_STATIC_LIBS \
		|| !LINGMO_USE_WCHAR || !LINGMO_TOOLCHAIN_HAS_THREADS \
		|| !LINGMO_TOOLCHAIN_GCC_AT_LEAST_4_9 \
		|| !LINGMO_TOOLCHAIN_HEADERS_AT_LEAST_3_7
```

## package/volk/Config.in
```kconfig
comment "volk needs a toolchain w/ C++, NPTL, wchar, dynamic library"
	depends on LINGMO_USE_MMU
	depends on !LINGMO_INSTALL_LIBSTDCPP || !LINGMO_TOOLCHAIN_GCC_AT_LEAST_7 || \
		!LINGMO_TOOLCHAIN_HAS_THREADS_NPTL || LINGMO_STATIC_LIBS

config LINGMO_PACKAGE_VOLK
	bool "volk"
	depends on LINGMO_INSTALL_LIBSTDCPP
	depends on !LINGMO_STATIC_LIBS
	depends on LINGMO_TOOLCHAIN_GCC_AT_LEAST_7 # C++17
	depends on LINGMO_TOOLCHAIN_HAS_THREADS_NPTL
	depends on LINGMO_USE_MMU # use fork()
	help
	  VOLK is the Vector-Optimized Library of Kernels. It is a
	  library that contains kernels of hand-written SIMD code
	  for different mathematical operations. Since each SIMD
	  architecture can be very different and no compiler has yet
	  come along to handle vectorization properly or highly
	  efficiently, VOLK approaches the problem differently.

	  For each architecture or platform that a developer wishes
	  to vectorize for, a new proto-kernel is added to VOLK. At
	  runtime, VOLK will select the correct proto-kernel. In this
	  way, the users of VOLK call a kernel for performing the
	  operation that is platform/architecture agnostic. This
	  allows us to write portable SIMD code.

	  https://www.libvolk.org/
```

## package/vorbis-tools/Config.in
```kconfig
config LINGMO_PACKAGE_VORBIS_TOOLS
	bool "vorbis-tools"
	select LINGMO_PACKAGE_LIBAO
	select LINGMO_PACKAGE_LIBOGG
	select LINGMO_PACKAGE_LIBVORBIS
	select LINGMO_PACKAGE_LIBCURL
	help
	  Standalone player, encoder and decoder for Ogg format files.

	  Works also as a streaming player.

	  http://www.vorbis.com/
```

## package/vpnc/Config.in
```kconfig
config LINGMO_PACKAGE_VPNC
	bool "vpnc"
	depends on LINGMO_PACKAGE_LIBGPG_ERROR_ARCH_SUPPORTS # libgcrypt
	depends on !LINGMO_STATIC_LIBS # gnutls
	depends on LINGMO_USE_MMU # fork()
	depends on LINGMO_USE_WCHAR # gnutls
	select LINGMO_PACKAGE_LIBGCRYPT
	select LINGMO_PACKAGE_LIBGPG_ERROR
	select LINGMO_PACKAGE_GNUTLS
	help
	  Client for Cisco VPN concentrator
	  3000 Series VPN Concentrator
	  IOS Routers
	  PIX/ASA Zecurity Appliances
	  Juniper/Netscreen

	  http://www.unix-ag.uni-kl.de/~massar/vpnc

comment "vpnc needs a toolchain w/ wchar, dynamic library"
	depends on LINGMO_USE_MMU
	depends on !LINGMO_USE_WCHAR || LINGMO_STATIC_LIBS
```

## package/vsftpd/Config.in
```kconfig
config LINGMO_PACKAGE_VSFTPD
	bool "vsftpd"
	depends on LINGMO_USE_MMU # fork()
	help
	  vsftpd is an ftp daemon written with security in mind.
	  http://vsftpd.beasts.org/

if LINGMO_PACKAGE_VSFTPD

config LINGMO_PACKAGE_VSFTPD_UTMPX
	bool "log vsftpd access to utmpx"
	# musl 1.1.4 has an empty utmpx implementation and no WTMPX_FILE
	depends on !LINGMO_TOOLCHAIN_USES_MUSL
	help
	  Enable logging of vsftpd access to utmpx.
	  Note that Buildroot does not generate utmpx by default.

endif
```

## package/vte/Config.in
```kconfig
config LINGMO_PACKAGE_VTE
	bool "vte"
	depends on LINGMO_PACKAGE_HOST_RUSTC_ARCH_SUPPORTS # libgtk3 -> host-libgtk3 -> host-librsvg
	depends on LINGMO_USE_WCHAR
	depends on LINGMO_TOOLCHAIN_HAS_THREADS
	depends on LINGMO_USE_MMU
	depends on LINGMO_INSTALL_LIBSTDCPP
	depends on LINGMO_TOOLCHAIN_GCC_AT_LEAST_10 # C++20
	depends on LINGMO_TOOLCHAIN_HAS_SYNC_4
	depends on !LINGMO_TOOLCHAIN_USES_MUSL
	depends on LINGMO_PACKAGE_HAS_LIBEGL_WAYLAND || \
		LINGMO_PACKAGE_HAS_LIBGL
	depends on LINGMO_PACKAGE_XORG7
	select LINGMO_PACKAGE_LIBGTK3
	select LINGMO_PACKAGE_PCRE2
	help
	  VTE is a library (libvte) implementing a terminal emulator
	  widget for GTK+, and a minimal sample application (vte)
	  using that. Vte is mainly used in gnome-terminal, but
	  can also be used to embed a console/terminal in games,
	  editors, IDEs, etc.

	  http://github.com/GNOME/vte

comment "vte needs a uClibc or glibc toolchain w/ wchar, threads, C++, gcc >= 10"
	depends on LINGMO_PACKAGE_HOST_RUSTC_ARCH_SUPPORTS
	depends on LINGMO_USE_MMU
	depends on LINGMO_TOOLCHAIN_HAS_SYNC_4
	depends on !LINGMO_USE_WCHAR || !LINGMO_INSTALL_LIBSTDCPP || \
		!LINGMO_TOOLCHAIN_HAS_THREADS || \
		!LINGMO_TOOLCHAIN_GCC_AT_LEAST_10 || \
		LINGMO_TOOLCHAIN_USES_MUSL

comment "vte needs an OpenGL or an OpenGL-EGL/wayland backend"
	depends on LINGMO_PACKAGE_HOST_RUSTC_ARCH_SUPPORTS
	depends on LINGMO_USE_MMU
	depends on LINGMO_TOOLCHAIN_HAS_SYNC_4
	depends on !LINGMO_PACKAGE_HAS_LIBEGL_WAYLAND && \
		!LINGMO_PACKAGE_HAS_LIBGL
```

## package/vtun/Config.in
```kconfig
config LINGMO_PACKAGE_VTUN
	bool "vtun"
	depends on LINGMO_USE_MMU # fork()
	select LINGMO_PACKAGE_LZO
	select LINGMO_PACKAGE_OPENSSL
	select LINGMO_PACKAGE_LIBOPENSSL_ENABLE_BLOWFISH if LINGMO_PACKAGE_LIBOPENSSL
	select LINGMO_PACKAGE_ZLIB
	help
	  Tool for easily creating Virtual Tunnels over TCP/IP networks
	  with traffic shaping, compression, and encryption.

	  It supports IP, PPP, SLIP, Ethernet and other tunnel types.

	  http://vtun.sourceforge.net/
```

## package/vulkan-headers/Config.in
```kconfig
config LINGMO_PACKAGE_VULKAN_HEADERS
	bool "vulkan-headers"
	help
	  The Khronos official Vulkan header files and API
	  registry.

	  https://github.com/KhronosGroup/Vulkan-Headers
```

## package/vulkan-loader/Config.in
```kconfig
config LINGMO_PACKAGE_VULKAN_LOADER
	bool "vulkan-loader"
	depends on LINGMO_INSTALL_LIBSTDCPP
	depends on !LINGMO_STATIC_LIBS # dlfcn.h
	depends on LINGMO_TOOLCHAIN_HAS_THREADS
	select LINGMO_PACKAGE_VULKAN_HEADERS
	help
	  The Khronos official Vulkan ICD desktop loader.

	  https://github.com/KhronosGroup/Vulkan-Loader

comment "vulkan-loader needs a toolchain w/ C++, dynamic library, threads"
	depends on !LINGMO_INSTALL_LIBSTDCPP || LINGMO_STATIC_LIBS || \
		!LINGMO_TOOLCHAIN_HAS_THREADS
```

## package/vulkan-tools/Config.in
```kconfig
config LINGMO_PACKAGE_VULKAN_TOOLS
	bool "vulkan-tools"
	depends on LINGMO_INSTALL_LIBSTDCPP # vulkan-loader
	depends on !LINGMO_STATIC_LIBS # vullan-loader
	depends on LINGMO_TOOLCHAIN_GCC_AT_LEAST_4_9 # C++11
	depends on LINGMO_TOOLCHAIN_HAS_THREADS # vulkan-loader
	select LINGMO_PACKAGE_VULKAN_HEADERS
	select LINGMO_PACKAGE_VULKAN_LOADER

	help
	  The Khronos official Vulkan Tools and Utilities.

	  https://github.com/KhronosGroup/Vulkan-Tools

comment "vulkan-tools needs a toolchain w/ C++, dynamic library, threads, gcc >= 4.9"
	depends on !LINGMO_INSTALL_LIBSTDCPP || LINGMO_STATIC_LIBS || \
		!LINGMO_TOOLCHAIN_HAS_THREADS || !LINGMO_TOOLCHAIN_GCC_AT_LEAST_4_9
```

## package/wampcc/Config.in
```kconfig
config LINGMO_PACKAGE_WAMPCC
	bool "wampcc"
	depends on LINGMO_INSTALL_LIBSTDCPP
	depends on LINGMO_TOOLCHAIN_HAS_THREADS_NPTL # libuv
	depends on LINGMO_USE_MMU # libuv
	depends on !LINGMO_STATIC_LIBS # libuv
	depends on LINGMO_TOOLCHAIN_HAS_ATOMIC
	depends on LINGMO_TOOLCHAIN_HAS_SYNC_4 # libuv
	depends on LINGMO_TOOLCHAIN_GCC_AT_LEAST_4_9 # libuv
	depends on !LINGMO_TOOLCHAIN_HAS_GCC_BUG_64735 # std::shared_future
	select LINGMO_PACKAGE_LIBUV
	select LINGMO_PACKAGE_JANSSON
	select LINGMO_PACKAGE_OPENSSL
	help
	  wampcc is a C++ library that implements the Web Application
	  Messaging Protocol.

	  https://github.com/darrenjs/wampcc

comment "wampcc needs a toolchain w/ C++, NPTL, dynamic library, gcc >= 4.9"
	depends on LINGMO_USE_MMU
	depends on LINGMO_TOOLCHAIN_HAS_ATOMIC
	depends on LINGMO_TOOLCHAIN_HAS_SYNC_4
	depends on !LINGMO_INSTALL_LIBSTDCPP || \
		!LINGMO_TOOLCHAIN_HAS_THREADS_NPTL || LINGMO_STATIC_LIBS || \
		!LINGMO_TOOLCHAIN_GCC_AT_LEAST_4_9

comment "wampcc needs a toolchain not affected by GCC bug 64735"
	depends on LINGMO_USE_MMU
	depends on LINGMO_TOOLCHAIN_HAS_ATOMIC
	depends on LINGMO_TOOLCHAIN_HAS_SYNC_4
	depends on LINGMO_TOOLCHAIN_HAS_GCC_BUG_64735
```
