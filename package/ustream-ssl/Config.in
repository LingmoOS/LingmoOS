## package/watchdogd/Config.in
```kconfig
config LINGMO_PACKAGE_WATCHDOGD
	bool "watchdogd"
	depends on LINGMO_USE_MMU # fork()
	select LINGMO_PACKAGE_LIBCONFUSE
	select LINGMO_PACKAGE_LIBITE
	select LINGMO_PACKAGE_LIBUEV
	help
	  Extended version of uClinux-dist watchdogd.  Monitors loadavg,
	  file descriptors and memory leaks, and capable of supervising
	  your processes main loop using an instrumentation API.

	  A reset reason is saved for power loss, CPU overload, or any
	  of the monitored conditions (above).	The full capabilities
	  are limited by the kernel watchdog driver, but even the basic
	  "softdog" driver is supported.  See /etc/watchdogd.conf for
	  details, and try watchdogctl for system status and available
	  commands.

	  https://github.com/troglobit/watchdogd/

if LINGMO_PACKAGE_WATCHDOGD

config LINGMO_PACKAGE_WATCHDOGD_TEST_SUITE
	bool "Enable watchdogctl test cases"
	help
	  The watchdogctl program comes with a suite of tests built-in.
	  They can be used to verify correct operation of watchdogd and
	  the kernel watchdog driver.

config LINGMO_PACKAGE_WATCHDOGD_GENERIC
	bool "Generic script monitor"
	default y if LINGMO_PACKAGE_WATCHDOGD_GENERIC_POLL_WRAP # legacy 2024.02
	help
	  Enable generic script monitor.

config LINGMO_PACKAGE_WATCHDOGD_LOADAVG
	bool "CPU load average monitor"
	default y if LINGMO_PACKAGE_WATCHDOGD_LOADAVG_POLL_WRAP # legacy 2024.02
	help
	  Enable CPU load average monitor.

config LINGMO_PACKAGE_WATCHDOGD_FILENR
	bool "File descriptor leak monitor"
	default y if LINGMO_PACKAGE_WATCHDOGD_FILENR_POLL_WRAP # legacy 2024.02
	help
	  Enable file descriptor leak monitor.

config LINGMO_PACKAGE_WATCHDOGD_MEMINFO
	bool "Memory leak monitor"
	default y if LINGMO_PACKAGE_WATCHDOGD_MEMINFO_POLL_WRAP # legacy 2024.02
	help
	  Enable memory leak monitor.

config LINGMO_PACKAGE_WATCHDOGD_FSMON
	bool "File system monitor"
	help
	  Enable file system monitor.

config LINGMO_PACKAGE_WATCHDOGD_TEMPMON
	bool "Temperature monitor"
	help
	  Enable temperature monitor.

endif
```

## package/wavemon/Config.in
```kconfig
config LINGMO_PACKAGE_WAVEMON
	bool "wavemon"
	depends on LINGMO_TOOLCHAIN_HAS_THREADS
	depends on !LINGMO_STATIC_LIBS # libnl tools
	select LINGMO_PACKAGE_NCURSES
	select LINGMO_PACKAGE_LIBNL
	select LINGMO_PACKAGE_LIBNL_TOOLS
	help
	  wavemon is a wireless device monitoring application that
	  allows you to watch signal and noise levels, packet
	  statistics, device configuration and network parameters of
	  your wireless network hardware.

	  Note that you need a Linux Kernel configuration with
	  wireless extensions or with wireless extensions
	  compatibility enabled.

	  https://github.com/uoaerg/wavemon

comment "wavemon needs a toolchain w/ threads, dynamic library"
	depends on !LINGMO_TOOLCHAIN_HAS_THREADS || LINGMO_STATIC_LIBS
```

## package/wavpack/Config.in
```kconfig
config LINGMO_PACKAGE_WAVPACK
	bool "wavpack"
	select LINGMO_PACKAGE_LIBICONV if !LINGMO_ENABLE_LOCALE
	help
	  WavPack is a completely open audio compression format
	  providing lossless, high-quality lossy, and a unique
	  hybrid compression mode.

	  http://www.wavpack.com/
```
