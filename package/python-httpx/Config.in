## package/python-httpx/Config.in
```kconfig
config LINGMO_PACKAGE_PYTHON_HTTPX
	bool "python-httpx"
	select LINGMO_PACKAGE_PYTHON_ANYIO # runtime
	select LINGMO_PACKAGE_PYTHON_CERTIFI # runtime
	select LINGMO_PACKAGE_PYTHON_HTTPCORE # runtime
	select LINGMO_PACKAGE_PYTHON_IDNA # runtime
	select LINGMO_PACKAGE_PYTHON_SNIFFIO # runtime
	help
	  The next generation HTTP client.

	  https://github.com/encode/httpx
```

## package/python-hwdata/Config.in
```kconfig
config LINGMO_PACKAGE_PYTHON_HWDATA
	bool "python-hwdata"
	select LINGMO_PACKAGE_HWDATA # runtime
	select LINGMO_PACKAGE_HWDATA_PCI_IDS
	select LINGMO_PACKAGE_HWDATA_PNP_IDS
	select LINGMO_PACKAGE_HWDATA_USB_IDS
	help
	  Provides python interface to database stored in hwdata
	  package. It allows you to get human readable description of
	  USB and PCI devices.

	  https://github.com/xsuchy/python-hwdata
```

## package/python-hyperframe/Config.in
```kconfig
config LINGMO_PACKAGE_PYTHON_HYPERFRAME
	bool "python-hyperframe"
	help
	  HTTP/2 framing layer for Python.

	  https://github.com/python-hyper/hyperframe/
```

## package/python-hyperlink/Config.in
```kconfig
config LINGMO_PACKAGE_PYTHON_HYPERLINK
	bool "python-hyperlink"
	select LINGMO_PACKAGE_PYTHON_IDNA # runtime
	help
	  A featureful, correct URL for Python.

	  https://github.com/python-hyper/hyperlink
```

## package/python-ibmiotf/Config.in
```kconfig
config LINGMO_PACKAGE_PYTHON_IBMIOTF
	bool "python-ibmiotf"
	select LINGMO_PACKAGE_PYTHON_ISO8601 # runtime
	select LINGMO_PACKAGE_PYTHON_PAHO_MQTT # runtime
	select LINGMO_PACKAGE_PYTHON_PYTZ # runtime
	select LINGMO_PACKAGE_PYTHON_REQUESTS # runtime
	select LINGMO_PACKAGE_PYTHON_REQUESTS_TOOLBELT # runtime
	select LINGMO_PACKAGE_PYTHON3_SSL # runtime
	help
	  Python Client for IBM Watson IoT Platform.

	  https://github.com/ibm-watson-iot/iot-python
```

## package/python-influxdb/Config.in
```kconfig
config LINGMO_PACKAGE_PYTHON_INFLUXDB
	bool "python-influxdb"
	select LINGMO_PACKAGE_PYTHON_DATEUTIL # runtime
	select LINGMO_PACKAGE_PYTHON_MSGPACK # runtime
	select LINGMO_PACKAGE_PYTHON_PYTZ # runtime
	select LINGMO_PACKAGE_PYTHON_REQUESTS # runtime
	select LINGMO_PACKAGE_PYTHON_SIX # runtime
	help
	  InfluxDB client.

	  https://github.com/influxdb/influxdb-python
```

## package/python-intelhex/Config.in
```kconfig
config LINGMO_PACKAGE_PYTHON_INTELHEX
	bool "python-intelhex"
	help
	  Python library for Intel HEX files manipulations.

	  https://github.com/python-intelhex/intelhex
```

## package/python-ipdb/Config.in
```kconfig
config LINGMO_PACKAGE_PYTHON_IPDB
	bool "python-ipdb"
	select LINGMO_PACKAGE_PYTHON_IPYTHON # runtime
	help
	  IPython-enabled pdb.

	  https://github.com/gotcha/ipdb
```

## package/python-iptables/Config.in
```kconfig
config LINGMO_PACKAGE_PYTHON_IPTABLES
	bool "python-iptables"
	depends on !LINGMO_STATIC_LIBS
	select LINGMO_PACKAGE_IPTABLES
	help
	  Python bindings for iptables.

	  https://github.com/ldx/python-iptables

comment "python-iptables needs a toolchain w/ dynamic library"
	depends on LINGMO_STATIC_LIBS
```

## package/python-ipython/Config.in
```kconfig
config LINGMO_PACKAGE_PYTHON_IPYTHON
	bool "python-ipython"
	select LINGMO_PACKAGE_PYTHON3_SQLITE # runtime
	select LINGMO_PACKAGE_PYTHON_BACKCALL # runtime
	select LINGMO_PACKAGE_PYTHON_DECORATOR # runtime
	select LINGMO_PACKAGE_PYTHON_JEDI # runtime
	select LINGMO_PACKAGE_PYTHON_MATPLOTLIB_INLINE # runtime
	select LINGMO_PACKAGE_PYTHON_PICKLESHARE # runtime
	select LINGMO_PACKAGE_PYTHON_PROMPT_TOOLKIT # runtime
	select LINGMO_PACKAGE_PYTHON_PYGMENTS  # runtime
	select LINGMO_PACKAGE_PYTHON_PEXPECT # runtime
	select LINGMO_PACKAGE_PYTHON_STACK_DATA # runtime
	select LINGMO_PACKAGE_PYTHON_TRAITLETS  # runtime
	help
	  IPython is a command shell for interactive computing in
	  multiple programming languages, originally developed for the
	  Python programming language, that offers enhanced
	  introspection, rich media, additional shell syntax, tab
	  completion, and rich history.

	  http://ipython.org/
```

## package/python-itsdangerous/Config.in
```kconfig
config LINGMO_PACKAGE_PYTHON_ITSDANGEROUS
	bool "python-itsdangerous"
	select LINGMO_PACKAGE_PYTHON3_ZLIB # runtime
	help
	  Itsdangerous contains various helpers to pass data to
	  untrusted environments and to get it back safe and sound.

	  http://pythonhosted.org/itsdangerous/
```

## package/python-iwlib/Config.in
```kconfig
config LINGMO_PACKAGE_PYTHON_IWLIB
	bool "python-iwlib"
	depends on LINGMO_PACKAGE_WIRELESS_TOOLS_LIB
	help
	  python-iwlib is a package for interfacing with iwlib,
	  providing an implementation to the wireless tools in Linux.

	  https://github.com/nhoad/python-iwlib
```

## package/python-janus/Config.in
```kconfig
config LINGMO_PACKAGE_PYTHON_JANUS
	bool "python-janus"
	select LINGMO_PACKAGE_PYTHON_TYPING_EXTENSIONS # runtime
	help
	  Mixed sync-async queue to interoperate between asyncio
	  tasks and classic threads.

	  https://github.com/aio-libs/janus/
```

## package/python-jaraco-functools/Config.in
```kconfig
config LINGMO_PACKAGE_PYTHON_JARACO_FUNCTOOLS
	bool "python-jaraco-functools"
	select LINGMO_PACKAGE_PYTHON_MORE_ITERTOOLS # runtime
	help
	  Additional functools in the spirit of stdlib’s
	  functools.

	  https://github.com/jaraco/jaraco.functools
```

## package/python-jsonmodels/Config.in
```kconfig
config LINGMO_PACKAGE_PYTHON_JSONMODELS
	bool "python-jsonmodels"
	select LINGMO_PACKAGE_PYTHON_DATEUTIL # runtime
	select LINGMO_PACKAGE_PYTHON_SIX # runtime
	help
	  Models to make easier to deal with structures that are
	  converted to, or read from JSON.

	  https://github.com/beregond/jsonmodels
```

## package/python-jsonschema-specifications/Config.in
```kconfig
config LINGMO_PACKAGE_PYTHON_JSONSCHEMA_SPECIFICATIONS
	bool "python-jsonschema-specifications"
	depends on LINGMO_PACKAGE_HOST_RUSTC_TARGET_ARCH_SUPPORTS # python-referencing -> python-rpds-py
	select LINGMO_PACKAGE_PYTHON_REFERENCING # runtime
	help
	  The JSON Schema meta-schemas and vocabularies, exposed as a
	  Registry.

	  https://github.com/python-jsonschema/jsonschema-specifications
```

## package/python-jsonschema/Config.in
```kconfig
config LINGMO_PACKAGE_PYTHON_JSONSCHEMA
	bool "python-jsonschema"
	depends on LINGMO_PACKAGE_HOST_RUSTC_TARGET_ARCH_SUPPORTS # python-rpds-py
	select LINGMO_PACKAGE_PYTHON_ATTRS # runtime
	select LINGMO_PACKAGE_PYTHON_JSONSCHEMA_SPECIFICATIONS # runtime
	select LINGMO_PACKAGE_PYTHON_REFERENCING # runtime
	select LINGMO_PACKAGE_PYTHON_RPDS_PY # runtime
	help
	  An implementation of JSON Schema validation for Python.

	  https://github.com/python-jsonschema/jsonschema
```

## package/python-keyring/Config.in
```kconfig
config LINGMO_PACKAGE_PYTHON_KEYRING
	bool "python-keyring"
	# python-secretstorage -> python-cryptography
	depends on LINGMO_PACKAGE_HOST_RUSTC_TARGET_ARCH_SUPPORTS
	select LINGMO_PACKAGE_PYTHON_ENTRYPOINTS # runtime
	select LINGMO_PACKAGE_PYTHON_JARACO_CLASSES # runtime
	select LINGMO_PACKAGE_PYTHON_JEEPNEY # runtime
	select LINGMO_PACKAGE_PYTHON_SECRETSTORAGE # runtime
	help
	  The Python keyring lib provides a easy way to access the
	  system keyring service from Python.

	  https://pypi.python.org/pypi/keyring
```

## package/python-kflash/Config.in.host
```kconfig
config LINGMO_PACKAGE_HOST_PYTHON_KFLASH
	bool "host python-kflash"
	depends on LINGMO_RISCV_64 && !LINGMO_USE_MMU
	help
	  Kendryte UART ISP Utility - programming code to k210.

	  https://github.com/vowstar/kflash.py
```

## package/python-kmod/Config.in
```kconfig
config LINGMO_PACKAGE_PYTHON_KMOD
	bool "python-kmod"
	depends on !LINGMO_STATIC_LIBS # kmod
	select LINGMO_PACKAGE_HOST_PYTHON_CYTHON
	select LINGMO_PACKAGE_KMOD
	help
	  Python binding for kmod

	  https://github.com/maurizio-lombardi/python-kmod

comment "python-kmod needs a toolchain w/ dynamic library"
	depends on LINGMO_STATIC_LIBS
```

## package/python-libconfig/Config.in
```kconfig
comment "python-libconfig needs a glibc or uClibc toolchain w/ C++, threads"
	depends on !LINGMO_INSTALL_LIBSTDCPP || !LINGMO_TOOLCHAIN_HAS_THREADS || \
		LINGMO_TOOLCHAIN_USES_MUSL

config LINGMO_PACKAGE_PYTHON_LIBCONFIG
	bool "python-libconfig"
	depends on LINGMO_INSTALL_LIBSTDCPP
	depends on LINGMO_TOOLCHAIN_HAS_THREADS
	# error: invalid use of incomplete type 'struct _IO_FILE'
	depends on !LINGMO_TOOLCHAIN_USES_MUSL
	select LINGMO_PACKAGE_BOOST
	select LINGMO_PACKAGE_BOOST_PYTHON
	select LINGMO_PACKAGE_LIBCONFIG
	help
	  Python bindings to the C++ library libconfig

	  Libconfig is a simple library for manipulating structured
	  configuration files. The file format is more compact and more
	  readable than XML. And unlike XML, it is type-aware, so it is
	  not necessary to do string parsing in application code.
	  http://www.hyperrealm.com/libconfig/

	  https://github.com/cnangel/python-libconfig
```

## package/python-libevdev/Config.in
```kconfig
config LINGMO_PACKAGE_PYTHON_LIBEVDEV
	bool "python-libevdev"
	select LINGMO_PACKAGE_LIBEVDEV # runtime
	help
	  Python wrapper for libevdev.

	  https://gitlab.freedesktop.org/libevdev/python-libevdev
```

## package/python-libusb1/Config.in
```kconfig
config LINGMO_PACKAGE_PYTHON_LIBUSB1
	bool "python-libusb1"
	depends on LINGMO_TOOLCHAIN_HAS_THREADS # libusb
	depends on LINGMO_TOOLCHAIN_GCC_AT_LEAST_4_9 # libusb
	select LINGMO_PACKAGE_LIBUSB
	help
	  Pure-python wrapper for libusb-1.0.

	  http://github.com/vpelletier/python-libusb1

comment "python-libusb1 needs a toolchain w/ threads, gcc >= 4.9"
	depends on !LINGMO_TOOLCHAIN_HAS_THREADS || \
		!LINGMO_TOOLCHAIN_GCC_AT_LEAST_4_9
```

## package/python-lmdb/Config.in
```kconfig
config LINGMO_PACKAGE_PYTHON_LMDB
	bool "python-lmdb"
	select LINGMO_PACKAGE_PYTHON_CFFI # runtime
	help
	  Universal Python binding for the LMDB 'Lightning' Database.

	  https://pypi.python.org/pypi/lmdb
```

## package/python-logbook/Config.in
```kconfig
config LINGMO_PACKAGE_PYTHON_LOGBOOK
	bool "python-logbook"
	select LINGMO_PACKAGE_PYTHON3_ZLIB
	help
	  A logging replacement for Python.

	  http://logbook.pocoo.org/
```
