## package/fcgiwrap/Config.in
```kconfig
config LINGMO_PACKAGE_FCGIWRAP
	bool "fcgiwrap"
	depends on LINGMO_USE_MMU # libfcgi
	select LINGMO_PACKAGE_LIBFCGI
	help
	  fcgiwrap is a simple server for running CGI applications
	  over FastCGI. It hopes to provide clean CGI support to Nginx
	  (and other web servers that may need it).

	  https://github.com/gnosek/fcgiwrap
```

## package/fdk-aac/Config.in
```kconfig
# These are the architectures supported by FDK AAC
config LINGMO_PACKAGE_FDK_AAC_ARCH_SUPPORTS
	bool
	default y if LINGMO_aarch64
	default y if LINGMO_arm || LINGMO_armeb
	default y if LINGMO_i386 || LINGMO_x86_64
	default y if LINGMO_mips || LINGMO_mipsel || LINGMO_mips64 || LINGMO_mips64el
	default y if LINGMO_powerpc
	default y if LINGMO_sh

config LINGMO_PACKAGE_FDK_AAC
	bool "fdk-aac"
	depends on LINGMO_PACKAGE_FDK_AAC_ARCH_SUPPORTS
	depends on LINGMO_INSTALL_LIBSTDCPP
	help
	  The Fraunhofer FDK AAC Codec Library for Android ("FDK AAC
	  Codec") is software that implements the MPEG Advanced Audio
	  Coding ("AAC") encoding and decoding scheme for digital audio

	  http://sourceforge.net/projects/opencore-amr/files/fdk-aac/

comment "fdk-aac needs a toolchain w/ C++"
	depends on LINGMO_PACKAGE_FDK_AAC_ARCH_SUPPORTS
	depends on !LINGMO_INSTALL_LIBSTDCPP
```

## package/feh/Config.in
```kconfig
config LINGMO_PACKAGE_FEH
	bool "feh"
	depends on LINGMO_PACKAGE_XORG7
	depends on LINGMO_USE_MMU # fork()
	select LINGMO_PACKAGE_XLIB_LIBXT
	select LINGMO_PACKAGE_IMLIB2
	select LINGMO_PACKAGE_IMLIB2_PNG
	select LINGMO_PACKAGE_IMLIB2_JPEG
	select LINGMO_PACKAGE_IMLIB2_X
	help
	  feh is an X11 image viewer aimed mostly at console users.

	  http://feh.finalrewind.org/
```

## package/fetchmail/Config.in
```kconfig
config LINGMO_PACKAGE_FETCHMAIL
	bool "fetchmail"
	depends on LINGMO_USE_MMU # fork()
	select LINGMO_PACKAGE_CA_CERTIFICATES
	select LINGMO_PACKAGE_OPENSSL
	select LINGMO_PACKAGE_OPENSSL_FORCE_LIBOPENSSL
	help
	  Fetchmail - the mail-retrieval daemon
	  Client daemon to move mail from POP and IMAP to your local
	  computer

	  http://www.fetchmail.info/
```

## package/fftw/fftw-long-double/Config.in
```kconfig
config LINGMO_PACKAGE_FFTW_LONG_DOUBLE
	bool "fftw-long-double"
	# long-double precision require long-double trigonometric routines
	depends on !(LINGMO_TOOLCHAIN_USES_UCLIBC && \
		(LINGMO_arm || LINGMO_mips || LINGMO_mipsel))
	help
	  Compile fftw in long double precision, i.e. use 'long double'
	  for floating point type.
```
