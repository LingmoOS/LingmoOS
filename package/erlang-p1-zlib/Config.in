## package/erlang-p1-zlib/Config.in
```kconfig
config LINGMO_PACKAGE_ERLANG_P1_ZLIB
	bool "erlang-p1-zlib"
	select LINGMO_PACKAGE_ZLIB
	help
	  Erlang interface to zlib

	  https://github.com/processone/zlib
```

## package/erlang/Config.in
```kconfig
config LINGMO_PACKAGE_HOST_ERLANG_ARCH_SUPPORTS
	bool
	default y if LINGMO_HOSTARCH = "aarch64"
	default y if LINGMO_HOSTARCH = "x86_64"
	default y if LINGMO_HOSTARCH = "x86"

config LINGMO_PACKAGE_ERLANG_ARCH_SUPPORTS
	bool
	# see HOWTO/INSTALL.md for Erlang's supported platforms
	# when using its native atomic ops implementation or gcc's
	# __atomic_* builtins
	default y if LINGMO_i386 || LINGMO_x86_64 || LINGMO_powerpc || \
		LINGMO_sparc_v9 || LINGMO_arm || LINGMO_aarch64 || LINGMO_mipsel || \
		LINGMO_RISCV_64
	# erlang needs host-erlang
	depends on LINGMO_PACKAGE_HOST_ERLANG_ARCH_SUPPORTS

comment "erlang needs a glibc or musl toolchain w/ dynamic library, threads, wchar"
	depends on LINGMO_USE_MMU # fork()
	depends on LINGMO_PACKAGE_ERLANG_ARCH_SUPPORTS
	depends on LINGMO_STATIC_LIBS || !LINGMO_TOOLCHAIN_HAS_THREADS \
		|| !LINGMO_USE_WCHAR || LINGMO_TOOLCHAIN_USES_UCLIBC

config LINGMO_PACKAGE_ERLANG
	bool "erlang"
	depends on LINGMO_USE_MMU # fork()
	depends on LINGMO_USE_WCHAR
	depends on !LINGMO_STATIC_LIBS
	depends on LINGMO_TOOLCHAIN_HAS_THREADS
	depends on !LINGMO_TOOLCHAIN_USES_UCLIBC
	depends on LINGMO_PACKAGE_ERLANG_ARCH_SUPPORTS
	select LINGMO_PACKAGE_ZLIB
	help
	  Erlang is a programming language used to build massively
	  scalable soft real-time systems with requirements on high
	  availability. Some of its uses are in telecoms, banking,
	  e-commerce, computer telephony and instant messaging.
	  Erlang's runtime system has built-in support for
	  concurrency, distribution and fault tolerance.

	  http://www.erlang.org

if LINGMO_PACKAGE_ERLANG

config LINGMO_PACKAGE_ERLANG_MEGACO
	bool "install megaco application"
	help
	  The Megaco application is a framework for building
	  applications on top of the Megaco/H.248 protocol. It is
	  approximately 14MB in size so if you do not need it then
	  it is recommended not to enable it.

endif # LINGMO_PACKAGE_ERLANG
```

## package/erofs-utils/Config.in
```kconfig
config LINGMO_PACKAGE_EROFS_UTILS
	bool "erofs-utils"
	select LINGMO_PACKAGE_UTIL_LINUX
	select LINGMO_PACKAGE_UTIL_LINUX_LIBUUID
	help
	  Userspace utilities for EROFS filesystem

	  https://git.kernel.org/pub/scm/linux/kernel/git/xiang/erofs-utils.git

if LINGMO_PACKAGE_EROFS_UTILS

config LINGMO_PACKAGE_EROFS_UTILS_LZ4
	bool "lz4 support"
	select LINGMO_PACKAGE_LZ4
	help
	  Support LZ4 compression algorithm

config LINGMO_PACKAGE_EROFS_UTILS_EROFSFUSE
	bool "erofsfuse support"
	depends on LINGMO_USE_MMU # libfuse
	depends on !LINGMO_STATIC_LIBS # libfuse
	depends on LINGMO_TOOLCHAIN_HAS_THREADS # libfuse
	select LINGMO_PACKAGE_LIBFUSE
	help
	  FUSE file system client for EROFS

comment "erofsfuse needs a toolchain w/ threads, dynamic library"
	depends on LINGMO_USE_MMU
	depends on !LINGMO_TOOLCHAIN_HAS_THREADS || LINGMO_STATIC_LIBS

endif
```

## package/esp-hosted/Config.in
```kconfig
comment "esp-hosted needs a Linux kernel to be built"
	depends on !LINGMO_s390x
	depends on !LINGMO_LINUX_KERNEL

config LINGMO_PACKAGE_ESP_HOSTED
	bool "esp-hosted"
	depends on !LINGMO_s390x
	depends on LINGMO_LINUX_KERNEL
	help
	  This package builds and installs the Linux kernel driver for
	  the Esp32-* Linux Wi-Fi driver. It supports both SDIO and SPI
	  busses that is selectable. It is compatible with recent Linux
	  kernels (>= 5.4).

if LINGMO_PACKAGE_ESP_HOSTED

choice
	prompt "HW interface"
	default LINGMO_PACKAGE_ESP_HOSTED_SDIO
	help
	  Select which bus type esp is attached to

config LINGMO_PACKAGE_ESP_HOSTED_SDIO
	bool "SDIO"

config LINGMO_PACKAGE_ESP_HOSTED_SPI
	bool "SPI"

endchoice

choice
	prompt "Target"
	default LINGMO_PACKAGE_ESP_HOSTED_TARGET_ESP32
	help
	  Select which SoC Target driver is used for

config LINGMO_PACKAGE_ESP_HOSTED_TARGET_ESP32
	bool "ESP32"

config LINGMO_PACKAGE_ESP_HOSTED_TARGET_ESP32C6
	bool "ESP32C6"

endchoice

endif
```

## package/eudev/Config.in
```kconfig
config LINGMO_PACKAGE_EUDEV
	bool "eudev"
	depends on LINGMO_ROOTFS_DEVICE_CREATION_DYNAMIC_EUDEV
	depends on LINGMO_USE_MMU # uses fork()
	depends on LINGMO_USE_WCHAR # needs C99 compiler
	depends on !LINGMO_STATIC_LIBS # kmod
	select LINGMO_PACKAGE_HAS_UDEV
	select LINGMO_PACKAGE_UDEV_GENTOO_SCRIPTS if LINGMO_INIT_OPENRC
	select LINGMO_PACKAGE_UTIL_LINUX
	select LINGMO_PACKAGE_UTIL_LINUX_LIBS
	select LINGMO_PACKAGE_UTIL_LINUX_LIBBLKID
	select LINGMO_PACKAGE_KMOD
	help
	  eudev is a fork of systemd-udev with the goal of obtaining
	  better compatibility with existing software such as OpenRC and
	  Upstart, older kernels, various toolchains and anything else
	  required by users and various distributions.

	  https://github.com/eudev-project/eudev

if LINGMO_PACKAGE_EUDEV

config LINGMO_PACKAGE_PROVIDES_UDEV
	default "eudev"

config LINGMO_PACKAGE_EUDEV_RULES_GEN
	bool "enable rules generator"
	help
	  Enable persistent rules generator

config LINGMO_PACKAGE_EUDEV_ENABLE_HWDB
	bool "enable hwdb installation"
	default y
	select LINGMO_PACKAGE_HOST_EUDEV # for udevadm, during target-finalize
	help
	  Enables hardware database installation to /etc/udev/hwdb.bin

endif

comment "eudev needs eudev /dev management"
	depends on LINGMO_USE_MMU
	depends on !LINGMO_ROOTFS_DEVICE_CREATION_DYNAMIC_EUDEV

comment "eudev needs a toolchain w/ wchar, dynamic library"
	depends on LINGMO_USE_MMU
	depends on !LINGMO_USE_WCHAR || LINGMO_STATIC_LIBS
```

## package/eudev/Config.in.host
```kconfig
# Select this if you need host eudev tools (e.g. udevadm)
config LINGMO_PACKAGE_HOST_EUDEV
	bool
```

## package/ev3dev-linux-drivers/Config.in
```kconfig
# Prompt-less option, because this package is not doing anything except
# downloading the ev3dev driver sources. The real work is done by a Linux
# extension.
config LINGMO_PACKAGE_EV3DEV_LINUX_DRIVERS
	bool
	depends on LINGMO_LINUX_KERNEL
	help
	  Linux drivers for LEGO MINDSTORMS EV3

	  This is only the download helper for the kernel patch.

	  https://github.com/ev3dev/lego-linux-drivers
```

## package/evemu/Config.in
```kconfig
config LINGMO_PACKAGE_EVEMU
	bool "evemu"
	select LINGMO_PACKAGE_LIBEVDEV
	help
	  evemu records and replays device descriptions and events

	  http://www.freedesktop.org/wiki/Evemu/
```

## package/exempi/Config.in
```kconfig
config LINGMO_PACKAGE_EXEMPI
	bool "exempi"
	depends on !LINGMO_STATIC_LIBS # dlfcn.h
	depends on LINGMO_INSTALL_LIBSTDCPP
	depends on LINGMO_TOOLCHAIN_HAS_THREADS
	depends on LINGMO_USE_WCHAR
	select LINGMO_PACKAGE_EXPAT
	select LINGMO_PACKAGE_LIBICONV if !LINGMO_ENABLE_LOCALE
	select LINGMO_PACKAGE_ZLIB
	help
	  Exempi is an implementation of XMP (Extensible Metadata
	  Platform). Version 2.x is based on Adobe XMP SDK.

	  http://libopenraw.freedesktop.org/wiki/Exempi

comment "exempi needs a toolchain w/ C++, dynamic library, threads, wchar"
	depends on LINGMO_STATIC_LIBS || !LINGMO_INSTALL_LIBSTDCPP || \
		!LINGMO_TOOLCHAIN_HAS_THREADS || !LINGMO_USE_WCHAR
```

## package/exfat/Config.in
```kconfig
config LINGMO_PACKAGE_EXFAT
	bool "exFAT (FUSE)"
	depends on LINGMO_TOOLCHAIN_HAS_THREADS # libfuse
	depends on LINGMO_USE_MMU # libfuse
	depends on LINGMO_USE_WCHAR
	depends on !LINGMO_STATIC_LIBS # libfuse
	select LINGMO_PACKAGE_LIBFUSE3 if !LINGMO_PACKAGE_LIBFUSE
	help
	  A full-featured exFAT file system implementation for GNU/Linux
	  and other Unix-like systems as a FUSE module.

	  https://github.com/relan/exfat

comment "exfat needs a toolchain w/ wchar, threads, dynamic library"
	depends on LINGMO_USE_MMU
	depends on !LINGMO_TOOLCHAIN_HAS_THREADS || !LINGMO_USE_WCHAR || LINGMO_STATIC_LIBS
```

## package/exiv2/Config.in
```kconfig
comment "exiv2 needs a uClibc or glibc toolchain w/ C++, wchar, dynamic library, threads"
	depends on LINGMO_STATIC_LIBS || !LINGMO_INSTALL_LIBSTDCPP \
		|| !LINGMO_USE_WCHAR || !LINGMO_TOOLCHAIN_HAS_THREADS \
		|| LINGMO_TOOLCHAIN_USES_MUSL

config LINGMO_PACKAGE_EXIV2
	bool "exiv2"
	depends on !LINGMO_STATIC_LIBS
	depends on LINGMO_INSTALL_LIBSTDCPP
	depends on LINGMO_TOOLCHAIN_HAS_THREADS
	depends on !LINGMO_TOOLCHAIN_USES_MUSL # PTHREAD_RECURSIVE_MUTEX_INITIALIZER_NP
	depends on LINGMO_USE_WCHAR
	help
	  Exiv2 is a C++ library and a command line utility to manage
	  image metadata. It provides fast and easy read and write
	  access to the Exif, IPTC and XMP metadata of images in
	  various formats.

	  http://www.exiv2.org/

if LINGMO_PACKAGE_EXIV2

config LINGMO_PACKAGE_EXIV2_PNG
	bool "PNG image support"
	select LINGMO_PACKAGE_ZLIB
	help
	  Build with PNG image support

config LINGMO_PACKAGE_EXIV2_XMP
	bool "XMP support"
	select LINGMO_PACKAGE_EXPAT
	help
	  Build with XMP support

config LINGMO_PACKAGE_EXIV2_LENSDATA
	bool "Nikon lens name database"
	help
	  Integrate Nikon lens name database.

	  This database comes from a thirdparty and is free to use in
	  non-commercial, GPL or open source software only.
	  For more informations src/nikonmn_int.cpp.

endif
```

## package/eza/Config.in
```kconfig
config LINGMO_PACKAGE_EZA
	bool "eza"
	depends on LINGMO_PACKAGE_HOST_RUSTC_TARGET_ARCH_SUPPORTS
	select LINGMO_PACKAGE_HOST_RUSTC
	help
	  eza is a modern, maintained replacement for ls, built on exa.

	  https://github.com/eza-community/eza.git
```

## package/f2fs-tools/Config.in
```kconfig
config LINGMO_PACKAGE_F2FS_TOOLS
	bool "f2fs-tools"
	depends on LINGMO_USE_WCHAR # uses wchar_t
	select LINGMO_PACKAGE_UTIL_LINUX
	select LINGMO_PACKAGE_UTIL_LINUX_LIBUUID
	help
	  Tools for Flash-Friendly File System (F2FS)

	  https://git.kernel.org/pub/scm/linux/kernel/git/jaegeuk/f2fs-tools.git

comment "f2fs-tools needs a toolchain w/ wchar"
	depends on !LINGMO_USE_WCHAR
```

## package/faifa/Config.in
```kconfig
config LINGMO_PACKAGE_FAIFA
	bool "faifa"
	depends on !LINGMO_STATIC_LIBS
	depends on LINGMO_TOOLCHAIN_HAS_THREADS
	select LINGMO_PACKAGE_LIBPCAP
	help
	  Faifa can configure any Intellon-based Power Line
	  Communication device using Intellon INT5000 and INT6000
	  series chips (6000 and 6300 chips). It supports all
	  Intellon-specific management and control frames as well as
	  standard management frames.

	  https://github.com/ffainelli/faifa

comment "faifa needs a toolchain w/ dynamic library, threads"
	depends on LINGMO_STATIC_LIBS || !LINGMO_TOOLCHAIN_HAS_THREADS
```

## package/falcosecurity-libs/Config.in
```kconfig
config LINGMO_PACKAGE_FALCOSECURITY_LIBS
	bool
	depends on LINGMO_PACKAGE_LIBABSEIL_CPP_ARCH_SUPPORTS # grpc
	depends on LINGMO_PACKAGE_PROTOBUF_ARCH_SUPPORTS # protobuf
	depends on LINGMO_LINUX_KERNEL
	depends on LINGMO_INSTALL_LIBSTDCPP # jsoncpp, protobuf, tbb
	depends on LINGMO_TOOLCHAIN_GCC_AT_LEAST_8 # grpc -> libabseil-cpp
	depends on LINGMO_TOOLCHAIN_HAS_THREADS # jq, protobuf, tbb
	depends on !LINGMO_STATIC_LIBS # protobuf, tbb
	depends on LINGMO_TOOLCHAIN_HAS_SYNC_4 || LINGMO_TOOLCHAIN_HAS_ATOMIC # grpc
	depends on LINGMO_TOOLCHAIN_USES_GLIBC # tbb
	depends on LINGMO_PACKAGE_LUAINTERPRETER_ABI_VERSION_5_1
	select LINGMO_PACKAGE_C_ARES
	select LINGMO_PACKAGE_ELFUTILS
	select LINGMO_PACKAGE_GRPC
	select LINGMO_PACKAGE_GTEST
	select LINGMO_PACKAGE_HOST_GRPC
	select LINGMO_PACKAGE_HOST_PROTOBUF
	select LINGMO_PACKAGE_JQ
	select LINGMO_PACKAGE_JSONCPP
	select LINGMO_PACKAGE_LIBB64
	select LINGMO_PACKAGE_LIBCURL
	select LINGMO_PACKAGE_OPENSSL
	select LINGMO_PACKAGE_PROTOBUF
	select LINGMO_PACKAGE_TBB
	select LINGMO_PACKAGE_VALIJSON
	select LINGMO_PACKAGE_ZLIB
	help
	  falcosecurity/libs provides libsinsp, libscap, the kernel
	  module driver and the eBPF driver sources.

	  https://github.com/falcosecurity/libs
```

## package/fan-ctrl/Config.in
```kconfig
config LINGMO_PACKAGE_FAN_CTRL
	bool "fan-ctrl"
	depends on LINGMO_USE_MMU # fork()
	help
	  Fan-ctrl is a little daemon that controls the speed of one
	  or more system or CPU fans. It does so by monitoring
	  temperature inputs and selecting a fan speed from an array
	  of available speeds based on a set of temperature
	  thresholds.

	  http://fan-ctrl.sourceforge.net/
```

## package/fastd/Config.in
```kconfig
config LINGMO_PACKAGE_FASTD
	bool "fastd"
	depends on LINGMO_USE_MMU # fork()
	depends on LINGMO_TOOLCHAIN_HAS_THREADS
	depends on !LINGMO_STATIC_LIBS # libuecc
	select LINGMO_PACKAGE_LIBUECC
	select LINGMO_PACKAGE_LIBSODIUM
	select LINGMO_PACKAGE_LIBSODIUM_FULL
	help
	  Fast and Secure Tunneling Daemon

	  https://github.com/NeoRaider/fastd/wiki

if LINGMO_PACKAGE_FASTD

config LINGMO_PACKAGE_FASTD_STATUS_SOCKET
	bool "status socket support"
	default y
	depends on LINGMO_TOOLCHAIN_HAS_SYNC_4 # json-c
	select LINGMO_PACKAGE_JSON_C
	help
	  Enable support for a socket to get fastd's status.

config LINGMO_PACKAGE_FASTD_OFFLOAD_L2TP
	bool "l2tp offload support"
	select LINGMO_PACKAGE_LIBMNL
	help
	  L2TP can be offloaded to the Linux kernel, significantly
	  increasing throughput.

endif

comment "fastd needs a toolchain w/ threads, dynamic library"
	depends on LINGMO_USE_MMU
	depends on !LINGMO_TOOLCHAIN_HAS_THREADS \
		|| LINGMO_STATIC_LIBS
```

## package/fbterm/Config.in
```kconfig
config LINGMO_PACKAGE_FBTERM
	bool "fbterm"
	depends on LINGMO_INSTALL_LIBSTDCPP
	depends on LINGMO_ENABLE_LOCALE
	depends on LINGMO_USE_WCHAR
	depends on LINGMO_USE_MMU # fork()
	select LINGMO_PACKAGE_FONTCONFIG
	select LINGMO_PACKAGE_LIBERATION
	help
	  fbterm is a fast terminal emulator for Linux with frame buffer
	  device or VESA video card.

	  https://code.google.com/archive/p/fbterm/

comment "fbterm needs a toolchain w/ C++, wchar, locale"
	depends on LINGMO_USE_MMU
	depends on !(LINGMO_INSTALL_LIBSTDCPP && LINGMO_ENABLE_LOCALE && LINGMO_USE_WCHAR)
```

## package/fbtft/Config.in
```kconfig
# Prompt-less option, because this package is not doing anything
# except downloading the FB TFT sources. The real work is done by a
# Linux extension.
config LINGMO_PACKAGE_FBTFT
	bool
	depends on LINGMO_LINUX_KERNEL
	help
	  Linux Framebuffer drivers for small TFT LCD display modules,
	  e.g. Adafruit PiTFT displays for Raspberry Pi.

	  This is only the download helper for the kernel patch.

	  https://github.com/notro/fbtft
```

## package/fcft/Config.in
```kconfig
config LINGMO_PACKAGE_FCFT
	bool "fcft"
	depends on LINGMO_TOOLCHAIN_USES_GLIBC || LINGMO_TOOLCHAIN_USES_MUSL # C11 threads
	select LINGMO_PACKAGE_FONTCONFIG
	select LINGMO_PACKAGE_FREETYPE
	select LINGMO_PACKAGE_PIXMAN
	select LINGMO_PACKAGE_TLLIST
	help
	  A simple library for font loading and glyph rasterization
	  using FontConfig, FreeType and pixman.

	  https://codeberg.org/dnkl/fcft

if LINGMO_PACKAGE_FCFT

config LINGMO_PACKAGE_FCFT_GRAPHEME_SHAPING
	bool "grapheme-shaping"
	depends on LINGMO_INSTALL_LIBSTDCPP # harfbuzz
	depends on LINGMO_TOOLCHAIN_HAS_SYNC_4 # harfbuzz
	depends on LINGMO_TOOLCHAIN_GCC_AT_LEAST_4_9 # harfbuzz
	select LINGMO_PACKAGE_HARFBUZZ
	help
	  Enables shaping of individual grapheme clusters

comment "grapheme-shaping needs a toolchain w/ C++, gcc >= 4.9"
	depends on LINGMO_TOOLCHAIN_HAS_SYNC_4
	depends on !LINGMO_INSTALL_LIBSTDCPP || !LINGMO_TOOLCHAIN_GCC_AT_LEAST_4_9

config LINGMO_PACKAGE_FCFT_RUN_SHAPING
	bool "run-shaping"
	depends on LINGMO_INSTALL_LIBSTDCPP # harfbuzz
	depends on LINGMO_TOOLCHAIN_HAS_SYNC_4 # harfbuzz
	depends on LINGMO_TOOLCHAIN_GCC_AT_LEAST_4_9 # harfbuzz
	select LINGMO_PACKAGE_HARFBUZZ
	select LINGMO_PACKAGE_UTF8PROC
	help
	  Enables shaping of whole text runs.

comment "run-shaping needs a toolchain w/ C++, gcc >= 4.9"
	depends on LINGMO_TOOLCHAIN_HAS_SYNC_4
	depends on !LINGMO_INSTALL_LIBSTDCPP || !LINGMO_TOOLCHAIN_GCC_AT_LEAST_4_9

config LINGMO_PACKAGE_FCFT_SVG_SUPPORT
	bool "svg support"
	help
	  Enables svg support. This option increases the size of the
	  library by approximately 55KB.

endif # LINGMO_PACKAGE_FCFT

comment "fcft needs a glibc or musl toolchain"
	depends on !(LINGMO_TOOLCHAIN_USES_GLIBC || LINGMO_TOOLCHAIN_USES_MUSL)
```
