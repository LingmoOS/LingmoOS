## package/wmctrl/Config.in
```kconfig
config LINGMO_PACKAGE_WMCTRL
	bool "wmctrl"
	depends on LINGMO_PACKAGE_XORG7
	depends on LINGMO_USE_WCHAR # libglib2
	depends on LINGMO_TOOLCHAIN_HAS_THREADS # libglib2
	depends on LINGMO_USE_MMU # libglib2
	select LINGMO_PACKAGE_XLIB_LIBX11
	select LINGMO_PACKAGE_XLIB_LIBXMU
	select LINGMO_PACKAGE_LIBGLIB2
	help
	  Provides command line access to almost all the features
	  defined in the EWMH specification. It can be used, for
	  example, to get information about the window manager, to get
	  a detailed list of desktops and managed windows, to switch
	  and resize desktops, to make windows full-screen,
	  always-above or sticky, and to activate, close, move,
	  resize, maximize and minimize them.

	  https://sites.google.com/site/tstyblo/wmctrl/

comment "wmctrl needs a toolchain w/ wchar, threads"
	depends on LINGMO_USE_MMU
	depends on LINGMO_PACKAGE_XORG7
	depends on !LINGMO_USE_WCHAR || !LINGMO_TOOLCHAIN_HAS_THREADS
```

## package/woff2/Config.in
```kconfig
config LINGMO_PACKAGE_WOFF2
	bool "woff2"
	depends on LINGMO_INSTALL_LIBSTDCPP
	select LINGMO_PACKAGE_BROTLI
	help
	  Reference implementation for the WOFF2 font file format,
	  typically used for Web fonts

	  https://github.com/google/woff2

comment "woff2 needs a toolchain w/ C++"
	depends on !LINGMO_INSTALL_LIBSTDCPP
```

## package/wolfssl/Config.in
```kconfig
config LINGMO_PACKAGE_WOLFSSL_ASM_SUPPORTS
	bool
	default y if LINGMO_aarch64
	default y if (LINGMO_arm || LINGMO_armeb) && !LINGMO_ARM_CPU_ARMV4 # clz
	default y if LINGMO_powerpc
	default y if LINGMO_powerpc64 || LINGMO_powerpc64le
	default y if LINGMO_mips64 && !LINGMO_MIPS_CPU_MIPS32R6
	default y if LINGMO_mips64el && !LINGMO_MIPS_CPU_MIPS32R6
	default y if LINGMO_mips || LINGMO_mipsel
	default y if LINGMO_riscv && LINGMO_RISCV_ISA_RVM
	default y if LINGMO_s390x

config LINGMO_PACKAGE_WOLFSSL
	bool "wolfssl"
	depends on LINGMO_TOOLCHAIN_HAS_THREADS
	help
	  The wolfSSL embedded SSL library (formerly CyaSSL) is a
	  lightweight, portable, C-language-based SSL/TLS library
	  targeted at IoT, embedded, and RTOS environments primarily
	  because of its size, speed, and feature set.

	  https://www.wolfssl.com/

if LINGMO_PACKAGE_WOLFSSL

config LINGMO_PACKAGE_WOLFSSL_ALL
	bool "enable all features, except SSLv3"
	depends on !LINGMO_STATIC_LIBS
	help
	  Enable all wolfSSL features, except SSL version 3.0 support.

comment "all features, except SSLv3 needs a toolchain w/ dynamic library"
	depends on LINGMO_STATIC_LIBS

config LINGMO_PACKAGE_WOLFSSL_SSLV3
	bool "enable SSLv3"
	help
	  Enable SSL version 3.0 support.

endif

comment "wolfssl needs a toolchain w/ threads"
	depends on !LINGMO_TOOLCHAIN_HAS_THREADS
```

## package/wolftpm/Config.in
```kconfig
config LINGMO_PACKAGE_WOLFTPM
	bool "wolftpm"
	help
	  wolfTPM is a portable, open-source TPM 2.0 stack with
	  backward API compatibility, designed for embedded use.
	  No external dependencies, compact code size with low
	  resource usage.

	  https://www.wolfssl.com/

if LINGMO_PACKAGE_WOLFTPM

config LINGMO_PACKAGE_WOLFTPM_WOLFCRYPT
	bool "wolfCrypt hooks"
	default y
	depends on LINGMO_TOOLCHAIN_HAS_THREADS # wolfssl
	depends on !LINGMO_STATIC_LIBS # wolfssl-all
	select LINGMO_PACKAGE_WOLFSSL
	# not mandatory, but needed to get all features
	select LINGMO_PACKAGE_WOLFSSL_ALL
	help
	  Enable wolfCrypt hooks for RNG, Auth Sessions and Parameter
	  encryption. Disabling this option is not recommended as it
	  could create a security breach in most environments.

comment "wolfCrypt hooks need a toolchain w/ threads, dynamic library"
	depends on !LINGMO_TOOLCHAIN_HAS_THREADS || LINGMO_STATIC_LIBS

config LINGMO_PACKAGE_WOLFTPM_ST33
	bool "ST33 extra functionality"
	help
	  Enable support of TPM 2.0 extra functionality offered by the
	  STMicroelectronics ST33 chip.

config LINGMO_PACKAGE_WOLFTPM_NUVOTON
	bool "NPCT750 extra functionality"
	help
	  Enable support of TPM 2.0 extra functionality offered by the
	  Nuvoton NPCT750 chip.

config LINGMO_PACKAGE_WOLFTPM_DEBUG
	bool "Debug output"
	help
	  Enable debug messages in wolfTPM.

endif
```

## package/wpan-tools/Config.in
```kconfig
config LINGMO_PACKAGE_WPAN_TOOLS
	bool "wpan-tools"
	depends on LINGMO_TOOLCHAIN_HAS_THREADS
	select LINGMO_PACKAGE_LIBNL
	help
	  Userspace tools for Linux IEEE 802.15.4 stack.

	  http://wpan.cakelab.org/

comment "wpan-tools needs a toolchain w/ threads"
	depends on !LINGMO_TOOLCHAIN_HAS_THREADS
```

## package/wpebackend-fdo/Config.in
```kconfig
comment "wpebackend-fdo needs a toolchain w/ C++, wchar, threads, dynamic library and an OpenEGL-capable Wayland backend"
	depends on !LINGMO_PACKAGE_HAS_LIBEGL_WAYLAND || !LINGMO_INSTALL_LIBSTDCPP || !LINGMO_USE_WCHAR \
		|| !LINGMO_TOOLCHAIN_HAS_THREADS || LINGMO_STATIC_LIBS

config LINGMO_PACKAGE_WPEBACKEND_FDO
	bool "wpebackend-fdo"
	depends on !LINGMO_STATIC_LIBS # wayland
	depends on LINGMO_INSTALL_LIBSTDCPP
	depends on LINGMO_TOOLCHAIN_HAS_THREADS # wayland, libglib2
	depends on LINGMO_USE_WCHAR # libglib2
	depends on LINGMO_USE_MMU # libglib2
	depends on LINGMO_PACKAGE_HAS_LIBEGL_WAYLAND
	select LINGMO_PACKAGE_LIBEPOXY
	select LINGMO_PACKAGE_LIBGLIB2
	select LINGMO_PACKAGE_LIBWPE
	select LINGMO_PACKAGE_WAYLAND
	help
	  WPEBackend interface using freedesktop.org API.

	  https://wpewebkit.org/
```

## package/wpewebkit/Config.in
```kconfig
config LINGMO_PACKAGE_WPEWEBKIT_ARCH_SUPPORTS
	bool
	# ARM needs BLX, so v5t+, BE completely untested so disabled
	default y if LINGMO_arm && !LINGMO_ARM_CPU_ARMV4
	default y if LINGMO_aarch64 || LINGMO_aarch64_be
	default y if LINGMO_i386 || LINGMO_x86_64
	# Disabled on MIPS big endian due to sigbus
	default y if LINGMO_mipsel || LINGMO_mips64el
	# Disabled on PowerPC pending runtime testing
	# RISC-V needs the g/imafd ISA.
	default y if LINGMO_riscv && LINGMO_RISCV_ISA_RVI \
		&& LINGMO_RISCV_ISA_RVM && LINGMO_RISCV_ISA_RVA \
		&& LINGMO_RISCV_ISA_RVF && LINGMO_RISCV_ISA_RVD
	# Disabled on SuperH because of segfault
	depends on LINGMO_USE_MMU # libglib2
	depends on LINGMO_TOOLCHAIN_HAS_SYNC_4
	depends on LINGMO_PACKAGE_LIBGPG_ERROR_ARCH_SUPPORTS # libgcrypt

comment "wpewebkit needs a toolchain w/ C++, wchar, threads, dynamic library, gcc >= 10, host gcc >= 4.9"
	depends on LINGMO_PACKAGE_WPEWEBKIT_ARCH_SUPPORTS
	depends on !LINGMO_BINFMT_FLAT
	depends on !LINGMO_INSTALL_LIBSTDCPP || !LINGMO_USE_WCHAR \
		|| !LINGMO_TOOLCHAIN_HAS_THREADS || LINGMO_STATIC_LIBS \
		|| !LINGMO_TOOLCHAIN_GCC_AT_LEAST_10 \
		|| !LINGMO_HOST_GCC_AT_LEAST_4_9

comment "wpewebkit needs an OpenGL ES w/ EGL-capable Wayland backend"
	depends on LINGMO_PACKAGE_WPEWEBKIT_ARCH_SUPPORTS
	depends on !LINGMO_BINFMT_FLAT
	depends on !LINGMO_PACKAGE_HAS_LIBGLES || !LINGMO_PACKAGE_HAS_LIBEGL \
		|| !LINGMO_PACKAGE_HAS_LIBEGL_WAYLAND

config LINGMO_PACKAGE_WPEWEBKIT
	bool "wpewebkit"
	depends on !LINGMO_STATIC_LIBS # wayland
	depends on !LINGMO_BINFMT_FLAT # icu
	depends on LINGMO_HOST_GCC_AT_LEAST_4_9 # icu, host-ruby
	depends on LINGMO_INSTALL_LIBSTDCPP # harfbuzz, icu
	depends on LINGMO_TOOLCHAIN_HAS_THREADS # wayland, icu, libsoup3
	depends on LINGMO_TOOLCHAIN_GCC_AT_LEAST_10
	depends on LINGMO_USE_WCHAR # icu, libsoup3
	depends on LINGMO_PACKAGE_HAS_LIBGLES # libepoxy
	depends on LINGMO_PACKAGE_HAS_LIBEGL # libepoxy
	depends on LINGMO_PACKAGE_HAS_LIBEGL_WAYLAND # wpebackend-fdo
	depends on LINGMO_PACKAGE_WPEWEBKIT_ARCH_SUPPORTS
	select LINGMO_PACKAGE_CAIRO
	select LINGMO_PACKAGE_CAIRO_PNG
	select LINGMO_PACKAGE_HARFBUZZ
	select LINGMO_PACKAGE_ICU
	select LINGMO_PACKAGE_JPEG
	select LINGMO_PACKAGE_LIBEPOXY
	select LINGMO_PACKAGE_LIBGCRYPT
	select LINGMO_PACKAGE_LIBPNG
	select LINGMO_PACKAGE_LIBSOUP3
	select LINGMO_PACKAGE_LIBTASN1
	select LINGMO_PACKAGE_LIBXSLT
	select LINGMO_PACKAGE_WAYLAND
	select LINGMO_PACKAGE_WAYLAND_PROTOCOLS
	select LINGMO_PACKAGE_WEBP
	select LINGMO_PACKAGE_WEBP_DEMUX
	select LINGMO_PACKAGE_WPEBACKEND_FDO
	help
	  WPE (Web Platform for Embedded) port of the WebKit engine,
	  to allow embedders to create simple and performant systems
	  based on Web platform technologies.

	  https://wpewebkit.org/

if LINGMO_PACKAGE_WPEWEBKIT

config LINGMO_PACKAGE_WPEWEBKIT_SANDBOX
	bool "sandboxing support"
	depends on LINGMO_PACKAGE_LIBSECCOMP_ARCH_SUPPORTS # libseccomp
	depends on LINGMO_TOOLCHAIN_HEADERS_AT_LEAST_3_12 # libseccomp
	select LINGMO_PACKAGE_BUBBLEWRAP # runtime
	select LINGMO_PACKAGE_XDG_DBUS_PROXY # runtime
	select LINGMO_PACKAGE_LIBSECCOMP
	help
	  Enable sandboxing of the processes used for network operation,
	  disk asccess, and Web content rendering.

comment "sandboxing supports needs a toolchain w/ headers >= 3.12"
	depends on LINGMO_PACKAGE_LIBSECCOMP_ARCH_SUPPORTS
	depends on !LINGMO_TOOLCHAIN_HEADERS_AT_LEAST_3_12

config LINGMO_PACKAGE_WPEWEBKIT_MULTIMEDIA
	bool "multimedia support"
	select LINGMO_PACKAGE_GSTREAMER1
	select LINGMO_PACKAGE_GST1_PLUGINS_BAD
	select LINGMO_PACKAGE_GST1_PLUGINS_BAD_PLUGIN_DEBUGUTILS
	select LINGMO_PACKAGE_GST1_PLUGINS_BAD_PLUGIN_MPEGTSDEMUX
	select LINGMO_PACKAGE_GST1_PLUGINS_BAD_PLUGIN_SUBENC
	select LINGMO_PACKAGE_GST1_PLUGINS_BASE
	select LINGMO_PACKAGE_GST1_PLUGINS_BASE_PLUGIN_ALSA
	select LINGMO_PACKAGE_GST1_PLUGINS_BASE_PLUGIN_APP
	select LINGMO_PACKAGE_GST1_PLUGINS_BASE_PLUGIN_AUDIOCONVERT
	select LINGMO_PACKAGE_GST1_PLUGINS_BASE_PLUGIN_AUDIORESAMPLE
	select LINGMO_PACKAGE_GST1_PLUGINS_BASE_PLUGIN_PLAYBACK
	select LINGMO_PACKAGE_GST1_PLUGINS_BASE_PLUGIN_VIDEOCONVERTSCALE
	select LINGMO_PACKAGE_GST1_PLUGINS_BASE_PLUGIN_VOLUME
	select LINGMO_PACKAGE_GST1_PLUGINS_GOOD
	select LINGMO_PACKAGE_GST1_PLUGINS_GOOD_PLUGIN_AUDIOFX
	select LINGMO_PACKAGE_GST1_PLUGINS_GOOD_PLUGIN_AUTODETECT
	select LINGMO_PACKAGE_GST1_PLUGINS_GOOD_PLUGIN_ISOMP4
	select LINGMO_PACKAGE_GST1_PLUGINS_GOOD_PLUGIN_MATROSKA
	select LINGMO_PACKAGE_GST1_PLUGINS_GOOD_PLUGIN_RTSP
	select LINGMO_PACKAGE_GST1_PLUGINS_GOOD_PLUGIN_VPX
	select LINGMO_PACKAGE_GST1_LIBAV
	help
	  This option pulls in all of the required dependencies
	  to enable multimedia (video/audio) support.

if LINGMO_PACKAGE_WPEWEBKIT_MULTIMEDIA

config LINGMO_PACKAGE_WPEWEBKIT_MEDIA_STREAM
	bool "media-stream support"
	select LINGMO_PACKAGE_GST1_PLUGINS_BASE_PLUGIN_VIDEORATE
	help
	  This option enables media-stream support.

config LINGMO_PACKAGE_WPEWEBKIT_USE_GSTREAMER_GL
	bool "use gstreamer-gl"
	default y
	depends on LINGMO_PACKAGE_GST1_PLUGINS_BASE_LIB_OPENGL_HAS_PLATFORM
	help
	  Use the GStreamer GL elements for handling video content.
	  This is recommended as it improves performance of video
	  playback. In some target configurations incorrect rendering
	  might be produced, and disabling this option may help.

endif

config LINGMO_PACKAGE_WPEWEBKIT_WEBDRIVER
	bool "WebDriver support"
	help
	  Enable support for WebDriver. This will build and install the
	  WebKitWebDriver program in the target.

endif
```

## package/wsapi-fcgi/Config.in
```kconfig
config LINGMO_PACKAGE_WSAPI_FCGI
	bool "wsapi-fcgi"
	depends on LINGMO_USE_MMU # fork()
	select LINGMO_PACKAGE_LIBFCGI
	select LINGMO_PACKAGE_WSAPI # runtime
	help
	  WSAPI is an API that abstracts the web server from Lua web
	  applications. This is the rock that contains the FCGI module
	  lfcgi.

	  https://luarocks.org/modules/mascarenhas/wsapi-fcgi
```

## package/wsapi-xavante/Config.in
```kconfig
config LINGMO_PACKAGE_WSAPI_XAVANTE
	bool "wsapi-xavante"
	select LINGMO_PACKAGE_WSAPI # runtime
	select LINGMO_PACKAGE_XAVANTE # runtime
	help
	  WSAPI is an API that abstracts the web server from Lua web
	  applications. This is the rock that contains the Xavante
	  adapter and launcher.

	  https://keplerproject.github.io/wsapi/
```

## package/wsapi/Config.in
```kconfig
config LINGMO_PACKAGE_WSAPI
	bool "wsapi"
	select LINGMO_PACKAGE_COXPCALL if LINGMO_PACKAGE_LUA_5_1 # runtime
	select LINGMO_PACKAGE_LUAFILESYSTEM # runtime
	select LINGMO_PACKAGE_RINGS # runtime
	help
	  API that abstracts the web server from Lua web applications.

	  https://keplerproject.github.io/wsapi/
```
