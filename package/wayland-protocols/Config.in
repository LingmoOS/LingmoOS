## package/weston/Config.in
```kconfig
comment "weston needs udev and a toolchain w/ locale, threads, dynamic library, headers >= 3.0"
	depends on !LINGMO_PACKAGE_HAS_UDEV || !LINGMO_TOOLCHAIN_HAS_THREADS || \
		!LINGMO_TOOLCHAIN_HEADERS_AT_LEAST_3_0 || LINGMO_STATIC_LIBS || \
		!LINGMO_ENABLE_LOCALE

config LINGMO_PACKAGE_WESTON
	bool "weston"
	depends on LINGMO_PACKAGE_HAS_UDEV
	depends on !LINGMO_STATIC_LIBS # wayland
	depends on LINGMO_TOOLCHAIN_HAS_THREADS # wayland
	depends on LINGMO_TOOLCHAIN_HEADERS_AT_LEAST_3_0
	select LINGMO_PACKAGE_WAYLAND
	select LINGMO_PACKAGE_WAYLAND_PROTOCOLS
	select LINGMO_PACKAGE_LIBXKBCOMMON
	select LINGMO_PACKAGE_CAIRO
	select LINGMO_PACKAGE_CAIRO_PNG
	select LINGMO_PACKAGE_LIBPNG
	select LINGMO_PACKAGE_JPEG
	select LINGMO_PACKAGE_LIBINPUT
	select LINGMO_PACKAGE_LIBDRM
	select LINGMO_PACKAGE_SEATD
	select LINGMO_PACKAGE_SEATD_DAEMON if !LINGMO_PACKAGE_SYSTEMD_LOGIND
	# Runtime dependency
	select LINGMO_PACKAGE_XKEYBOARD_CONFIG
	select LINGMO_PACKAGE_WESTON_SHELL_DESKTOP if !LINGMO_PACKAGE_WESTON_HAS_SHELL
	help
	  Weston is the reference implementation of a Wayland
	  compositor, and a useful compositor in its own right.
	  Weston has various backends that lets it run on Linux kernel
	  modesetting and evdev input as well as under X11.

	  http://wayland.freedesktop.org/

if LINGMO_PACKAGE_WESTON

choice
	prompt "default compositor"

config LINGMO_PACKAGE_WESTON_DEFAULT_DRM
	bool "drm"
	select LINGMO_PACKAGE_WESTON_DRM

config LINGMO_PACKAGE_WESTON_DEFAULT_HEADLESS
	bool "headless"
	select LINGMO_PACKAGE_WESTON_HEADLESS

config LINGMO_PACKAGE_WESTON_DEFAULT_RDP
	bool "rdp"
	depends on LINGMO_USE_MMU # freerdp, libglib2
	depends on LINGMO_TOOLCHAIN_HAS_SYNC_4
	depends on LINGMO_USE_WCHAR # freerdp
	depends on LINGMO_INSTALL_LIBSTDCPP # freerdp
	depends on LINGMO_PACKAGE_XORG7 # freerdp-server
	select LINGMO_PACKAGE_WESTON_RDP

config LINGMO_PACKAGE_WESTON_DEFAULT_WAYLAND
	bool "wayland (nested)"
	select LINGMO_PACKAGE_WESTON_WAYLAND

config LINGMO_PACKAGE_WESTON_DEFAULT_X11
	bool "X11 (nested)"
	depends on LINGMO_PACKAGE_XORG7
	select LINGMO_PACKAGE_WESTON_X11

comment "X11 (nested) backend needs X.org"
	depends on !LINGMO_PACKAGE_XORG7

endchoice

config LINGMO_PACKAGE_WESTON_DEFAULT_COMPOSITOR
	string
	default "drm"      if LINGMO_PACKAGE_WESTON_DEFAULT_DRM
	default "headless" if LINGMO_PACKAGE_WESTON_DEFAULT_HEADLESS
	default "rdp"      if LINGMO_PACKAGE_WESTON_DEFAULT_RDP
	default "wayland"  if LINGMO_PACKAGE_WESTON_DEFAULT_WAYLAND
	default "x11"      if LINGMO_PACKAGE_WESTON_DEFAULT_X11

config LINGMO_PACKAGE_WESTON_DRM
	bool "DRM compositor"

# FreeRDP needs threads and !static, already the case for weston
config LINGMO_PACKAGE_WESTON_RDP
	bool "RDP compositor"
	depends on LINGMO_USE_MMU # freerdp, libglib2
	depends on LINGMO_TOOLCHAIN_HAS_SYNC_4
	depends on LINGMO_USE_WCHAR # freerdp
	depends on LINGMO_INSTALL_LIBSTDCPP # freerdp
	depends on LINGMO_PACKAGE_XORG7 # freerdp-server
	select LINGMO_PACKAGE_FREERDP
	select LINGMO_PACKAGE_FREERDP_SERVER
	help
	  This enables the RDP backend, which allows accessing weston
	  through the network with any RDP-compliant client.

	  Please note that one must pass those options to weston for RDP
	  to be functional:
	    --rdp-tls-cert=/path/to/server.crt
	    --rdp-tls-key=/path/to/server.key

	  By default, Buildroot installs such files in
	  /etc/freerdp/server/ so you may want to change them in a
	  post-build script or a rootfs overlay.

comment "RDP compositor needs a toolchain w/ wchar, C++, X.org"
	depends on LINGMO_USE_MMU
	depends on LINGMO_TOOLCHAIN_HAS_SYNC_4
	depends on !LINGMO_USE_WCHAR || !LINGMO_INSTALL_LIBSTDCPP || \
		!LINGMO_PACKAGE_XORG7

config LINGMO_PACKAGE_WESTON_HEADLESS
	bool "headless (testing) compositor"

config LINGMO_PACKAGE_WESTON_WAYLAND
	bool "Wayland (nested) compositor"

config LINGMO_PACKAGE_WESTON_X11
	bool "X11 (nested) compositor"
	depends on LINGMO_PACKAGE_XORG7
	select LINGMO_PACKAGE_LIBXCB
	select LINGMO_PACKAGE_XLIB_LIBX11

comment "X11 (nested) compositor needs X.org enabled"
	depends on !LINGMO_PACKAGE_XORG7

config LINGMO_PACKAGE_WESTON_XWAYLAND
	bool "XWayland support"
	depends on LINGMO_PACKAGE_LIBEPOXY
	depends on LINGMO_PACKAGE_XORG7 # xwayland
	depends on LINGMO_USE_MMU # xwayland
	depends on !LINGMO_STATIC_LIBS # xwayland
	depends on LINGMO_TOOLCHAIN_HAS_THREADS # xwayland
	depends on !LINGMO_RISCV_32 # xwayland -> xlib_libxshmfence
	depends on LINGMO_TOOLCHAIN_HAS_SYNC_4 # xwayland -> xlib_libxshmfence
	select LINGMO_PACKAGE_CAIRO
	select LINGMO_PACKAGE_LIBXCB
	select LINGMO_PACKAGE_XCB_UTIL_CURSOR
	select LINGMO_PACKAGE_XLIB_LIBX11
	select LINGMO_PACKAGE_XLIB_LIBXCURSOR
	select LINGMO_PACKAGE_XWAYLAND

comment "XWayland support needs libepoxy and X.org enabled"
	depends on !LINGMO_PACKAGE_XORG7 || !LINGMO_PACKAGE_LIBEPOXY

comment "XWayland support needs a toolchain w/ threads, dynamic library"
	depends on LINGMO_USE_MMU
	depends on !LINGMO_RISCV_32
	depends on LINGMO_TOOLCHAIN_HAS_SYNC_4
	depends on !LINGMO_TOOLCHAIN_HAS_THREADS || LINGMO_STATIC_LIBS

# Weston needs at least one shell; this can be one of the bundled ones,
# below, of from a third-party package, which should then select this.
config LINGMO_PACKAGE_WESTON_HAS_SHELL
	bool

config LINGMO_PACKAGE_WESTON_SHELL_DESKTOP
	bool "desktop shell"
	default y

config LINGMO_PACKAGE_WESTON_SHELL_FULLSCREEN
	bool "fullscreen shell"
	default y
	select LINGMO_PACKAGE_WESTON_HAS_SHELL

config LINGMO_PACKAGE_WESTON_SHELL_IVI
	bool "ivi shell"
	default y
	select LINGMO_PACKAGE_WESTON_HAS_SHELL

config LINGMO_PACKAGE_WESTON_SHELL_KIOSK
	bool "kiosk shell"
	default y
	select LINGMO_PACKAGE_WESTON_HAS_SHELL

config LINGMO_PACKAGE_WESTON_SCREENSHARE
	bool "screenshare"
	default y

config LINGMO_PACKAGE_WESTON_SIMPLE_CLIENTS
	bool "simple clients"
	help
	  Simple clients includes application such as:
	  damage, dmabuf-feedback, dmabuf-egl, dmabuf-v4l, egl

	  In the target filesystem, simple client program binaries are
	  prefixed with "weston-simple-".

	  Note: Weston has two sets of clients. See also the weston
	  "demo clients" option.

config LINGMO_PACKAGE_WESTON_DEMO_CLIENTS
	bool "demo clients"
	depends on LINGMO_USE_MMU # pango
	depends on LINGMO_TOOLCHAIN_HAS_SYNC_4 # pango
	depends on LINGMO_TOOLCHAIN_GCC_AT_LEAST_4_9 # pango
	depends on LINGMO_INSTALL_LIBSTDCPP # pango
	depends on LINGMO_TOOLCHAIN_HAS_THREADS # pango
	depends on LINGMO_USE_WCHAR # pango
	depends on LINGMO_PACKAGE_HAS_LIBGLES
	depends on LINGMO_PACKAGE_HAS_LIBEGL_WAYLAND
	select LINGMO_PACKAGE_PANGO
	help
	  This enables the installation of Weston's demo clients.

	  Demo clients includes application such as:
	  clickdot, confine, content_protection, dnd, editor,
	  eventdemo, flower, fullscreen, image, multi-resource,
	  presentation-shm, resizor, scaler, smoke, stacking,
	  subsurfaces, tablet, transformed...

	  In the target filesystem, demo client program binaries are
	  prefixed with "weston-".

	  Note: Weston has two sets of clients. See also the weston
	  "simple clients" option.

comment "demo clients needs an OpenGL ES provider, an OpenEGL-capable Wayland backend and a toolchain w/ wchar, threads, C++, gcc >= 4.9"
	depends on LINGMO_USE_MMU
	depends on LINGMO_TOOLCHAIN_HAS_SYNC_4
	depends on !LINGMO_INSTALL_LIBSTDCPP || !LINGMO_TOOLCHAIN_HAS_THREADS || \
		!LINGMO_USE_WCHAR || !LINGMO_PACKAGE_HAS_LIBGLES || \
		!LINGMO_PACKAGE_HAS_LIBEGL_WAYLAND || !LINGMO_TOOLCHAIN_GCC_AT_LEAST_4_9

endif
```

## package/wget/Config.in
```kconfig
config LINGMO_PACKAGE_WGET
	bool "wget"
	# fork()
	depends on LINGMO_USE_MMU
	depends on LINGMO_USE_WCHAR
	depends on LINGMO_PACKAGE_BUSYBOX_SHOW_OTHERS
	select LINGMO_PACKAGE_LIBOPENSSL_ENABLE_DES if LINGMO_PACKAGE_LIBOPENSSL
	select LINGMO_PACKAGE_LIBOPENSSL_ENABLE_MD4 if LINGMO_PACKAGE_LIBOPENSSL
	help
	  Network utility to retrieve files from http, https and ftp.

	  http://www.gnu.org/software/wget/

comment "wget needs a toolchain w/ wchar"
	depends on LINGMO_USE_MMU
	depends on !LINGMO_USE_WCHAR
	depends on LINGMO_PACKAGE_BUSYBOX_SHOW_OTHERS
```

## package/which/Config.in
```kconfig
config LINGMO_PACKAGE_WHICH
	bool "which"
	depends on LINGMO_PACKAGE_BUSYBOX_SHOW_OTHERS
	help
	  The standard 'which' utility.

	  http://carlowood.github.io/which/index.html
```

## package/whois/Config.in
```kconfig
config LINGMO_PACKAGE_WHOIS
	bool "whois"
	depends on LINGMO_PACKAGE_BUSYBOX_SHOW_OTHERS
	help
	  Improved whois client.

	  https://github.com/rfc1036/whois
```

## package/wine/Config.in
```kconfig
config LINGMO_PACKAGE_WINE_ARCH_SUPPORTS
	bool
	default y
	# Wine only builds on certain architectures
	depends on LINGMO_HOSTARCH = "x86_64" || LINGMO_HOSTARCH = "x86" || \
	           LINGMO_HOSTARCH = "powerpc" || LINGMO_HOSTARCH = "arm" || \
	           LINGMO_HOSTARCH = "aarch64"
	# Wine has much CPU specific code and mostly makes sense on x86
	depends on LINGMO_i386

config LINGMO_PACKAGE_WINE
	bool "wine"
	depends on LINGMO_PACKAGE_WINE_ARCH_SUPPORTS
	# Wine unconditionally builds shared libraries
	depends on !LINGMO_STATIC_LIBS
	# pthread_attr_setstack
	depends on LINGMO_TOOLCHAIN_HAS_THREADS_NPTL
	select LINGMO_PACKAGE_ALSA_LIB_SEQ if LINGMO_PACKAGE_ALSA_LIB
	select LINGMO_PACKAGE_ALSA_LIB_RAWMIDI if LINGMO_PACKAGE_ALSA_LIB
	help
	  Wine is a compatibility layer capable of running Windows
	  applications on Linux. Instead of simulating internal
	  Windows logic like a virtual machine or emulator, Wine
	  translates Windows API calls into POSIX calls on-the-fly,
	  eliminating the performance and memory penalties of other
	  methods.

	  http://www.winehq.org

comment "wine needs a toolchain w/ dynamic library, NPTL"
	depends on LINGMO_PACKAGE_WINE_ARCH_SUPPORTS
	depends on LINGMO_STATIC_LIBS || !LINGMO_TOOLCHAIN_HAS_THREADS_NPTL
```

## package/wireless_tools/Config.in
```kconfig
config LINGMO_PACKAGE_WIRELESS_TOOLS
	bool "wireless tools"
	select LINGMO_PACKAGE_WIRELESS_TOOLS_IWCONFIG if \
		!LINGMO_PACKAGE_WIRELESS_TOOLS_IFRENAME && \
		!LINGMO_PACKAGE_WIRELESS_TOOLS_LIB
	help
	  A collection of tools to configure wireless lan cards.

	  https://hewlettpackard.github.io/wireless-tools/

if LINGMO_PACKAGE_WIRELESS_TOOLS

config LINGMO_PACKAGE_WIRELESS_TOOLS_IWCONFIG
	bool "Install tools"
	default y
	help
	  Build and install the iwconfig, iwlist, iwspy, iwpriv, and
	  iwgetid tools.

config LINGMO_PACKAGE_WIRELESS_TOOLS_IFRENAME
	bool "Install ifrename"
	help
	  Build and install the ifrename tool

config LINGMO_PACKAGE_WIRELESS_TOOLS_LIB
	bool "Install shared library"
	depends on !LINGMO_STATIC_LIBS
	help
	  The shared library of wireless tools

endif
```

## package/wireplumber/Config.in
```kconfig
config LINGMO_PACKAGE_WIREPLUMBER
	bool "wireplumber"
	depends on LINGMO_PACKAGE_PIPEWIRE
	depends on LINGMO_PACKAGE_LUA_5_3 || LINGMO_PACKAGE_LUA_5_4
	depends on LINGMO_USE_WCHAR # libglib2
	depends on LINGMO_TOOLCHAIN_HAS_THREADS # libglib2
	depends on LINGMO_USE_MMU # libglib2
	select LINGMO_PACKAGE_LIBGLIB2
	help
	  WirePlumber is a modular session / policy manager for
	  PipeWire and a GObject-based high-level library that
	  wraps PipeWire’s API, providing convenience for writing
	  the daemon’s modules as well as external tools for
	  managing PipeWire.

	  https://pipewire.pages.freedesktop.org/wireplumber/

comment "wireplumber needs a toolchain w/ wchar, threads and Lua >= 5.3"
	depends on LINGMO_PACKAGE_PIPEWIRE
	depends on LINGMO_USE_MMU
	depends on !LINGMO_USE_WCHAR || !LINGMO_TOOLCHAIN_HAS_THREADS || \
		(!LINGMO_PACKAGE_LUA_5_3 && !LINGMO_PACKAGE_LUA_5_4)
```

## package/wireshark/Config.in
```kconfig
config LINGMO_PACKAGE_WIRESHARK
	bool "wireshark"
	depends on LINGMO_PACKAGE_LIBGPG_ERROR_ARCH_SUPPORTS # libgcrypt -> libgpg-error
	depends on !LINGMO_STATIC_LIBS
	depends on LINGMO_USE_MMU # fork(), glib2
	depends on LINGMO_USE_WCHAR # glib2
	depends on LINGMO_TOOLCHAIN_HAS_THREADS # glib2
	depends on LINGMO_INSTALL_LIBSTDCPP
	select LINGMO_PACKAGE_C_ARES
	select LINGMO_PACKAGE_LIBPCAP
	select LINGMO_PACKAGE_LIBGCRYPT
	select LINGMO_PACKAGE_LIBGLIB2
	select LINGMO_PACKAGE_PCRE2
	select LINGMO_PACKAGE_SPEEXDSP
	help
	  Network traffic sniffer and protocol decoder.

	  https://www.wireshark.org

if LINGMO_PACKAGE_WIRESHARK

config LINGMO_PACKAGE_WIRESHARK_GUI
	bool "Qt5 GUI"
	default y
	depends on LINGMO_INSTALL_LIBSTDCPP # qt5
	depends on LINGMO_HOST_GCC_AT_LEAST_5 # qt5
	depends on LINGMO_TOOLCHAIN_HAS_THREADS_NPTL # qt5
	depends on LINGMO_TOOLCHAIN_GCC_AT_LEAST_5 # qt5
	depends on LINGMO_PACKAGE_HAS_UDEV # qt5 input
	select LINGMO_PACKAGE_QT5
	select LINGMO_PACKAGE_QT5BASE_FONTCONFIG # runtime
	select LINGMO_PACKAGE_QT5BASE_PNG # runtime
	select LINGMO_PACKAGE_QT5BASE_WIDGETS
	select LINGMO_PACKAGE_QT5MULTIMEDIA
	select LINGMO_PACKAGE_QT5SVG
	select LINGMO_PACKAGE_QT5TOOLS
	select LINGMO_PACKAGE_QT5TOOLS_LINGUIST_TOOLS
	help
	  Enable Qt5 GUI

comment "Qt5 GUI needs a udev /dev management and a toolchain w/ C++, NPTL, host gcc >= 5.0, gcc >= 5.0"
	depends on !LINGMO_PACKAGE_HAS_UDEV || !LINGMO_INSTALL_LIBSTDCPP || \
		!LINGMO_TOOLCHAIN_HAS_THREADS_NPTL || !LINGMO_TOOLCHAIN_GCC_AT_LEAST_5 || \
		!LINGMO_HOST_GCC_AT_LEAST_5

endif # LINGMO_PACKAGE_WIRESHARK

comment "wireshark needs a toolchain w/ wchar, threads, dynamic library, C++"
	depends on LINGMO_PACKAGE_LIBGPG_ERROR_ARCH_SUPPORTS
	depends on LINGMO_USE_MMU
	depends on !LINGMO_USE_WCHAR || !LINGMO_TOOLCHAIN_HAS_THREADS || \
		LINGMO_STATIC_LIBS || !LINGMO_INSTALL_LIBSTDCPP
```

## package/wlroots/Config.in
```kconfig
comment "wlroots needs udev, EGL w/ Wayland backend and OpenGL ES support"
	depends on !LINGMO_PACKAGE_HAS_LIBEGL || \
		!LINGMO_PACKAGE_HAS_LIBEGL_WAYLAND || \
		!LINGMO_PACKAGE_HAS_LIBGLES || \
		!LINGMO_PACKAGE_HAS_UDEV

comment "wlroots needs a toolchain w/ threads, dynamic library"
	depends on !LINGMO_TOOLCHAIN_HAS_THREADS || \
		LINGMO_STATIC_LIBS

config LINGMO_PACKAGE_WLROOTS
	bool "wlroots"
	depends on !LINGMO_STATIC_LIBS # wayland
	depends on LINGMO_TOOLCHAIN_HAS_THREADS # libdrm, wayland
	depends on LINGMO_PACKAGE_HAS_UDEV # libinput
	depends on LINGMO_PACKAGE_HAS_LIBEGL
	depends on LINGMO_PACKAGE_HAS_LIBEGL_WAYLAND
	depends on LINGMO_PACKAGE_HAS_LIBGLES
	select LINGMO_PACKAGE_HWDATA
	select LINGMO_PACKAGE_HWDATA_PNP_IDS
	select LINGMO_PACKAGE_LIBDRM
	select LINGMO_PACKAGE_LIBINPUT
	select LINGMO_PACKAGE_LIBXKBCOMMON
	select LINGMO_PACKAGE_PIXMAN
	select LINGMO_PACKAGE_SEATD
	select LINGMO_PACKAGE_WAYLAND
	select LINGMO_PACKAGE_WAYLAND_PROTOCOLS
	help
	  wlroots is a modular Wayland library for building compositors
	  which implements many of their common features.

	  https://gitlab.freedesktop.org/wlroots/wlroots

if LINGMO_PACKAGE_WLROOTS

config LINGMO_PACKAGE_WLROOTS_X11
	bool "X11 backend"
	depends on LINGMO_PACKAGE_XORG7
	select LINGMO_PACKAGE_LIBXCB
	select LINGMO_PACKAGE_XCB_UTIL_RENDERUTIL
	select LINGMO_PACKAGE_XCB_UTIL_WM
	select LINGMO_PACKAGE_XLIB_LIBX11
	help
	  Support Wayland sessions nested inside a X11 window

config LINGMO_PACKAGE_WLROOTS_XWAYLAND
	bool "XWayland support"
	depends on LINGMO_PACKAGE_XORG7 # libxcb, xcb-util-wm, xwayland
	depends on LINGMO_USE_MMU # xwayland
	depends on !LINGMO_STATIC_LIBS # xwayland
	depends on LINGMO_TOOLCHAIN_HAS_THREADS # xwayland
	depends on !LINGMO_RISCV_32 # xwayland -> xlib_libxshmfence
	depends on LINGMO_TOOLCHAIN_HAS_SYNC_4 # xwayland -> xlib_libxshmfence
	select LINGMO_PACKAGE_LIBXCB
	select LINGMO_PACKAGE_XCB_UTIL_WM
	select LINGMO_PACKAGE_XWAYLAND
	help
	  Support for running X11 applications under wayland

comment "XWayland support needs X.org enabled"
	depends on !LINGMO_PACKAGE_XORG7

comment "XWayland support needs a toolchain w/ threads, dynamic library"
	depends on LINGMO_USE_MMU
	depends on !LINGMO_RISCV_32
	depends on LINGMO_TOOLCHAIN_HAS_SYNC_4
	depends on !LINGMO_TOOLCHAIN_HAS_THREADS || LINGMO_STATIC_LIBS

endif
```
