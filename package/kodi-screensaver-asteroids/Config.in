## package/kvmtool/Config.in
```kconfig
config LINGMO_PACKAGE_KVMTOOL
	bool "kvmtool"
	depends on LINGMO_USE_MMU # guest simple init fork()
	# No MADV_HUGEPAGE define in uClibc(-ng)
	depends on (LINGMO_TOOLCHAIN_USES_GLIBC || LINGMO_TOOLCHAIN_USES_MUSL)
	# Only mips big-endian seems to be supported (build breaks)
	# Should work on powerpc64 but the build breaks with missing types
	depends on LINGMO_aarch64 || LINGMO_arm || LINGMO_armeb || LINGMO_i386 || \
		LINGMO_mips || LINGMO_x86_64
	# libfdt is only required for DT architectures...
	# ...but it's not able to build for static targets
	depends on !(LINGMO_STATIC_LIBS && (LINGMO_aarch64 || LINGMO_arm || LINGMO_armeb))
	select LINGMO_PACKAGE_DTC if LINGMO_aarch64 || LINGMO_arm || LINGMO_armeb
	help
	  kvmtool is a lightweight tool for hosting KVM guests.
	  As a pure virtualization tool it only supports guests using
	  the same architecture, though it supports running 32-bit
	  guests on those 64-bit architectures that allow this.

	  https://git.kernel.org/cgit/linux/kernel/git/will/kvmtool.git/tree/README

comment "kvmtool needs a glibc or musl toolchain"
	depends on LINGMO_USE_MMU
	depends on LINGMO_i386 || LINGMO_mips || LINGMO_x86_64
	depends on !(LINGMO_TOOLCHAIN_USES_GLIBC || LINGMO_TOOLCHAIN_USES_MUSL)

comment "kvmtool needs a glibc or musl toolchain w/ dynamic library"
	depends on LINGMO_USE_MMU
	depends on LINGMO_aarch64 || LINGMO_arm || LINGMO_armeb
	depends on !(LINGMO_TOOLCHAIN_USES_GLIBC || LINGMO_TOOLCHAIN_USES_MUSL) || \
		LINGMO_STATIC_LIBS
```

## package/kyua/Config.in
```kconfig
config LINGMO_PACKAGE_KYUA
	bool "kyua"
	depends on LINGMO_INSTALL_LIBSTDCPP
	depends on LINGMO_PACKAGE_HAS_LUAINTERPRETER # lutok
	depends on !LINGMO_PACKAGE_LUAJIT # lutok
	depends on !LINGMO_STATIC_LIBS # lutok
	depends on LINGMO_USE_MMU # atf
	select LINGMO_PACKAGE_ATF
	select LINGMO_PACKAGE_LUTOK
	select LINGMO_PACKAGE_SQLITE
	help
	  Kyua is a testing framework for infrastructure software,
	  originally designed to equip BSD-based operating systems
	  with a test suite. This means that Kyua is lightweight
	  and simple, and that Kyua integrates well with various build
	  systems and continuous integration frameworks.

	  https://github.com/jmmv/kyua

comment "kyua needs a toolchain w/ C++, dynamic library and full Lua"
	depends on !LINGMO_INSTALL_LIBSTDCPP || LINGMO_PACKAGE_LUAJIT || LINGMO_STATIC_LIBS
	depends on LINGMO_PACKAGE_HAS_LUAINTERPRETER
	depends on LINGMO_USE_MMU
```

## package/lapack/Config.in
```kconfig
config LINGMO_PACKAGE_LAPACK_ARCH_SUPPORTS
	bool
	default y
	# _fpu_control is used on PowerPC, but not available with
	# uClibc or musl
	depends on !LINGMO_powerpc || LINGMO_TOOLCHAIN_USES_GLIBC

comment "lapack/blas needs a glibc toolchain"
	depends on LINGMO_powerpc
	depends on !LINGMO_TOOLCHAIN_USES_GLIBC

comment "lapack/blas needs a toolchain w/ fortran"
	depends on LINGMO_PACKAGE_LAPACK_ARCH_SUPPORTS
	depends on !LINGMO_TOOLCHAIN_HAS_FORTRAN

config LINGMO_PACKAGE_LAPACK
	bool "lapack/blas"
	depends on LINGMO_PACKAGE_LAPACK_ARCH_SUPPORTS
	depends on LINGMO_TOOLCHAIN_HAS_FORTRAN
	help
	  LAPACK and BLAS FORTRAN implementation. This package
	  installs two libraries: libblas and liblapack.

	  http://www.netlib.org/lapack/

config LINGMO_PACKAGE_LAPACK_COMPLEX
	bool "Complex/Complex16 support"
	default y
	depends on LINGMO_PACKAGE_LAPACK
	help
	  Builds support for COMPLEX and COMPLEX16 data types.
```
