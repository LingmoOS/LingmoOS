## package/kodi-screensaver-asteroids/Config.in
```kconfig
config LINGMO_PACKAGE_KODI_SCREENSAVER_ASTEROIDS
	bool "kodi-screensaver-asteroids"
	select LINGMO_PACKAGE_GLM
	help
	  Asteroids screensaver for Kodi

	  https://github.com/xbmc/screensaver.asteroids
```

## package/kodi-screensaver-asterwave/Config.in
```kconfig
config LINGMO_PACKAGE_KODI_SCREENSAVER_ASTERWAVE
	bool "kodi-screensaver-asterwave"
	select LINGMO_PACKAGE_GLM
	help
	  AsterWave screensaver for Kodi

	  https://github.com/xbmc/screensaver.asterwave
```

## package/kodi-screensaver-biogenesis/Config.in
```kconfig
config LINGMO_PACKAGE_KODI_SCREENSAVER_BIOGENESIS
	bool "kodi-screensaver-biogenesis"
	help
	  BioGenesis screensaver for Kodi

	  https://github.com/xbmc/screensaver.biogenesis
```

## package/kodi-screensaver-cpblobs/Config.in
```kconfig
config LINGMO_PACKAGE_KODI_SCREENSAVER_CPBLOBS
	bool "kodi-screensaver-cpblobs"
	select LINGMO_PACKAGE_GLM
	help
	  CpBlobs screensaver for Kodi

	  https://github.com/xbmc/screensaver.cpblobs
```

## package/kodi-screensaver-greynetic/Config.in
```kconfig
config LINGMO_PACKAGE_KODI_SCREENSAVER_GREYNETIC
	bool "kodi-screensaver-greynetic"
	select LINGMO_PACKAGE_GLM
	help
	  Greynetic screensaver for Kodi

	  https://github.com/xbmc/screensaver.greynetic
```

## package/kodi-screensaver-pingpong/Config.in
```kconfig
config LINGMO_PACKAGE_KODI_SCREENSAVER_PINGPONG
	bool "kodi-screensaver-pingpong"
	select LINGMO_PACKAGE_GLM
	help
	  Ping-pong screensaver for Kodi

	  https://github.com/xbmc/screensaver.pingpong
```

## package/kodi-screensaver-rsxs/Config.in
```kconfig
config LINGMO_PACKAGE_KODI_SCREENSAVER_RSXS
	bool "kodi-screensaver-rsxs"
	depends on LINGMO_PACKAGE_KODI_RENDER_SYSTEM_GL
	select LINGMO_PACKAGE_BZIP2
	select LINGMO_PACKAGE_GLI
	select LINGMO_PACKAGE_GLM
	help
	  RSXS screensaver add-ons for Kodi

	  https://github.com/xbmc/screensavers.rsxs

comment "kodi-screensaver-rsxs needs OpenGL as Kodi render system"
	depends on !LINGMO_PACKAGE_KODI_RENDER_SYSTEM_GL
```

## package/kodi-skin-confluence/Config.in
```kconfig
config LINGMO_PACKAGE_KODI_SKIN_CONFLUENCE
	bool "kodi-skin-confluence"
	help
	  Kodi confluence skin

	  https://github.com/xbmc/skin.confluence
```

## package/kodi-vfs-libarchive/Config.in
```kconfig
config LINGMO_PACKAGE_KODI_VFS_LIBARCHIVE
	bool "kodi-vfs-libarchive"
	select LINGMO_PACKAGE_BZIP2
	select LINGMO_PACKAGE_LIBARCHIVE
	select LINGMO_PACKAGE_LZ4
	select LINGMO_PACKAGE_LZO
	select LINGMO_PACKAGE_OPENSSL
	select LINGMO_PACKAGE_XZ
	select LINGMO_PACKAGE_ZLIB
	help
	  Libarchive VFS add-on for Kodi

	  https://github.com/xbmc/vfs.libarchive
```

## package/kodi-vfs-rar/Config.in
```kconfig
config LINGMO_PACKAGE_KODI_VFS_RAR
	bool "kodi-vfs-rar"
	select LINGMO_PACKAGE_TINYXML
	help
	  RAR VFS addon for Kodi

	  https://github.com/xbmc/vfs.rar
```

## package/kodi-vfs-sftp/Config.in
```kconfig
config LINGMO_PACKAGE_KODI_VFS_SFTP
	bool "kodi-vfs-sftp"
	select LINGMO_PACKAGE_LIBSSH
	select LINGMO_PACKAGE_OPENSSL
	select LINGMO_PACKAGE_ZLIB
	help
	  SFTP VFS addon for Kodi

	  https://github.com/xbmc/vfs.sftp
```

## package/kodi-visualisation-fishbmc/Config.in
```kconfig
config LINGMO_PACKAGE_KODI_VISUALISATION_FISHBMC
	bool "kodi-visualisation-fishbmc"
	select LINGMO_PACKAGE_GLM
	help
	  Fische visualiser for Kodi

	  https://github.com/xbmc/visualization.fishbmc
```

## package/kodi-visualisation-goom/Config.in
```kconfig
config LINGMO_PACKAGE_KODI_VISUALISATION_GOOM
	bool "kodi-visualisation-goom"
	depends on LINGMO_PACKAGE_KODI_RENDER_SYSTEM_GL
	select LINGMO_PACKAGE_GLM
	help
	  GOOM visualiser for Kodi

	  https://github.com/notspiff/visualization.goom

comment "kodi-visualization-goom needs OpenGL as Kodi render system"
	depends on !LINGMO_PACKAGE_KODI_RENDER_SYSTEM_GL
```

## package/kodi-visualisation-matrix/Config.in
```kconfig
config LINGMO_PACKAGE_KODI_VISUALISATION_MATRIX
	bool "kodi-visualisation-matrix"
	select LINGMO_PACKAGE_GLM
	help
	  Matrix themed visualization addon for Kodi

	  https://github.com/xbmc/visualization.matrix
```

## package/kodi-visualisation-shadertoy/Config.in
```kconfig
config LINGMO_PACKAGE_KODI_VISUALISATION_SHADERTOY
	bool "kodi-visualisation-shadertoy"
	depends on LINGMO_TOOLCHAIN_GCC_AT_LEAST_4_7 # jsoncpp
	select LINGMO_PACKAGE_GLM
	select LINGMO_PACKAGE_JSONCPP
	help
	  Shadertoy visualiser for Kodi

	  https://github.com/notspiff/visualization.shadertoy

comment "kodi-visualisation-shadertoy needs a toolchain w/ gcc >= 4.7"
	depends on !LINGMO_TOOLCHAIN_GCC_AT_LEAST_4_7
```

## package/kodi-visualisation-spectrum/Config.in
```kconfig
config LINGMO_PACKAGE_KODI_VISUALISATION_SPECTRUM
	bool "kodi-visualisation-spectrum"
	select LINGMO_PACKAGE_GLM
	help
	  Spectrum visualiser for Kodi

	  https://github.com/notspiff/visualization.spectrum
```

## package/kodi-visualisation-waveform/Config.in
```kconfig
config LINGMO_PACKAGE_KODI_VISUALISATION_WAVEFORM
	bool "kodi-visualisation-waveform"
	select LINGMO_PACKAGE_GLM
	help
	  Waveform visualiser for Kodi

	  https://github.com/notspiff/visualization.waveform
```
