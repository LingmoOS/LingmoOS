## package/racehound/Config.in
```kconfig
config LINGMO_PACKAGE_RACEHOUND
	bool "racehound"
	depends on LINGMO_LINUX_KERNEL
	depends on LINGMO_INSTALL_LIBSTDCPP
	depends on LINGMO_USE_WCHAR # elfutils
	depends on !LINGMO_STATIC_LIBS # elfutils
	depends on LINGMO_TOOLCHAIN_HAS_THREADS # elfutils
	# only x86/x86_64 supported
	depends on LINGMO_i386 || LINGMO_x86_64
	select LINGMO_PACKAGE_ELFUTILS
	select LINGMO_LINUX_NEEDS_MODULES # not using kernel-module infra
	help
	  RaceHound can be used to detect data races in the Linux
	  kernel on x86.

	  RaceHound needs the following kernel configurations enabled:
	  - CONFIG_X86_32 or CONFIG_X86_64
	  - CONFIG_MODULES
	  - CONFIG_MODULE_UNLOAD
	  - CONFIG_SYSFS
	  - CONFIG_DEBUG_FS
	  - CONFIG_KALLSYMS
	  - CONFIG_KALLSYMS_ALL
	  - CONFIG_KPROBES

	  https://github.com/winnukem/racehound

comment "racehound needs an Linux kernel >= 3.14 to be built"
	depends on !LINGMO_LINUX_KERNEL
	depends on LINGMO_i386 || LINGMO_x86_64

comment "racehound needs a toolchain w/ C++, wchar, dynamic library, threads"
	depends on LINGMO_i386 || LINGMO_x86_64
	depends on !LINGMO_INSTALL_LIBSTDCPP || !LINGMO_USE_WCHAR || LINGMO_STATIC_LIBS \
		|| !LINGMO_TOOLCHAIN_HAS_THREADS
```

## package/ramsmp/Config.in
```kconfig
config LINGMO_PACKAGE_RAMSMP
	bool "ramspeed/smp"
	depends on LINGMO_USE_MMU # fork()
	help
	  RAMspeed/SMP is a free open source command line utility to
	  measure cache and memory performance of multiprocessor
	  machines.

	  http://alasir.com/software/ramspeed/
```

## package/ranger/Config.in
```kconfig
config LINGMO_PACKAGE_RANGER
	bool "ranger"
	depends on LINGMO_USE_MMU # python3
	depends on LINGMO_USE_WCHAR # python3
	depends on LINGMO_TOOLCHAIN_HAS_THREADS # python3
	depends on !LINGMO_STATIC_LIBS # python3
	select LINGMO_PACKAGE_PYTHON3
	select LINGMO_PACKAGE_PYTHON3_CURSES
	help
	  ranger is a console file manager with VI key bindings. It
	  provides a minimalistic and nice curses interface with a
	  view on the directory hierarchy.  It ships with "rifle", a
	  file launcher that is good at automatically finding out
	  which program to use for what file type.

	  https://ranger.github.io

comment "ranger needs a toolchain w/ wchar, threads, dynamic library"
	depends on LINGMO_USE_MMU
	depends on !LINGMO_USE_WCHAR || !LINGMO_TOOLCHAIN_HAS_THREADS || LINGMO_STATIC_LIBS
```

## package/rapidjson/Config.in
```kconfig
config LINGMO_PACKAGE_RAPIDJSON
	bool "rapidjson"
	depends on LINGMO_INSTALL_LIBSTDCPP
	help
	  A fast JSON parser/generator for C++ with both SAX/DOM style
	  API.

	  http://rapidjson.org/

comment "rapidjson needs a toolchain w/ C++"
	depends on !LINGMO_INSTALL_LIBSTDCPP
```

## package/raptor/Config.in
```kconfig
config LINGMO_PACKAGE_RAPTOR
	bool "raptor"
	select LINGMO_PACKAGE_LIBXML2
	select LINGMO_PACKAGE_LIBXSLT
	help
	  A C library that provides a set of parsers and
	  serializers that generate Resource Description
	  Framework (RDF) triples by parsing syntaxes or
	  serialize the triples into a syntax.

	  http://librdf.org/raptor/
```

## package/rauc-hawkbit-updater/Config.in
```kconfig
config LINGMO_PACKAGE_RAUC_HAWKBIT_UPDATER
	bool "rauc-hawkbit-updater"
	depends on LINGMO_TOOLCHAIN_HAS_THREADS # rauc, json-glib
	depends on LINGMO_USE_MMU # rauc, json-glib
	depends on LINGMO_USE_WCHAR # rauc, json-glib
	select LINGMO_PACKAGE_JSON_GLIB
	select LINGMO_PACKAGE_LIBCURL
	# runtime
	select LINGMO_PACKAGE_RAUC
	help
	  rauc-hawkbit-updater is a link between Pengutronix RAUC and
	  the Eclipse Hawkbit API. Hawkbit can communicate to remote
	  update servers, and use the d-bus interface to trigger
	  updates from RAUC.

	  http://rauc.io/

comment "rauc-hawkbit-updater needs a toolchain w/ wchar, threads"
	depends on LINGMO_USE_MMU
	depends on !LINGMO_USE_WCHAR || !LINGMO_TOOLCHAIN_HAS_THREADS
```

## package/rauc/Config.in
```kconfig
config LINGMO_PACKAGE_RAUC
	bool "rauc"
	depends on LINGMO_TOOLCHAIN_HAS_THREADS # glib2
	depends on LINGMO_USE_MMU # glib2
	depends on LINGMO_USE_WCHAR # glib2
	select LINGMO_PACKAGE_LIBGLIB2
	select LINGMO_PACKAGE_OPENSSL
	select LINGMO_PACKAGE_SQUASHFS # run-time dependency
	select LINGMO_PACKAGE_UBOOT_TOOLS if LINGMO_TARGET_UBOOT # run-time dependency
	select LINGMO_PACKAGE_UBOOT_TOOLS_FWPRINTENV if LINGMO_TARGET_UBOOT
	help
	  RAUC is the Robust Auto-Update Controller developed by
	  Pengutronix. It supports updating embedded Linux
	  systems over the network or from disks and provides a
	  d-bus interface.

	  http://rauc.io/

if LINGMO_PACKAGE_RAUC

config LINGMO_PACKAGE_RAUC_DBUS
	bool "dbus support"
	select LINGMO_PACKAGE_DBUS
	help
	  This option enables support for controlling rauc through
	  D-Bus.

config LINGMO_PACKAGE_RAUC_GPT
	bool "GPT support"
	select LINGMO_PACKAGE_UTIL_LINUX
	select LINGMO_PACKAGE_UTIL_LINUX_LIBS
	select LINGMO_PACKAGE_UTIL_LINUX_LIBFDISK
	help
	    This option enables support for GPT partition tables.

config LINGMO_PACKAGE_RAUC_NETWORK
	bool "network support"
	select LINGMO_PACKAGE_LIBCURL
	help
	  This option enables support for updating firmware over
	  the network using libcurl.

if LINGMO_PACKAGE_RAUC_NETWORK

config LINGMO_PACKAGE_RAUC_STREAMING
	bool "streaming update support"
	select LINGMO_PACKAGE_LIBNL
	help
	  This option enables support for streaming update mode.

endif

config LINGMO_PACKAGE_RAUC_JSON
	bool "JSON output support"
	select LINGMO_PACKAGE_JSON_GLIB
	help
	  This option enables support for providing output in
	  JSON format.

endif

comment "rauc needs a toolchain w/ wchar, threads"
	depends on !LINGMO_USE_WCHAR || !LINGMO_TOOLCHAIN_HAS_THREADS
	depends on LINGMO_USE_MMU
```

## package/rdesktop/Config.in
```kconfig
config LINGMO_PACKAGE_RDESKTOP
	bool "rdesktop"
	depends on LINGMO_USE_MMU # fork()
	depends on !LINGMO_STATIC_LIBS # gnutls
	depends on LINGMO_USE_WCHAR # gnutls
	depends on LINGMO_PACKAGE_XORG7
	select LINGMO_PACKAGE_GNUTLS
	select LINGMO_PACKAGE_LIBICONV if !LINGMO_ENABLE_LOCALE
	select LINGMO_PACKAGE_LIBTASN1
	select LINGMO_PACKAGE_NETTLE
	select LINGMO_PACKAGE_XLIB_LIBX11
	select LINGMO_PACKAGE_XLIB_LIBXCURSOR
	select LINGMO_PACKAGE_XLIB_LIBXT
	help
	  rdesktop is an open source client for Windows NT Terminal
	  Server and Windows 2000/2003 Terminal Services, capable of
	  natively speaking Remote Desktop Protocol (RDP) in order to
	  present the user's NT desktop.

	  http://rdesktop.sf.net/

comment "rdesktop needs a toolchain w/ wchar, dynamic library"
	depends on LINGMO_USE_MMU
	depends on !LINGMO_USE_WCHAR || LINGMO_STATIC_LIBS
```

## package/rdma-core/Config.in
```kconfig
config LINGMO_PACKAGE_RDMA_CORE
	bool "rdma-core"
	depends on LINGMO_USE_MMU # fork() used in rstream example
	depends on LINGMO_TOOLCHAIN_HAS_SYNC_4
	depends on LINGMO_TOOLCHAIN_HEADERS_AT_LEAST_3_4  # iproute2
	depends on !LINGMO_STATIC_LIBS # dlopen()
	depends on LINGMO_TOOLCHAIN_HAS_THREADS_NPTL
	select LINGMO_PACKAGE_IPROUTE2  # runtime
	select LINGMO_PACKAGE_LIBNL
	help
	  This is the userspace components for the Linux Kernel's
	  drivers/infiniband subsystem.

	  https://github.com/linux-rdma/rdma-core

comment "rdma-core needs a toolchain w/ headers >= 3.4, NPTL, dynamic library"
	depends on LINGMO_USE_MMU
	depends on LINGMO_TOOLCHAIN_HAS_SYNC_4
	depends on !LINGMO_TOOLCHAIN_HEADERS_AT_LEAST_3_4 \
		|| !LINGMO_TOOLCHAIN_HAS_THREADS_NPTL || LINGMO_STATIC_LIBS
```

## package/re2/Config.in
```kconfig
config LINGMO_PACKAGE_RE2
	bool "re2"
	depends on LINGMO_PACKAGE_LIBABSEIL_CPP_ARCH_SUPPORTS
	depends on LINGMO_INSTALL_LIBSTDCPP
	depends on LINGMO_TOOLCHAIN_GCC_AT_LEAST_8 # C++14
	depends on LINGMO_TOOLCHAIN_HAS_THREADS
	depends on !LINGMO_STATIC_LIBS # libabseil-cpp
	select LINGMO_PACKAGE_LIBABSEIL_CPP
	help
	  RE2 is a fast, safe, thread-friendly alternative
	  to backtracking regular expression engines like
	  those used in PCRE, Perl, and Python.
	  It is a C++ library.

	  https://github.com/google/re2

comment "re2 needs a toolchain w/ C++, threads, dynamic library, gcc >= 8"
	depends on LINGMO_PACKAGE_LIBABSEIL_CPP_ARCH_SUPPORTS
	depends on !LINGMO_INSTALL_LIBSTDCPP || \
		!LINGMO_TOOLCHAIN_HAS_THREADS || \
		LINGMO_STATIC_LIBS || !LINGMO_TOOLCHAIN_GCC_AT_LEAST_8
```

## package/redir/Config.in
```kconfig
config LINGMO_PACKAGE_REDIR
	bool "redir"
	depends on LINGMO_USE_MMU # fork()
	help
	  This is a TCP port redirector for UNIX.

	  https://github.com/troglobit/redir
```

## package/redis-plus-plus/Config.in
```kconfig
config LINGMO_PACKAGE_REDIS_PLUS_PLUS
	bool "redis-plus-plus"
	depends on LINGMO_INSTALL_LIBSTDCPP
	depends on LINGMO_TOOLCHAIN_HAS_THREADS
	select LINGMO_PACKAGE_HIREDIS
	help
	  Redis client written in C++

	  This is a C++ client library for Redis.
	  It's based on hiredis, and is compatible
	  with C++ 17, C++ 14, and C++ 11.

	  https://github.com/sewenew/redis-plus-plus

comment "redis-plus-plus needs a toolchain w/ C++, threads"
	depends on !LINGMO_INSTALL_LIBSTDCPP || !LINGMO_TOOLCHAIN_HAS_THREADS
```

## package/redis/Config.in
```kconfig
config LINGMO_PACKAGE_REDIS
	bool "redis"
	depends on LINGMO_USE_MMU # fork()
	depends on !LINGMO_STATIC_LIBS # dlfcn.h
	depends on LINGMO_TOOLCHAIN_GCC_AT_LEAST_4_9 # _Atomic keyword
	depends on LINGMO_TOOLCHAIN_HAS_ATOMIC
	depends on LINGMO_TOOLCHAIN_HAS_THREADS_NPTL # pthread_setname_np()
	help
	  Redis is an open source (BSD licensed), in-memory data
	  structure store, used as a database, cache and message
	  broker. It supports data structures such as strings,
	  hashes, lists, sets, sorted sets with range queries,
	  bitmaps, hyperloglogs, geospatial indexes with radius
	  queries and streams.

	  http://www.redis.io

comment "redis needs a toolchain w/ gcc>=4.9, dynamic library, nptl"
	depends on LINGMO_USE_MMU
	depends on LINGMO_TOOLCHAIN_HAS_ATOMIC
	depends on LINGMO_STATIC_LIBS || !LINGMO_TOOLCHAIN_HAS_THREADS_NPTL \
		|| !LINGMO_TOOLCHAIN_GCC_AT_LEAST_4_9
```

## package/refpolicy/Config.in
```kconfig
config LINGMO_PACKAGE_REFPOLICY
	bool "refpolicy"
	depends on LINGMO_TOOLCHAIN_HAS_THREADS # libsepol
	depends on LINGMO_TOOLCHAIN_GCC_AT_LEAST_5 # libsepol
	depends on LINGMO_HOST_GCC_AT_LEAST_5 # host-setools -> host-libsepol
	# Even though libsepol is not necessary for building, we get
	# the policy version from libsepol, so we select it, and treat
	# it like a runtime dependency.
	select LINGMO_PACKAGE_LIBSEPOL
	help
	  The SELinux Reference Policy project (refpolicy) is a
	  complete SELinux policy that can be used as the system
	  policy for a variety of systems and used as the basis for
	  creating other policies. Reference Policy was originally
	  based on the NSA example policy, but aims to accomplish many
	  additional goals.

	  The current refpolicy does not fully support Buildroot and
	  needs modifications to work with the default system file
	  layout. These changes should be added as patches to the
	  refpolicy that modify a single SELinux policy.

	  The refpolicy works for the most part in permissive
	  mode. Only the basic set of utilities are enabled in the
	  example policy config and some of the pathing in the
	  policies is not correct.  Individual policies would need to
	  be tweaked to get everything functioning properly.

	  https://github.com/TresysTechnology/refpolicy

if LINGMO_PACKAGE_REFPOLICY

choice
	prompt "Refpolicy version"
	default LINGMO_PACKAGE_REFPOLICY_UPSTREAM_VERSION

config LINGMO_PACKAGE_REFPOLICY_UPSTREAM_VERSION
	bool "Upstream version"
	# Consider reworking the following when adding new entries:
	# Upstream refpolicy for openssh expects linux-pam to be used
	select LINGMO_PACKAGE_LINUX_PAM if LINGMO_PACKAGE_OPENSSH \
		&& LINGMO_USE_MMU \
		&& LINGMO_ENABLE_LOCALE \
		&& LINGMO_USE_WCHAR \
		&& !LINGMO_STATIC_LIBS \
		&& LINGMO_TOOLCHAIN_GCC_AT_LEAST_4_9
	help
	  Use the refpolicy as provided by Buildroot.

config LINGMO_PACKAGE_REFPOLICY_CUSTOM_GIT
	bool "Custom git repository"
	help
	  Allows to get the refpolicy from a custom git repository.

	  The custom refpolicy must define the full policy explicitly,
	  and must be a fork of the original refpolicy, to have the
	  same build system.  When this is selected, only the custom
	  policy definition are taken into account and all the modules
	  of the policy are built into the binary policy.

endchoice

if LINGMO_PACKAGE_REFPOLICY_CUSTOM_GIT

config LINGMO_PACKAGE_REFPOLICY_CUSTOM_REPO_URL
	string "URL of custom repository"

config LINGMO_PACKAGE_REFPOLICY_CUSTOM_REPO_VERSION
	string "Custom repository version"
	help
	  Revision to use in the typical format used by Git.
	  E.g. a sha id, tag, branch...

endif

choice
	prompt "SELinux default state"
	default LINGMO_PACKAGE_REFPOLICY_POLICY_STATE_PERMISSIVE

config LINGMO_PACKAGE_REFPOLICY_POLICY_STATE_ENFORCING
	bool "Enforcing"
	help
	  SELinux security policy is enforced

config LINGMO_PACKAGE_REFPOLICY_POLICY_STATE_PERMISSIVE
	bool "Permissive"
	help
	  SELinux prints warnings instead of enforcing

config LINGMO_PACKAGE_REFPOLICY_POLICY_STATE_DISABLED
	bool "Disabled"
	help
	  No SELinux policy is loaded
endchoice

config LINGMO_PACKAGE_REFPOLICY_POLICY_STATE
	string
	default "permissive" if LINGMO_PACKAGE_REFPOLICY_POLICY_STATE_PERMISSIVE
	default "enforcing" if LINGMO_PACKAGE_REFPOLICY_POLICY_STATE_ENFORCING
	default "disabled" if LINGMO_PACKAGE_REFPOLICY_POLICY_STATE_DISABLED

if LINGMO_PACKAGE_REFPOLICY_UPSTREAM_VERSION

config LINGMO_REFPOLICY_EXTRA_MODULES_DIRS
	string "Extra modules directories"
	help
	  Specify a space-separated list of directories containing
	  SELinux modules that will be built into the SELinux
	  policy. The modules will be automatically enabled in the
	  policy.

	  Each of those directories must contain the SELinux policy
	  .fc, .if and .te files directly at the top-level, with no
	  sub-directories. Also, you cannot have several modules with
	  the same name in different directories.

config LINGMO_REFPOLICY_EXTRA_MODULES
	string "Extra modules to enable"
	help
	  List of extra SELinux modules to enable in the refpolicy.

endif

endif

comment "refpolicy needs a toolchain w/ threads, gcc >= 5, host gcc >= 5"
	depends on !LINGMO_TOOLCHAIN_HAS_THREADS || \
		!LINGMO_TOOLCHAIN_GCC_AT_LEAST_5 || \
		!LINGMO_HOST_GCC_AT_LEAST_5
```

## package/reproc/Config.in
```kconfig
config LINGMO_PACKAGE_REPROC
	bool "reproc"
	depends on LINGMO_USE_MMU # fork()
	depends on LINGMO_USE_WCHAR # uses wchar_t
	depends on LINGMO_TOOLCHAIN_HAS_THREADS # pthread
	help
	  reproc is a cross-platform C/C++ library that simplifies
	  starting, stopping and communicating with external programs.

	  https://github.com/DaanDeMeyer/reproc

comment "reproc needs a toolchain w/ threads, wchar"
	depends on LINGMO_USE_MMU
	depends on !LINGMO_USE_WCHAR || !LINGMO_TOOLCHAIN_HAS_THREADS
```
