## package/qt5cinex/Config.in
```kconfig
comment "qt5cinex needs an Open(E)GL-capable backend"
	depends on LINGMO_PACKAGE_QT5
	depends on LINGMO_PACKAGE_QT5_JSCORE_AVAILABLE
	depends on !LINGMO_PACKAGE_QT5_GL_AVAILABLE || !LINGMO_PACKAGE_HAS_LIBEGL

config LINGMO_PACKAGE_QT5CINEX
	bool "qt5cinex"
	depends on LINGMO_PACKAGE_QT5
	depends on LINGMO_PACKAGE_HAS_LIBEGL # qt5base-eglfs
	depends on LINGMO_PACKAGE_QT5_GL_AVAILABLE
	# No comment needed for this option, it's an architecture
	# dependency.
	depends on LINGMO_PACKAGE_QT5_JSCORE_AVAILABLE
	select LINGMO_PACKAGE_QT5BASE_NETWORK
	select LINGMO_PACKAGE_QT5BASE_PNG
	select LINGMO_PACKAGE_QT5BASE_WIDGETS
	select LINGMO_PACKAGE_QT5BASE_EGLFS
	select LINGMO_PACKAGE_QT5GRAPHICALEFFECTS
	help
	  This application demonstrates the power of Qt5 and few of
	  the new additions available in QtQuick 2.0.

	  http://quitcoding.com/?page=work#cinex

if LINGMO_PACKAGE_QT5CINEX

config LINGMO_PACKAGE_QT5CINEX_HD
	bool "High-definition version (aka RPi Edition)"
	help
	  High definition version (1920x1080 resolution) of the
	  application, optimised for Raspberry PI cards. This version
	  can also be run on any platform supported by Qt5.

endif
```

## package/qt6/Config.in
```kconfig
# based on src/corelib/global/qprocessordetection.h
config LINGMO_PACKAGE_QT6_ARCH_SUPPORTS
	bool
	# no support for ARMv4
	default y if LINGMO_ARM_CPU_ARMV5 || LINGMO_ARM_CPU_ARMV6 || LINGMO_ARM_CPU_ARMV7A || LINGMO_ARM_CPU_ARMV8A
	default y if LINGMO_i386
	default y if LINGMO_x86_64
	default y if LINGMO_mips || LINGMO_mipsel || LINGMO_mips64 || LINGMO_mips64el
	default y if LINGMO_powerpc || LINGMO_powerpc64 || LINGMO_powerpc64le
	# sparc 32-bit is supposedly supported, but has issues due to
	# the need of libatomic
	default y if LINGMO_sparc64
	depends on LINGMO_USE_MMU

config LINGMO_PACKAGE_QT6_GL_SUPPORTS
	bool
	default y
	depends on LINGMO_PACKAGE_HAS_LIBGL || LINGMO_PACKAGE_HAS_LIBGLES

comment "qt6 needs a toolchain w/ C++, threads, wchar, dynamic library, gcc >= 8, host gcc >= 8"
	depends on !LINGMO_PACKAGE_QT5
	depends on LINGMO_PACKAGE_QT6_ARCH_SUPPORTS
	depends on !LINGMO_INSTALL_LIBSTDCPP || !LINGMO_TOOLCHAIN_GCC_AT_LEAST_8 || \
		!LINGMO_HOST_GCC_AT_LEAST_8 || !LINGMO_TOOLCHAIN_HAS_THREADS || \
		LINGMO_STATIC_LIBS || !LINGMO_USE_WCHAR

menuconfig LINGMO_PACKAGE_QT6
	bool "Qt6"
	depends on LINGMO_INSTALL_LIBSTDCPP
	depends on LINGMO_TOOLCHAIN_GCC_AT_LEAST_8
	depends on LINGMO_HOST_GCC_AT_LEAST_8
	depends on LINGMO_PACKAGE_QT6_ARCH_SUPPORTS
	depends on LINGMO_TOOLCHAIN_HAS_THREADS
	depends on !LINGMO_STATIC_LIBS
	depends on LINGMO_USE_WCHAR
	depends on !LINGMO_PACKAGE_QT5
	select LINGMO_PACKAGE_QT6BASE
	help
	  This option enables the Qt6 framework. Sub-options allow to
	  select which modules should be built.

	  http://qt.io

if LINGMO_PACKAGE_QT6

source "package/qt6/qt6base/Config.in"
source "package/qt6/qt6core5compat/Config.in"
source "package/qt6/qt6serialbus/Config.in"
source "package/qt6/qt6serialport/Config.in"
source "package/qt6/qt6svg/Config.in"

endif
```

## package/qt6/qt6base/Config.in
```kconfig
config LINGMO_PACKAGE_QT6BASE
	bool "qt6base"
	select LINGMO_PACKAGE_DOUBLE_CONVERSION
	select LINGMO_PACKAGE_LIBB2
	select LINGMO_PACKAGE_PCRE2
	select LINGMO_PACKAGE_PCRE2_16
	select LINGMO_PACKAGE_ZLIB
	help
	  Qt is a cross-platform application and UI framework for
	  developers using C++.

	  This package corresponds to the qt6base module, which
	  contains the base Qt libraries: QtCore, QtNetwork, QtGui,
	  QtWidgets, etc.

	  http://qt.io

if LINGMO_PACKAGE_QT6BASE

config LINGMO_PACKAGE_QT6BASE_CONCURRENT
	bool "concurrent module"
	help
	  This options enables the Qt6Concurrent library.

config LINGMO_PACKAGE_QT6BASE_DBUS
	bool "DBus module"
	depends on LINGMO_TOOLCHAIN_HAS_THREADS
	depends on LINGMO_USE_MMU
	select LINGMO_PACKAGE_DBUS
	help
	  This option enables the D-Bus module.

config LINGMO_PACKAGE_QT6BASE_GUI
	bool "gui module"
	select LINGMO_PACKAGE_FREETYPE
	# At least one graphic backend must be enabled, so enable
	# linuxfb if nothing is enabled.
	select LINGMO_PACKAGE_QT6BASE_LINUXFB if \
	       !LINGMO_PACKAGE_QT6BASE_XCB && \
	       !LINGMO_PACKAGE_QT6BASE_EGLFS
	help
	  This option enables the Qt6Gui library.

if LINGMO_PACKAGE_QT6BASE_GUI

config LINGMO_PACKAGE_QT6BASE_VULKAN
	bool "Vulkan support"
	depends on LINGMO_INSTALL_LIBSTDCPP # vulkan-loader
	depends on !LINGMO_STATIC_LIBS # vulkan-loader
	depends on LINGMO_TOOLCHAIN_HAS_THREADS # vulkan-loader
	select LINGMO_PACKAGE_VULKAN_HEADERS
	select LINGMO_PACKAGE_VULKAN_LOADER
	help
	  This option enables Vulkan support.

config LINGMO_PACKAGE_QT6BASE_LINUXFB
	bool "linuxfb support"

config LINGMO_PACKAGE_QT6BASE_XCB
	bool "X.org XCB support"
	depends on LINGMO_PACKAGE_XORG7
	select LINGMO_PACKAGE_XLIB_LIBX11
	select LINGMO_PACKAGE_LIBXCB
	select LINGMO_PACKAGE_XCB_UTIL_IMAGE
	select LINGMO_PACKAGE_XCB_UTIL_KEYSYMS
	select LINGMO_PACKAGE_XCB_UTIL_RENDERUTIL
	select LINGMO_PACKAGE_XCB_UTIL_WM
	select LINGMO_PACKAGE_LIBXKBCOMMON

comment "X.org XCB backend available if X.org is enabled"
	depends on !LINGMO_PACKAGE_XORG7

config LINGMO_PACKAGE_QT6BASE_EGLFS
	bool "eglfs support"
	depends on LINGMO_PACKAGE_HAS_LIBEGL
	depends on LINGMO_PACKAGE_HAS_LIBGBM
	depends on LINGMO_PACKAGE_QT6_GL_SUPPORTS
	select LINGMO_PACKAGE_QT6BASE_OPENGL

config LINGMO_PACKAGE_QT6BASE_DEFAULT_QPA
	string "Default graphical platform"
	help
	  Choose the default platform abstraction to use for graphical
	  applications (e.g xcb, linuxfb, eglfs, ...). If this is
	  empty, the default for your architecture will be used
	  (usually this is eglfs).

	  You can get a list of supported platforms by running a Qt
	  application with the option "-platform help" on your
	  target. You can choose a different platform at runtime with
	  the -platform option.

config LINGMO_PACKAGE_QT6BASE_OPENGL
	bool "OpenGL support"
	depends on LINGMO_PACKAGE_QT6_GL_SUPPORTS
	help
	  This option enables OpenGL support.

comment "OpenGL support needs an OpenGL-capable backend"
	depends on !LINGMO_PACKAGE_QT6_GL_SUPPORTS

if LINGMO_PACKAGE_QT6BASE_OPENGL

choice
	prompt "OpenGL API"
	help
	  Select OpenGL API.

config LINGMO_PACKAGE_QT6BASE_OPENGL_DESKTOP
	bool "Desktop OpenGL"
	depends on LINGMO_PACKAGE_HAS_LIBGL
	help
	  Use desktop OpenGL.

config LINGMO_PACKAGE_QT6BASE_OPENGL_ES2
	bool "OpenGL ES 2.0+"
	depends on LINGMO_PACKAGE_HAS_LIBGLES
	help
	  Use OpenGL ES 2.0 and later versions.

endchoice

endif

config LINGMO_PACKAGE_QT6BASE_FONTCONFIG
	bool "fontconfig support"
	select LINGMO_PACKAGE_FONTCONFIG
	help
	  This option enables Fontconfig support using the system
	  fontconfig library.

config LINGMO_PACKAGE_QT6BASE_HARFBUZZ
	bool "harfbuzz support"
	select LINGMO_PACKAGE_HARFBUZZ if \
		LINGMO_TOOLCHAIN_HAS_SYNC_4 && \
		LINGMO_TOOLCHAIN_GCC_AT_LEAST_4_8
	help
	  This option enables HarfBuzz support (either system harfbuzz
	  if the toolchain supports __sync for 4 bytes, or the qt
	  provided one which avoids this dependency by using QAtomic).

config LINGMO_PACKAGE_QT6BASE_GIF
	bool "GIF support"
	help
	  This compiles and installs the plugin for GIF reading support.

config LINGMO_PACKAGE_QT6BASE_JPEG
	bool "JPEG support"
	select LINGMO_PACKAGE_JPEG
	help
	  This option enables JPEG support using the system libjpeg
	  library.

config LINGMO_PACKAGE_QT6BASE_PNG
	bool "PNG support"
	select LINGMO_PACKAGE_LIBPNG
	help
	  This option enables PNG support using the system libpng
	  library.

config LINGMO_PACKAGE_QT6BASE_WIDGETS
	bool "widgets module"
	help
	  This option enables the Qt6Widgets library.

config LINGMO_PACKAGE_QT6BASE_PRINTSUPPORT
	bool "printing support"
	# yes, print support needs widgets
	depends on LINGMO_PACKAGE_QT6BASE_WIDGETS
	help
	  This option enables printing support, optionally using CUPS
	  if available.

endif

config LINGMO_PACKAGE_QT6BASE_NETWORK
	bool "network module"
	select LINGMO_PACKAGE_LIBOPENSSL_ENABLE_PSK if LINGMO_PACKAGE_LIBOPENSSL
	help
	  This options enables the Qt6Network library.

config LINGMO_PACKAGE_QT6BASE_SQL
	bool "sql module"
	help
	  This options enables the Qt6Sql library.

if LINGMO_PACKAGE_QT6BASE_SQL
config LINGMO_PACKAGE_QT6BASE_MYSQL
	bool "MySQL Plugin"
	depends on LINGMO_INSTALL_LIBSTDCPP
	depends on LINGMO_USE_MMU
	depends on LINGMO_TOOLCHAIN_HAS_THREADS
	select LINGMO_PACKAGE_MARIADB
	help
	  Build MySQL plugin

comment "MySQL plugin needs a toolchain w/ C++, threads"
	depends on LINGMO_USE_MMU
	depends on !LINGMO_INSTALL_LIBSTDCPP || !LINGMO_TOOLCHAIN_HAS_THREADS

config LINGMO_PACKAGE_QT6BASE_PSQL
	bool "PostgreSQL Plugin"
	depends on LINGMO_USE_MMU
	depends on !LINGMO_STATIC_LIBS
	depends on LINGMO_USE_WCHAR
	depends on !LINGMO_OPTIMIZE_FAST
	select LINGMO_PACKAGE_POSTGRESQL
	help
	  Build PostgreSQL plugin

comment "PostgreSQL plugin needs a toolchain w/ wchar, dynamic library"
	depends on LINGMO_USE_MMU
	depends on LINGMO_STATIC_LIBS || !LINGMO_USE_WCHAR

comment "PostgreSQL plugin can't be built with optimize for fast"
	depends on LINGMO_USE_MMU
	depends on LINGMO_OPTIMIZE_FAST

config LINGMO_PACKAGE_QT6BASE_SQLITE
	bool "SQLite plugin"
	select LINGMO_PACKAGE_SQLITE
	select LINGMO_PACKAGE_SQLITE_ENABLE_COLUMN_METADATA
	help
	  Build SQLite plugin

endif

config LINGMO_PACKAGE_QT6BASE_SYSLOG
	bool "syslog support"
	help
	  Logs to the standard UNIX logging mechanism.

config LINGMO_PACKAGE_QT6BASE_TEST
	bool "test module"
	help
	  This options enables the Qt6Test library.

config LINGMO_PACKAGE_QT6BASE_TSLIB
	bool "Enable Tslib support"
	select LINGMO_PACKAGE_TSLIB
	help
	  This options enables the Tslib plugin

config LINGMO_PACKAGE_QT6BASE_XML
	bool "XML module"
	help
	  This options enables the Qt6Xml library.

endif
```

## package/qt6/qt6serialbus/Config.in
```kconfig
config LINGMO_PACKAGE_QT6SERIALBUS
	bool "qt6serialbus"
	depends on LINGMO_TOOLCHAIN_HEADERS_AT_LEAST_3_6 # CAN FD
	select LINGMO_PACKAGE_QT6SERIALPORT
	select LINGMO_PACKAGE_QT6BASE_NETWORK
	help
	  Qt is a cross-platform application and UI framework for
	  developers using C++.

	  This package corresponds to the qt6serialbus module.

	  https://doc.qt.io/qt-6/qtserialbus-index.html

comment "qt6serialbus needs headers >= 3.6"
	depends on !LINGMO_TOOLCHAIN_HEADERS_AT_LEAST_3_6
```

## package/quagga/Config.in
```kconfig
config LINGMO_PACKAGE_QUAGGA
	bool "quagga"
	depends on LINGMO_USE_MMU # fork()
	help
	  Routing software suite, providing implementations of OSPFv2,
	  OSPFv3 (IPv6), RIP v1 and v2, RIPng (IPv6) and BGPv4+.

	  http://www.quagga.net/

if LINGMO_PACKAGE_QUAGGA

config LINGMO_PACKAGE_QUAGGA_ZEBRA
	bool "zebra daemon"
	help
	  Build zebra daemon.

config LINGMO_PACKAGE_QUAGGA_TCP_ZEBRA
	bool "Use TCP sockets between zebra and protocol daemons"
	depends on LINGMO_PACKAGE_QUAGGA_ZEBRA
	help
	  Use a TCP socket to communicate between zebra (supervisor)
	  and the different protocol daemons.

	  You'll want this enabled if zebra and the protocol daemon(s)
	  run on different hosts.

config LINGMO_PACKAGE_QUAGGA_BGPD
	bool "BGPv4+ protocol"
	help
	  Build bgpd daemon.

config LINGMO_PACKAGE_QUAGGA_BGP_ANNOUNCE
	bool "BGP route announcement"
	depends on LINGMO_PACKAGE_QUAGGA_BGPD

config LINGMO_PACKAGE_QUAGGA_ISISD
	bool "IS-IS protocol"
	help
	  Enable isisd support in quagga.

config LINGMO_PACKAGE_QUAGGA_NHRPD
	bool "NHRPD protocol"
	select LINGMO_PACKAGE_C_ARES
	help
	  Build Next Hop Routing Protocol daemon.

config LINGMO_PACKAGE_QUAGGA_OSPFD
	bool "OSPFv2 protocol"
	help
	  Build ospfd daemon.

config LINGMO_PACKAGE_QUAGGA_OSPF6D
	bool "OSPFv3 (IPv6) protocol"
	help
	  Build ospf6d daemon.

config LINGMO_PACKAGE_QUAGGA_RIPD
	bool "RIPv2/v3 protocol"
	help
	  Build ripd daemon.

config LINGMO_PACKAGE_QUAGGA_RIPNGD
	bool "RIPng (IPv6) protocol"
	help
	  Build ripngd daemon.

config LINGMO_PACKAGE_QUAGGA_PIMD
	bool "PIMd protocol"
	help
	  Provides IPv4 PIM-SSM multicast routing.

config LINGMO_PACKAGE_QUAGGA_WATCHQUAGGA
	bool "Build watchquagga"
	help
	  Build and install watchquagga, a zebra/protocol daemon
	  supervisor.

config LINGMO_PACKAGE_QUAGGA_VTYSH
	bool "Build vtysh"
	select LINGMO_PACKAGE_READLINE
	help
	  Build and install vtysh, a vty shell for Quagga.

config LINGMO_PACKAGE_QUAGGA_SNMP
	bool "SNMP support"
	depends on LINGMO_USE_MMU # net-snmp
	select LINGMO_PACKAGE_NETSNMP
	help
	  Make quagga information available via SNMP SMUX.

comment "AgentX support must be enabled in net-snmp or the build will break"
	depends on LINGMO_PACKAGE_QUAGGA_SNMP

endif
```

## package/quazip/Config.in
```kconfig
config LINGMO_PACKAGE_QUAZIP
	bool "quazip"
	depends on LINGMO_PACKAGE_QT5 || LINGMO_PACKAGE_QT6
	select LINGMO_PACKAGE_ZLIB
	select LINGMO_PACKAGE_ZLIB_FORCE_LIBZLIB
	select LINGMO_PACKAGE_QT6CORE5COMPAT if LINGMO_PACKAGE_QT6
	help
	  QuaZIP is a simple C++ wrapper over Gilles Vollant's
	  ZIP/UNZIP package that can be used to access ZIP
	  archives. It uses the Qt toolkit.

	  http://quazip.sourceforge.net
```

## package/quickjs/Config.in
```kconfig
config LINGMO_PACKAGE_QUICKJS
	bool "quickjs"
	depends on !LINGMO_microblaze # fenv.h lacks FE_{DOWN,UP}WARD
	depends on !LINGMO_nios2 # fenv.h lacks FE_{DOWN,UP}WARD on nios2
	depends on !LINGMO_sh # fenv.h lacks FE_{DOWN,UP}WARD
	depends on !LINGMO_STATIC_LIBS
	# No way to check for fenv support.
	depends on !LINGMO_TOOLCHAIN_USES_UCLIBC
	depends on LINGMO_TOOLCHAIN_GCC_AT_LEAST_4_9 # C11/stdatomic.h
	depends on LINGMO_HOST_GCC_AT_LEAST_4_9 # C11/stdatomic.h
	depends on LINGMO_USE_MMU # fork()
	help
	  QuickJS is a small and embeddable Javascript engine.
	  It supports the ES2020 specification including modules,
	  asynchronous generators, proxies and BigInt.

	  https://bellard.org/quickjs/

comment "quickjs needs a glibc or musl toolchain w/ gcc >= 4.9, host gcc >= 4.9, dynamic library"
	depends on !LINGMO_microblaze
	depends on !LINGMO_nios2
	depends on !LINGMO_sh
	depends on LINGMO_USE_MMU
	depends on LINGMO_STATIC_LIBS || LINGMO_TOOLCHAIN_USES_UCLIBC || \
		!LINGMO_TOOLCHAIN_GCC_AT_LEAST_4_9 || !LINGMO_HOST_GCC_AT_LEAST_4_9
```

## package/quota/Config.in
```kconfig
config LINGMO_PACKAGE_QUOTA
	bool "quota"
	depends on LINGMO_USE_WCHAR
	depends on LINGMO_USE_MMU # fork()
	depends on LINGMO_TOOLCHAIN_HAS_NATIVE_RPC || LINGMO_TOOLCHAIN_HAS_THREADS # libtirpc
	select LINGMO_PACKAGE_LIBTIRPC if !LINGMO_TOOLCHAIN_HAS_NATIVE_RPC
	help
	  Implementation of the disk quota system.

	  http://sourceforge.net/projects/linuxquota/

comment "quota needs a toolchain w/ wchar, threads"
	depends on LINGMO_USE_MMU
	depends on !LINGMO_USE_WCHAR || \
		!(LINGMO_TOOLCHAIN_HAS_THREADS || LINGMO_TOOLCHAIN_HAS_NATIVE_RPC)
```

## package/qwt/Config.in
```kconfig
config LINGMO_PACKAGE_QWT
	bool "qwt"
	depends on LINGMO_PACKAGE_QT5
	select LINGMO_PACKAGE_QT5BASE_GUI
	select LINGMO_PACKAGE_QT5BASE_WIDGETS # printsupport
	select LINGMO_PACKAGE_QT5BASE_CONCURRENT
	help
	  Qwt is a graphics extension to the Qt GUI application
	  framework. It provides a 2D plotting widget and more.

	  http://qwt.sourceforge.net/

if LINGMO_PACKAGE_QWT

config LINGMO_PACKAGE_QWT_SVG
	bool "SVG support"
	select LINGMO_PACKAGE_QT5SVG

config LINGMO_PACKAGE_QWT_MATHML
	bool "MathML support"

config LINGMO_PACKAGE_QWT_OPENGL
	bool "OpenGL support"
	depends on LINGMO_PACKAGE_QT5_GL_AVAILABLE
	select LINGMO_PACKAGE_QT5BASE_OPENGL
	select LINGMO_PACKAGE_QT5BASE_OPENGL_LIB

endif
```

## package/rabbitmq-c/Config.in
```kconfig
config LINGMO_PACKAGE_RABBITMQ_C
	bool "rabbitmq-c"
	depends on !LINGMO_STATIC_LIBS
	depends on LINGMO_TOOLCHAIN_HAS_THREADS
	help
	  This is a C-language AMQP client library for use with v2.0+
	  of the RabbitMQ broker.

	  https://github.com/alanxz/rabbitmq-c

comment "rabbitmq-c needs a toolchain w/ dynamic library, threads"
	depends on LINGMO_STATIC_LIBS || !LINGMO_TOOLCHAIN_HAS_THREADS
```
