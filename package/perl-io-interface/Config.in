## package/perl-io-interface/Config.in
```kconfig
config LINGMO_PACKAGE_PERL_IO_INTERFACE
	bool "perl-io-interface"
	depends on !LINGMO_STATIC_LIBS
	help
	  Access and modify network interface card configuration.

	  https://metacpan.org/release/IO-Interface

comment "perl-io-interface needs a toolchain w/ dynamic library"
	depends on LINGMO_STATIC_LIBS
```

## package/perl-io-socket-multicast/Config.in
```kconfig
config LINGMO_PACKAGE_PERL_IO_SOCKET_MULTICAST
	bool "perl-io-socket-multicast"
	depends on !LINGMO_STATIC_LIBS
	select LINGMO_PACKAGE_PERL_IO_INTERFACE # runtime
	help
	  Send and receive multicast messages.

	  https://metacpan.org/release/IO-Socket-Multicast

comment "perl-io-socket-multicast needs a toolchain w/ dynamic library"
	depends on LINGMO_STATIC_LIBS
```

## package/perl-io-socket-ssl/Config.in
```kconfig
config LINGMO_PACKAGE_PERL_IO_SOCKET_SSL
	bool "perl-io-socket-ssl"
	depends on !LINGMO_STATIC_LIBS
	select LINGMO_PACKAGE_PERL_MOZILLA_CA # runtime
	select LINGMO_PACKAGE_PERL_NET_SSLEAY # runtime
	help
	  Nearly transparent SSL encapsulation for IO::Socket::INET.

	  https://github.com/noxxi/p5-io-socket-ssl

comment "perl-io-socket-ssl needs a toolchain w/ dynamic library"
	depends on LINGMO_STATIC_LIBS
```

## package/perl-libwww-perl/Config.in
```kconfig
config LINGMO_PACKAGE_PERL_LIBWWW_PERL
	bool "perl-libwww-perl"
	depends on !LINGMO_STATIC_LIBS
	select LINGMO_PACKAGE_PERL_ENCODE_LOCALE # runtime
	select LINGMO_PACKAGE_PERL_FILE_LISTING # runtime
	select LINGMO_PACKAGE_PERL_HTML_PARSER # runtime
	select LINGMO_PACKAGE_PERL_HTTP_COOKIES # runtime
	select LINGMO_PACKAGE_PERL_HTTP_DATE # runtime
	select LINGMO_PACKAGE_PERL_HTTP_MESSAGE # runtime
	select LINGMO_PACKAGE_PERL_HTTP_NEGOTIATE # runtime
	select LINGMO_PACKAGE_PERL_LWP_MEDIATYPES # runtime
	select LINGMO_PACKAGE_PERL_NET_HTTP # runtime
	select LINGMO_PACKAGE_PERL_TRY_TINY # runtime
	select LINGMO_PACKAGE_PERL_URI # runtime
	select LINGMO_PACKAGE_PERL_WWW_ROBOTRULES # runtime
	help
	  The World-Wide Web library for Perl.

	  https://github.com/libwww-perl/libwww-perl

comment "perl-libwww-perl needs a toolchain w/ dynamic library"
	depends on LINGMO_STATIC_LIBS
```

## package/perl-lwp-protocol-https/Config.in
```kconfig
config LINGMO_PACKAGE_PERL_LWP_PROTOCOL_HTTPS
	bool "perl-lwp-protocol-https"
	depends on !LINGMO_STATIC_LIBS
	select LINGMO_PACKAGE_PERL_IO_SOCKET_SSL # runtime
	select LINGMO_PACKAGE_PERL_NET_HTTP # runtime
	select LINGMO_PACKAGE_PERL_LIBWWW_PERL # runtime
	help
	  Provide https support for LWP::UserAgent.

	  https://github.com/libwww-perl/LWP-Protocol-https

comment "perl-lwp-protocol-https needs a toolchain w/ dynamic library"
	depends on LINGMO_STATIC_LIBS
```

## package/perl-mail-dkim/Config.in
```kconfig
config LINGMO_PACKAGE_PERL_MAIL_DKIM
	bool "perl-mail-dkim"
	depends on !LINGMO_STATIC_LIBS
	select LINGMO_PACKAGE_PERL_CRYPT_OPENSSL_RSA # runtime
	select LINGMO_PACKAGE_PERL_MAILTOOLS # runtime
	select LINGMO_PACKAGE_PERL_NET_DNS # runtime
	help
	  Signs/verifies Internet mail with DKIM/DomainKey signatures.

	  https://metacpan.org/release/Mail-DKIM

comment "perl-mail-dkim needs a toolchain w/ dynamic library"
	depends on LINGMO_STATIC_LIBS
```

## package/perl-mailtools/Config.in
```kconfig
config LINGMO_PACKAGE_PERL_MAILTOOLS
	bool "perl-mailtools"
	select LINGMO_PACKAGE_PERL_TIMEDATE # runtime
	help
	  Various ancient e-mail related modules.

	  http://perl.overmeer.net/CPAN/
```

## package/perl-math-int64/Config.in
```kconfig
config LINGMO_PACKAGE_PERL_MATH_INT64
	bool "perl-math-int64"
	depends on !LINGMO_STATIC_LIBS
	help
	  Manipulate 64 bits integers in Perl.

	  http://metacpan.org/release/Math-Int64

comment "perl-math-int64 needs a toolchain w/ dynamic library"
	depends on LINGMO_STATIC_LIBS
```

## package/perl-math-prime-util/Config.in
```kconfig
config LINGMO_PACKAGE_PERL_MATH_PRIME_UTIL
	bool "perl-math-prime-util"
	depends on !LINGMO_STATIC_LIBS
	help
	  Utilities related to prime numbers, including fast sieves and
	  factoring.

	  https://github.com/danaj/Math-Prime-Util

comment "perl-math-prime-util needs a toolchain w/ dynamic library"
	depends on LINGMO_STATIC_LIBS
```

## package/perl-module-implementation/Config.in
```kconfig
config LINGMO_PACKAGE_PERL_MODULE_IMPLEMENTATION
	bool "perl-module-implementation"
	select LINGMO_PACKAGE_PERL_MODULE_RUNTIME # runtime
	select LINGMO_PACKAGE_PERL_TRY_TINY # runtime
	help
	  Loads one of several alternate underlying implementations for
	  a module.

	  http://metacpan.org/release/Module-Implementation
```

## package/perl-mojolicious-plugin-cspheader/Config.in
```kconfig
config LINGMO_PACKAGE_PERL_MOJOLICIOUS_PLUGIN_CSPHEADER
	bool "perl-mojolicious-plugin-cspheader"
	select LINGMO_PACKAGE_PERL_MOJOLICIOUS # runtime
	help
	  Mojolicious Plugin to add Content-Security-Policy header to
	  every HTTP response.

	  https://metacpan.org/release/Mojolicious-Plugin-CSPHeader
```

## package/perl-mojolicious-plugin-i18n/Config.in
```kconfig
config LINGMO_PACKAGE_PERL_MOJOLICIOUS_PLUGIN_I18N
	bool "perl-mojolicious-plugin-i18n"
	select LINGMO_PACKAGE_PERL_MOJOLICIOUS # runtime
	help
	  Internationalization Plugin for Mojolicious.

	  https://metacpan.org/release/Mojolicious-Plugin-I18N
```

## package/perl-mojolicious-plugin-securityheader/Config.in
```kconfig
config LINGMO_PACKAGE_PERL_MOJOLICIOUS_PLUGIN_SECURITYHEADER
	bool "perl-mojolicious-plugin-securityheader"
	select LINGMO_PACKAGE_PERL_MOJOLICIOUS # runtime
	help
	  Mojolicious Plugin.

	  http://github.com/reneeb/Mojolicious-Plugin-SecurityHeader
```

## package/perl-moo/Config.in
```kconfig
config LINGMO_PACKAGE_PERL_MOO
	bool "perl-moo"
	select LINGMO_PACKAGE_PERL_CLASS_METHOD_MODIFIERS # runtime
	select LINGMO_PACKAGE_PERL_ROLE_TINY # runtime
	select LINGMO_PACKAGE_PERL_SUB_QUOTE # runtime
	help
	  Minimalist Object Orientation (with Moose compatibility).

	  https://metacpan.org/release/Moo
```

## package/perl-net-dns/Config.in
```kconfig
config LINGMO_PACKAGE_PERL_NET_DNS
	bool "perl-net-dns"
	select LINGMO_PACKAGE_PERL_DIGEST_HMAC # runtime
	help
	  Perl Interface to the Domain Name System.

	  https://metacpan.org/release/Net-DNS
```

## package/perl-net-http/Config.in
```kconfig
config LINGMO_PACKAGE_PERL_NET_HTTP
	bool "perl-net-http"
	select LINGMO_PACKAGE_PERL_URI # runtime
	help
	  Low-level HTTP connection (client).

	  https://github.com/libwww-perl/Net-HTTP
```

## package/perl-net-ssh2/Config.in
```kconfig
config LINGMO_PACKAGE_PERL_NET_SSH2
	bool "perl-net-ssh2"
	depends on !LINGMO_STATIC_LIBS
	depends on LINGMO_PACKAGE_LIBSSH2_OPENSSL || LINGMO_PACKAGE_LIBSSH2_LIBGCRYPT
	select LINGMO_PACKAGE_ZLIB
	help
	  Support for the SSH 2 protocol via libssh2.

	  Note: only the OpenSSL and Libgcrypt backends of libssh2 are
	  supported.

	  https://metacpan.org/release/Net-SSH2

comment "perl-net-ssh2 needs a toolchain w/ dynamic library"
	depends on LINGMO_STATIC_LIBS

comment "perl-net-ssh2 needs libssh2 with OpenSSL or Libgcrypt backend"
	depends on !(LINGMO_PACKAGE_LIBSSH2_OPENSSL || LINGMO_PACKAGE_LIBSSH2_LIBGCRYPT)
```

## package/perl-net-ssleay/Config.in
```kconfig
config LINGMO_PACKAGE_PERL_NET_SSLEAY
	bool "perl-net-ssleay"
	depends on !LINGMO_STATIC_LIBS
	select LINGMO_PACKAGE_OPENSSL
	select LINGMO_PACKAGE_LIBOPENSSL_ENABLE_RMD160 if LINGMO_PACKAGE_LIBOPENSSL
	help
	  Perl extension for using OpenSSL.

	  https://metacpan.org/release/Net-SSLeay

comment "perl-net-ssleay needs a toolchain w/ dynamic library"
	depends on LINGMO_STATIC_LIBS
```

## package/perl-package-stash/Config.in
```kconfig
config LINGMO_PACKAGE_PERL_PACKAGE_STASH
	bool "perl-package-stash"
	select LINGMO_PACKAGE_PERL_DIST_CHECKCONFLICTS # runtime
	select LINGMO_PACKAGE_PERL_MODULE_IMPLEMENTATION # runtime
	help
	  Routines for manipulating stashes.

	  https://github.com/moose/Package-Stash
```

## package/perl-params-util/Config.in
```kconfig
config LINGMO_PACKAGE_PERL_PARAMS_UTIL
	bool "perl-params-util"
	depends on !LINGMO_STATIC_LIBS
	help
	  Simple, compact and correct param-checking functions.

	  https://metacpan.org/release/Params-Util

comment "perl-params-util needs a toolchain w/ dynamic library"
	depends on LINGMO_STATIC_LIBS
```

## package/perl-plack/Config.in
```kconfig
config LINGMO_PACKAGE_PERL_PLACK
	bool "perl-plack"
	depends on !LINGMO_STATIC_LIBS # perl-http-message -> perl-clone
	select LINGMO_PACKAGE_PERL_APACHE_LOGFORMAT_COMPILER # runtime
	select LINGMO_PACKAGE_PERL_COOKIE_BAKER # runtime
	select LINGMO_PACKAGE_PERL_DEVEL_STACKTRACE # runtime
	select LINGMO_PACKAGE_PERL_DEVEL_STACKTRACE_ASHTML # runtime
	select LINGMO_PACKAGE_PERL_FILE_SHAREDIR # runtime
	select LINGMO_PACKAGE_PERL_FILESYS_NOTIFY_SIMPLE # runtime
	select LINGMO_PACKAGE_PERL_HTTP_ENTITY_PARSER # runtime
	select LINGMO_PACKAGE_PERL_HTTP_HEADERS_FAST # runtime
	select LINGMO_PACKAGE_PERL_HTTP_MESSAGE # runtime
	select LINGMO_PACKAGE_PERL_HASH_MULTIVALUE # runtime
	select LINGMO_PACKAGE_PERL_STREAM_BUFFERED # runtime
	select LINGMO_PACKAGE_PERL_TRY_TINY # runtime
	select LINGMO_PACKAGE_PERL_URI # runtime
	select LINGMO_PACKAGE_PERL_WWW_FORM_URLENCODED # runtime
	help
	  Perl Superglue for Web frameworks and Web Servers (PSGI
	  toolkit).

	  https://github.com/plack/Plack

comment "perl-plack needs a toolchain w/ dynamic library"
	depends on LINGMO_STATIC_LIBS
```

## package/perl-sys-cpu/Config.in
```kconfig
config LINGMO_PACKAGE_PERL_SYS_CPU
	bool "perl-sys-cpu"
	depends on !LINGMO_STATIC_LIBS
	help
	  Perl module for getting information about the system CPU
	  (Sys::CPU).

	  http://search.cpan.org/dist/Sys-CPU/

comment "perl-sys-cpu needs a toolchain w/ dynamic library"
	depends on LINGMO_STATIC_LIBS
```

## package/perl-sys-mmap/Config.in
```kconfig
config LINGMO_PACKAGE_PERL_SYS_MMAP
	bool "perl-sys-mmap"
	depends on !LINGMO_STATIC_LIBS
	help
	  uses mmap to map in a file as a Perl variable.

	  https://metacpan.org/release/Sys-Mmap

comment "perl-sys-mmap needs a toolchain w/ dynamic library"
	depends on LINGMO_STATIC_LIBS
```

## package/perl-type-tiny/Config.in
```kconfig
config LINGMO_PACKAGE_PERL_TYPE_TINY
	bool "perl-type-tiny"
	select LINGMO_PACKAGE_PERL_EXPORTER_TINY # runtime
	help
	  tiny, yet Moo(se)-compatible type constraint.

	  https://typetiny.toby.ink/
```

## package/perl-www-robotrules/Config.in
```kconfig
config LINGMO_PACKAGE_PERL_WWW_ROBOTRULES
	bool "perl-www-robotrules"
	select LINGMO_PACKAGE_PERL_URI # runtime
	help
	  database of robots.txt-derived permissions.

	  https://metacpan.org/release/WWW-RobotRules
```
