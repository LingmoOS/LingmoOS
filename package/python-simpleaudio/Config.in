## package/python-simpleaudio/Config.in
```kconfig
config LINGMO_PACKAGE_PYTHON_SIMPLEAUDIO
	bool "python-simpleaudio"
	depends on LINGMO_TOOLCHAIN_HAS_THREADS # alsa-lib
	select LINGMO_PACKAGE_ALSA_LIB
	help
	  The simplaudio package provides cross-platform,
	  dependency-free audio playback capability for Python 3 on
	  OSX, Windows, and Linux.

	  https://github.com/hamiltron/py-simple-audio

comment "python-simpleaudio needs a toolchain w/ threads"
	depends on !LINGMO_TOOLCHAIN_HAS_THREADS
```

## package/python-simplelogging/Config.in
```kconfig
config LINGMO_PACKAGE_PYTHON_SIMPLELOGGING
	bool "python-simplelogging"
	select LINGMO_PACKAGE_PYTHON_COLORLOG # runtime
	help
	  Logging made simple, no excuse for any debug print call.

	  https://github.com/vpoulailleau/simplelogging
```

## package/python-simplesqlite/Config.in
```kconfig
config LINGMO_PACKAGE_PYTHON_SIMPLESQLITE
	bool "python-simplesqlite"
	select LINGMO_PACKAGE_PYTHON_DATAPROPERTY # runtime
	select LINGMO_PACKAGE_PYTHON_MBSTRDECODER # runtime
	select LINGMO_PACKAGE_PYTHON_PATHVALIDATE # runtime
	select LINGMO_PACKAGE_PYTHON3_SQLITE # runtime
	select LINGMO_PACKAGE_PYTHON_SQLITESCHEMA # runtime
	select LINGMO_PACKAGE_PYTHON_TABLEDATA # runtime
	select LINGMO_PACKAGE_PYTHON_TYPEPY # runtime
	help
	  SimpleSQLite is a Python library to simplify SQLite database
	  operations: table creation, data insertion and get data as
	  other data formats.

	  https://github.com/thombashi/SimpleSQLite
```

## package/python-slob/Config.in
```kconfig
config LINGMO_PACKAGE_PYTHON_SLOB
	bool "python-slob"
	depends on !LINGMO_BINFMT_FLAT # python-pyicu -> icu
	depends on LINGMO_HOST_GCC_AT_LEAST_4_9 # python-pyicu -> icu
	depends on LINGMO_INSTALL_LIBSTDCPP # python-pyicu -> icu
	depends on LINGMO_TOOLCHAIN_GCC_AT_LEAST_4_9 # python-pyicu -> icu
	select LINGMO_PACKAGE_PYTHON_PYICU # runtime
	# although optional, it is used as default compression
	select LINGMO_PACKAGE_PYTHON3_XZ # runtime
	help
	  slob.py is a reference implementation of slob format reader
	  and writer.

	  https://github.com/itkach/slob

comment "python-slob needs a toolchain w/ C++, gcc >= 4.9, host gcc >= 4.9"
	depends on !LINGMO_INSTALL_LIBSTDCPP || \
		!LINGMO_TOOLCHAIN_GCC_AT_LEAST_4_9 || \
		!LINGMO_HOST_GCC_AT_LEAST_4_9
```

## package/python-smbprotocol/Config.in
```kconfig
config LINGMO_PACKAGE_PYTHON_SMBPROTOCOL
	bool "python-smbprotocol"
	depends on LINGMO_PACKAGE_HOST_RUSTC_TARGET_ARCH_SUPPORTS # python-cryptography
	select LINGMO_PACKAGE_PYTHON_CRYPTOGRAPHY # runtime
	select LINGMO_PACKAGE_PYTHON_PYSPNEGO # runtime
	help
	  Interact with a server using the SMB 2/3 Protocol.

	  https://github.com/jborean93/smbprotocol
```

## package/python-snappy/Config.in
```kconfig
config LINGMO_PACKAGE_PYTHON_SNAPPY
	bool "python-snappy"
	depends on LINGMO_INSTALL_LIBSTDCPP # snappy
	select LINGMO_PACKAGE_SNAPPY
	help
	  Python library for the snappy compression library from
	  Google.

	  http://github.com/andrix/python-snappy

comment "python-snappy needs a toolchain w/ C++"
	depends on !LINGMO_INSTALL_LIBSTDCPP
```

## package/python-socketio/Config.in
```kconfig
config LINGMO_PACKAGE_PYTHON_SOCKETIO
	bool "python-socketio"
	select LINGMO_PACKAGE_PYTHON_BIDICT # runtime
	select LINGMO_PACKAGE_PYTHON_ENGINEIO # runtime
	help
	  Socket.IO server.

	  http://github.com/miguelgrinberg/python-socketio/
```

## package/python-sockjs/Config.in
```kconfig
config LINGMO_PACKAGE_PYTHON_SOCKJS
	bool "python-sockjs"
	select LINGMO_PACKAGE_PYTHON_AIOHTTP # runtime
	help
	  SockJS server implementation for aiohttp.

	  https://github.com/aio-libs/sockjs/
```

## package/python-sqliteschema/Config.in
```kconfig
config LINGMO_PACKAGE_PYTHON_SQLITESCHEMA
	bool "python-sqliteschema"
	select LINGMO_PACKAGE_PYTHON_MBSTRDECODER # runtime
	select LINGMO_PACKAGE_PYTHON_TABLEDATA # runtime
	select LINGMO_PACKAGE_PYTHON_TYPEPY # runtime
	help
	  A Python library to dump table schema of a SQLite database
	  file.

	  https://github.com/thombashi/sqliteschema
```

## package/python-stack-data/Config.in
```kconfig
config LINGMO_PACKAGE_PYTHON_STACK_DATA
	bool "python-stack-data"
	select LINGMO_PACKAGE_PYTHON_ASTTOKENS # runtime
	select LINGMO_PACKAGE_PYTHON_EXECUTING # runtime
	select LINGMO_PACKAGE_PYTHON_PURE_EVAL # runtime
	help
	  Extract data from python stack frames and tracebacks
	  for informative displays.

	  http://github.com/alexmojaki/stack_data
```

## package/python-starlette/Config.in
```kconfig
config LINGMO_PACKAGE_PYTHON_STARLETTE
	bool "python-starlette"
	select LINGMO_PACKAGE_PYTHON_ANYIO # runtime
	help
	  The little ASGI library that shines.

	  https://github.com/encode/starlette
```

## package/python-tabledata/Config.in
```kconfig
config LINGMO_PACKAGE_PYTHON_TABLEDATA
	bool "python-tabledata"
	select LINGMO_PACKAGE_PYTHON_DATAPROPERTY # runtime
	select LINGMO_PACKAGE_PYTHON_TYPEPY # runtime
	help
	  A Python library to represent tabular data for
	  pytablewriter/pytablereader/SimpleSQLite.

	  https://github.com/thombashi/tabledata
```

## package/python-tempora/Config.in
```kconfig
config LINGMO_PACKAGE_PYTHON_TEMPORA
	bool "python-tempora"
	select LINGMO_PACKAGE_PYTHON_JARACO_FUNCTOOLS # runtime
	select LINGMO_PACKAGE_PYTHON_PYTZ # runtime
	help
	  Objects and routines pertaining to date and time.

	  https://github.com/jaraco/tempora
```

## package/python-thrift/Config.in
```kconfig
config LINGMO_PACKAGE_PYTHON_THRIFT
	bool "python-thrift"
	select LINGMO_PACKAGE_PYTHON_SIX # runtime
	help
	  Python bindings for the Apache Thrift RPC system.

	  https://thrift.apache.org
```

## package/python-tinycss2/Config.in
```kconfig
config LINGMO_PACKAGE_PYTHON_TINYCSS2
	bool "python-tinycss2"
	select LINGMO_PACKAGE_PYTHON_WEBENCODINGS # runtime
	help
	  A tiny CSS parser.

	  https://www.courtbouillon.org/tinycss2
```

## package/python-tomako/Config.in
```kconfig
config LINGMO_PACKAGE_PYTHON_TOMAKO
	bool "python-tomako"
	select LINGMO_PACKAGE_PYTHON_TORNADO # runtime
	select LINGMO_PACKAGE_PYTHON_MAKO # runtime
	help
	  Tomako is the easiest way to use Mako as a template engine for
	  Tornado.

	  https://github.com/rcmachado/tomako
```

## package/python-toml/Config.in
```kconfig
config LINGMO_PACKAGE_PYTHON_TOML
	bool "python-toml"
	help
	  Python Library for Tom's Obvious, Minimal Language.

	  https://github.com/uiri/toml
```

## package/python-trafaret/Config.in
```kconfig
config LINGMO_PACKAGE_PYTHON_TRAFARET
	bool "python-trafaret"
	help
	  Ultimate transformation library that supports validation,
	  contexts and aiohttp.

	  https://github.com/Deepwalker/trafaret/
```

## package/python-treq/Config.in
```kconfig
config LINGMO_PACKAGE_PYTHON_TREQ
	bool "python-treq"
	# twisted TLS -> python-{pyopenssl,service-identity}
	depends on LINGMO_PACKAGE_HOST_RUSTC_TARGET_ARCH_SUPPORTS
	select LINGMO_PACKAGE_PYTHON_ATTRS # runtime
	select LINGMO_PACKAGE_PYTHON_HYPERLINK # runtime
	select LINGMO_PACKAGE_PYTHON_INCREMENTAL # runtime
	select LINGMO_PACKAGE_PYTHON_REQUESTS # runtime
	select LINGMO_PACKAGE_PYTHON_TWISTED # runtime
	select LINGMO_PACKAGE_PYTHON_TWISTED_TLS # runtime
	help
	  treq is an HTTP library inspired by requests but written on
	  top of Twisted's Agents. It provides a simple, higher level
	  API for making HTTP requests when using Twisted.

	  https://github.com/twisted/treq
```

## package/python-trio-websocket/Config.in
```kconfig
config LINGMO_PACKAGE_PYTHON_TRIO_WEBSOCKET
	bool "python-trio-websocket"
	select LINGMO_PACKAGE_PYTHON_ASYNC_GENERATOR # runtime
	select LINGMO_PACKAGE_PYTHON_TRIO # runtime
	select LINGMO_PACKAGE_PYTHON_WSPROTO # runtime
	help
	  WebSocket library for Trio.

	  https://github.com/HyperionGray/trio-websocket
```

## package/python-trio/Config.in
```kconfig
config LINGMO_PACKAGE_PYTHON_TRIO
	bool "python-trio"
	select LINGMO_PACKAGE_PYTHON_ASYNC_GENERATOR # runtime
	select LINGMO_PACKAGE_PYTHON_ATTRS # runtime
	select LINGMO_PACKAGE_PYTHON_IDNA # runtime
	select LINGMO_PACKAGE_PYTHON_OUTCOME # runtime
	select LINGMO_PACKAGE_PYTHON_SNIFFIO # runtime
	select LINGMO_PACKAGE_PYTHON_SORTEDCONTAINERS # runtime
	help
	  A friendly Python library for async concurrency and I/O.

	  https://github.com/python-trio/trio
```

## package/python-twisted/Config.in
```kconfig
config LINGMO_PACKAGE_PYTHON_TWISTED
	bool "python-twisted"
	select LINGMO_PACKAGE_PYTHON_INCREMENTAL
	select LINGMO_PACKAGE_PYTHON_ATTRS # runtime
	select LINGMO_PACKAGE_PYTHON_AUTOMAT # runtime
	select LINGMO_PACKAGE_PYTHON_CONSTANTLY # runtime
	select LINGMO_PACKAGE_PYTHON_HYPERLINK # runtime
	select LINGMO_PACKAGE_PYTHON_PYHAMCREST # runtime
	select LINGMO_PACKAGE_PYTHON_ZOPE_INTERFACE # runtime
	select LINGMO_PACKAGE_PYTHON_TYPING_EXTENSIONS # runtime
	help
	  Twisted is an event-driven networking engine written in
	  Python.

	  https://twistedmatrix.com/trac/

if LINGMO_PACKAGE_PYTHON_TWISTED

config LINGMO_PACKAGE_PYTHON_TWISTED_HTTP2
	bool "HTTP2 support"
	select LINGMO_PACKAGE_PYTHON_H2 # runtime
	select LINGMO_PACKAGE_PYTHON_PRIORITY # runtime

config LINGMO_PACKAGE_PYTHON_TWISTED_TLS
	bool "TLS support"
	# python-{pyopenssl,service-identity}
	depends on LINGMO_PACKAGE_HOST_RUSTC_TARGET_ARCH_SUPPORTS
	select LINGMO_PACKAGE_PYTHON_IDNA # runtime
	select LINGMO_PACKAGE_PYTHON_PYOPENSSL # runtime
	select LINGMO_PACKAGE_PYTHON_SERVICE_IDENTITY # runtime

config LINGMO_PACKAGE_PYTHON_TWISTED_CONCH
	bool "Conch support"
	depends on LINGMO_PACKAGE_HOST_RUSTC_TARGET_ARCH_SUPPORTS # python-cryptography, python-bcrypt
	select LINGMO_PACKAGE_PYTHON_APPDIRS # runtime
	select LINGMO_PACKAGE_PYTHON_BCRYPT # runtime
	select LINGMO_PACKAGE_PYTHON_CRYPTOGRAPHY # runtime
	select LINGMO_PACKAGE_PYTHON_PYASN1 # runtime

config LINGMO_PACKAGE_PYTHON_TWISTED_SERIAL
	bool "Serial support"
	select LINGMO_PACKAGE_PYTHON_SERIAL # runtime

endif
```

## package/python-txaio/Config.in
```kconfig
config LINGMO_PACKAGE_PYTHON_TXAIO
	bool "python-txaio"
	help
	  Compatibility API between asyncio/Twisted/Trollius.

	  https://pypi.python.org/pypi/txaio
```

## package/python-txdbus/Config.in
```kconfig
config LINGMO_PACKAGE_PYTHON_TXDBUS
	bool "python-txdbus"
	# python-twisted -> python-cryptography
	depends on LINGMO_PACKAGE_HOST_RUSTC_TARGET_ARCH_SUPPORTS
	select LINGMO_PACKAGE_PYTHON_TWISTED # runtime
	select LINGMO_PACKAGE_PYTHON_SIX # runtime
	help
	  A native Python implementation of the DBus protocol for
	  Twisted applications.

	  https://github.com/cocagne/txdbus
```

## package/python-txtorcon/Config.in
```kconfig
config LINGMO_PACKAGE_PYTHON_TXTORCON
	bool "python-txtorcon"
	# python-pyopenssl -> python-cryptography
	depends on LINGMO_PACKAGE_HOST_RUSTC_TARGET_ARCH_SUPPORTS
	select LINGMO_PACKAGE_PYTHON_AUTOMAT # runtime
	select LINGMO_PACKAGE_PYTHON_IDNA # runtime
	select LINGMO_PACKAGE_PYTHON_INCREMENTAL # runtime
	select LINGMO_PACKAGE_PYTHON_PYOPENSSL # runtime
	select LINGMO_PACKAGE_PYTHON_SERVICE_IDENTITY # runtime
	select LINGMO_PACKAGE_PYTHON_TWISTED # runtime
	select LINGMO_PACKAGE_PYTHON_ZOPE_INTERFACE # runtime
	help
	  Twisted-based Tor controller client, with state-tracking and
	  configuration abstractions.

	  https://github.com/meejah/txtorcon
```
