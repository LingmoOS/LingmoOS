## package/tl-expected/Config.in
```kconfig
config LINGMO_PACKAGE_TL_EXPECTED
	bool "tl-expected"
	depends on LINGMO_INSTALL_LIBSTDCPP
	depends on LINGMO_TOOLCHAIN_GCC_AT_LEAST_4_8 # C++11
	help
	  C++11/14/17 std::expected with functional-style extensions and
	  reference support.

	  https://github.com/TartanLlama/expected

comment "tl-expected needs a toolchain w/ C++, gcc >= 4.8"
	depends on !LINGMO_INSTALL_LIBSTDCPP || !LINGMO_TOOLCHAIN_GCC_AT_LEAST_4_8
```

## package/tllist/Config.in
```kconfig
config LINGMO_PACKAGE_TLLIST
	bool "tllist"
	help
	  A C header file only implementation of a typed linked list.

	  https://codeberg.org/dnkl/tllist
```

## package/tmux/Config.in
```kconfig
config LINGMO_PACKAGE_TMUX
	bool "tmux"
	depends on LINGMO_USE_MMU # fork()
	depends on LINGMO_USE_WCHAR # mbtowc()
	depends on LINGMO_ENABLE_LOCALE # runtime
	select LINGMO_PACKAGE_LIBEVENT
	select LINGMO_PACKAGE_NCURSES
	help
	  tmux is a terminal multiplexer, it enables a number of
	  terminals (or windows) to be accessed and controlled from a
	  single terminal.

	  NOTE: tmux needs a working UTF-8 locale (LINGMO_GENERATE_LOCALE)

	  https://tmux.github.io/

comment "tmux needs a toolchain w/ wchar, locale"
	depends on LINGMO_USE_MMU
	depends on !LINGMO_USE_WCHAR || !LINGMO_ENABLE_LOCALE
```

## package/tor/Config.in
```kconfig
config LINGMO_PACKAGE_TOR
	bool "tor"
	depends on LINGMO_USE_MMU # fork()
	depends on LINGMO_TOOLCHAIN_HAS_THREADS_NPTL
	select LINGMO_PACKAGE_LIBEVENT
	select LINGMO_PACKAGE_OPENSSL
	select LINGMO_PACKAGE_ZLIB
	help
	  Tor is free software and an open network that helps you
	  defend against traffic analysis, a form of network
	  surveillance that threatens personal freedom and privacy,
	  confidential business activities and relationships, and
	  state security.

	  https://www.torproject.org

comment "tor needs a toolchain w/ NPTL"
	depends on LINGMO_USE_MMU
	depends on !LINGMO_TOOLCHAIN_HAS_THREADS_NPTL
```

## package/tpm-tools/Config.in
```kconfig
config LINGMO_PACKAGE_TPM_TOOLS
	bool "tpm-tools"
	depends on LINGMO_TOOLCHAIN_HAS_THREADS # trousers
	depends on !LINGMO_STATIC_LIBS # trousers
	select LINGMO_PACKAGE_TROUSERS
	select LINGMO_PACKAGE_OPENSSL
	select LINGMO_PACKAGE_LIBOPENSSL_ENABLE_DES if LINGMO_PACKAGE_LIBOPENSSL
	help
	  Tools to manage and diagnose a TPM

	  http://trousers.sourceforge.net/

comment "tpm-tools needs a toolchain w/ threads, dynamic library"
	depends on !LINGMO_TOOLCHAIN_HAS_THREADS || LINGMO_STATIC_LIBS
```

## package/tpm2-abrmd/Config.in
```kconfig
config LINGMO_PACKAGE_TPM2_ABRMD
	bool "tpm2-abrmd"
	depends on LINGMO_USE_WCHAR # libglib2
	depends on LINGMO_TOOLCHAIN_HAS_THREADS # libglib2
	depends on LINGMO_USE_MMU # libglib2
	depends on !LINGMO_STATIC_LIBS # tpm2-tss
	select LINGMO_PACKAGE_LIBGLIB2
	select LINGMO_PACKAGE_TPM2_TSS
	help
	  A system daemon implementing the TPM2 access broker (TAB) &
	  Resource Manager (RM) spec from the TCG. It should be started
	  during the OS boot process. Communication between the daemon
	  and clients using the TPM is done with a combination of DBus
	  and Unix pipes.

	  The package also provides a client library for interacting
	  with the daemon via TPM Command Transmission Interface (TCTI).
	  It is intended for use with the SAPI library (libtss2-sys)
	  like any other TCTI.

	  https://github.com/tpm2-software/tpm2-abrmd

comment "tpm2-abrmd needs a toolchain w/ dynamic library, wchar, threads"
	depends on LINGMO_USE_MMU
	depends on !LINGMO_USE_WCHAR || !LINGMO_TOOLCHAIN_HAS_THREADS || \
		LINGMO_STATIC_LIBS
```

## package/tpm2-pkcs11/Config.in
```kconfig
config LINGMO_PACKAGE_TPM2_PKCS11
	bool "tpm2-pkcs11"
	depends on !LINGMO_STATIC_LIBS # tpm2-tss
	depends on LINGMO_TOOLCHAIN_HAS_THREADS
	select LINGMO_PACKAGE_LIBYAML
	select LINGMO_PACKAGE_OPENSSL
	select LINGMO_PACKAGE_SQLITE
	select LINGMO_PACKAGE_TPM2_TSS
	help
	  A PKCS#11 interface for TPM2 hardware

	  https://github.com/tpm2-software/tpm2-pkcs11

comment "tpm2-pkcs11 needs a toolchain w/ dynamic library, threads"
	depends on LINGMO_STATIC_LIBS || !LINGMO_TOOLCHAIN_HAS_THREADS
```

## package/tpm2-tools/Config.in
```kconfig
config LINGMO_PACKAGE_TPM2_TOOLS
	bool "tpm2-tools"
	depends on !LINGMO_STATIC_LIBS # tpm2-tss
	depends on LINGMO_USE_WCHAR
	# c16rtomb() not implemented in uClibc
	depends on LINGMO_TOOLCHAIN_USES_GLIBC || LINGMO_TOOLCHAIN_USES_MUSL
	select LINGMO_PACKAGE_LIBCURL
	select LINGMO_PACKAGE_OPENSSL
	select LINGMO_PACKAGE_TPM2_TSS
	help
	  TPM (Trusted Platform Module) 2.0 CLI tools based on system
	  API of TPM2-TSS. These tools can be used to manage keys,
	  perform encryption/decryption/signing/etc crypto operations,
	  and manage non-volatile storage through a TPM2.0 HW
	  implementation.

	  Notice: An in-kernel resource manager is provided by the
	  Linux kernel since 4.12. Depending on use cases and kernel
	  version, the user space resource manager provided by
	  tpm2-abrmd may be needed.

	  https://github.com/tpm2-software/tpm2-tools

if LINGMO_PACKAGE_TPM2_TOOLS

config LINGMO_PACKAGE_TPM2_TOOLS_FAPI
	bool "fapi tools"
	depends on LINGMO_TOOLCHAIN_HAS_SYNC_4
	select LINGMO_PACKAGE_TPM2_TSS_FAPI
	help
	  This option enables Feature API (FAPI) support in
	  tpm2-tools. The FAPI tools are prefixed with tss2_.

endif

comment "tpm2-tools needs a glibc or musl toolchain w/ dynamic library, wchar"
	depends on LINGMO_STATIC_LIBS || !LINGMO_USE_WCHAR || \
		!(LINGMO_TOOLCHAIN_USES_GLIBC || LINGMO_TOOLCHAIN_USES_MUSL)
```

## package/trace-cmd/Config.in
```kconfig
config LINGMO_PACKAGE_TRACE_CMD
	bool "trace-cmd"
	# pthread_setaffinity_np
	depends on LINGMO_TOOLCHAIN_HAS_THREADS_NPTL
	depends on LINGMO_USE_MMU # fork()
	depends on !LINGMO_STATIC_LIBS # dlopen()
	depends on LINGMO_TOOLCHAIN_HAS_THREADS # libtracefs
	select LINGMO_PACKAGE_LIBTRACEEVENT
	select LINGMO_PACKAGE_LIBTRACEFS
	help
	  Command line reader for ftrace.

	  To use this profiling tool, you should enable ftrace in your
	  kernel configuration. This command collect traces on your
	  target.  You can analyse these traces on the target or on
	  the host via the gui "kernel shark"

	  http://git.kernel.org/cgit/linux/kernel/git/rostedt/trace-cmd.git

comment "trace-cmd needs a toolchain w/ threads, NPTL, dynamic library"
	depends on LINGMO_USE_MMU
	depends on !LINGMO_TOOLCHAIN_HAS_THREADS || \
		!LINGMO_TOOLCHAIN_HAS_THREADS_NPTL || LINGMO_STATIC_LIBS
```

## package/transmission/Config.in
```kconfig
config LINGMO_PACKAGE_TRANSMISSION
	bool "transmission"
	depends on !LINGMO_BINFMT_FLAT # libnatpmp
	depends on LINGMO_INSTALL_LIBSTDCPP # libutp
	depends on !LINGMO_STATIC_LIBS # libnatpmp
	depends on LINGMO_TOOLCHAIN_GCC_AT_LEAST_7 # C++17
	depends on LINGMO_TOOLCHAIN_HAS_THREADS
	depends on LINGMO_USE_MMU # fork()
	depends on LINGMO_USE_WCHAR # libpsl
	select LINGMO_PACKAGE_DHT
	select LINGMO_PACKAGE_LIBB64
	select LINGMO_PACKAGE_LIBCURL
	select LINGMO_PACKAGE_LIBDEFLATE
	select LINGMO_PACKAGE_LIBEVENT
	select LINGMO_PACKAGE_LIBMINIUPNPC
	select LINGMO_PACKAGE_LIBNATPMP
	select LINGMO_PACKAGE_LIBPSL
	select LINGMO_PACKAGE_LIBUTP
	select LINGMO_PACKAGE_OPENSSL
	select LINGMO_PACKAGE_ZLIB
	help
	  Transmission is a cross-platform BitTorrent client.

	  http://www.transmissionbt.com/

if LINGMO_PACKAGE_TRANSMISSION

config LINGMO_PACKAGE_TRANSMISSION_CLI
	bool "transmission-cli"
	help
	  Install transmission command line interface.

config LINGMO_PACKAGE_TRANSMISSION_DAEMON
	bool "transmission-daemon"
	help
	  Install transmission daemon.

config LINGMO_PACKAGE_TRANSMISSION_GTK
	bool "transmission-gtk"
	depends on !LINGMO_nios2 # gtkmm3
	depends on LINGMO_TOOLCHAIN_HAS_SYNC_4 # pangomm, libgtk3 -> pango -> harfbuzz -> gtkmm3
	depends on LINGMO_PACKAGE_LIBGTK3 && LINGMO_SYSTEM_ENABLE_NLS
	select LINGMO_PACKAGE_GTKMM3
	help
	  Install transmission GTK-based GUI interface.

comment "transmission-gtk needs libgtk3 and a toolchain with NLS enabled"
	depends on !LINGMO_nios2
	depends on LINGMO_TOOLCHAIN_HAS_SYNC_4
	depends on LINGMO_PACKAGE_LIBGTK3 && !LINGMO_SYSTEM_ENABLE_NLS
endif

comment "transmission needs a toolchain w/ dynamic library, threads, C++, gcc >= 7"
	depends on LINGMO_USE_MMU
	depends on !LINGMO_BINFMT_FLAT
	depends on !LINGMO_TOOLCHAIN_HAS_THREADS || !LINGMO_INSTALL_LIBSTDCPP || \
		!LINGMO_TOOLCHAIN_GCC_AT_LEAST_7 || LINGMO_STATIC_LIBS
```

## package/trinity/Config.in
```kconfig
config LINGMO_PACKAGE_TRINITY_ARCH_SUPPORTS
	bool
	default y
	depends on LINGMO_USE_MMU # fork()
	depends on LINGMO_TOOLCHAIN_HAS_SYNC_4 # __sync_val_compare_and_swap_4
	depends on LINGMO_aarch64 || LINGMO_arm || LINGMO_armeb || LINGMO_i386 || \
		LINGMO_mips || LINGMO_mipsel || LINGMO_powerpc || LINGMO_powerpc64 || \
		LINGMO_powerpc64le || LINGMO_sparc || LINGMO_x86_64

config LINGMO_PACKAGE_TRINITY
	bool "trinity"
	depends on LINGMO_PACKAGE_TRINITY_ARCH_SUPPORTS
	depends on LINGMO_TOOLCHAIN_HEADERS_AT_LEAST_3_4 # IPV6_UNICAST_IF
	help
	  A Linux System call fuzz tester

	  http://codemonkey.org.uk/projects/trinity/

comment "trinity needs a toolchain w/ headers >= 3.4"
	depends on LINGMO_PACKAGE_TRINITY_ARCH_SUPPORTS
	depends on !LINGMO_TOOLCHAIN_HEADERS_AT_LEAST_3_4
```

## package/trousers/Config.in
```kconfig
config LINGMO_PACKAGE_TROUSERS
	bool "trousers"
	depends on LINGMO_TOOLCHAIN_HAS_THREADS
	# doesn't build properly in static only configurations
	depends on !LINGMO_STATIC_LIBS
	select LINGMO_PACKAGE_OPENSSL
	select LINGMO_PACKAGE_LIBICONV if !LINGMO_ENABLE_LOCALE
	help
	  The open-source TCG Software Stack (TSS).

	  This library enables the use of a Trusted Platform Module
	  that complies with the TPM specification, version 1.2. It
	  implements the TSS specification, version 1.2.

	  http://trousers.sourceforge.net/

comment "trousers needs a toolchain w/ threads, dynamic library"
	depends on !LINGMO_TOOLCHAIN_HAS_THREADS || LINGMO_STATIC_LIBS
```

## package/tslib/Config.in
```kconfig
config LINGMO_PACKAGE_TSLIB
	bool "tslib"
	help
	  Tslib is a filtering layer for touchscreen panel events.

	  http://tslib.org
```

## package/ttyd/Config.in
```kconfig
config LINGMO_PACKAGE_TTYD
	bool "ttyd"
	depends on !LINGMO_STATIC_LIBS # libuv, libwebsockets
	depends on LINGMO_TOOLCHAIN_HAS_THREADS_NPTL # libuv
	depends on LINGMO_TOOLCHAIN_HAS_SYNC_4 # libuv, json-c
	depends on LINGMO_USE_MMU # libuv
	depends on LINGMO_TOOLCHAIN_GCC_AT_LEAST_4_9 # libuv
	select LINGMO_PACKAGE_JSON_C
	select LINGMO_PACKAGE_LIBUV
	select LINGMO_PACKAGE_LIBWEBSOCKETS
	select LINGMO_PACKAGE_OPENSSL
	select LINGMO_PACKAGE_ZLIB
	help
	  ttyd is a simple command-line tool for sharing terminal
	  over the web.

	  https://github.com/tsl0922/ttyd

comment "ttyd needs a toolchain w/ NPTL, dynamic library, gcc >= 4.9"
	depends on !LINGMO_TOOLCHAIN_HAS_THREADS_NPTL || LINGMO_STATIC_LIBS \
		|| !LINGMO_TOOLCHAIN_GCC_AT_LEAST_4_9
	depends on LINGMO_USE_MMU
	depends on LINGMO_TOOLCHAIN_HAS_SYNC_4
```

## package/tvheadend/Config.in
```kconfig
comment "tvheadend needs a toolchain w/ NPTL, headers >= 3.2, dynamic library"
	depends on !LINGMO_TOOLCHAIN_HAS_THREADS_NPTL || \
		!LINGMO_TOOLCHAIN_HEADERS_AT_LEAST_3_2 || LINGMO_STATIC_LIBS
	depends on LINGMO_TOOLCHAIN_HAS_SYNC_8

menuconfig LINGMO_PACKAGE_TVHEADEND
	bool "tvheadend"
	depends on !LINGMO_STATIC_LIBS # dladdr()
	depends on LINGMO_TOOLCHAIN_HAS_THREADS_NPTL
	depends on LINGMO_TOOLCHAIN_HEADERS_AT_LEAST_3_2
	depends on LINGMO_TOOLCHAIN_HAS_SYNC_8
	select LINGMO_PACKAGE_DTV_SCAN_TABLES
	select LINGMO_PACKAGE_LIBICONV if !LINGMO_ENABLE_LOCALE
	select LINGMO_PACKAGE_OPENSSL
	select LINGMO_PACKAGE_LIBOPENSSL_ENABLE_DES if LINGMO_PACKAGE_LIBOPENSSL
	help

	  Tvheadend is a TV streaming server for Linux supporting
	  DVB-S, DVB-S2, DVB-C, DVB-T, ATSC, IPTV, and Analog video
	  (V4L) as input sources.

	  https://www.lonelycoder.com/redmine/projects/tvheadend/

	  Note:
	    - on first run, tvheadend will start in wizard mode; the
	      webUI is available on port 9981.
	    - if you want Avahi support, you'll need to enable:
	          Avahi, D-Bus, libdaemon

if LINGMO_PACKAGE_TVHEADEND

config LINGMO_PACKAGE_TVHEADEND_DESCRAMBLER
	bool "descrambler support"
	default y
	help
	  Enable support for various descrambler modules.

config LINGMO_PACKAGE_TVHEADEND_IPTV
	bool "IPTV support"
	default y
	help
	  Enable IPTV support.

	  Note that some IPTV streams will need to be piped through
	  ffmpeg (the commandline tool), so you may have to enable it
	  with:
	    LINGMO_PACKAGE_FFMPEG=y
	    LINGMO_PACKAGE_FFMPEG_FFMPEG=y

config LINGMO_PACKAGE_TVHEADEND_SATIP
	bool "SAT>IP support"
	default y
	help
	  Enable SAT>IP support.

config LINGMO_PACKAGE_TVHEADEND_TIMESHIFT
	bool "timeshift support"
	default y
	help
	  Enable timeshift support.

config LINGMO_PACKAGE_TVHEADEND_TRANSCODING
	bool "transcoding support"
	depends on LINGMO_PACKAGE_FFMPEG_ARCH_SUPPORTS
	select LINGMO_PACKAGE_FFMPEG
	select LINGMO_PACKAGE_FFMPEG_GPL # needed for x264 support
	select LINGMO_PACKAGE_FFMPEG_SWSCALE
	# vp8 encoder needs c++
	select LINGMO_PACKAGE_LIBVPX if LINGMO_INSTALL_LIBSTDCPP
	select LINGMO_PACKAGE_X264
	help
	  Enable transcoding support.

endif
```

## package/tzdata/Config.in
```kconfig
# This package is not meant to be user-visible.
# It gets selected by LINGMO_TARGET_TZ in system/Config.in

config LINGMO_PACKAGE_TZDATA
	bool
	help
	  Time zone database

	  https://data.iana.org/time-zones/tz-link.html
```

## package/uacme/Config.in
```kconfig
config LINGMO_PACKAGE_UACME
	bool "uacme"
	depends on LINGMO_USE_MMU # fork()
	select LINGMO_PACKAGE_OPENSSL if !(LINGMO_PACKAGE_GNUTLS || LINGMO_PACKAGE_MBEDTLS)
	select LINGMO_PACKAGE_LIBCURL
	select LINGMO_PACKAGE_LIBCURL_FORCE_TLS
	help
	  uacme is a client for the ACMEv2 protocol described in
	  RFC8555, written in plain C with minimal dependencies
	  (libcurl and either of GnuTLS, OpenSSL or mbedTLS). The
	  ACMEv2 protocol allows a Certificate Authority
	  (https://letsencrypt.org is a popular one) and an applicant
	  to automate the process of verification and certificate
	  issuance.

	  https://github.com/ndilieto/uacme

if LINGMO_PACKAGE_UACME

config LINGMO_PACKAGE_UACME_UALPN
	bool "enable ualpn"
	depends on LINGMO_TOOLCHAIN_HAS_THREADS
	select LINGMO_PACKAGE_LIBEV
	select LINGMO_PACKAGE_OPENSSL_FORCE_LIBOPENSSL \
		if !(LINGMO_PACKAGE_GNUTLS || LINGMO_PACKAGE_MBEDTLS)
	help
	  Build and install ualpn, the transparent proxying tls-alpn-01
	  challenge responder.

comment "ualpn needs a toolchain w/ threads"
	depends on !LINGMO_TOOLCHAIN_HAS_THREADS

endif
```

## package/ubus/Config.in
```kconfig
comment "ubus needs a toolchain w/ dynamic library"
	depends on LINGMO_TOOLCHAIN_HAS_SYNC_4
	depends on LINGMO_STATIC_LIBS

config LINGMO_PACKAGE_UBUS
	bool "ubus"
	depends on LINGMO_TOOLCHAIN_HAS_SYNC_4 # json-c
	depends on !LINGMO_STATIC_LIBS # libubox
	select LINGMO_PACKAGE_LIBUBOX
	select LINGMO_PACKAGE_JSON_C
	help
	  IPC/RPC bus that allows communication between processes.

	  It consists of few parts including a daemon (ubusd), a
	  library (libubus) and a command line interface
	  (ubus). Although created for the OpenWRT project, it can be
	  used as a general IPC/RPC mechanism in other projects.

	  * Select LINGMO_PACKAGE_LUA_5_1 if you want to have Lua
	    support.

	  https://openwrt.org/docs/techref/ubus

if LINGMO_PACKAGE_UBUS

config LINGMO_PACKAGE_UBUS_EXAMPLES
	bool "build and install ubus examples"
	help
	  Build and install client and server ubus examples.

endif
```
