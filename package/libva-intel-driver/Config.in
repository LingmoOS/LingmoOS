## package/lighttpd/Config.in
```kconfig
comment "lighttpd needs a toolchain w/ dynamic library"
	depends on LINGMO_USE_MMU
	depends on LINGMO_STATIC_LIBS

config LINGMO_PACKAGE_LIGHTTPD
	bool "lighttpd"
	depends on LINGMO_USE_MMU # fork()
	depends on !LINGMO_STATIC_LIBS
	select LINGMO_PACKAGE_XXHASH
	help
	  lighttpd a secure, fast, compliant and very flexible
	  web-server which has been optimized for high-performance
	  environments. It has a very low memory footprint compared to
	  other webservers and takes care of cpu-load. Its advanced
	  feature-set (FastCGI, CGI, Auth, Output-Compression,
	  URL-Rewriting and many more) make lighttpd the perfect
	  webserver-software for every server that is suffering load
	  problems.

	  https://www.lighttpd.net/

if LINGMO_PACKAGE_LIGHTTPD

config LINGMO_PACKAGE_LIGHTTPD_BROTLI
	bool "brotli support"
	select LINGMO_PACKAGE_BROTLI
	help
	  Enable brotli support for lighttpd mod_deflate.

config LINGMO_PACKAGE_LIGHTTPD_BZIP2
	bool "bzip2 support"
	select LINGMO_PACKAGE_BZIP2
	help
	  Enable bzip2 support for lighttpd mod_deflate.

config LINGMO_PACKAGE_LIGHTTPD_KRB5
	bool "krb5 support"
	select LINGMO_PACKAGE_LIBKRB5
	help
	  Enable Kerberos5 support for lighttpd mod_auth.

config LINGMO_PACKAGE_LIGHTTPD_LDAP
	bool "ldap support"
	depends on LINGMO_USE_WCHAR # openldap
	select LINGMO_PACKAGE_OPENLDAP
	help
	  Enable LDAP support for lighttpd mod_auth mod_vhostdb_ldap.

comment "ldap support needs a toolchain w/ wchar"
	depends on !LINGMO_USE_WCHAR

config LINGMO_PACKAGE_LIGHTTPD_LUA
	bool "lua support"
	depends on LINGMO_PACKAGE_LUA
	help
	  Enable Lua support. Needed to support mod_magnet

config LINGMO_PACKAGE_LIGHTTPD_MAXMINDDB
	bool "maxminddb support"
	select LINGMO_PACKAGE_LIBMAXMINDDB
	help
	  Enable MaxMind GeoIP2 support. Needed to support mod_maxminddb

config LINGMO_PACKAGE_LIGHTTPD_MYSQL
	bool "mysql support"
	depends on LINGMO_PACKAGE_MARIADB
	help
	  Enable mysql support for lighttpd mod_vhostdb_mysql.

comment "mysql support needs mariadb"
	depends on !LINGMO_PACKAGE_MARIADB

config LINGMO_PACKAGE_LIGHTTPD_OPENSSL
	bool "openssl support"
	select LINGMO_PACKAGE_OPENSSL
	help
	  Enable OpenSSL support for lighttpd.

config LINGMO_PACKAGE_LIGHTTPD_PAM
	bool "pam authentication support"
	default y
	depends on LINGMO_PACKAGE_LINUX_PAM
	help
	  Enable PAM authentication support for lighttpd.

config LINGMO_PACKAGE_LIGHTTPD_PCRE
	bool "pcre support"
	select LINGMO_PACKAGE_PCRE2
	help
	  Enable PCRE support. Needed to support mod_rewrite

config LINGMO_PACKAGE_LIGHTTPD_PGSQL
	bool "pgsql support"
	depends on LINGMO_USE_MMU # postgresql
	depends on LINGMO_USE_WCHAR # postgresql
	depends on !LINGMO_OPTIMIZE_FAST # postgresql
	select LINGMO_PACKAGE_POSTGRESQL
	help
	  Enable postgres support for lighttpd mod_vhostdb_pgsql.

comment "pgsql support needs a toolchain w/ wchar"
	depends on LINGMO_USE_MMU
	depends on !LINGMO_USE_WCHAR

comment "pgsql support can't be built with Optimize for fast"
	depends on LINGMO_OPTIMIZE_FAST

config LINGMO_PACKAGE_LIGHTTPD_WEBDAV
	bool "webdav support"
	select LINGMO_PACKAGE_LIBXML2
	select LINGMO_PACKAGE_SQLITE
	help
	  Enable webdav support. Needed to support mod_webdav

config LINGMO_PACKAGE_LIGHTTPD_ZLIB
	bool "zlib support"
	select LINGMO_PACKAGE_ZLIB
	help
	  Enable zlib support for lighttpd mod_deflate.

config LINGMO_PACKAGE_LIGHTTPD_ZSTD
	bool "zstd support"
	select LINGMO_PACKAGE_ZSTD
	help
	  Enable zstd support for lighttpd mod_deflate.

endif
```

## package/lilv/Config.in
```kconfig
config LINGMO_PACKAGE_LILV
	bool "lilv"
	depends on !LINGMO_STATIC_LIBS
	select LINGMO_PACKAGE_LV2
	select LINGMO_PACKAGE_SERD
	select LINGMO_PACKAGE_SORD
	select LINGMO_PACKAGE_SRATOM
	help
	  Lilv is a C library to make the use of LV2 plugins as simple
	  as possible for applications.

	  https://drobilla.net/software/lilv.html

comment "lilv needs a toolchain w/ dynamic library"
	depends on LINGMO_STATIC_LIBS
```

## package/linenoise/Config.in
```kconfig
config LINGMO_PACKAGE_LINENOISE
	bool "linenoise"
	help
	  A small self-contained alternative to readline and libedit

	  https://github.com/antirez/linenoise
```

## package/linknx/Config.in
```kconfig
config LINGMO_PACKAGE_LINKNX
	bool "linknx"
	depends on LINGMO_INSTALL_LIBSTDCPP
	depends on LINGMO_USE_MMU # libpthsem
	select LINGMO_PACKAGE_LIBPTHSEM
	select LINGMO_PACKAGE_ARGP_STANDALONE \
	       if LINGMO_TOOLCHAIN_USES_UCLIBC || LINGMO_TOOLCHAIN_USES_MUSL
	select LINGMO_PACKAGE_LIBICONV if !LINGMO_ENABLE_LOCALE
	help
	  Linknx is an automation platform providing high level
	  functionalities to EIB/KNX installation.

	  http://linknx.sourceforge.net/
	  https://github.com/linknx/linknx

comment "linknx needs a toolchain w/ C++"
	depends on LINGMO_USE_MMU
	depends on !LINGMO_INSTALL_LIBSTDCPP
```

## package/links/Config.in
```kconfig
config LINGMO_PACKAGE_LINKS
	bool "links"
	depends on LINGMO_USE_MMU # fork()
	help
	  Graphics and text mode WWW browser (kind of like lynx).

	  http://links.twibright.com/

if LINGMO_PACKAGE_LINKS

config LINGMO_PACKAGE_LINKS_GRAPHICS
	bool "use graphics"
	depends on LINGMO_PACKAGE_GPM || LINGMO_PACKAGE_DIRECTFB || LINGMO_PACKAGE_XORG7
	select LINGMO_PACKAGE_XLIB_LIBXT if LINGMO_PACKAGE_XORG7
	select LINGMO_PACKAGE_LIBPNG
	help
	  Enable graphics output for framebuffer, DirectFB or X11.
	  Framebuffer output requires GPM (console mouse).
	  Otherwise links will be text-mode only.

comment "links graphics needs GPM, DirectFB or X11"
	depends on !LINGMO_PACKAGE_GPM && !LINGMO_PACKAGE_DIRECTFB && !LINGMO_PACKAGE_XORG7

endif
```

## package/linphone/Config.in
```kconfig
config LINGMO_PACKAGE_LINPHONE
	bool "linphone"
	depends on LINGMO_USE_MMU
	depends on LINGMO_INSTALL_LIBSTDCPP
	depends on !LINGMO_STATIC_LIBS # belle-sip, mediastreamer
	depends on LINGMO_TOOLCHAIN_HAS_THREADS # belr, belle-sip, mediastreamer
	# belr, belle-sip, mediastreamer
	depends on !LINGMO_TOOLCHAIN_HAS_GCC_BUG_64735
	depends on LINGMO_USE_WCHAR # belle-sip
	depends on LINGMO_TOOLCHAIN_GCC_AT_LEAST_5 # mediastreamer
	select LINGMO_PACKAGE_BELLE_SIP
	select LINGMO_PACKAGE_BELR
	select LINGMO_PACKAGE_LIBXML2
	select LINGMO_PACKAGE_MEDIASTREAMER
	select LINGMO_PACKAGE_SQLITE
	help
	  Linphone is an internet phone or Voice Over IP phone (VoIP).

	  With linphone you can communicate freely with people over
	  the internet, with voice, video, and text instant messaging.
	  Linphone makes use of the SIP protocol, an open standard
	  for internet telephony. You can use Linphone with any SIP
	  VoIP operator, including our free SIP audio/video service.
	  linphone is free-software (or open-source), you can download
	  and redistribute it freely.
	  Linphone is available for desktop computers: Linux, Windows,
	  MacOSX, and for mobile phones: Android, iPhone, Blackberry.

	  Linphone support in Buildroot is limited to the commandline
	  client, linphonec, and video support is not enabled.

	  http://www.linphone.org/

comment "linphone needs a toolchain w/ threads, C++, dynamic library, wchar, gcc >= 5"
	depends on LINGMO_USE_MMU
	depends on !LINGMO_INSTALL_LIBSTDCPP || LINGMO_STATIC_LIBS || \
		!LINGMO_TOOLCHAIN_HAS_THREADS || !LINGMO_USE_WCHAR || \
		!LINGMO_TOOLCHAIN_GCC_AT_LEAST_5

comment "linphone needs a toolchain not affected by GCC bug 64735"
	depends on LINGMO_TOOLCHAIN_HAS_GCC_BUG_64735
```

## package/linux-fusion/Config.in
```kconfig
comment "linux-fusion needs a Linux kernel to be built"
	depends on !LINGMO_LINUX_KERNEL

config LINGMO_PACKAGE_LINUX_FUSION
	bool "linux-fusion communication layer for DirectFB multi"
	depends on LINGMO_LINUX_KERNEL
	select LINGMO_LINUX_NEEDS_MODULES # not using kernel-module infra
	help
	  DirectFB Communication Layer allowing multiple DirectFB
	  applications to run concurrently

	  https://github.com/deniskropp/linux-fusion
```
