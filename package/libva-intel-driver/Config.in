## package/libva-intel-driver/Config.in
```kconfig
config LINGMO_PACKAGE_LIBVA_INTEL_DRIVER
	bool "libva-intel-driver"
	depends on LINGMO_i386 || LINGMO_x86_64
	depends on LINGMO_TOOLCHAIN_HAS_THREADS # libdrm/libpthread-stubs
	depends on !LINGMO_STATIC_LIBS # libva
	select LINGMO_PACKAGE_LIBVA
	select LINGMO_PACKAGE_LIBDRM
	select LINGMO_PACKAGE_LIBDRM_INTEL
	select LINGMO_PACKAGE_XLIB_LIBX11 if LINGMO_PACKAGE_XORG7
	select LINGMO_PACKAGE_XLIB_LIBXEXT if LINGMO_PACKAGE_XORG7
	select LINGMO_PACKAGE_XLIB_LIBXFIXES if LINGMO_PACKAGE_XORG7
	help
	  VA-API back-end driver for Intel graphics chips

	  https://01.org/vaapi

comment "libva intel driver needs a toolchain w/ threads, dynamic library"
	depends on !LINGMO_TOOLCHAIN_HAS_THREADS || LINGMO_STATIC_LIBS
	depends on LINGMO_i386 || LINGMO_x86_64
```

## package/libva-utils/Config.in
```kconfig
config LINGMO_PACKAGE_LIBVA_UTILS
	bool "libva-utils"
	depends on LINGMO_INSTALL_LIBSTDCPP
	depends on !LINGMO_STATIC_LIBS # libva
	depends on LINGMO_TOOLCHAIN_HAS_THREADS # libva
	select LINGMO_PACKAGE_LIBVA
	help
	  Libva-utils is a collection of tests for VA-API (Video
	  Acceleration API)

	  https://01.org/vaapi

comment "libva-utils needs a toolchain w/ C++, threads, dynamic library"
	depends on !LINGMO_INSTALL_LIBSTDCPP || \
		LINGMO_STATIC_LIBS || !LINGMO_TOOLCHAIN_HAS_THREADS
```

## package/libva/Config.in
```kconfig
config LINGMO_PACKAGE_LIBVA
	bool "libva"
	depends on LINGMO_TOOLCHAIN_HAS_THREADS # libdrm/libpthread-stubs
	depends on !LINGMO_STATIC_LIBS
	select LINGMO_PACKAGE_LIBDRM
	select LINGMO_PACKAGE_XLIB_LIBX11 if LINGMO_PACKAGE_XORG7
	select LINGMO_PACKAGE_XLIB_LIBXEXT if LINGMO_PACKAGE_XORG7
	select LINGMO_PACKAGE_XLIB_LIBXFIXES if LINGMO_PACKAGE_XORG7
	help
	  The main motivation for VA-API (Video Acceleration API) is to
	  enable hardware accelerated video decode/encode at various
	  entry-points (VLD, IDCT, Motion Compensation etc.) for the
	  prevailing coding standards today (MPEG-2, MPEG-4 ASP/H.263,
	  MPEG-4 AVC/H.264, and VC-1/VMW3).

	  https://01.org/vaapi

comment "libva needs a toolchain w/ threads, dynamic library"
	depends on !LINGMO_TOOLCHAIN_HAS_THREADS || LINGMO_STATIC_LIBS
```

## package/libvdpau/Config.in
```kconfig
config LINGMO_PACKAGE_LIBVDPAU
	bool "libvdpau"
	depends on LINGMO_TOOLCHAIN_HAS_THREADS
	depends on LINGMO_INSTALL_LIBSTDCPP
	depends on LINGMO_PACKAGE_XORG7
	select LINGMO_PACKAGE_XLIB_LIBX11
	select LINGMO_PACKAGE_XLIB_LIBXEXT
	help
	  VDPAU is the Video Decode and Presentation API for UNIX.
	  It provides an interface to video decode acceleration and
	  presentation hardware present in modern GPUs.

	  http://freedesktop.org/wiki/Software/VDPAU

comment "libvdpau needs a toolchain w/ threads, C++"
	depends on LINGMO_PACKAGE_XORG7
	depends on !LINGMO_TOOLCHAIN_HAS_THREADS || !LINGMO_INSTALL_LIBSTDCPP
```

## package/libvips/Config.in
```kconfig
config LINGMO_PACKAGE_LIBVIPS
	bool "libvips"
	depends on LINGMO_USE_WCHAR # libglib2
	depends on LINGMO_TOOLCHAIN_HAS_THREADS # libglib2
	depends on LINGMO_USE_MMU # fork()
	# C++ support is required to build libvips
	# https://github.com/jcupitt/libvips/issues/231
	depends on LINGMO_INSTALL_LIBSTDCPP
	select LINGMO_PACKAGE_EXPAT
	select LINGMO_PACKAGE_LIBGLIB2
	help
	  libvips is a 2D image processing library. Compared to
	  similar libraries, libvips runs quickly and uses little
	  memory.

	  http://www.vips.ecs.soton.ac.uk/

comment "libvips needs a toolchain w/ wchar, threads, C++"
	depends on LINGMO_USE_MMU
	depends on !LINGMO_USE_WCHAR || !LINGMO_TOOLCHAIN_HAS_THREADS || \
		!LINGMO_INSTALL_LIBSTDCPP
```

## package/libvirt/Config.in
```kconfig
config LINGMO_PACKAGE_LIBVIRT_ARCH_SUPPORTS
	bool
	default y if LINGMO_aarch64
	default y if LINGMO_i386
	default y if LINGMO_x86_64
	depends on LINGMO_USE_MMU # fork()

comment "libvirt needs udev /dev management, a toolchain w/ threads, dynamic library, wchar, kernel headers >= 3.12 (4.11 for AArch64)"
	depends on LINGMO_PACKAGE_LIBVIRT_ARCH_SUPPORTS
	depends on !LINGMO_PACKAGE_HAS_UDEV || LINGMO_STATIC_LIBS || \
		!LINGMO_TOOLCHAIN_HAS_THREADS || !LINGMO_USE_WCHAR || \
		!(LINGMO_TOOLCHAIN_HEADERS_AT_LEAST_3_12 && \
			(LINGMO_TOOLCHAIN_HEADERS_AT_LEAST_4_11 || !LINGMO_aarch64))

config LINGMO_PACKAGE_LIBVIRT
	bool "libvirt"
	depends on LINGMO_PACKAGE_LIBVIRT_ARCH_SUPPORTS
	depends on LINGMO_TOOLCHAIN_HEADERS_AT_LEAST_3_12
	depends on LINGMO_TOOLCHAIN_HEADERS_AT_LEAST_4_11 || !LINGMO_aarch64
	depends on LINGMO_PACKAGE_HAS_UDEV
	depends on !LINGMO_STATIC_LIBS
	depends on LINGMO_TOOLCHAIN_HAS_THREADS
	depends on LINGMO_USE_WCHAR
	select LINGMO_PACKAGE_GNUTLS
	# configure: You must install the pciaccess module to build with udev
	select LINGMO_PACKAGE_LIBPCIACCESS
	select LINGMO_PACKAGE_LIBGLIB2
	select LINGMO_PACKAGE_LIBTIRPC
	select LINGMO_PACKAGE_LIBXML2
	select LINGMO_PACKAGE_ZLIB
	# run-time dependencies
	select LINGMO_PACKAGE_CGROUPFS_MOUNT if !LINGMO_INIT_SYSTEMD
	help
	  Libvirt is collection of software that provides a convenient
	  way to manage virtual machines and other virtualization
	  functionality, such as storage and network interface
	  management. These software pieces include an API library, a
	  daemon (libvirtd), and a command line utility (virsh).

	  https://libvirt.org/

if LINGMO_PACKAGE_LIBVIRT

config LINGMO_PACKAGE_LIBVIRT_DAEMON
	bool "libvirtd"
	default y
	depends on LINGMO_INSTALL_LIBSTDCPP # nmap
	select LINGMO_PACKAGE_BUSYBOX_SHOW_OTHERS
	select LINGMO_PACKAGE_DNSMASQ
	select LINGMO_PACKAGE_EBTABLES
	select LINGMO_PACKAGE_IPTABLES
	select LINGMO_PACKAGE_IPROUTE2
	# These are required because there is no way to unequivocally select a modern netcat
	select LINGMO_PACKAGE_NMAP      if !LINGMO_PACKAGE_NETCAT_OPENBSD
	select LINGMO_PACKAGE_NMAP_NCAT if !LINGMO_PACKAGE_NETCAT_OPENBSD
	select LINGMO_PACKAGE_RADVD
	help
	  Build the libvirt daemon (libvirtd) otherwise build only the
	  utility programs.

comment "libvirtd needs a toolchain w/ C++"
	depends on !LINGMO_INSTALL_LIBSTDCPP

# Stateful drivers are useful only when building the daemon.
if LINGMO_PACKAGE_LIBVIRT_DAEMON

config LINGMO_PACKAGE_LIBVIRT_QEMU
	bool "qemu"
	depends on LINGMO_PACKAGE_LIBSECCOMP_ARCH_SUPPORTS # libseccomp
	depends on LINGMO_PACKAGE_QEMU_ARCH_SUPPORTS_TARGET
	depends on LINGMO_TOOLCHAIN_GCC_AT_LEAST_8 # qemu
	select LINGMO_PACKAGE_HWDATA         # libpciaccess
	select LINGMO_PACKAGE_HWDATA_PCI_IDS # libpciaccess
	select LINGMO_PACKAGE_LIBSECCOMP
	select LINGMO_PACKAGE_QEMU
	select LINGMO_PACKAGE_QEMU_SYSTEM
	select LINGMO_PACKAGE_YAJL
	help
	  QEMU/KVM support

comment "qemu needs a toolchain with gcc >= 8"
	depends on LINGMO_PACKAGE_LIBSECCOMP_ARCH_SUPPORTS
	depends on LINGMO_PACKAGE_QEMU_ARCH_SUPPORTS_TARGET
	depends on !LINGMO_TOOLCHAIN_GCC_AT_LEAST_8

config LINGMO_PACKAGE_LIBVIRT_LXC
	bool "lxc"
	depends on LINGMO_TOOLCHAIN_GCC_AT_LEAST_4_7 # lxc
	select LINGMO_PACKAGE_LXC
	help
	  Linux Container support

comment "lxc needs a toolchain w/ gcc >= 4.7"
	depends on !LINGMO_TOOLCHAIN_GCC_AT_LEAST_4_7

endif

endif
```

## package/libvncserver/Config.in
```kconfig
config LINGMO_PACKAGE_LIBVNCSERVER
	bool "libvncserver"
	depends on LINGMO_USE_MMU # VNCommand.c uses fork()
	# binutils issue (bad expression)
	depends on !LINGMO_nios2
	depends on !LINGMO_STATIC_LIBS
	select LINGMO_PACKAGE_LZO
	select LINGMO_PACKAGE_LIBOPENSSL_ENABLE_DES if LINGMO_PACKAGE_LIBOPENSSL
	help
	  libvncserver is a VNC server/client library.

	  https://libvnc.github.io/

if LINGMO_PACKAGE_LIBVNCSERVER

config LINGMO_PACKAGE_LIBVNCSERVER_TIGHTPNG
	bool "TightPNG encoding support"
	select LINGMO_PACKAGE_JPEG
	select LINGMO_PACKAGE_LIBPNG
	help
	  TightPNG encoding speeds up HTML5 based VNC clients like
	  noVNC.

	  http://wiki.qemu.org/VNC_Tight_PNG

endif

comment "libvncserver needs a toolchain w/ dynamic library"
	depends on LINGMO_USE_MMU
	depends on !LINGMO_nios2
	depends on LINGMO_STATIC_LIBS
```

## package/libvpl/Config.in
```kconfig
config LINGMO_PACKAGE_LIBVPL_ARCH_SUPPORTS
	bool
	default y if LINGMO_ARCH_IS_64
	default y if LINGMO_arm

config LINGMO_PACKAGE_LIBVPL
	bool "libvpl"
	depends on LINGMO_PACKAGE_LIBVPL_ARCH_SUPPORTS
	depends on LINGMO_INSTALL_LIBSTDCPP
	depends on !LINGMO_STATIC_LIBS # dlfcn.h
	depends on LINGMO_TOOLCHAIN_GCC_AT_LEAST_7
	depends on LINGMO_TOOLCHAIN_HAS_THREADS
	select LINGMO_PACKAGE_WAYLAND_PROTOCOLS if LINGMO_PACKAGE_WAYLAND
	# libva support needs a libdrm with intel driver
	select LINGMO_PACKAGE_LIBDRM_INTEL if LINGMO_PACKAGE_LIBVA && \
		(LINGMO_i386 || LINGMO_x86_64) && \
		LINGMO_PACKAGE_LIBDRM_HAS_ATOMIC
	select LINGMO_PACKAGE_LIBXCB if LINGMO_PACKAGE_XORG7
	select LINGMO_PACKAGE_XLIB_LIBX11 if LINGMO_PACKAGE_XORG7
	help
	  oneAPI Video Processing Library (oneVPL) dispatcher,
	  tools, and examples

	  https://github.com/oneapi-src/oneVPL

comment "libvpl needs a toolchain w/ dynamic library, gcc >= 7, C++, threads"
	depends on LINGMO_PACKAGE_LIBVPL_ARCH_SUPPORTS
	depends on LINGMO_STATIC_LIBS || !LINGMO_TOOLCHAIN_GCC_AT_LEAST_7 || \
		!LINGMO_INSTALL_LIBSTDCPP || !LINGMO_TOOLCHAIN_HAS_THREADS
```

## package/libvpx/Config.in
```kconfig
config LINGMO_PACKAGE_LIBVPX
	bool "libvpx"
	depends on LINGMO_TOOLCHAIN_HAS_THREADS
	help
	  A high-quality, open video format that's freely available to
	  everyone. Supports the VP8 and VP9 formats.

	  http://webmproject.org

comment "libvpx needs a toolchain w/ threads"
	depends on !LINGMO_TOOLCHAIN_HAS_THREADS
```

## package/libwebsock/Config.in
```kconfig
config LINGMO_PACKAGE_LIBWEBSOCK
	bool "libwebsock"
	depends on LINGMO_TOOLCHAIN_HAS_THREADS
	select LINGMO_PACKAGE_LIBEVENT
	help
	  C library for easy WebSockets servers.

	  This library allows a developer to quickly develop WebSocket
	  servers by focusing on the actual logic of your WebSocket
	  implementation instead of the details of the WebSocket
	  protocol or even specifics of C sockets.

	  https://github.com/payden/libwebsock

comment "libwebsock needs a toolchain w/ threads"
	depends on !LINGMO_TOOLCHAIN_HAS_THREADS
```

## package/libwebsockets/Config.in
```kconfig
config LINGMO_PACKAGE_LIBWEBSOCKETS
	bool "libwebsockets"
	depends on !LINGMO_STATIC_LIBS
	select LINGMO_PACKAGE_ZLIB
	help
	  Libwebsockets is a lightweight pure C library built to use
	  minimal CPU and memory resources, and provide fast throughput
	  in both directions.

	  https://libwebsockets.org/

if LINGMO_PACKAGE_LIBWEBSOCKETS

config LINGMO_PACKAGE_LIBWEBSOCKETS_EXT_POLL
	bool "enable external poll loop support"
	default y  # legacy, was previously always enabled
	help
	  Enable external poll loop support code. This was
	  unconditionally compiled in for library versions
	  prior to 3.2.0.

endif

comment "libwebsockets needs a toolchain w/ dynamic library"
	depends on LINGMO_STATIC_LIBS
```

## package/libwpe/Config.in
```kconfig
comment "libwpe needs a toolchain w/ C++, dynamic library and an OpenEGL-capable backend"
	depends on !LINGMO_PACKAGE_HAS_LIBEGL || !LINGMO_INSTALL_LIBSTDCPP || LINGMO_STATIC_LIBS

config LINGMO_PACKAGE_LIBWPE
	bool "libwpe"
	depends on !LINGMO_STATIC_LIBS # dlfcn.h
	depends on LINGMO_INSTALL_LIBSTDCPP
	depends on LINGMO_PACKAGE_HAS_LIBEGL
	select LINGMO_PACKAGE_LIBXKBCOMMON
	help
	  Base library for the WPE WebKit port.

	  https://wpewebkit.org/
```

## package/libxkbcommon/Config.in
```kconfig
config LINGMO_PACKAGE_LIBXKBCOMMON
	bool "libxkbcommon"
	select LINGMO_PACKAGE_LIBXCB if LINGMO_PACKAGE_XORG7
	help
	  xkbcommon is a keymap compiler and support library which
	  processes a reduced subset of keymaps as defined by the XKB
	  specification.

	  https://xkbcommon.org

if LINGMO_PACKAGE_LIBXKBCOMMON

config LINGMO_PACKAGE_LIBXKBCOMMON_TOOLS
	bool "tools"
	select LINGMO_PACKAGE_WAYLAND_PROTOCOLS if LINGMO_PACKAGE_WAYLAND
	help
	  Tools: xkbcli, xkbcli-compile-keymap, xkbcli-how-to-type,
	  xkbcli-interactive-evdev, xkbcli-interactive-x11,
	  xkbcli-interactive-wayland

endif
```

## package/libxmlpp/Config.in
```kconfig
config LINGMO_PACKAGE_LIBXMLPP
	bool "libxml++"
	depends on LINGMO_TOOLCHAIN_GCC_AT_LEAST_7 # glibmm -> libsigc
	depends on LINGMO_INSTALL_LIBSTDCPP
	depends on LINGMO_USE_WCHAR # glibmm -> libglib2
	depends on LINGMO_TOOLCHAIN_HAS_THREADS # glibmm -> libglib2
	depends on LINGMO_USE_MMU # glibmm -> libglib2
	select LINGMO_PACKAGE_LIBXML2
	select LINGMO_PACKAGE_GLIBMM
	help
	  libxml++ is a C++ wrapper for the libxml XML parser library.

	  https://libxmlplusplus.github.io/libxmlplusplus/

comment "libxml++ needs a toolchain w/ C++, wchar, threads, gcc >= 7"
	depends on !LINGMO_TOOLCHAIN_GCC_AT_LEAST_7 || !LINGMO_USE_WCHAR \
		||!LINGMO_TOOLCHAIN_HAS_THREADS || !LINGMO_INSTALL_LIBSTDCPP
	depends on LINGMO_USE_MMU
```

## package/libyang/Config.in
```kconfig
config LINGMO_PACKAGE_LIBYANG
	bool "libyang"
	depends on LINGMO_TOOLCHAIN_HAS_SYNC_4 # __sync_*_4 intrinsics
	depends on LINGMO_TOOLCHAIN_HAS_THREADS
	depends on !LINGMO_STATIC_LIBS
	select LINGMO_PACKAGE_PCRE2
	help
	  Libyang is YANG data modeling language parser and toolkit
	  written (and providing API) in C.

	  https://github.com/CESNET/libyang

comment "libyang needs a toolchain w/ threads, dynamic library"
	depends on LINGMO_TOOLCHAIN_HAS_SYNC_4
	depends on !LINGMO_TOOLCHAIN_HAS_THREADS || LINGMO_STATIC_LIBS
```

## package/libyuv/Config.in
```kconfig
config LINGMO_PACKAGE_LIBYUV
	bool "libyuv"
	depends on LINGMO_INSTALL_LIBSTDCPP
	depends on !LINGMO_STATIC_LIBS
	help
	  libyuv is an open source project that includes YUV scaling
	  and conversion functionality.

	  https://chromium.googlesource.com/libyuv/libyuv/

comment "libyuv needs a toolchain w/ C++, dynamic library"
	depends on !LINGMO_INSTALL_LIBSTDCPP || LINGMO_STATIC_LIBS
```

## package/libzip/Config.in
```kconfig
config LINGMO_PACKAGE_LIBZIP
	bool "libzip"
	depends on !LINGMO_STATIC_LIBS # dlsym()
	select LINGMO_PACKAGE_MUSL_FTS if !LINGMO_TOOLCHAIN_USES_GLIBC
	select LINGMO_PACKAGE_ZLIB
	help
	  C library for reading, creating, and modifying zip archives.
	  This package also contains zipcmp, ziptorrent and zipmerge
	  utilities.

	  https://libzip.org/

comment "libzip needs a toolchain w/ dynamic library"
	depends on LINGMO_STATIC_LIBS
```

## package/lightning/Config.in
```kconfig
comment "lightning needs a toolchain w/ dynamic library, threads"
	depends on LINGMO_sparc || LINGMO_i386 || LINGMO_x86_64 || LINGMO_mips || \
		LINGMO_mipsel || LINGMO_arm || LINGMO_powerpc || LINGMO_RISCV_64 || \
		LINGMO_mips64 || LINGMO_mips64el
	depends on LINGMO_STATIC_LIBS || !LINGMO_TOOLCHAIN_HAS_THREADS

config LINGMO_PACKAGE_LIGHTNING
	bool "lightning"
	depends on LINGMO_sparc || LINGMO_i386 || LINGMO_x86_64 || LINGMO_mips || \
		LINGMO_mipsel || LINGMO_arm || LINGMO_powerpc || LINGMO_RISCV_64 || \
		LINGMO_mips64 || LINGMO_mips64el
	depends on !LINGMO_STATIC_LIBS
	depends on LINGMO_TOOLCHAIN_HAS_THREADS
	help
	  GNU lightning is a library that generates
	  assembly language code at run-time.

	  https://www.gnu.org/software/lightning/

if LINGMO_PACKAGE_LIGHTNING

config LINGMO_PACKAGE_LIGHTNING_DISASSEMBLER
	bool "enable disassembler"
	depends on !LINGMO_nios2 # binutils
	depends on LINGMO_USE_WCHAR # binutils
	select LINGMO_PACKAGE_BINUTILS
	select LINGMO_PACKAGE_ZLIB
	help
	  Enable the GNU lightning disassembler.

comment "lightning disassembler needs a toolchain w/ wchar"
	depends on !LINGMO_nios2
	depends on !LINGMO_USE_WCHAR

endif
```
