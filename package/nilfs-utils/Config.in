## package/ntpsec/Config.in
```kconfig
config LINGMO_PACKAGE_NTPSEC
	bool "ntpsec"
	depends on LINGMO_USE_MMU # python3
	depends on LINGMO_USE_WCHAR # python3
	depends on LINGMO_TOOLCHAIN_HAS_THREADS # python3
	depends on !LINGMO_STATIC_LIBS # python3
	select LINGMO_PACKAGE_LIBCAP
	select LINGMO_PACKAGE_OPENSSL
	select LINGMO_PACKAGE_PYTHON3
	help
	  NTPsec project - a secure, hardened, and improved
	  implementation of Network Time Protocol derived
	  from NTP Classic, Dave Mills’s original.

	  Provides things like ntpd, ntpdate, ntpq, etc...

	  https://www.ntpsec.org/

if LINGMO_PACKAGE_NTPSEC

config LINGMO_PACKAGE_NTPSEC_CLASSIC_MODE
	bool "classic-mode"
	help
	  Enable strict configuration and log-format compatibility
	  with NTP Classic.

config LINGMO_PACKAGE_NTPSEC_NTS
	bool "NTS support"
	help
	  Enable Network Time Security (NTS) support.

config LINGMO_PACKAGE_NTPSEC_REFCLOCK_ALL
	bool "refclock-all"
	select LINGMO_PACKAGE_PPS_TOOLS
	help
	  Enable all refclocks (hardware, sync source and discplined
	  clocks)

endif

comment "ntpsec needs a toolchain w/ wchar, threads, dynamic library"
	depends on LINGMO_USE_MMU
	depends on !LINGMO_USE_WCHAR || !LINGMO_TOOLCHAIN_HAS_THREADS || \
		LINGMO_STATIC_LIBS
```

## package/numactl/Config.in
```kconfig
config LINGMO_PACKAGE_NUMACTL
	bool "numactl"
	depends on LINGMO_USE_MMU # madvise()
	depends on LINGMO_TOOLCHAIN_HAS_ATOMIC
	help
	  numactl allows you to run your application on specific cpus
	  and memory nodes. It does this by supplying a NUMA memory
	  policy to the operating system before running your program.

	  https://github.com/numactl/numactl
```

## package/nushell/Config.in
```kconfig
config LINGMO_PACKAGE_NUSHELL
	bool "nushell"
	depends on LINGMO_PACKAGE_HOST_RUSTC_TARGET_ARCH_SUPPORTS
	select LINGMO_PACKAGE_HOST_RUSTC
	select LINGMO_PACKAGE_OPENSSL
	select LINGMO_PACKAGE_HOST_PKGCONF
	select LINGMO_PACKAGE_NCURSES
	select LINGMO_PACKAGE_NCURSES_TARGET_PROGS
	help
	  A new type of shell.

	  https://github.com/nushell/nushell
```

## package/nut/Config.in
```kconfig
comment "nut needs a toolchain w/ C++"
	depends on LINGMO_USE_MMU
	depends on !LINGMO_INSTALL_LIBSTDCPP

config LINGMO_PACKAGE_NUT
	bool "nut"
	depends on LINGMO_USE_MMU # fork()
	depends on LINGMO_INSTALL_LIBSTDCPP
	help
	  Network UPS tools

	  The primary goal of the Network UPS Tools (NUT) project is
	  to provide support for Power Devices, such as
	  Uninterruptible Power Supplies, Power Distribution Units and
	  Solar Controllers.

	  http://www.networkupstools.org/

if LINGMO_PACKAGE_NUT

config LINGMO_PACKAGE_NUT_DRIVERS
	string "drivers"
	help
	  Select the individual drivers to enable, in a
	  comma-separated list. Leave empty for all.

endif # LINGMO_PACKAGE_NUT
```

## package/nuttcp/Config.in
```kconfig
config LINGMO_PACKAGE_NUTTCP
	bool "nuttcp"
	depends on LINGMO_USE_MMU # fork()
	help
	  nuttcp is a TCP/UDP network testing tool, much like iperf

	  http://nuttcp.net
```

## package/nvidia-driver/Config.in
```kconfig
comment "nvidia-driver needs a glibc toolchain"
	depends on LINGMO_i386 || LINGMO_x86_64
	depends on !LINGMO_TOOLCHAIN_USES_GLIBC

config LINGMO_PACKAGE_NVIDIA_DRIVER
	bool "nvidia-driver"
	depends on LINGMO_i386 || LINGMO_x86_64
	depends on LINGMO_TOOLCHAIN_USES_GLIBC
	help
	  The binary-only driver blob for NVidia cards.
	  This is the userland part only.

	  http://www.nvidia.com/

if LINGMO_PACKAGE_NVIDIA_DRIVER

comment "nvidia-driver X.org drivers needs a modular Xorg server"
	depends on !LINGMO_PACKAGE_XSERVER_XORG_SERVER_MODULAR

config LINGMO_PACKAGE_NVIDIA_DRIVER_XORG
	bool "X.org drivers"
	default y
	depends on LINGMO_PACKAGE_XSERVER_XORG_SERVER_MODULAR
	select LINGMO_PACKAGE_MESA3D_HEADERS
	select LINGMO_PACKAGE_XLIB_LIBX11
	select LINGMO_PACKAGE_XLIB_LIBXEXT
	select LINGMO_PACKAGE_HAS_LIBGL
	select LINGMO_PACKAGE_HAS_LIBEGL
	select LINGMO_PACKAGE_HAS_LIBEGL_WAYLAND
	select LINGMO_PACKAGE_HAS_LIBGLES

if LINGMO_PACKAGE_NVIDIA_DRIVER_XORG

config LINGMO_PACKAGE_PROVIDES_LIBGL
	default "nvidia-driver"

config LINGMO_PACKAGE_PROVIDES_LIBEGL
	default "nvidia-driver"

config LINGMO_PACKAGE_PROVIDES_LIBGLES
	default "nvidia-driver"

config LINGMO_PACKAGE_NVIDIA_DRIVER_PRIVATE_LIBS
	bool "Install private libraries"
	help
	  Two libraries require special agreement with NVidia to
	  develop code linking to those libraries: libnvidia-ifr.so
	  and libnvidia-fbc.so (to grab and encode an OpenGL buffer or
	  an X framebuffer.)

	  Say 'y' here if you plan on running a program that uses
	  those private libraries.

endif # LINGMO_PACKAGE_NVIDIA_DRIVER_XORG

config LINGMO_PACKAGE_NVIDIA_DRIVER_CUDA
	bool "CUDA support"

if LINGMO_PACKAGE_NVIDIA_DRIVER_CUDA

config LINGMO_PACKAGE_NVIDIA_DRIVER_OPENCL
	bool "OpenCL support"
	select LINGMO_PACKAGE_MESA3D_HEADERS
	select LINGMO_PACKAGE_HAS_LIBOPENCL

config LINGMO_PACKAGE_PROVIDES_LIBOPENCL
	default "nvidia-driver" if LINGMO_PACKAGE_NVIDIA_DRIVER_OPENCL

config LINGMO_PACKAGE_NVIDIA_DRIVER_CUDA_PROGS
	bool "CUDA MPS server and control"
	help
	  Say 'y' here if you need to run more than one program
	  doing CUDA at the same time. The MPS server will be
	  launched automatically when needed.

endif # LINGMO_PACKAGE_NVIDIA_DRIVER_CUDA

comment "nvidia kernel module needs a Linux kernel to be built"
	depends on !LINGMO_LINUX_KERNEL

config LINGMO_PACKAGE_NVIDIA_DRIVER_MODULE
	bool "nvidia kernel module"
	depends on LINGMO_LINUX_KERNEL
	select LINGMO_LINUX_NEEDS_MODULES # not using kernel-module infra
	help
	  Build the nvidia.ko kernel module.

	  If CUDA support (above) is set, and the target is x86_64, then
	  this will also build the nvidia-uvm.ko kernel module, which
	  provides Unified Memory access to the GPU and CPU memories for
	  CUDA programs.

endif # LINGMO_PACKAGE_NVIDIA_DRIVER
```

## package/nvidia-modprobe/Config.in
```kconfig
config LINGMO_PACKAGE_NVIDIA_MODPROBE
	bool "nvidia-modprobe"
	depends on LINGMO_USE_MMU # fork()
	help
	  nvidia-modprobe package adds a utility and headers for
	  probing the NVIDIA hardware at runtime.

	  https://github.com/NVIDIA/nvidia-modprobe
```

## package/nvidia-persistenced/Config.in
```kconfig
config LINGMO_PACKAGE_NVIDIA_PERSISTENCED
	bool "nvidia-persistenced"
	depends on LINGMO_USE_MMU # fork()
	depends on !LINGMO_STATIC_LIBS # dlfcn.h
	depends on LINGMO_TOOLCHAIN_HAS_THREADS # libtirpc
	select LINGMO_PACKAGE_LIBTIRPC if !LINGMO_TOOLCHAIN_HAS_NATIVE_RPC
	help
	  NVIDIA driver persistence daemon.

	  https://github.com/NVIDIA/nvidia-persistenced

comment "nvidia-persistenced needs a toolchain w/ threads, dynamic libs"
	depends on LINGMO_USE_MMU
	depends on !LINGMO_TOOLCHAIN_HAS_THREADS || LINGMO_STATIC_LIBS
```

## package/oatpp/Config.in
```kconfig
config LINGMO_PACKAGE_OATPP
	bool "oatpp"
	depends on LINGMO_INSTALL_LIBSTDCPP
	depends on LINGMO_TOOLCHAIN_HAS_THREADS
	help
	  Oat++ is an open-source C++ web framework for highly scalable
	  and resource-efficient web applications. It provides all the
	  necessary components for production-grade development.

	  https://oatpp.io/docs/start

comment "oatpp needs a toolchain w/ C++, threads"
	depends on !LINGMO_INSTALL_LIBSTDCPP || !LINGMO_TOOLCHAIN_HAS_THREADS
```

## package/ocrad/Config.in
```kconfig
config LINGMO_PACKAGE_OCRAD
	bool "ocrad"
	depends on LINGMO_INSTALL_LIBSTDCPP
	select LINGMO_PACKAGE_LIBPNG
	help
	  GNU Ocrad is an OCR (Optical Character Recognition) program
	  based on a feature extraction method.
	  It reads images in pbm (bitmap), pgm (greyscale) or
	  ppm (color) formats and produces text in byte (8-bit) or
	  UTF-8 formats.

	  http://www.gnu.org/software/ocrad/

comment "ocrad needs a toolchain w/ C++"
	depends on !LINGMO_INSTALL_LIBSTDCPP
```

## package/ofono/Config.in
```kconfig
config LINGMO_PACKAGE_OFONO
	bool "ofono"
	depends on LINGMO_USE_WCHAR # gettext, libglib2, ell
	depends on LINGMO_TOOLCHAIN_HAS_THREADS # dbus, libglib2
	depends on LINGMO_USE_MMU # dbus, libglib2
	depends on !LINGMO_STATIC_LIBS # dlopen(), ell
	depends on LINGMO_TOOLCHAIN_HAS_SYNC_4
	depends on LINGMO_TOOLCHAIN_HEADERS_AT_LEAST_4_12 # ell
	select LINGMO_PACKAGE_DBUS
	select LINGMO_PACKAGE_ELL
	select LINGMO_PACKAGE_LIBCAP_NG
	select LINGMO_PACKAGE_LIBGLIB2
	select LINGMO_PACKAGE_MOBILE_BROADBAND_PROVIDER_INFO
	help
	  oFono is a free, open source project for mobile telephony
	  (GSM/UMTS) applications. It uses high-level D-Bus API for
	  use by telephony applications. It uses 3GPP standard.

	  http://ofono.org/

comment "ofono needs a toolchain w/ dynamic library, wchar, threads, headers >= 4.12"
	depends on LINGMO_USE_MMU
	depends on LINGMO_TOOLCHAIN_HAS_SYNC_4
	depends on LINGMO_STATIC_LIBS || !LINGMO_USE_WCHAR || \
		!LINGMO_TOOLCHAIN_HAS_THREADS || \
		!LINGMO_TOOLCHAIN_HEADERS_AT_LEAST_4_12
```

## package/ogre/Config.in
```kconfig
config LINGMO_PACKAGE_OGRE
	bool "ogre"
	depends on LINGMO_PACKAGE_HAS_LIBGL # libglu
	depends on LINGMO_PACKAGE_XORG7
	depends on LINGMO_INSTALL_LIBSTDCPP
	depends on LINGMO_TOOLCHAIN_HAS_THREADS
	depends on LINGMO_TOOLCHAIN_GCC_AT_LEAST_4_8 # C++11
	depends on !LINGMO_STATIC_LIBS
	depends on LINGMO_USE_MMU
	depends on LINGMO_USE_WCHAR # use wchar_t
	depends on !LINGMO_arc # libfreeimage
	select LINGMO_PACKAGE_FREETYPE
	select LINGMO_PACKAGE_LIBFREEIMAGE
	select LINGMO_PACKAGE_PUGIXML
	select LINGMO_PACKAGE_SDL2
	select LINGMO_PACKAGE_SDL2_OPENGL
	select LINGMO_PACKAGE_SDL2_X11 # use wmInfo.info.x11
	select LINGMO_PACKAGE_XLIB_LIBX11
	select LINGMO_PACKAGE_XLIB_LIBXAW
	select LINGMO_PACKAGE_XLIB_LIBXEXT
	select LINGMO_PACKAGE_XLIB_LIBXRANDR
	select LINGMO_PACKAGE_ZZIPLIB
	help
	  OGRE is a scene-oriented, flexible 3D engine written in C++
	  designed to make it easier and more intuitive for developers
	  to produce games and demos utilising 3D hardware. The class
	  library abstracts all the details of using the underlying
	  system libraries like Direct3D and OpenGL and provides an
	  interface based on world objects and other intuitive classes.

	  https://ogrecave.github.io/ogre

comment "ogre needs X11 and an OpenGL provider"
	depends on !LINGMO_PACKAGE_HAS_LIBGL || !LINGMO_PACKAGE_XORG7
	depends on LINGMO_TOOLCHAIN_HAS_THREADS && LINGMO_TOOLCHAIN_GCC_AT_LEAST_4_8 \
		&& LINGMO_INSTALL_LIBSTDCPP && !LINGMO_STATIC_LIBS && LINGMO_USE_WCHAR
	depends on LINGMO_USE_MMU
	depends on !LINGMO_arc

comment "ogre needs a toolchain w/ C++, dynamic library, gcc >= 4.8, threads, wchar"
	depends on !LINGMO_INSTALL_LIBSTDCPP || !LINGMO_TOOLCHAIN_GCC_AT_LEAST_4_8 \
		|| LINGMO_STATIC_LIBS || !LINGMO_TOOLCHAIN_HAS_THREADS \
		|| !LINGMO_USE_WCHAR
	depends on LINGMO_USE_MMU
	depends on !LINGMO_arc
```
