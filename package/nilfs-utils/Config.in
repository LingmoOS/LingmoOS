## package/nilfs-utils/Config.in
```kconfig
config LINGMO_PACKAGE_NILFS_UTILS
	bool "nilfs-utils"
	depends on LINGMO_USE_MMU # util-linux libmount, libblkid
	depends on LINGMO_TOOLCHAIN_HAS_THREADS # sem_open()
	select LINGMO_PACKAGE_UTIL_LINUX_LIBUUID
	select LINGMO_PACKAGE_UTIL_LINUX_LIBBLKID
	select LINGMO_PACKAGE_UTIL_LINUX_LIBMOUNT
	select LINGMO_PACKAGE_UTIL_LINUX
	help
	  Tools for creating and managing NILFS2 filesystems.

	  https://nilfs.sourceforge.io

comment "nilfs-utils needs a toolchain w/ threads"
	depends on LINGMO_USE_MMU
	depends on !LINGMO_TOOLCHAIN_HAS_THREADS
```

## package/nload/Config.in
```kconfig
comment "nload needs a toolchain w/ C++"
	depends on !LINGMO_INSTALL_LIBSTDCPP

config LINGMO_PACKAGE_NLOAD
	bool "nload"
	depends on LINGMO_INSTALL_LIBSTDCPP
	select LINGMO_PACKAGE_NCURSES
	help
	  nload is a console application which monitors network traffic
	  and bandwidth usage in real time. It visualizes the in- and
	  outgoing traffic using two graphs and provides additional info
	  like total amount of transfered data and min/max network
	  usage.

	  http://www.roland-riegel.de/nload/
```

## package/nmap/Config.in
```kconfig
config LINGMO_PACKAGE_NMAP
	bool "nmap"
	depends on LINGMO_INSTALL_LIBSTDCPP
	depends on LINGMO_USE_MMU # fork()
	depends on LINGMO_TOOLCHAIN_HAS_THREADS
	select LINGMO_PACKAGE_LIBLINEAR
	select LINGMO_PACKAGE_LIBPCAP
	select LINGMO_PACKAGE_NMAP_NMAP \
	       if !LINGMO_PACKAGE_NMAP_NCAT && !LINGMO_PACKAGE_NMAP_NPING
	help
	  Nmap ("Network Mapper") is a free and open source (license)
	  utility for network discovery and security auditing.

	  http://nmap.org

if  LINGMO_PACKAGE_NMAP

config LINGMO_PACKAGE_NMAP_NCAT
	bool "install ncat"
	depends on LINGMO_PACKAGE_BUSYBOX_SHOW_OTHERS
	help
	  Ncat is a feature-packed networking utility which reads and
	  writes data across networks from the command line. Ncat was
	  written for the Nmap Project as a much-improved
	  reimplementation of the venerable Netcat.

	  A symlink to "nc" is installed if neither netcat or
	  netcat-openbsd is selected.

comment "a symlink from ncat to 'nc' will be installed"
	depends on LINGMO_PACKAGE_NMAP_NCAT
	depends on !LINGMO_PACKAGE_NETCAT
	depends on !LINGMO_PACKAGE_NETCAT_OPENBSD

config LINGMO_PACKAGE_NMAP_NMAP
	bool "install nmap"
	select LINGMO_PACKAGE_PCRE
	help
	  This option installs 'nmap' itself.

config LINGMO_PACKAGE_NMAP_NPING
	bool "install nping"
	help
	  This option installs the 'nping' tool.

endif

comment "nmap-nmap needs a toolchain w/ C++, threads"
	depends on LINGMO_USE_MMU
	depends on !(LINGMO_INSTALL_LIBSTDCPP && LINGMO_TOOLCHAIN_HAS_THREADS)
```

## package/nmon/Config.in
```kconfig
config LINGMO_PACKAGE_NMON
	bool "nmon"
	depends on LINGMO_TOOLCHAIN_USES_GLIBC # fstab.h
	select LINGMO_PACKAGE_NCURSES
	help
	  Nmon is short for Nigel's performance Monitor for Linux

	  http://nmon.sourceforge.net/pmwiki.php

comment "nmon needs a glibc toolchain"
	depends on !LINGMO_TOOLCHAIN_USES_GLIBC
```

## package/nodejs/Config.in
```kconfig
config LINGMO_PACKAGE_NODEJS_ARCH_SUPPORTS
	bool
	# On ARM, at least ARMv6+ with VFPv2+ is needed
	default y if LINGMO_arm && !LINGMO_ARM_CPU_ARMV4 && !LINGMO_ARM_CPU_ARMV5 && LINGMO_ARM_CPU_HAS_VFPV2
	default y if LINGMO_aarch64 || LINGMO_i386 || LINGMO_x86_64
	# libuv
	depends on LINGMO_TOOLCHAIN_HAS_SYNC_4
	depends on LINGMO_PACKAGE_HOST_QEMU_USER_ARCH_SUPPORTS

comment "nodejs needs a toolchain w/ C++, dynamic library, NPTL, gcc >= 10, wchar, host gcc >= 10"
	depends on LINGMO_USE_MMU
	depends on LINGMO_PACKAGE_NODEJS_ARCH_SUPPORTS
	depends on !LINGMO_INSTALL_LIBSTDCPP || LINGMO_STATIC_LIBS || !LINGMO_TOOLCHAIN_HAS_THREADS_NPTL || \
		!LINGMO_HOST_GCC_AT_LEAST_10 || !LINGMO_TOOLCHAIN_GCC_AT_LEAST_10 || !LINGMO_USE_WCHAR

config LINGMO_PACKAGE_NODEJS
	bool "nodejs"
	depends on LINGMO_TOOLCHAIN_HAS_THREADS_NPTL # libuv
	depends on LINGMO_INSTALL_LIBSTDCPP
	depends on LINGMO_PACKAGE_NODEJS_ARCH_SUPPORTS
	depends on LINGMO_HOST_GCC_AT_LEAST_10
	depends on LINGMO_TOOLCHAIN_GCC_AT_LEAST_10
	depends on LINGMO_USE_WCHAR
	# uses fork()
	depends on LINGMO_USE_MMU
	# uses dlopen(). On ARMv5, we could technically support static
	# linking, but that's too much of a corner case to support it.
	depends on !LINGMO_STATIC_LIBS
	select LINGMO_PACKAGE_NODEJS_SRC
	select LINGMO_PACKAGE_HOST_NODEJS if LINGMO_PACKAGE_NODEJS_MODULES_ADDITIONAL != ""
	select LINGMO_PACKAGE_HOST_PYTHON3
	select LINGMO_PACKAGE_HOST_PYTHON3_BZIP2
	select LINGMO_PACKAGE_HOST_PYTHON3_SSL
	select LINGMO_PACKAGE_HOST_QEMU
	select LINGMO_PACKAGE_HOST_QEMU_LINUX_USER_MODE
	select LINGMO_PACKAGE_C_ARES
	select LINGMO_PACKAGE_LIBUV
	select LINGMO_PACKAGE_ZLIB
	select LINGMO_PACKAGE_NGHTTP2
	help
	  Event-driven I/O server-side JavaScript environment based on
	  V8.

	  http://nodejs.org/

if LINGMO_PACKAGE_NODEJS

config LINGMO_PACKAGE_NODEJS_NPM
	bool "NPM for the target"
	select LINGMO_PACKAGE_OPENSSL
	help
	  NPM is the package manager for the Node JavaScript platform.
	  Note that enabling NPM on the target also selects OpenSSL
	  for the target.

	  http://www.npmjs.org

	  Note that NPM is always built for the buildroot host.

config LINGMO_PACKAGE_NODEJS_MODULES_ADDITIONAL
	string "Additional modules"
	help
	  List of space-separated nodejs modules to install via npm.
	  See https://npmjs.org/ to find modules and 'npm help install'
	  for available installation methods. For repeatable builds,
	  download and save tgz files or clone git repos for the
	  components you care about.

	  Example:
	  serialport uglify-js@1.3.4 /my/module/mymodule.tgz \
	    git://github.com/someuser/somemodule.git#v1.2

	  This would install the serialport module (at the newest
	  version), the uglify-js module at 1.3.4, a module from a
	  filesystem path, and a module from a git repository.

config LINGMO_PACKAGE_NODEJS_MODULES_ADDITIONAL_DEPS
	string "Additional module dependencies"
	help
	  List of space-separated buildroot recipes which must be
	  built before your npms can be installed. For example, if in
	  'Additional modules' you specified 'node-curl' (see:
	  https://github.com/jiangmiao/node-curl), you could then
	  specify 'libcurl' here, to ensure that buildroot builds the
	  libcurl package, and does so before building your node
	  modules.

endif

source "package/nodejs/nodejs-src/Config.in"
```

## package/nodejs/Config.in.host
```kconfig
config LINGMO_PACKAGE_HOST_NODEJS_BIN_ARCH_SUPPORTS
	bool
	default y if LINGMO_HOSTARCH = "aarch64"
	default y if LINGMO_HOSTARCH = "arm"
	default y if LINGMO_HOSTARCH = "ppc64le"
	default y if LINGMO_HOSTARCH = "x86_64"

comment "host nodejs needs a host gcc >= 8"
	depends on !LINGMO_PACKAGE_HOST_NODEJS_BIN_ARCH_SUPPORTS
	depends on !LINGMO_HOST_GCC_AT_LEAST_8

config LINGMO_PACKAGE_HOST_NODEJS
	bool "host nodejs"
	depends on LINGMO_PACKAGE_HOST_NODEJS_BIN_ARCH_SUPPORTS || \
		LINGMO_HOST_GCC_AT_LEAST_8
	help
	  Event-driven I/O server-side JavaScript environment based on
	  V8.

	  http://nodejs.org/

if LINGMO_PACKAGE_HOST_NODEJS

choice
	prompt "host nodejs variant"
	default LINGMO_PACKAGE_HOST_NODEJS_BIN if LINGMO_PACKAGE_HOST_NODEJS_BIN_ARCH_SUPPORTS
	default LINGMO_PACKAGE_HOST_NODEJS_SRC
	help
	  Select a nodejs variant - built from source or
	  pre-built.

config LINGMO_PACKAGE_HOST_NODEJS_BIN
	bool "pre-built version"
	depends on LINGMO_PACKAGE_HOST_NODEJS_BIN_ARCH_SUPPORTS

config LINGMO_PACKAGE_HOST_NODEJS_SRC
	bool "compile from source"
	depends on LINGMO_HOST_GCC_AT_LEAST_8
	select LINGMO_PACKAGE_HOST_PYTHON3
	select LINGMO_PACKAGE_HOST_PYTHON3_BZIP2
	select LINGMO_PACKAGE_HOST_PYTHON3_SSL

comment "host nodejs from source needs a host gcc >= 8"
	depends on !LINGMO_HOST_GCC_AT_LEAST_8

endchoice

config LINGMO_PACKAGE_HOST_NODEJS_COREPACK
	bool "Corepack"
	help
	  Enable Corepack with host nodejs.

	  Corepack is a zero-runtime-dependency Node.js script that
	  acts as a bridge between Node.js projects and the package
	  managers they are intended to be used with during
	  development. In practical terms, Corepack will let you use
	  Yarn and pnpm without having to install them - just like
	  what currently happens with npm, which is shipped by Node.js
	  by default.

endif

config LINGMO_PACKAGE_PROVIDES_HOST_NODEJS
	string
	default "host-nodejs-src" if LINGMO_PACKAGE_HOST_NODEJS_SRC
	# default to host-nodejs-bin so it's used if nothing is set explicitly
	default "host-nodejs-bin" if !LINGMO_PACKAGE_HOST_NODEJS_SRC
```

## package/nodm/Config.in
```kconfig
config LINGMO_PACKAGE_NODM
	bool "nodm"
	depends on LINGMO_PACKAGE_XORG7
	depends on (LINGMO_ENABLE_LOCALE && LINGMO_USE_WCHAR) # linux-pam
	depends on !LINGMO_STATIC_LIBS # linux-pam
	depends on LINGMO_USE_MMU # linux-pam
	depends on LINGMO_TOOLCHAIN_GCC_AT_LEAST_4_9 # linux-pam
	select LINGMO_PACKAGE_XLIB_LIBX11
	select LINGMO_PACKAGE_LINUX_PAM
	help
	  nodm is a minimal display manager that simply logs in
	  as a given user and starts an X session, without asking
	  for username or password.

	  For those cases where automatic login is needed (and
	  does not imply a security issue), nodm is simple to setup,
	  lightweight, and it should do exactly the right thing.

	  https://github.com/spanezz/nodm/

comment "nodm needs a toolchain w/ wchar, locale, dynamic library, gcc >= 4.9"
	depends on LINGMO_PACKAGE_XORG7
	depends on !(LINGMO_ENABLE_LOCALE && LINGMO_USE_WCHAR) \
		|| LINGMO_STATIC_LIBS || !LINGMO_TOOLCHAIN_GCC_AT_LEAST_4_9
```

## package/noip/Config.in
```kconfig
config LINGMO_PACKAGE_NOIP
	bool "noip"
	depends on LINGMO_USE_MMU # fork()
	help
	  Dynamic DNS update client for no-ip.com

	  http://www.no-ip.com/downloads.php
```

## package/norm/Config.in
```kconfig
comment "norm needs a toolchain w/ C++, threads, dynamic library"
	depends on !LINGMO_INSTALL_LIBSTDCPP || LINGMO_STATIC_LIBS || \
		!LINGMO_TOOLCHAIN_HAS_THREADS

config LINGMO_PACKAGE_NORM
	bool "norm"
	depends on LINGMO_INSTALL_LIBSTDCPP
	depends on LINGMO_TOOLCHAIN_HAS_THREADS
	depends on !LINGMO_STATIC_LIBS
	help
	  The NORM protocol is designed to provide end-to-end reliable
	  transport of bulk data objects or streams over generic IP
	  multicast routing and forwarding services.

	  http://www.nrl.navy.mil/itd/ncs/products/norm
```

## package/nss-mdns/Config.in
```kconfig
config LINGMO_PACKAGE_NSS_MDNS
	bool "nss-mdns"
	# libdaemon->avahi uses fork()
	depends on LINGMO_USE_MMU
	depends on LINGMO_TOOLCHAIN_USES_GLIBC
	depends on LINGMO_PACKAGE_AVAHI_DAEMON
	help
	  nss-mdns is a plugin for the GNU Name Service Switch (NSS)
	  functionality of the GNU C Library (glibc) providing host
	  name resolution via Multicast DNS (aka Zeroconf, aka Apple
	  Rendezvous, aka Apple Bonjour), effectively allowing name
	  resolution by common Unix/Linux programs in the ad-hoc
	  mDNS domain .local.

	  https://github.com/lathiat/nss-mdns

comment "nss-mdns needs a glibc toolchain"
	depends on LINGMO_USE_MMU && LINGMO_PACKAGE_AVAHI_DAEMON
	depends on !LINGMO_TOOLCHAIN_USES_GLIBC
```

## package/ntfs-3g/Config.in
```kconfig
config LINGMO_PACKAGE_NTFS_3G
	bool "ntfs-3g"
	depends on LINGMO_USE_WCHAR
	depends on LINGMO_TOOLCHAIN_HAS_THREADS
	depends on LINGMO_USE_MMU
	depends on !LINGMO_STATIC_LIBS
	help
	  The NTFS-3G driver is an open source, freely available
	  read/write NTFS driver for Linux, FreeBSD, Mac OS X, NetBSD,
	  and Haiku. It provides safe and fast handling of the Windows
	  XP, Windows Server 2003, Windows 2000 and Windows Vista file
	  systems. Most POSIX file system operations are supported, with
	  the exception of full file ownership and access right support.

	  http://www.ntfs-3g.org/

if LINGMO_PACKAGE_NTFS_3G

config LINGMO_PACKAGE_NTFS_3G_ENCRYPTED
	bool "encrypted volumes"
	depends on LINGMO_PACKAGE_LIBGPG_ERROR_ARCH_SUPPORTS # libgcrypt
	select LINGMO_PACKAGE_GNUTLS
	select LINGMO_PACKAGE_LIBGCRYPT
	help
	  Enable support for NTFS encrypted volumes.

config LINGMO_PACKAGE_NTFS_3G_NTFSPROGS
	bool "ntfsprogs"
	help
	  Install NTFS utilities.

endif

comment "ntfs-3g needs a toolchain w/ wchar, threads, dynamic library"
	depends on LINGMO_USE_MMU
	depends on !LINGMO_USE_WCHAR || !LINGMO_TOOLCHAIN_HAS_THREADS || LINGMO_STATIC_LIBS
```

## package/ntp/Config.in
```kconfig
config LINGMO_PACKAGE_NTP
	bool "ntp"
	depends on LINGMO_USE_MMU || LINGMO_TOOLCHAIN_HAS_THREADS
	select LINGMO_PACKAGE_LIBEVENT
	help
	  Network Time Protocol suite/programs.
	  Provides things like ntpd, ntpdate, ntpq, etc...

	  http://www.ntp.org/

if LINGMO_PACKAGE_NTP

config LINGMO_PACKAGE_NTP_SNTP
	bool "sntp"
	help
	  Simple network time protocol program (a replacement
	  for the ntpdate tool)

	  A script is installed as S48sntp which will retrieve and
	  step the time if there is a large difference before ntpd
	  takes over the necessary slew adjustments in S49ntp.

config LINGMO_PACKAGE_NTP_NTP_KEYGEN
	bool "ntp-keygen"
	help
	  Create a NTP host key

config LINGMO_PACKAGE_NTP_NTP_SHM_CLK
	bool "SHM clock support"
	help
	  Compile ntp with support for a SHM clock attached through
	  shared memory.

config LINGMO_PACKAGE_NTP_NTP_WAIT
	bool "ntp-wait"
	depends on LINGMO_PACKAGE_PERL
	help
	  ntp-wait waits until the locally running ntpd is in state 4
	  (synchronized). This could be useful at boot time, to delay
	  the boot sequence until after "ntpd -g" has set the time.

config LINGMO_PACKAGE_NTP_NTPD
	bool "ntpd"
	default y
	help
	  ntpd is the time synchronization daemon keeping your local
	  system date and time in sync and optionally serving time and
	  date information on the network via the NTP protocol.

config LINGMO_PACKAGE_NTP_NTPD_ATOM_PPS
	bool "PPS support"
	depends on LINGMO_PACKAGE_NTP_NTPD
	select LINGMO_PACKAGE_PPS_TOOLS
	help
	  Compile ntpd with the ability to use an ATOM PPS source.

config LINGMO_PACKAGE_NTP_NTPDATE
	bool "ntpdate"
	help
	  The ntpdate utility program is used to set the local date
	  and time from an NTP server given as an argument.

config LINGMO_PACKAGE_NTP_NTPDC
	bool "ntpdc"
	help
	  The ntpdc utility program is used to query an NTP daemon about
	  its current state and to request changes in that state.

config LINGMO_PACKAGE_NTP_NTPQ
	bool "ntpq"
	help
	  The ntpq utility program is used to query NTP servers
	  requesting information about current state and/or changes in
	  that state.

config LINGMO_PACKAGE_NTP_NTPSNMPD
	bool "ntpsnmpd"
	depends on LINGMO_USE_MMU # netsnmp fork()
	select LINGMO_PACKAGE_NETSNMP
	help
	  Install ntpsnmpd NTP SNMP MIB agent.

config LINGMO_PACKAGE_NTP_NTPTIME
	bool "ntptime"
	help
	  The ntptime utility program is used to read and set kernel
	  time variables.

config LINGMO_PACKAGE_NTP_NTPTRACE
	bool "ntptrace"
	depends on LINGMO_PACKAGE_PERL
	help
	  ntptrace is a perl script that uses the ntpq utility program
	  to follow the chain of NTP servers from a given host back to
	  the primary time source

config LINGMO_PACKAGE_NTP_TICKADJ
	bool "tickadj"
	help
	  set time-related kernel variables

endif
```
