## package/kmsxx/Config.in
```kconfig
config LINGMO_PACKAGE_KMSXX
	bool "kms++"
	depends on LINGMO_TOOLCHAIN_GCC_AT_LEAST_4_8
	depends on LINGMO_TOOLCHAIN_HEADERS_AT_LEAST_4_11 # linux/dma-buf.h
	depends on LINGMO_INSTALL_LIBSTDCPP
	depends on LINGMO_TOOLCHAIN_HAS_THREADS # libdrm
	depends on LINGMO_USE_WCHAR # fmt
	select LINGMO_PACKAGE_FMT
	select LINGMO_PACKAGE_LIBDRM
	help
	  libkms++ is a C++11 library for kernel mode setting.

	  Also included are simple test tools for KMS.

	  https://github.com/tomba/kmsxx

if LINGMO_PACKAGE_KMSXX

config LINGMO_PACKAGE_KMSXX_INSTALL_TESTS
	bool "Install test programs"
	help
	  This option allows to install the kmsxx test programs.

endif

comment "kms++ needs a toolchain w/ threads, C++, gcc >= 4.8, headers >= 4.11, wchar"
	depends on !LINGMO_TOOLCHAIN_HAS_THREADS || !LINGMO_INSTALL_LIBSTDCPP || \
		!LINGMO_TOOLCHAIN_GCC_AT_LEAST_4_8 || !LINGMO_TOOLCHAIN_HEADERS_AT_LEAST_4_11 \
		|| !LINGMO_USE_WCHAR
```

## package/knock/Config.in
```kconfig
config LINGMO_PACKAGE_KNOCK
	bool "knock"
	help
	  A port knocking implementation.
	  Provides a daemon and a user application. Port knocking can be
	  used to run an arbitrary application, once the daemon detects
	  a predefined sequence of incoming TCP/UDP packets on a network
	  interface. This can be used, e.g. to open up ports in a
	  firewall.

	  http://www.zeroflux.org/projects/knock

if LINGMO_PACKAGE_KNOCK

config LINGMO_PACKAGE_KNOCK_KNOCKD
	bool "knockd"
	default y
	depends on LINGMO_USE_MMU # fork()
	select LINGMO_PACKAGE_LIBPCAP
	help
	  Enable knockd

endif
```

## package/kodi-audiodecoder-modplug/Config.in
```kconfig
config LINGMO_PACKAGE_KODI_AUDIODECODER_MODPLUG
	bool "kodi-audiodecoder-modplug"
	select LINGMO_PACKAGE_LIBMODPLUG
	help
	  Modplug decoder addon for Kodi

	  https://github.com/xbmc/audiodecoder.modplug
```

## package/kodi-audiodecoder-sidplay/Config.in
```kconfig
config LINGMO_PACKAGE_KODI_AUDIODECODER_SIDPLAY
	bool "kodi-audiodecoder-sidplay"
	select LINGMO_PACKAGE_LIBSIDPLAY2
	help
	  Sidplay decoder addon for Kodi

	  https://github.com/xbmc/audiodecoder.sidplay
```

## package/kodi-audioencoder-flac/Config.in
```kconfig
config LINGMO_PACKAGE_KODI_AUDIOENCODER_FLAC
	bool "kodi-audioencoder-flac"
	select LINGMO_PACKAGE_FLAC
	select LINGMO_PACKAGE_KODI_OPTICALDRIVE
	select LINGMO_PACKAGE_LIBOGG
	help
	  An audioencoder addon for Kodi

	  https://github.com/xbmc/audioencoder.flac
```

## package/kodi-audioencoder-lame/Config.in
```kconfig
config LINGMO_PACKAGE_KODI_AUDIOENCODER_LAME
	bool "kodi-audioencoder-lame"
	select LINGMO_PACKAGE_KODI_OPTICALDRIVE
	select LINGMO_PACKAGE_LAME
	select LINGMO_PACKAGE_LIBICONV if !LINGMO_ENABLE_LOCALE
	help
	  An audioencoder addon for Kodi

	  https://github.com/xbmc/audioencoder.lame
```

## package/kodi-audioencoder-vorbis/Config.in
```kconfig
config LINGMO_PACKAGE_KODI_AUDIOENCODER_VORBIS
	bool "kodi-audioencoder-vorbis"
	select LINGMO_PACKAGE_KODI_OPTICALDRIVE
	select LINGMO_PACKAGE_LIBOGG
	select LINGMO_PACKAGE_LIBVORBIS
	help
	  An audioencoder addon for Kodi

	  https://github.com/xbmc/audioencoder.vorbis
```

## package/kodi-imagedecoder-heif/Config.in
```kconfig
config LINGMO_PACKAGE_KODI_IMAGEDECODER_HEIF
	bool "kodi-imagedecoder-heif"
	depends on LINGMO_INSTALL_LIBSTDCPP # libde265, libheif, tinyxml2
	depends on LINGMO_TOOLCHAIN_HAS_THREADS # libde265
	depends on !LINGMO_TOOLCHAIN_HAS_BINUTILS_BUG_30730 # libheif
	depends on LINGMO_TOOLCHAIN_GCC_AT_LEAST_4_8 # libheif
	select LINGMO_PACKAGE_LIBDE265
	select LINGMO_PACKAGE_LIBHEIF
	select LINGMO_PACKAGE_TINYXML2
	help
	  HEIF image decoder add-on for Kodi

	  https://github.com/xbmc/imagedecoder.heif

comment "kodi-imagedecoder-heif needs a toolchain w/ C++, threads, gcc >= 4.8"
	depends on !LINGMO_TOOLCHAIN_HAS_BINUTILS_BUG_30730 # libheif
	depends on !LINGMO_INSTALL_LIBSTDCPP || !LINGMO_TOOLCHAIN_HAS_THREADS || \
		!LINGMO_TOOLCHAIN_GCC_AT_LEAST_4_8
```

## package/kodi-imagedecoder-raw/Config.in
```kconfig
config LINGMO_PACKAGE_KODI_IMAGEDECODER_RAW
	bool "kodi-imagedecoder-raw"
	depends on LINGMO_TOOLCHAIN_HAS_SYNC_4
	depends on LINGMO_INSTALL_LIBSTDCPP
	select LINGMO_PACKAGE_JPEG
	select LINGMO_PACKAGE_LCMS2
	select LINGMO_PACKAGE_LIBRAW
	help
	  RAW image decoder add-on for Kodi

	  https://github.com/xbmc/imagedecoder.raw

comment "kodi-imagedecoder-raw needs a toolchain w/ C++"
	depends on LINGMO_TOOLCHAIN_HAS_SYNC_4
	depends on !LINGMO_INSTALL_LIBSTDCPP
```

## package/kodi-inputstream-adaptive/Config.in
```kconfig
config LINGMO_PACKAGE_KODI_INPUTSTREAM_ADAPTIVE
	bool "kodi-inputstream-adaptive"
	# wvdecrypter/cdm/build/build_config.h
	depends on LINGMO_aarch64 || LINGMO_arm || LINGMO_i386 || LINGMO_mipsel \
		|| LINGMO_mips64el || LINGMO_x86_64
	select LINGMO_PACKAGE_BENTO4
	select LINGMO_PACKAGE_EXPAT
	help
	  Kodi inputstream addon for several manifest types

	  https://github.com/xbmc/inputstream.adaptive
```

## package/kodi-inputstream-rtmp/Config.in
```kconfig
config LINGMO_PACKAGE_KODI_INPUTSTREAM_RTMP
	bool "kodi-inputstream-rtmp"
	select LINGMO_PACKAGE_OPENSSL
	select LINGMO_PACKAGE_RTMPDUMP
	select LINGMO_PACKAGE_ZLIB
	help
	  RTMP input stream add-on for Kodi

	  https://github.com/xbmc/inputstream.rtmp
```

## package/kodi-peripheral-joystick/Config.in
```kconfig
config LINGMO_PACKAGE_KODI_PERIPHERAL_JOYSTICK
	bool "kodi-peripheral-joystick"
	depends on LINGMO_PACKAGE_HAS_UDEV
	select LINGMO_PACKAGE_TINYXML
	help
	  Kodi joystick support (drivers and button maps)

	  https://github.com/xbmc/peripheral.joystick

comment "kodi-peripheral-joystick needs udev /dev management"
	depends on !LINGMO_PACKAGE_HAS_UDEV
```

## package/kodi-pvr-argustv/Config.in
```kconfig
config LINGMO_PACKAGE_KODI_PVR_ARGUSTV
	bool "kodi-pvr-argustv"
	select LINGMO_PACKAGE_JSONCPP
	help
	  Kodi's ARGUS TV client addon

	  https://github.com/kodi-pvr/pvr.argustv
```

## package/kodi-pvr-dvblink/Config.in
```kconfig
config LINGMO_PACKAGE_KODI_PVR_DVBLINK
	bool "kodi-pvr-dvblink"
	select LINGMO_PACKAGE_TINYXML2
	help
	  Kodi's DVBLink client addon

	  https://github.com/kodi-pvr/pvr.dvblink
```

## package/kodi-pvr-dvbviewer/Config.in
```kconfig
config LINGMO_PACKAGE_KODI_PVR_DVBVIEWER
	bool "kodi-pvr-dvbviewer"
	select LINGMO_PACKAGE_TINYXML
	help
	  Kodi's DVBViewer client addon

	  https://github.com/kodi-pvr/pvr.dvbviewer
```

## package/kodi-pvr-filmon/Config.in
```kconfig
config LINGMO_PACKAGE_KODI_PVR_FILMON
	bool "kodi-pvr-filmon"
	select LINGMO_PACKAGE_JSONCPP
	help
	  Filmon PVR client addon for Kodi

	  https://github.com/kodi-pvr/pvr.filmon
```

## package/kodi-pvr-hdhomerun/Config.in
```kconfig
config LINGMO_PACKAGE_KODI_PVR_HDHOMERUN
	bool "kodi-pvr-hdhomerun"
	select LINGMO_PACKAGE_JSONCPP
	select LINGMO_PACKAGE_LIBHDHOMERUN
	help
	  Kodi's HDHomeRun client addon

	  https://github.com/kodi-pvr/pvr.hdhomerun
```

## package/kodi-pvr-iptvsimple/Config.in
```kconfig
config LINGMO_PACKAGE_KODI_PVR_IPTVSIMPLE
	bool "kodi-pvr-iptvsimple"
	# kodi-inputstream-adaptive
	depends on LINGMO_aarch64 || LINGMO_arm || LINGMO_i386 || LINGMO_mipsel \
		|| LINGMO_mips64el || LINGMO_x86_64
	select LINGMO_PACKAGE_KODI_INPUTSTREAM_ADAPTIVE # runtime
	select LINGMO_PACKAGE_KODI_INPUTSTREAM_FFMPEGDIRECT # runtime
	select LINGMO_PACKAGE_KODI_INPUTSTREAM_RTMP # runtime
	select LINGMO_PACKAGE_PUGIXML
	select LINGMO_PACKAGE_XZ
	select LINGMO_PACKAGE_ZLIB
	help
	  IPTV Live TV and Radio PVR client addon for Kodi

	  https://github.com/kodi-pvr/pvr.iptvsimple
```

## package/kodi-pvr-nextpvr/Config.in
```kconfig
config LINGMO_PACKAGE_KODI_PVR_NEXTPVR
	bool "kodi-pvr-nextpvr"
	select LINGMO_PACKAGE_TINYXML2
	help
	  Kodi's NextPVR client addon

	  https://github.com/kodi-pvr/pvr.nextpvr
```

## package/kodi-pvr-octonet/Config.in
```kconfig
config LINGMO_PACKAGE_KODI_PVR_OCTONET
	bool "kodi-pvr-octonet"
	depends on LINGMO_TOOLCHAIN_GCC_AT_LEAST_4_7 # jsoncpp
	select LINGMO_PACKAGE_JSONCPP
	help
	  DigitalDevices Octonet PVR client addon for Kodi

	  https://github.com/DigitalDevices/pvr.octonet

comment "kodi-pvr-octonet needs a toolchain w/ gcc >= 4.7"
	depends on !LINGMO_TOOLCHAIN_GCC_AT_LEAST_4_7
```

## package/kodi-pvr-pctv/Config.in
```kconfig
config LINGMO_PACKAGE_KODI_PVR_PCTV
	bool "kodi-pvr-pctv"
	select LINGMO_PACKAGE_JSONCPP
	help
	  PCTV PVR client addon for Kodi

	  https://github.com/kodi-pvr/pvr.vdr.vnsi
```

## package/kodi-pvr-plutotv/Config.in
```kconfig
config LINGMO_PACKAGE_KODI_PVR_PLUTOTV
	bool "kodi-pvr-plutotv"
	select LINGMO_PACKAGE_RAPIDJSON
	help
	  Pluto.tv PVR Client for Kodi

	  https://github.com/kodi-pvr/pvr.plutotv
```

## package/kodi-pvr-stalker/Config.in
```kconfig
config LINGMO_PACKAGE_KODI_PVR_STALKER
	bool "kodi-pvr-stalker"
	select LINGMO_PACKAGE_JSONCPP
	select LINGMO_PACKAGE_LIBXML2
	help
	  A PVR Client that connects Kodi to Stalker Middleware

	  https://github.com/kodi-pvr/pvr.stalker
```

## package/kodi-pvr-vbox/Config.in
```kconfig
config LINGMO_PACKAGE_KODI_PVR_VBOX
	bool "kodi-pvr-vbox"
	select LINGMO_PACKAGE_TINYXML2
	help
	  Kodi PVR addon for interfacing with VBox Communications XTi TV
	  Gateway

	  https://github.com/kodi-pvr/pvr.vbox
```

## package/kodi-pvr-zattoo/Config.in
```kconfig
config LINGMO_PACKAGE_KODI_PVR_ZATTOO
	bool "kodi-pvr-zattoo"
	select LINGMO_PACKAGE_RAPIDJSON
	select LINGMO_PACKAGE_TINYXML2
	help
	  Kodi PVR-Addon for Zattoo

	  https://github.com/rbuehlma/pvr.zattoo
```
