## package/openipmi/Config.in
```kconfig
config LINGMO_PACKAGE_OPENIPMI
	bool "openipmi"
	depends on LINGMO_USE_MMU # fork()
	depends on !LINGMO_STATIC_LIBS # dlopen()
	depends on LINGMO_TOOLCHAIN_HAS_THREADS_NPTL
	select LINGMO_PACKAGE_POPT
	select LINGMO_PACKAGE_NCURSES
	select LINGMO_PACKAGE_READLINE
	help
	  IPMI allows remote monitoring and remote management of
	  devices. OpenIPMI provides a library and command line tools
	  to interact with IPMI enabled devices. OpenIPMI also provides
	  an IPMI BMC simulator.

	  http://openipmi.sourceforge.net

comment "openipmi needs a toolchain w/ dynamic library, NPTL"
	depends on LINGMO_USE_MMU
	depends on LINGMO_STATIC_LIBS || !LINGMO_TOOLCHAIN_HAS_THREADS_NPTL
```

## package/openldap/Config.in
```kconfig
config LINGMO_PACKAGE_OPENLDAP
	bool "openldap"
	depends on LINGMO_USE_WCHAR
	depends on LINGMO_USE_MMU # needs fork()
	help
	  OpenLDAP Software is an open source implementation of the
	  Lightweight Directory Access Protocol.

	  This only installs client-side support.

	  https://www.openldap.org/

if LINGMO_PACKAGE_OPENLDAP

config LINGMO_PACKAGE_OPENLDAP_CLIENTS
	bool "openldap client binaries"
	default y
	help
	  Install the OpenLDAP client tools (ldapadd, ldapcompare,
	  ldapdelete, ldapexop, ldapmodify, ldapmodrdn, ldappasswd,
	  ldapsearch, ldapurl, ldapwhoami)

endif

comment "openldap needs a toolchain w/ wchar"
	depends on LINGMO_USE_MMU # needs fork()
	depends on !LINGMO_USE_WCHAR
```

## package/openmpi/Config.in
```kconfig
comment "openmpi needs a toolchain w/ dynamic library, NPTL, wchar, C++"
	depends on LINGMO_USE_MMU
	depends on LINGMO_TOOLCHAIN_HAS_ATOMIC
	depends on !LINGMO_sparc
	depends on LINGMO_STATIC_LIBS || !LINGMO_TOOLCHAIN_HAS_THREADS_NPTL \
		|| !LINGMO_USE_WCHAR || !LINGMO_INSTALL_LIBSTDCPP

config LINGMO_PACKAGE_OPENMPI
	bool "openmpi"
	depends on LINGMO_USE_MMU # fork()
	depends on LINGMO_USE_WCHAR
	depends on LINGMO_TOOLCHAIN_HAS_ATOMIC
	depends on LINGMO_TOOLCHAIN_HAS_THREADS_NPTL
	depends on LINGMO_INSTALL_LIBSTDCPP
	depends on !LINGMO_STATIC_LIBS # dlfcn.h
	# from the configure script: "Sparc v8 target is not supported
	# in this release of Open MPI"
	depends on !LINGMO_sparc
	help
	  A High Performance Message Passing Library.

	  https://www.open-mpi.org/
```

## package/openocd/Config.in.host
```kconfig
config LINGMO_PACKAGE_HOST_OPENOCD
	bool "host openocd"
	depends on LINGMO_HOST_GCC_AT_LEAST_4_9 # host-libusb
	help
	  OpenOCD - Open On-Chip Debugger

	  http://openocd.org/

comment "host openocd needs a toolchain w/ host gcc >= 4.9"
	depends on !LINGMO_HOST_GCC_AT_LEAST_4_9
```

## package/openpgm/Config.in
```kconfig
config LINGMO_PACKAGE_OPENPGM
	bool "openpgm"
	depends on LINGMO_TOOLCHAIN_HAS_SYNC_2
	depends on LINGMO_TOOLCHAIN_HAS_SYNC_4
	depends on LINGMO_TOOLCHAIN_HAS_THREADS
	depends on LINGMO_USE_WCHAR
	help
	  OpenPGM is an open source implementation of the Pragmatic
	  General Multicast (PGM) specification in RFC 3208 available at
	  www.ietf.org. PGM is a reliable and scalable multicast
	  protocol that enables receivers to detect loss, request
	  retransmission of lost data, or notify an application of
	  unrecoverable loss.

	  https://github.com/steve-o/openpgm/

comment "openpgm needs a toolchain w/ wchar, threads"
	depends on LINGMO_TOOLCHAIN_HAS_SYNC_2
	depends on LINGMO_TOOLCHAIN_HAS_SYNC_4
	depends on !(LINGMO_TOOLCHAIN_HAS_THREADS && LINGMO_USE_WCHAR)
```

## package/openpowerlink/Config.in
```kconfig
comment "openpowerlink needs a toolchain w/ C++, threads"
	depends on LINGMO_i386 || LINGMO_x86_64
	depends on !LINGMO_INSTALL_LIBSTDCPP || !LINGMO_TOOLCHAIN_HAS_THREADS

config LINGMO_PACKAGE_OPENPOWERLINK
	bool "openpowerlink"
	depends on LINGMO_INSTALL_LIBSTDCPP
	depends on LINGMO_TOOLCHAIN_HAS_THREADS
	depends on LINGMO_i386 || LINGMO_x86_64
	help
	  openPOWERLINK is an Open Source Industrial Ethernet stack
	  implementing the POWERLINK protocol for Managing Node (MN,
	  POWERLINK Master) and Controlled Node (CN, POWERLINK Slave).

	  It is provided by
	  SYSTEC electronic (http://www.systec-electronic.com),
	  B&R (http://www.br-automation.com) and
	  Kalycito (http://www.kalycito.com).

	  http://openpowerlink.sourceforge.net/web/

if LINGMO_PACKAGE_OPENPOWERLINK

choice
	prompt "MN/CN mode"

config LINGMO_PACKAGE_OPENPOWERLINK_MN
	bool "Managing Node"
	help
	  Enable Managing Node (master) mode

config LINGMO_PACKAGE_OPENPOWERLINK_CN
	bool "Controlled Node"
	help
	  Enable Controlled Node (slave) mode

endchoice

choice
	prompt "stack type"
	default LINGMO_PACKAGE_OPENPOWERLINK_STACK_KERNEL_STACK_LIB if LINGMO_PACKAGE_OPENPOWERLINK_KERNEL_MODULE # legacy
	default LINGMO_PACKAGE_OPENPOWERLINK_STACK_USERSPACE_DAEMON_LIB if LINGMO_PACKAGE_OPENPOWERLINK_LIBPCAP # legacy

config LINGMO_PACKAGE_OPENPOWERLINK_STACK_MONOLITHIC_USER_STACK_LIB
	bool "linked into application"
	select LINGMO_PACKAGE_LIBPCAP
	help
	  Compile a monolithic openPOWERLINK library. The library
	  contains an Ethernet driver which is using the PCAP library
	  for accessing the network. No kernel-side driver is needed.

config LINGMO_PACKAGE_OPENPOWERLINK_STACK_USERSPACE_DAEMON_LIB
	bool "user-space pcap daemon"
	select LINGMO_PACKAGE_LIBPCAP
	help
	  Compile openPOWERLINK application library which contains the
	  interface to a Linux user space driver, and the Linux user
	  space driver. It is used for implementing a multi-process
	  solution where the openPOWERLINK layer is running as a
	  separate Linux user space daemon (i.e. a PCAP based user
	  space daemon).  No kernel-side stack is needed.

config LINGMO_PACKAGE_OPENPOWERLINK_STACK_KERNEL_STACK_LIB
	bool "kernel-space driver"
	depends on LINGMO_LINUX_KERNEL
	help
	  Compile openPOWERLINK application library which contains the
	  interface to a Linux kernel space driver. This will also
	  build and install a Linux kernel module openPOWERLINK
	  driver.

config LINGMO_PACKAGE_OPENPOWERLINK_STACK_KERNEL_PCIE_STACK_LIB
	bool "kernel-space PCIe driver"
	depends on LINGMO_LINUX_KERNEL
	depends on LINGMO_PACKAGE_OPENPOWERLINK_MN # MN support only
	help
	  Compile openPOWERLINK application library which contains the
	  interface to a Linux kernel PCIe interface driver. The kernel
	  part of the openPOWERLINK stack is located on an external PCIe
	  device. The status/control and data exchange between the
	  application and kernel stack is handled by the PCIe interface
	  driver.

comment "openpowerlink kernel stack needs a Linux kernel to be built"
	depends on !LINGMO_LINUX_KERNEL

endchoice

if LINGMO_PACKAGE_OPENPOWERLINK_STACK_KERNEL_STACK_LIB

menu "Ethernet drivers"

config LINGMO_PACKAGE_OPENPOWERLINK_KERNEL_DRIVER_82573
	bool "Intel 82573"
	default y

config LINGMO_PACKAGE_OPENPOWERLINK_KERNEL_DRIVER_8255x
	bool "Intel 8255x"

config LINGMO_PACKAGE_OPENPOWERLINK_KERNEL_DRIVER_I210
	bool "Intel I210"

config LINGMO_PACKAGE_OPENPOWERLINK_KERNEL_DRIVER_RTL8111
	bool "Realtek RTL-8111/8168"

config LINGMO_PACKAGE_OPENPOWERLINK_KERNEL_DRIVER_RTL8139
	bool "Realtek RTL-8139"

endmenu

endif # LINGMO_PACKAGE_OPENPOWERLINK_STACK_KERNEL_STACK_LIB

config LINGMO_PACKAGE_OPENPOWERLINK_KERNEL_PCIE_DRIVER
	bool "PCIe Powerlink Driver"
	depends on LINGMO_PACKAGE_OPENPOWERLINK_STACK_KERNEL_PCIE_STACK_LIB

menu "demos"

config LINGMO_PACKAGE_OPENPOWERLINK_DEMO_MN_CONSOLE
	bool "console MN demo"
	depends on LINGMO_PACKAGE_OPENPOWERLINK_MN

config LINGMO_PACKAGE_OPENPOWERLINK_DEMO_CN_CONSOLE
	bool "console CN demo"
	depends on LINGMO_PACKAGE_OPENPOWERLINK_CN

endmenu

endif # LINGMO_PACKAGE_OPENPOWERLINK
```

## package/opensc/Config.in
```kconfig
config LINGMO_PACKAGE_OPENSC
	bool "opensc"
	depends on !LINGMO_STATIC_LIBS
	depends on LINGMO_TOOLCHAIN_HAS_THREADS
	depends on LINGMO_USE_MMU # fork()
	depends on LINGMO_TOOLCHAIN_GCC_AT_LEAST_4_9 # pcsc-lite
	select LINGMO_PACKAGE_PCSC_LITE
	select LINGMO_PACKAGE_LIBOPENSSL_ENABLE_DES if LINGMO_PACKAGE_LIBOPENSSL
	select LINGMO_PACKAGE_LIBOPENSSL_ENABLE_RMD160 if LINGMO_PACKAGE_LIBOPENSSL
	help
	  OpenSC provides a set of libraries and utilities to work
	  with smart cards.

	  https://github.com/OpenSC/OpenSC/wiki

comment "opensc needs a toolchain with dynamic library, threads, gcc >= 4.9"
	depends on LINGMO_USE_MMU
	depends on LINGMO_STATIC_LIBS || !LINGMO_TOOLCHAIN_HAS_THREADS || \
		!LINGMO_TOOLCHAIN_GCC_AT_LEAST_4_9
```

## package/openssh/Config.in
```kconfig
config LINGMO_PACKAGE_OPENSSH
	bool "openssh"
	depends on LINGMO_USE_MMU # fork()
	select LINGMO_PACKAGE_OPENSSL
	select LINGMO_PACKAGE_ZLIB
	help
	  A free version of the SSH protocol suite of network
	  connectivity tools. The standard 'ssh', 'sshd', 'scp', and
	  friends.

	  http://www.openssh.com/

if LINGMO_PACKAGE_OPENSSH

config LINGMO_PACKAGE_OPENSSH_CLIENT
	bool "client"
	default y
	help
	  Client programs: ssh, scp, sftp, ssh-agent, ssh-add,
	  ssh-copy-id.

config LINGMO_PACKAGE_OPENSSH_SERVER
	bool "server"
	default y
	help
	  Server programs: sshd, sftp-server

config LINGMO_PACKAGE_OPENSSH_KEY_UTILS
	bool "key utilities"
	default y
	help
	  Key utilities: ssh-keygen, ssh-keyscan.

config LINGMO_PACKAGE_OPENSSH_SANDBOX
	bool "use sandboxing"
	default y
	help
	  Use sandboxing for extra privilege protection of processes.

	  This is normally preferable, but may cause seccomp problems
	  for certain combinations of C libraries and kernel versions.
endif
```

## package/openssl/Config.in
```kconfig
config LINGMO_PACKAGE_OPENSSL_FORCE_LIBOPENSSL
	bool

config LINGMO_PACKAGE_OPENSSL
	bool "openssl support"
	select LINGMO_PACKAGE_HAS_OPENSSL
	help
	  Select the desired ssl library provider.

if LINGMO_PACKAGE_OPENSSL

choice
	prompt "ssl library"
	help
	  Select OpenSSL or LibreSSL.

config LINGMO_PACKAGE_LIBOPENSSL
	bool "openssl"
	select LINGMO_PACKAGE_ZLIB
	help
	  A collaborative effort to develop a robust, commercial-grade,
	  fully featured, and Open Source toolkit implementing the
	  Secure Sockets Layer (SSL v2/v3) and Transport Security
	  (TLS v1) as well as a full-strength general-purpose
	  cryptography library.

	  http://www.openssl.org/

	  Note: Some helper scripts need perl.

source "package/libopenssl/Config.in"

config LINGMO_PACKAGE_LIBRESSL
	bool "libressl"
	depends on !LINGMO_PACKAGE_OPENSSL_FORCE_LIBOPENSSL
	depends on LINGMO_TOOLCHAIN_HAS_THREADS
	# uClibc doesn't provide __register_atfork() without NPTL
	depends on !LINGMO_TOOLCHAIN_USES_UCLIBC || LINGMO_TOOLCHAIN_HAS_THREADS_NPTL
	help
	  LibreSSL is a version of the TLS/crypto stack forked from
	  OpenSSL in 2014, with goals of modernizing the codebase,
	  improving security, and applying best practice development
	  processes.

	  http://www.libressl.org/

source "package/libressl/Config.in"

# openssl from br2-external trees, if any
source "$LINGMO_BASE_DIR/.br2-external.in.openssl"

endchoice

config LINGMO_PACKAGE_HAS_OPENSSL
	bool

config LINGMO_PACKAGE_PROVIDES_OPENSSL
	string
	default "libopenssl" if LINGMO_PACKAGE_LIBOPENSSL
	default "libressl" if LINGMO_PACKAGE_LIBRESSL

endif

# ensure libopenssl is used for the host variant
config LINGMO_PACKAGE_PROVIDES_HOST_OPENSSL
	string
	default "host-libopenssl"
```

## package/openswan/Config.in
```kconfig
config LINGMO_PACKAGE_OPENSWAN
	bool "openswan"
	depends on LINGMO_USE_MMU # iproute2
	depends on LINGMO_TOOLCHAIN_HEADERS_AT_LEAST_3_4 # iproute2
	select LINGMO_PACKAGE_GMP
	select LINGMO_PACKAGE_IPROUTE2
	help
	  Openswan is an implementation of IPsec for Linux

	  http://www.openswan.org

comment "openswan needs a toolchain w/ headers >= 3.4"
	depends on LINGMO_USE_MMU
	depends on !LINGMO_TOOLCHAIN_HEADERS_AT_LEAST_3_4
```

## package/opentracing-cpp/Config.in
```kconfig
config LINGMO_PACKAGE_OPENTRACING_CPP
	bool "opentracing-cpp"
	depends on LINGMO_INSTALL_LIBSTDCPP
	depends on LINGMO_TOOLCHAIN_HAS_THREADS
	depends on !LINGMO_STATIC_LIBS
	depends on LINGMO_TOOLCHAIN_GCC_AT_LEAST_4_8 # C++11
	depends on !LINGMO_TOOLCHAIN_HAS_GCC_BUG_64735 # exception_ptr
	help
	  OpenTracing API for C++

	  http://opentracing.io

comment "opentracing-cpp needs a toolchain w/ C++, threads, dynamic library, gcc >= 4.8"
	depends on !LINGMO_INSTALL_LIBSTDCPP || !LINGMO_TOOLCHAIN_HAS_THREADS \
		|| LINGMO_STATIC_LIBS || !LINGMO_TOOLCHAIN_GCC_AT_LEAST_4_8

comment "opentracing-cpp needs exception_ptr"
	depends on LINGMO_TOOLCHAIN_HAS_GCC_BUG_64735
```

## package/openvmtools/Config.in
```kconfig
config LINGMO_PACKAGE_OPENVMTOOLS_ARCH_SUPPORTS
	bool
	default y if LINGMO_i386
	default y if LINGMO_x86_64
	default y if LINGMO_aarch64

config LINGMO_PACKAGE_OPENVMTOOLS
	bool "openvmtools"
	depends on LINGMO_PACKAGE_OPENVMTOOLS_ARCH_SUPPORTS
	depends on LINGMO_USE_MMU # libglib2
	depends on LINGMO_USE_WCHAR # libglib2
	depends on LINGMO_TOOLCHAIN_HAS_THREADS # libglib2
	depends on LINGMO_ENABLE_LOCALE
	depends on !LINGMO_STATIC_LIBS
	depends on !LINGMO_TOOLCHAIN_USES_UCLIBC
	select LINGMO_PACKAGE_LIBGLIB2
	select LINGMO_PACKAGE_LIBDNET
	select LINGMO_PACKAGE_LIBTIRPC if !LINGMO_TOOLCHAIN_HAS_NATIVE_RPC
	help
	  Open Virtual Machine Tools for VMware guest OS

	  https://github.com/vmware/open-vm-tools

	  ICU locales, Xerces, and X11 tools are currently not
	  supported.

	  NOTE: Support for vmblock-fuse will be enabled in
	  openvmtools if the libfuse package is selected.

if LINGMO_PACKAGE_OPENVMTOOLS

config LINGMO_PACKAGE_OPENVMTOOLS_PAM
	bool "PAM support"
	# linux-pam needs locale, dynamic library and wchar, but we
	# already have these dependencies on the main symbol, above.
	depends on LINGMO_TOOLCHAIN_GCC_AT_LEAST_4_9 # linux-pam
	select LINGMO_PACKAGE_LINUX_PAM
	help
	  Support for PAM in openvmtools

comment "PAM support needs a toolchain w/ gcc >= 4.9"
	depends on !LINGMO_TOOLCHAIN_GCC_AT_LEAST_4_9

config LINGMO_PACKAGE_OPENVMTOOLS_RESOLUTIONKMS
	bool "resolutionkms support"
	depends on LINGMO_PACKAGE_HAS_UDEV
	depends on LINGMO_TOOLCHAIN_HAS_THREADS # libdrm
	depends on LINGMO_i386 || LINGMO_x86_64 # libdrm vmwgfx
	select LINGMO_PACKAGE_LIBDRM
	select LINGMO_PACKAGE_LIBDRM_VMWGFX
	help
	  Enable support for resolutionkms

comment "resolutionkms needs udev, a toolchain w/ threads"
	depends on LINGMO_i386 || LINGMO_x86_64
	depends on !LINGMO_PACKAGE_HAS_UDEV || !LINGMO_TOOLCHAIN_HAS_THREADS

endif

comment "openvmtools needs a glibc or musl toolchain w/ wchar, threads, locale, dynamic library"
	depends on LINGMO_PACKAGE_OPENVMTOOLS_ARCH_SUPPORTS
	depends on LINGMO_USE_MMU
	depends on !LINGMO_USE_WCHAR || !LINGMO_TOOLCHAIN_HAS_THREADS || \
		!LINGMO_ENABLE_LOCALE || LINGMO_STATIC_LIBS || \
		LINGMO_TOOLCHAIN_USES_UCLIBC
```

## package/openvpn/Config.in
```kconfig
config LINGMO_PACKAGE_OPENVPN
	bool "openvpn"
	depends on LINGMO_USE_MMU # fork()
	select LINGMO_PACKAGE_LIBCAP_NG
	select LINGMO_PACKAGE_OPENSSL if !LINGMO_PACKAGE_MBEDTLS
	select LINGMO_PACKAGE_LIBOPENSSL_ENABLE_DES if LINGMO_PACKAGE_LIBOPENSSL
	help
	  OpenVPN is a full-featured SSL VPN solution which can
	  accomodate a wide range of configurations, including road
	  warrior access, home/office/campus telecommuting, WiFi
	  security, secure branch office linking, and enterprise-scale
	  remote access solutions with load balancing, failover, and
	  fine-grained access-controls.

	  http://openvpn.net/

if LINGMO_PACKAGE_OPENVPN

config LINGMO_PACKAGE_OPENVPN_LZ4
	bool "LZ4 compression"
	default y
	select LINGMO_PACKAGE_LZ4
	help
	  Enable LZ4 compression.

config LINGMO_PACKAGE_OPENVPN_LZO
	bool "LZO compression"
	default y
	select LINGMO_PACKAGE_LZO
	help
	  Enable LZO compression.

config LINGMO_PACKAGE_OPENVPN_SMALL
	bool "Optimize for small size"
	help
	  Make OpenVPN as small as possible.
	  You loose eurephia, debugging info, help messages and more.
	  It saves around 100 KiB in binary file size.

endif
```
