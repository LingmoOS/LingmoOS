## package/openzwave/Config.in
```kconfig
config LINGMO_PACKAGE_OPENZWAVE
	bool "openzwave"
	depends on LINGMO_TOOLCHAIN_HAS_THREADS_NPTL
	depends on LINGMO_INSTALL_LIBSTDCPP
	depends on !LINGMO_STATIC_LIBS
	depends on LINGMO_USE_WCHAR
	select LINGMO_PACKAGE_TINYXML
	help
	  Free software library that interfaces with selected Z-Wave
	  PC controllers, allowing anyone to create applications that
	  manipulate and respond to devices on a Z-Wave network,
	  without requiring in-depth knowledge of the Z-Wave protocol

	  http://www.openzwave.net

comment "openzwave needs a toolchain w/ C++, dynamic library, NPTL, wchar"
	depends on !LINGMO_INSTALL_LIBSTDCPP || LINGMO_STATIC_LIBS || \
		!LINGMO_TOOLCHAIN_HAS_THREADS_NPTL || !LINGMO_USE_WCHAR
```

## package/opkg-utils/Config.in
```kconfig
config LINGMO_PACKAGE_OPKG_UTILS
	bool "opkg-utils"
	depends on !LINGMO_nios2 || LINGMO_PACKAGE_BUSYBOX # binutils
	depends on LINGMO_USE_MMU # bash, python3
	depends on LINGMO_USE_WCHAR # python3
	depends on LINGMO_TOOLCHAIN_HAS_THREADS # python3 <- libffi
	depends on !LINGMO_STATIC_LIBS # python3
	select LINGMO_PACKAGE_BINUTILS if !LINGMO_PACKAGE_BUSYBOX # runtime
	select LINGMO_PACKAGE_BINUTILS_TARGET if !LINGMO_PACKAGE_BUSYBOX # runtime
	select LINGMO_PACKAGE_COREUTILS if !LINGMO_PACKAGE_BUSYBOX # runtime
	select LINGMO_PACKAGE_DIFFUTILS if !LINGMO_PACKAGE_BUSYBOX # runtime
	select LINGMO_PACKAGE_FINDUTILS if !LINGMO_PACKAGE_BUSYBOX # runtime
	select LINGMO_PACKAGE_GREP if !LINGMO_PACKAGE_BUSYBOX # runtime
	select LINGMO_PACKAGE_GZIP if !LINGMO_PACKAGE_BUSYBOX # runtime
	select LINGMO_PACKAGE_SED if !LINGMO_PACKAGE_BUSYBOX # runtime
	select LINGMO_PACKAGE_TAR if !LINGMO_PACKAGE_BUSYBOX # runtime
	select LINGMO_PACKAGE_BUSYBOX_SHOW_OTHERS # bash
	select LINGMO_PACKAGE_BASH # runtime
	select LINGMO_PACKAGE_PYTHON3 # runtime
	help
	  Helper scripts for use with the opkg package manager.

	  https://git.yoctoproject.org/cgit/cgit.cgi/opkg-utils/

comment "opkg-utils needs a toolchain w/ wchar, threads, dynamic library"
	depends on !LINGMO_nios2 || LINGMO_PACKAGE_BUSYBOX
	depends on LINGMO_USE_MMU
	depends on !LINGMO_USE_WCHAR || !LINGMO_TOOLCHAIN_HAS_THREADS || LINGMO_STATIC_LIBS
```

## package/opkg/Config.in
```kconfig
comment "opkg needs a toolchain w/ wchar"
	depends on LINGMO_USE_MMU
	depends on !LINGMO_USE_WCHAR

config LINGMO_PACKAGE_OPKG
	bool "opkg"
	depends on LINGMO_USE_MMU # fork()
	depends on LINGMO_USE_WCHAR # libarchive
	select LINGMO_PACKAGE_LIBARCHIVE
	help
	  Opkg is a lightweight package management system, based on
	  ipkg. It is written in C and resembles apt/dpkg in
	  operation. It is intended for use on embedded Linux devices.
	  Opkg is maintained, stable, robust and conservative in its
	  memory usage, despite its buggy ipkg ancestry. As best it
	  can, opkg maintains backwards compatibility with ipkg and
	  conforms to a subset of debian's policy manual regarding
	  control files.

	  https://code.google.com/archive/p/opkg/

if LINGMO_PACKAGE_OPKG

config LINGMO_PACKAGE_OPKG_GPG_SIGN
	bool "gnupg support"
	depends on LINGMO_PACKAGE_LIBGPG_ERROR_ARCH_SUPPORTS # libgpg-error
	select LINGMO_PACKAGE_LIBGPGME
	select LINGMO_PACKAGE_LIBGPG_ERROR
	help
	  Enable opkg package signature checking support using
	  gnupg/libgpgme.

endif
```

## package/oprofile/Config.in
```kconfig
# memory barrier function implemented only for some architectures
config LINGMO_PACKAGE_OPROFILE_ARCH_SUPPORTS
	bool
	default y
	depends on LINGMO_arceb || LINGMO_arcle || LINGMO_arm || LINGMO_armeb || \
		LINGMO_aarch64 || LINGMO_aarch64_be || LINGMO_i386 || LINGMO_mips || \
		LINGMO_mipsel || LINGMO_mips64 || LINGMO_mips64el || LINGMO_powerpc || \
		LINGMO_powerpc64 || LINGMO_powerpc64le || LINGMO_s390x || LINGMO_sh || \
		LINGMO_sparc || LINGMO_sparc64 || LINGMO_x86_64

config LINGMO_PACKAGE_OPROFILE_NEEDS_LIBPFM4
	bool
	default y if LINGMO_powerpc || LINGMO_powerpc64 || LINGMO_powerpc64le

config LINGMO_PACKAGE_OPROFILE
	bool "oprofile"
	depends on LINGMO_USE_MMU # fork()
	depends on LINGMO_INSTALL_LIBSTDCPP
	depends on LINGMO_USE_WCHAR # binutils
	depends on LINGMO_PACKAGE_OPROFILE_ARCH_SUPPORTS
	# libpfm4 is needed on PowerPC, and requires thread support
	depends on LINGMO_TOOLCHAIN_HAS_THREADS_NPTL || !LINGMO_PACKAGE_OPROFILE_NEEDS_LIBPFM4
	select LINGMO_PACKAGE_POPT
	select LINGMO_PACKAGE_BINUTILS
	select LINGMO_PACKAGE_LIBPFM4 if LINGMO_PACKAGE_OPROFILE_NEEDS_LIBPFM4
	help
	  OProfile is a system-wide profiler for Linux systems,
	  capable of profiling all running code at low overhead.
	  OProfile is released under the GNU GPL.

	  It consists of a kernel driver and a daemon for collecting
	  sample data, and several post-profiling tools for turning
	  data into information.

	  OProfile leverages the hardware performance counters of the
	  CPU to enable profiling of a wide variety of interesting
	  statistics, which can also be used for basic time-spent
	  profiling. All code is profiled: hardware and software
	  interrupt handlers, kernel modules, the kernel, shared
	  libraries, and applications.

	  https://sourceforge.net/projects/oprofile/

comment "oprofile needs a toolchain w/ C++, wchar"
	depends on LINGMO_USE_MMU
	depends on LINGMO_PACKAGE_OPROFILE_ARCH_SUPPORTS
	depends on !LINGMO_INSTALL_LIBSTDCPP || !LINGMO_USE_WCHAR

comment "oprofile needs a toolchain w/ NPTL on PowerPC(64)"
	depends on LINGMO_USE_MMU && LINGMO_PACKAGE_OPROFILE_NEEDS_LIBPFM4
	depends on !LINGMO_TOOLCHAIN_HAS_THREADS_NPTL
```

## package/optee-client/Config.in
```kconfig
config LINGMO_PACKAGE_OPTEE_CLIENT
	bool "optee-client"
	depends on LINGMO_TOOLCHAIN_HAS_THREADS
	depends on LINGMO_TOOLCHAIN_HEADERS_AT_LEAST_4_3 # MMC_IOC_MULTI_CMD
	depends on LINGMO_USE_MMU # fork()
	help
	  Enable the OP-TEE client package that brings non-secure
	  client application resources for OP-TEE support. OP-TEE
	  client is a component delivered by the OP-TEE project.

	  The client API library allows application to invoke trusted
	  applications hosted in the OP-TEE OS secure world.  The
	  supplicant provides services hosted by the non-secure world
	  and invoked by the secure world.

	  https://github.com/OP-TEE/optee_client

if LINGMO_PACKAGE_OPTEE_CLIENT

config LINGMO_PACKAGE_OPTEE_CLIENT_TEE_FS_PATH
	string "Path for normal world OS secure storage"
	default "/data/tee"
	help
	  Path to storage area for secure storage based on the
	  normal world OS providing the actual storage via
	  tee-supplicant.

config LINGMO_PACKAGE_OPTEE_CLIENT_RPMB_EMU
	bool "Enable RPMB emulation"
	default y
	help
	  Enable RPMB device emulation in tee-supplicant.

config LINGMO_PACKAGE_OPTEE_CLIENT_SUPP_PLUGINS
	bool "Enable TEE supplicant plugins"
	default y
	depends on !LINGMO_STATIC_LIBS # dlfcn.h
	help
	  Enable TEE supplicant plugin support.

config LINGMO_PACKAGE_OPTEE_CLIENT_TEEACL
	bool "Enable TEE Access Control List login"
	select LINGMO_PACKAGE_UTIL_LINUX
	select LINGMO_PACKAGE_UTIL_LINUX_LIBUUID
	help
	  Enable TEE ACL login identification for OP-TEE service that
	  supports them as OP-TEE PKCS#11 services.

endif

comment "optee-client needs a toolchain w/ threads, headers >= 4.3"
	depends on LINGMO_USE_MMU
	depends on !LINGMO_TOOLCHAIN_HAS_THREADS || \
		!LINGMO_TOOLCHAIN_HEADERS_AT_LEAST_4_3
```

## package/optee-examples/Config.in
```kconfig
config LINGMO_PACKAGE_OPTEE_EXAMPLES
	bool "optee-examples"
	depends on LINGMO_TARGET_OPTEE_OS
	depends on LINGMO_TOOLCHAIN_HAS_THREADS # optee-client
	depends on !LINGMO_STATIC_LIBS # optee-client
	depends on LINGMO_TOOLCHAIN_HEADERS_AT_LEAST_4_3 # optee-client
	depends on LINGMO_USE_MMU # optee-client
	select LINGMO_PACKAGE_OPTEE_CLIENT
	select LINGMO_TARGET_OPTEE_OS_SDK
	help
	  Enable the OP-TEE examples package that brings examples of
	  implementation of OP-TEE non-secure client applications and
	  secure trusted applications. OP-TEE examples is a
	  component delivered by the OP-TEE project.

	  Trusted application binary files are installed in the target
	  directory /lib/optee_armtz as other trusted applications.
	  At runtime OP-TEE OS can load trusted applications from this
	  non-secure filesystem/directory into the secure world for
	  execution.

	  https://github.com/linaro-swg/optee_examples

comment "optee-examples needs a toolchain w/ threads, dynamic library, headers >= 4.3"
	depends on LINGMO_TARGET_OPTEE_OS
	depends on LINGMO_USE_MMU
	depends on !LINGMO_TOOLCHAIN_HAS_THREADS || LINGMO_STATIC_LIBS || \
		!LINGMO_TOOLCHAIN_HEADERS_AT_LEAST_4_3
```

## package/optee-test/Config.in
```kconfig
config LINGMO_PACKAGE_OPTEE_TEST
	bool "optee-test"
	depends on LINGMO_TARGET_OPTEE_OS
	depends on LINGMO_TOOLCHAIN_HAS_THREADS # optee-client
	depends on LINGMO_INSTALL_LIBSTDCPP
	depends on !LINGMO_STATIC_LIBS # optee-client
	depends on LINGMO_TOOLCHAIN_HEADERS_AT_LEAST_4_3 # optee-client
	depends on LINGMO_USE_MMU # optee-client
	select LINGMO_PACKAGE_OPTEE_CLIENT
	select LINGMO_TARGET_OPTEE_OS_SDK
	help
	  This build option enables OP-TEE test package from the
	  OP-TEE project. It helps platforms to verify the OP-TEE
	  installation against a set of regression and performance
	  tests.

	  The package generates userspace test applications and
	  data files for the Linux userland. It also generates
	  OP-TEE trusted applications.

	  Trusted application binary files are installed in the target
	  directory /lib/optee_armtz as other trusted applications.
	  At runtime OP-TEE OS can load trusted applications from this
	  non-secure filesystem/directory into the secure world for
	  execution.

	  http://github.com/OP-TEE/optee_test

comment "optee-test needs a toolchain w/ threads, C++, dynamic library, headers >= 4.3"
	depends on LINGMO_TARGET_OPTEE_OS
	depends on LINGMO_USE_MMU
	depends on !LINGMO_TOOLCHAIN_HAS_THREADS || !LINGMO_INSTALL_LIBSTDCPP || \
		LINGMO_STATIC_LIBS || !LINGMO_TOOLCHAIN_HEADERS_AT_LEAST_4_3
```

## package/opus-tools/Config.in
```kconfig
config LINGMO_PACKAGE_OPUS_TOOLS
	bool "opus-tools"
	select LINGMO_PACKAGE_LIBOGG
	select LINGMO_PACKAGE_LIBOPUSENC
	select LINGMO_PACKAGE_OPUS
	select LINGMO_PACKAGE_OPUSFILE
	help
	  Opus codec command line tools. This package provides the
	  reference implementations of encoder and decoder utilities
	  for libopus.

	  http://opus-codec.org
```

## package/opus/Config.in
```kconfig
config LINGMO_PACKAGE_OPUS
	bool "opus"
	help
	  The Opus codec is designed for interactive speech and audio
	  transmission over the Internet. It is designed by the IETF
	  Codec Working Group and incorporates technology from Skype's
	  SILK codec and Xiph.Org's CELT codec.

	  It is intended to suit a wide range of interactive audio
	  applications, including Voice over IP, videoconferencing,
	  in-game chat, and even remote live music performances. It
	  can scale from low bit-rate narrowband speech to very high
	  quality stereo music.

	  http://opus-codec.org

if LINGMO_PACKAGE_OPUS

config LINGMO_PACKAGE_OPUS_FIXED_POINT
	bool "use fixed-point" if !LINGMO_SOFT_FLOAT
	default y if LINGMO_SOFT_FLOAT
	help
	  Compile without floating point operations (for machines
	  without a fast enough FPU).

endif
```

## package/opusfile/Config.in
```kconfig
config LINGMO_PACKAGE_OPUSFILE
	bool "opusfile"
	select LINGMO_PACKAGE_LIBOGG
	select LINGMO_PACKAGE_OPUS
	help
	  A convenient high-level API for decoding and basic
	  manipulation of all Ogg Opus audio streams.

	  http://opus-codec.org
```

## package/orbit/Config.in
```kconfig
config LINGMO_PACKAGE_ORBIT
	bool "orbit"
	depends on LINGMO_PACKAGE_LUA_5_1 || LINGMO_PACKAGE_LUAJIT
	select LINGMO_PACKAGE_LPEG # runtime
	select LINGMO_PACKAGE_LUAFILESYSTEM # runtime
	select LINGMO_PACKAGE_WSAPI_XAVANTE # runtime
	help
	  An MVC web framework for Lua. The design is inspired by
	  lightweight Ruby frameworks such as Camping

	  http://keplerproject.github.com/orbit

comment "orbit needs a Lua 5.1 interpreter"
	depends on !LINGMO_PACKAGE_LUA_5_1
	depends on !LINGMO_PACKAGE_LUAJIT
```

## package/orc/Config.in
```kconfig
config LINGMO_PACKAGE_ORC
	bool "orc"
	depends on LINGMO_TOOLCHAIN_HAS_THREADS
	help
	  Orc is a library and set of tools for compiling and executing
	  very simple programs that operate on arrays of data.

	  https://gstreamer.freedesktop.org/projects/orc.html

comment "orc needs a toolchain w/ threads"
	depends on !LINGMO_TOOLCHAIN_HAS_THREADS
```
