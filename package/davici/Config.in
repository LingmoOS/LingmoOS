## package/davici/Config.in
```kconfig
comment "davici needs a toolchain w/ threads, dynamic library"
	depends on LINGMO_USE_MMU
	depends on LINGMO_TOOLCHAIN_HAS_ATOMIC
	depends on !LINGMO_TOOLCHAIN_HAS_THREADS || LINGMO_STATIC_LIBS

config LINGMO_PACKAGE_DAVICI
	bool "davici"
	depends on LINGMO_USE_MMU # fork()
	depends on LINGMO_TOOLCHAIN_HAS_THREADS
	depends on LINGMO_TOOLCHAIN_HAS_ATOMIC
	depends on !LINGMO_STATIC_LIBS
	select LINGMO_PACKAGE_STRONGSWAN
	help
	  davici is an alternative implementation of the VICI
	  client protocol, targeting better integration in other
	  software stacks.

	  https://github.com/strongswan/davici
```

## package/dawgdic/Config.in
```kconfig
config LINGMO_PACKAGE_DAWGDIC
	bool "dawgdic"
	depends on LINGMO_INSTALL_LIBSTDCPP
	# needs std::strtoll
	depends on LINGMO_TOOLCHAIN_GCC_AT_LEAST_4_6
	help
	  dawgdic provides a library for building and accessing
	  dictionaries implemented with directed acyclic word graphs
	  (DAWG). A dawg is constructed by minimizing a trie as a
	  deterministic finite automaton (DFA), and thus the dawg has
	  an advantage in memory usage. In addition, dawgdic uses a
	  double-array as a base data structure, so its retrieval
	  speed is as fast as that of Darts, a library for building
	  and accessing double-array tries.

	  https://github.com/stil/dawgdic

comment "dawgdic needs a toolchain w/ C++, gcc >= 4.6"
	depends on !LINGMO_INSTALL_LIBSTDCPP || !LINGMO_TOOLCHAIN_GCC_AT_LEAST_4_6
```

## package/dbus-broker/Config.in
```kconfig
config LINGMO_PACKAGE_DBUS_BROKER
	bool "dbus-broker"
	depends on LINGMO_USE_MMU
	depends on LINGMO_TOOLCHAIN_HAS_THREADS
	depends on LINGMO_TOOLCHAIN_HEADERS_AT_LEAST_4_17
	depends on LINGMO_PACKAGE_SYSTEMD
	select LINGMO_PACKAGE_EXPAT
	select LINGMO_PACKAGE_LIBCAP_NG if LINGMO_PACKAGE_AUDIT
	help
	  Linux D-Bus Message Broker.

	  The dbus-broker project is an implementation of a message bus
	  as defined by the D-Bus specification. Its aim is to provide
	  high performance and reliability, while keeping compatibility
	  to the D-Bus reference implementation.

	  It is exclusively written for Linux systems, and makes use of
	  many modern features provided by recent linux kernel releases.

	  https://github.com/bus1/dbus-broker/wiki

comment "dbusbroker needs systemd and a toolchain w/ threads"
	depends on LINGMO_USE_MMU
	depends on !LINGMO_TOOLCHAIN_HAS_THREADS || !LINGMO_PACKAGE_SYSTEMD
```

## package/dbus-cpp/Config.in
```kconfig
config LINGMO_PACKAGE_DBUS_CPP
	bool "dbus-c++"
	depends on LINGMO_PACKAGE_DBUS
	depends on LINGMO_TOOLCHAIN_HAS_THREADS # dbus
	depends on LINGMO_USE_MMU # dbus
	depends on LINGMO_INSTALL_LIBSTDCPP
	depends on !LINGMO_TOOLCHAIN_USES_MUSL # no PTHREAD_RECURSIVE_MUTEX_*
	select LINGMO_PACKAGE_EXPAT
	help
	  dbus-c++ attempts to provide a C++ API for D-BUS.
	  The library has a glib/gtk and an Ecore mainloop integration.
	  It also offers an optional own main loop.

	  http://sourceforge.net/projects/dbus-cplusplus/

comment "dbus-c++ needs a uClibc or glibc toolchain w/ C++, threads"
	depends on LINGMO_USE_MMU
	depends on LINGMO_PACKAGE_DBUS
	depends on !LINGMO_INSTALL_LIBSTDCPP || !LINGMO_TOOLCHAIN_HAS_THREADS \
		|| LINGMO_TOOLCHAIN_USES_MUSL
```

## package/dbus-cxx/Config.in
```kconfig
config LINGMO_PACKAGE_DBUS_CXX
	bool "dbus-cxx"
	depends on LINGMO_USE_MMU # dbus
	depends on LINGMO_INSTALL_LIBSTDCPP
	depends on LINGMO_TOOLCHAIN_GCC_AT_LEAST_7 # libsigc
	depends on LINGMO_TOOLCHAIN_HAS_THREADS
	depends on !LINGMO_STATIC_LIBS
	select LINGMO_PACKAGE_DBUS # runtime
	select LINGMO_PACKAGE_LIBSIGC
	help
	  DBus-cxx is a C++ implementation for DBus. DBus is a
	  Linux-specific RPC (remote procedure call) and
	  IPC (inter-process communications) mechanism.
	  DBus-cxx provides an object-oriented view of all programs
	  on the DBus, and allows an object-oriented way of
	  exporting methods onto the DBus.

	  https://dbus-cxx.github.io/

comment "dbus-cxx needs a toolchain w/ C++, threads, gcc >= 7 and dynamic library support"
	depends on LINGMO_USE_MMU # dbus
	depends on !LINGMO_INSTALL_LIBSTDCPP || LINGMO_STATIC_LIBS || \
		!LINGMO_TOOLCHAIN_HAS_THREADS || \
		!LINGMO_TOOLCHAIN_GCC_AT_LEAST_7
```

## package/dbus-glib/Config.in
```kconfig
config LINGMO_PACKAGE_DBUS_GLIB
	bool "dbus-glib"
	depends on LINGMO_PACKAGE_DBUS
	depends on LINGMO_USE_WCHAR # glib2
	depends on LINGMO_TOOLCHAIN_HAS_THREADS # glib2
	depends on LINGMO_USE_MMU # glib2
	select LINGMO_PACKAGE_LIBGLIB2
	help
	  GLib bindings for D-Bus.

	  http://www.freedesktop.org/software/dbus

comment "dbus-glib needs a toolchain w/ wchar, threads"
	depends on LINGMO_USE_MMU
	depends on LINGMO_PACKAGE_DBUS
	depends on !LINGMO_USE_WCHAR || !LINGMO_TOOLCHAIN_HAS_THREADS
```

## package/dbus-python/Config.in
```kconfig
config LINGMO_PACKAGE_DBUS_PYTHON
	bool "dbus-python"
	depends on LINGMO_USE_WCHAR # glib2
	depends on LINGMO_TOOLCHAIN_HAS_THREADS # glib2
	depends on LINGMO_PACKAGE_DBUS
	depends on LINGMO_PACKAGE_PYTHON3
	select LINGMO_PACKAGE_LIBGLIB2
	select LINGMO_PACKAGE_PYTHON3_PYEXPAT # runtime
	help
	  Python bindings for D-Bus

	  http://dbus.freedesktop.org/doc/dbus-python/

comment "dbus-python needs a toolchain w/ wchar, threads"
	depends on LINGMO_PACKAGE_DBUS && LINGMO_PACKAGE_PYTHON3
	depends on !LINGMO_USE_WCHAR || !LINGMO_TOOLCHAIN_HAS_THREADS
```

## package/dbus-triggerd/Config.in
```kconfig
config LINGMO_PACKAGE_DBUS_TRIGGERD
	bool "dbus-triggerd"
	depends on LINGMO_USE_MMU # fork(), dbus
	depends on LINGMO_TOOLCHAIN_HAS_THREADS # dbus
	depends on LINGMO_PACKAGE_DBUS
	help
	  dbus-triggerd is a tool to trigger shell-commands upon
	  receiving a given dbus-signal.

	  http://gareus.org/oss/dbustriggerd/start

comment "dbus-triggerd needs a toolchain w/ threads"
	depends on LINGMO_USE_MMU
	depends on LINGMO_PACKAGE_DBUS
	depends on !LINGMO_TOOLCHAIN_HAS_THREADS
```

## package/dbus/Config.in
```kconfig
config LINGMO_PACKAGE_DBUS
	bool "dbus"
	depends on LINGMO_TOOLCHAIN_HAS_THREADS
	# uses fork()
	depends on LINGMO_USE_MMU
	select LINGMO_PACKAGE_EXPAT
	help
	  The D-Bus message bus system.

	  https://www.freedesktop.org/wiki/Software/dbus

comment "dbus needs a toolchain w/ threads"
	depends on LINGMO_USE_MMU
	depends on !LINGMO_TOOLCHAIN_HAS_THREADS
```

## package/dc3dd/Config.in
```kconfig
config LINGMO_PACKAGE_DC3DD
	bool "dc3dd"
	depends on !LINGMO_RISCV_32
	depends on !LINGMO_arc
	depends on LINGMO_TOOLCHAIN_HAS_THREADS
	depends on !LINGMO_TOOLCHAIN_USES_MUSL
	help
	  dc3dd is a patch to the GNU dd program, this version has
	  several features intended for forensic acquisition of data.
	  Highlights include hashing on-the-fly, split output files,
	  pattern writing, a progress meter, and file verification.

	  https://sourceforge.net/projects/dc3dd/

comment "dc3dd needs a glibc or uClibc toolchain w/ threads"
	depends on !LINGMO_RISCV_32
	depends on !LINGMO_arc
	depends on !LINGMO_TOOLCHAIN_HAS_THREADS || \
		LINGMO_TOOLCHAIN_USES_MUSL
```

## package/delve/Config.in
```kconfig
# Supported architectures are listed in
# pkg/proc/native/support_sentinel.go
config LINGMO_PACKAGE_DELVE_ARCH_SUPPORTS
	bool
	default y if LINGMO_aarch64
	default y if LINGMO_i386
	default y if LINGMO_x86_64
	depends on LINGMO_PACKAGE_HOST_GO_TARGET_ARCH_SUPPORTS
	depends on LINGMO_PACKAGE_HOST_GO_TARGET_CGO_LINKING_SUPPORTS

config LINGMO_PACKAGE_DELVE
	bool "delve"
	depends on LINGMO_PACKAGE_DELVE_ARCH_SUPPORTS
	depends on LINGMO_TOOLCHAIN_HAS_THREADS
	help
	  Delve is a debugger for the Go programming language.

	  https://github.com/go-delve/delve

comment "delve needs a toolchain w/ threads"
	depends on LINGMO_PACKAGE_DELVE_ARCH_SUPPORTS
	depends on !LINGMO_TOOLCHAIN_HAS_THREADS
```

## package/depot-tools/Config.in.host
```kconfig
config LINGMO_PACKAGE_HOST_DEPOT_TOOLS
	bool "host depot-tools"
	select LINGMO_PACKAGE_HOST_PYTHON3
	select LINGMO_PACKAGE_HOST_PYTHON3_SSL
	select LINGMO_PACKAGE_HOST_PYTHON_SIX
	help
	  Chromium and Chromium OS use a package of scripts called
	  depot_tools to manage checkouts and code reviews.

	  https://www.chromium.org/developers/how-tos/install-depot-tools/
```

## package/dfu-util/Config.in
```kconfig
config LINGMO_PACKAGE_DFU_UTIL
	bool "dfu-util"
	depends on LINGMO_TOOLCHAIN_HAS_THREADS
	depends on LINGMO_TOOLCHAIN_GCC_AT_LEAST_4_9 # libusb
	select LINGMO_PACKAGE_LIBUSB
	help
	  Dfu-util is the host side implementation of the DFU 1.0 and
	  DFU 1.1 specification of the USB forum.
	  DFU is intended to download and upload firmware to devices
	  connected over USB.

	  http://dfu-util.sourceforge.net/

comment "dfu-util needs a toolchain w/ threads, gcc >= 4.9"
	depends on !LINGMO_TOOLCHAIN_HAS_THREADS || \
		!LINGMO_TOOLCHAIN_GCC_AT_LEAST_4_9
```

## package/dhcpcd/Config.in
```kconfig
comment "dhcpcd needs a toolchain w/ headers >= 3.1"
	depends on !LINGMO_TOOLCHAIN_HEADERS_AT_LEAST_3_1

config LINGMO_PACKAGE_DHCPCD
	bool "dhcpcd"
	depends on LINGMO_TOOLCHAIN_HEADERS_AT_LEAST_3_1 # sa_family_t in linux/socket.h
	help
	  An RFC2131 compliant DHCP client

	  http://roy.marples.name/projects/dhcpcd/

if LINGMO_PACKAGE_DHCPCD

config LINGMO_PACKAGE_DHCPCD_ENABLE_PRIVSEP
	bool
	default y
	depends on LINGMO_USE_MMU
	# Audit headers were only added in recent kernels for some arches
	depends on !(LINGMO_arceb || LINGMO_arcle) || \
		LINGMO_TOOLCHAIN_HEADERS_AT_LEAST_5_2
	depends on !(LINGMO_microblazeel || LINGMO_microblazebe) || \
		LINGMO_TOOLCHAIN_HEADERS_AT_LEAST_3_18
	depends on !LINGMO_nios2 || LINGMO_TOOLCHAIN_HEADERS_AT_LEAST_5_2
	depends on !LINGMO_or1k || LINGMO_TOOLCHAIN_HEADERS_AT_LEAST_3_7
	depends on !LINGMO_sh || LINGMO_TOOLCHAIN_HEADERS_AT_LEAST_3_7
	depends on !LINGMO_xtensa || LINGMO_TOOLCHAIN_HEADERS_AT_LEAST_5_0

endif
```

## package/dhcpdump/Config.in
```kconfig
config LINGMO_PACKAGE_DHCPDUMP
	bool "dhcpdump"
	select LINGMO_PACKAGE_LIBPCAP
	help
	  A tool for monitoring dhcp requests using tcpdump.

	  http://www.mavetju.org/unix/general.php
```

## package/dht/Config.in
```kconfig
config LINGMO_PACKAGE_DHT
	bool "dht"
	help
	  BitTorrent DHT library

	  https://www.irif.fr/~jch/software/bittorrent
```

## package/dialog/Config.in
```kconfig
config LINGMO_PACKAGE_DIALOG
	bool "dialog"
	depends on LINGMO_USE_MMU # fork()
	select LINGMO_PACKAGE_NCURSES
	select LINGMO_PACKAGE_LIBICONV if !LINGMO_ENABLE_LOCALE
	help
	  dialog - display dialog boxes from shell scripts

	  This application provides a method of displaying several
	  different types of dialog boxes from shell scripts. This
	  allows a developer of a script to interact with the user in a
	  much friendlier manner.

	  http://invisible-island.net/dialog/dialog.html
```

## package/diffutils/Config.in
```kconfig
config LINGMO_PACKAGE_DIFFUTILS
	bool "diffutils"
	depends on LINGMO_USE_WCHAR
	depends on LINGMO_PACKAGE_BUSYBOX_SHOW_OTHERS
	help
	  GNU diff. Compare files per line.

	  http://www.gnu.org/software/diffutils/diffutils.html

comment "diffutils needs a toolchain w/ wchar"
	depends on !LINGMO_USE_WCHAR
	depends on LINGMO_PACKAGE_BUSYBOX_SHOW_OTHERS
```

## package/dillo/Config.in
```kconfig
config LINGMO_PACKAGE_DILLO
	bool "dillo"
	depends on LINGMO_PACKAGE_XORG7
	depends on LINGMO_INSTALL_LIBSTDCPP
	depends on LINGMO_USE_MMU # fltk fork()
	select LINGMO_PACKAGE_FLTK
	select LINGMO_PACKAGE_LIBICONV if !LINGMO_ENABLE_LOCALE
	select LINGMO_PACKAGE_ZLIB
	help
	  Dillo is a multi-platform graphical web browser known
	  for its speed and small footprint.

	  Enable openssl package to gain https support.

	  http://www.dillo.org

comment "dillo needs a toolchain w/ C++"
	depends on LINGMO_PACKAGE_XORG7 && LINGMO_USE_MMU
	depends on !LINGMO_INSTALL_LIBSTDCPP
```
