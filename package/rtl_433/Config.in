## package/rtl_433/Config.in
```kconfig
config LINGMO_PACKAGE_RTL_433
	bool "rtl_433"
	depends on LINGMO_USE_MMU # fork()
	select LINGMO_PACKAGE_LIBOPENSSL_ENABLE_PSK if LINGMO_PACKAGE_LIBOPENSSL
	help
	  rtl_433 (despite the name) is a generic data receiver, mainly
	  for the 433.92 MHz, 868 MHz (SRD), 315 MHz, 345 MHz, and 915
	  MHz ISM bands.

	  https://github.com/merbanan/rtl_433
```

## package/rtorrent/Config.in
```kconfig
config LINGMO_PACKAGE_RTORRENT
	bool "rtorrent"
	depends on LINGMO_INSTALL_LIBSTDCPP
	depends on LINGMO_USE_WCHAR
	depends on LINGMO_TOOLCHAIN_HAS_THREADS
	depends on LINGMO_USE_MMU # fork()
	# gcc < 4.9 cause an "internal compiler error"
	depends on LINGMO_TOOLCHAIN_GCC_AT_LEAST_4_9
	depends on LINGMO_TOOLCHAIN_HAS_SYNC_1 && LINGMO_TOOLCHAIN_HAS_SYNC_4
	select LINGMO_PACKAGE_LIBCURL
	select LINGMO_PACKAGE_LIBTORRENT
	select LINGMO_PACKAGE_NCURSES
	select LINGMO_PACKAGE_OPENSSL
	help
	  BitTorrent Client using libtorrent

	  https://github.com/rakshasa/rtorrent

comment "rtorrent needs a toolchain w/ C++, threads, wchar, gcc >= 4.9"
	depends on LINGMO_USE_MMU
	depends on LINGMO_TOOLCHAIN_HAS_SYNC_1 && LINGMO_TOOLCHAIN_HAS_SYNC_4
	depends on !(LINGMO_INSTALL_LIBSTDCPP && LINGMO_USE_WCHAR && \
		LINGMO_TOOLCHAIN_HAS_THREADS && LINGMO_TOOLCHAIN_GCC_AT_LEAST_4_9)
```

## package/rtty/Config.in
```kconfig
config LINGMO_PACKAGE_RTTY
	bool "rtty"
	depends on LINGMO_USE_MMU # fork()
	select LINGMO_PACKAGE_LIBEV
	help
	  Access your device's terminal from anywhere via the web.

	  https://github.com/zhaojh329/rtty
```

## package/rubix/Config.in
```kconfig
config LINGMO_PACKAGE_RUBIX
	bool "rubix"
	depends on LINGMO_PACKAGE_XORG7
	select LINGMO_PACKAGE_XLIB_LIBX11
	help
	  A 3D rubiks cube game for X

	  http://sed.free.fr/rubix
```

## package/ruby/Config.in
```kconfig
config LINGMO_PACKAGE_RUBY
	bool "ruby"
	depends on LINGMO_USE_WCHAR
	depends on LINGMO_TOOLCHAIN_HAS_THREADS
	depends on !LINGMO_STATIC_LIBS
	depends on LINGMO_TOOLCHAIN_GCC_AT_LEAST_4_9
	depends on LINGMO_HOST_GCC_AT_LEAST_4_9
	help
	  Object Oriented Scripting Language.

	  http://www.ruby-lang.org/

comment "ruby needs a toolchain w/ wchar, threads, dynamic library, gcc >= 4.9, host gcc >= 4.9"
	depends on !LINGMO_USE_WCHAR || !LINGMO_TOOLCHAIN_HAS_THREADS || \
		LINGMO_STATIC_LIBS || !LINGMO_TOOLCHAIN_GCC_AT_LEAST_4_9 || \
		!LINGMO_HOST_GCC_AT_LEAST_4_9
```

## package/runc/Config.in
```kconfig
config LINGMO_PACKAGE_RUNC
	bool "runc"
	depends on LINGMO_PACKAGE_HOST_GO_TARGET_ARCH_SUPPORTS
	depends on LINGMO_PACKAGE_HOST_GO_TARGET_CGO_LINKING_SUPPORTS
	depends on LINGMO_TOOLCHAIN_HAS_THREADS
	depends on !LINGMO_TOOLCHAIN_USES_UCLIBC # no fexecve
	help
	  runC is a CLI tool for spawning and running containers
	  according to the OCI specification.

	  https://github.com/opencontainers/runc

comment "runc needs a glibc or musl toolchain w/ threads"
	depends on LINGMO_PACKAGE_HOST_GO_TARGET_ARCH_SUPPORTS && \
		LINGMO_PACKAGE_HOST_GO_TARGET_CGO_LINKING_SUPPORTS
	depends on !LINGMO_TOOLCHAIN_HAS_THREADS || LINGMO_TOOLCHAIN_USES_UCLIBC
```

## package/rustc/Config.in.host
```kconfig
# All host rust packages should depend on this option
config LINGMO_PACKAGE_HOST_RUSTC_ARCH_SUPPORTS
	bool
	default y if LINGMO_HOSTARCH = "aarch64"
	default y if LINGMO_HOSTARCH = "powerpc"
	default y if LINGMO_HOSTARCH = "powerpc64"
	default y if LINGMO_HOSTARCH = "powerpc64le"
	default y if LINGMO_HOSTARCH = "riscv64"
	default y if LINGMO_HOSTARCH = "s390x"
	default y if LINGMO_HOSTARCH = "x86"
	default y if LINGMO_HOSTARCH = "x86_64"

# The pre-built Rust standard library is only available for a number
# of architectures/C libraries combinations, with different levels of
# support: Tier 1 platforms, Tier 2 platforms with host tools, Tier 2
# platforms, Tier 3 platforms. Below, we support Tier 1, Tier 2 with
# host tools and Tier 2 platforms.

# The below entries match Tier 1 platforms as described at
# https://doc.rust-lang.org/nightly/rustc/platform-support.html.
config LINGMO_PACKAGE_HOST_RUSTC_TARGET_TIER1_PLATFORMS
	bool
	# aarch64-unknown-linux-gnu
	default y if LINGMO_aarch64 && LINGMO_TOOLCHAIN_USES_GLIBC
	# i686-unknown-linux-gnu
	default y if (LINGMO_x86_i686 || LINGMO_x86_pentiumpro || LINGMO_X86_CPU_HAS_MMX) && LINGMO_TOOLCHAIN_USES_GLIBC
	# x86_64-unknown-linux-gnu
	default y if LINGMO_x86_64 && LINGMO_TOOLCHAIN_USES_GLIBC

# The below entries match Tier 2 platforms with host tools as
# described at
# https://doc.rust-lang.org/nightly/rustc/platform-support.html.
config LINGMO_PACKAGE_HOST_RUSTC_TARGET_TIER2_HOST_TOOLS_PLATFORMS
	bool
	# aarch64-unknown-linux-musl
	default y if LINGMO_aarch64 && LINGMO_TOOLCHAIN_USES_MUSL
	# arm-unknown-linux-gnueabi
	default y if LINGMO_ARM_CPU_ARMV6 && LINGMO_ARM_EABI && LINGMO_TOOLCHAIN_USES_GLIBC
	# arm-unknown-linux-gnueabihf
	default y if LINGMO_ARM_CPU_ARMV6 && LINGMO_ARM_EABIHF && LINGMO_TOOLCHAIN_USES_GLIBC
	# armv7-unknown-linux-gnueabihf
	default y if LINGMO_ARM_CPU_ARMV7A && LINGMO_ARM_EABIHF && LINGMO_TOOLCHAIN_USES_GLIBC
	# armv7-unknown-linux-gnueabihf for armv8 hardware with 32-bit
	# userspace
	default y if LINGMO_arm && LINGMO_ARM_CPU_ARMV8A && LINGMO_ARM_EABIHF && LINGMO_TOOLCHAIN_USES_GLIBC
	# powerpc-unknown-linux-gnu
	default y if LINGMO_powerpc && LINGMO_TOOLCHAIN_USES_GLIBC
	# powerpc64-unknown-linux-gnu
	default y if LINGMO_powerpc64 && LINGMO_TOOLCHAIN_USES_GLIBC
	# powerpc64le-unknown-linux-gnu
	default y if LINGMO_powerpc64le && LINGMO_TOOLCHAIN_USES_GLIBC
	# riscv64gc-unknown-linux-gnu
	# "g" stands for imafd, and we also need "c".
	default y if LINGMO_RISCV_64 && LINGMO_RISCV_ISA_RVI && LINGMO_RISCV_ISA_RVM && \
			LINGMO_RISCV_ISA_RVA && LINGMO_RISCV_ISA_RVF && \
			LINGMO_RISCV_ISA_RVD && LINGMO_RISCV_ISA_RVC && \
			LINGMO_TOOLCHAIN_USES_GLIBC
	# s390x-unknown-linux-gnu
	default y if LINGMO_s390x && LINGMO_TOOLCHAIN_USES_GLIBC
	# x86_64-unknown-linux-musl
	default y if LINGMO_x86_64 && LINGMO_TOOLCHAIN_USES_MUSL

# The below entries match Tier 2 platforms without host tools as
# described at
# https://doc.rust-lang.org/nightly/rustc/platform-support.html.
config LINGMO_PACKAGE_HOST_RUSTC_TARGET_TIER2_PLATFORMS
	bool
	# arm-unknown-linux-musleabi
	default y if LINGMO_ARM_CPU_ARMV6 && LINGMO_ARM_EABI && LINGMO_TOOLCHAIN_USES_MUSL
	# arm-unknown-linux-musleabihf
	default y if LINGMO_ARM_CPU_ARMV6 && LINGMO_ARM_EABIHF && LINGMO_TOOLCHAIN_USES_MUSL
	# armv5te-unknown-linux-gnueabi
	default y if LINGMO_ARM_CPU_ARMV5 && LINGMO_ARM_EABI && LINGMO_TOOLCHAIN_USES_GLIBC
	# armv5te-unknown-linux-musleabi
	default y if LINGMO_ARM_CPU_ARMV5 && LINGMO_ARM_EABI && LINGMO_TOOLCHAIN_USES_MUSL
	# armv7-unknown-linux-gnueabi
	default y if LINGMO_ARM_CPU_ARMV7A && LINGMO_ARM_EABI && LINGMO_TOOLCHAIN_USES_GLIBC
	# armv7-unknown-linux-musleabi
	default y if LINGMO_ARM_CPU_ARMV7A && LINGMO_ARM_EABI && LINGMO_TOOLCHAIN_USES_MUSL
	# armv7-unknown-linux-musleabihf
	default y if LINGMO_ARM_CPU_ARMV7A && LINGMO_ARM_EABIHF && LINGMO_TOOLCHAIN_USES_MUSL
	# armv7-unknown-linux-musleabihf for armv8 hardware with 32-bit
	# userspace
	default y if LINGMO_arm && LINGMO_ARM_CPU_ARMV8A && LINGMO_ARM_EABIHF && LINGMO_TOOLCHAIN_USES_MUSL
	# i586-unknown-linux-gnu
	default y if LINGMO_x86_i586 && LINGMO_TOOLCHAIN_USES_GLIBC
	# i586-unknown-linux-musl
	default y if LINGMO_x86_i586 && LINGMO_TOOLCHAIN_USES_MUSL
	# i686-unknown-linux-musl
	default y if (LINGMO_x86_i686 || LINGMO_x86_pentiumpro || LINGMO_X86_CPU_HAS_MMX) && LINGMO_TOOLCHAIN_USES_MUSL
	# mips-unknown-linux-musl
	default y if LINGMO_mips && LINGMO_TOOLCHAIN_USES_MUSL && !LINGMO_MIPS_CPU_MIPS32R6
	# mips64-unknown-linux-muslabi64
	default y if LINGMO_mips64 && LINGMO_TOOLCHAIN_USES_MUSL && LINGMO_MIPS_NABI64 && !LINGMO_MIPS_CPU_MIPS64R6
	# mips64el-unknown-linux-muslabi64
	default y if LINGMO_mips64el && LINGMO_TOOLCHAIN_USES_MUSL && LINGMO_MIPS_NABI64 && !LINGMO_MIPS_CPU_MIPS64R6
	# mipsel-unknown-linux-musl
	default y if LINGMO_mipsel && LINGMO_TOOLCHAIN_USES_MUSL && !LINGMO_MIPS_CPU_MIPS32R6
	# sparc64-unknown-linux-gnu
	default y if LINGMO_sparc64 && LINGMO_TOOLCHAIN_USES_GLIBC

# All target rust packages should depend on this option
# Note: With musl based toolchain, we need a C++ cross compiler to
# build host-rust some target libraries (libunwind) from llvm source
# code bundled in rust sources.
config LINGMO_PACKAGE_HOST_RUSTC_TARGET_ARCH_SUPPORTS
	bool
	default y if LINGMO_PACKAGE_HOST_RUSTC_TARGET_TIER1_PLATFORMS
	default y if LINGMO_PACKAGE_HOST_RUSTC_TARGET_TIER2_HOST_TOOLS_PLATFORMS
	default y if LINGMO_PACKAGE_HOST_RUSTC_TARGET_TIER2_PLATFORMS
	depends on LINGMO_INSTALL_LIBSTDCPP || !LINGMO_TOOLCHAIN_USES_MUSL
	depends on LINGMO_PACKAGE_HOST_RUSTC_ARCH_SUPPORTS

config LINGMO_PACKAGE_HOST_RUSTC_ARCH
	string
	default "armv5te" if LINGMO_ARM_CPU_ARMV5
	default "arm" if LINGMO_ARM_CPU_ARMV6
	default "armv7"  if LINGMO_ARM_CPU_ARMV7A
	default "armv7"  if LINGMO_ARM_CPU_ARMV7A || (LINGMO_arm && LINGMO_ARM_CPU_ARMV8A)
	default "riscv64gc" if LINGMO_RISCV_64
	default LINGMO_ARCH

config LINGMO_PACKAGE_HOST_RUSTC_ABI
	string
	default "eabi"   if LINGMO_ARM_EABI
	default "eabihf" if LINGMO_ARM_EABIHF
	default "abi64"  if LINGMO_MIPS_NABI64

config LINGMO_PACKAGE_HOST_RUSTC
	bool "host rustc"
	depends on LINGMO_PACKAGE_HOST_RUSTC_ARCH_SUPPORTS
	help
	  Compiler for the Rust language

	  http://www.rust-lang.org

if LINGMO_PACKAGE_HOST_RUSTC

choice
	prompt "Rust compiler variant"
	default LINGMO_PACKAGE_HOST_RUST_BIN
	help
	  Select a Rust compiler

config LINGMO_PACKAGE_HOST_RUST
	bool "host rust"
	# RUSTC_TARGET_NAME must be set for building host-rust
	# otherwise config.toml is broken.
	depends on LINGMO_PACKAGE_HOST_RUSTC_TARGET_ARCH_SUPPORTS
	# triggers ICE on trunc_int_for_mode, at explow.c:56
	depends on LINGMO_TOOLCHAIN_GCC_AT_LEAST_5 || !LINGMO_aarch64
	# rust uses llvm >= 17 since 1.73.0
	select LINGMO_HOST_CMAKE_AT_LEAST_3_20
	help
	  This package will build the compiler for the host as well as
	  two flavors of the standard library: one for the host, another
	  for the target. Both are installed in the host directory.

comment "host-rust needs a toolchain w/ gcc >= 5"
	depends on LINGMO_aarch64
	depends on !LINGMO_TOOLCHAIN_GCC_AT_LEAST_5

config LINGMO_PACKAGE_HOST_RUST_BIN
	bool "host rust (pre-built)"
	help
	  This package will install pre-built versions of the compiler
	  for the host and the Rust standard library for the target.

endchoice

endif

config LINGMO_PACKAGE_PROVIDES_HOST_RUSTC
	string
	default "host-rust" if LINGMO_PACKAGE_HOST_RUST
	# Default to host-rust-bin as long as host arch supports it
	default "host-rust-bin" if !LINGMO_PACKAGE_HOST_RUST
	depends on LINGMO_PACKAGE_HOST_RUSTC_ARCH_SUPPORTS
```

## package/rwmem/Config.in
```kconfig
config LINGMO_PACKAGE_RWMEM
	bool "rwmem"
	depends on LINGMO_TOOLCHAIN_GCC_AT_LEAST_10 # C++20
	depends on LINGMO_INSTALL_LIBSTDCPP
	depends on LINGMO_USE_WCHAR # fmt
	select LINGMO_PACKAGE_FMT
	select LINGMO_PACKAGE_INIH
	help
	  Simple program to read/write from/to any location in memory.

	  https://github.com/tomba/rwmem

comment "rwmem needs a toolchain w/ C++, wchar, gcc >= 10"
	depends on !LINGMO_INSTALL_LIBSTDCPP || !LINGMO_USE_WCHAR || \
		!LINGMO_TOOLCHAIN_GCC_AT_LEAST_10
```

## package/rygel/Config.in
```kconfig
config LINGMO_PACKAGE_RYGEL
	bool "rygel"
	depends on LINGMO_PACKAGE_XORG7
	depends on LINGMO_USE_WCHAR # gupnp-av
	depends on LINGMO_TOOLCHAIN_HAS_THREADS # gupnp-av
	depends on LINGMO_USE_MMU # gupnp-av, gobject-introspection
	depends on LINGMO_PACKAGE_GOBJECT_INTROSPECTION_ARCH_SUPPORTS # gobject-introspection
	depends on LINGMO_TOOLCHAIN_GCC_AT_LEAST_4_9 # gobject-introspection
	depends on LINGMO_HOST_GCC_AT_LEAST_8 # gobject-introspection -> host-qemu
	depends on LINGMO_TOOLCHAIN_USES_GLIBC # gobject-introspection
	depends on LINGMO_PACKAGE_PYTHON3 # gobject-introspection
	select LINGMO_PACKAGE_GDK_PIXBUF
	select LINGMO_PACKAGE_GOBJECT_INTROSPECTION
	select LINGMO_PACKAGE_GUPNP_AV
	select LINGMO_PACKAGE_GUPNP_DLNA
	select LINGMO_PACKAGE_LIBGEE
	select LINGMO_PACKAGE_LIBMEDIAART
	select LINGMO_PACKAGE_SQLITE
	select LINGMO_PACKAGE_XLIB_LIBX11
	help
	  Rygel is a home media solution (UPnP AV MediaServer) that
	  allows you to easily share audio, video and pictures to other
	  devices.

	  Additionally, media player software may use Rygel to become a
	  MediaRenderer that may be controlled remotely by a UPnP or
	  DLNA Controller.

	  Rygel achieves interoperability with other devices in the
	  market by trying to conform to the very strict requirements of
	  DLNA and by converting media on-the-fly to formats that client
	  devices can handle.

	  Most Rygel functionality is implemented through a plug-in
	  mechanism.

	  https://wiki.gnome.org/Projects/Rygel

if LINGMO_PACKAGE_RYGEL

choice
	prompt "media engine"
	default LINGMO_PACKAGE_RYGEL_MEDIA_ENGINE_SIMPLE

config LINGMO_PACKAGE_RYGEL_MEDIA_ENGINE_SIMPLE
	bool "simple"

config LINGMO_PACKAGE_RYGEL_MEDIA_ENGINE_GSTREAMER1
	bool "gstreamer1"
	depends on LINGMO_PACKAGE_GSTREAMER1_EDITING_SERVICES

comment "gstreamer1 needs gst1-editing-services"
	depends on !LINGMO_PACKAGE_GSTREAMER1_EDITING_SERVICES

endchoice

endif # LINGMO_PACKAGE_RYGEL

comment "rygel needs python3 and a glibc toolchain w/ wchar, threads, gcc >= 4.9, host gcc >= 8"
	depends on LINGMO_USE_MMU
	depends on LINGMO_PACKAGE_GOBJECT_INTROSPECTION_ARCH_SUPPORTS
	depends on LINGMO_PACKAGE_XORG7
	depends on !LINGMO_USE_WCHAR || !LINGMO_TOOLCHAIN_HAS_THREADS || \
		!LINGMO_TOOLCHAIN_USES_GLIBC || \
		!LINGMO_TOOLCHAIN_GCC_AT_LEAST_4_9 || \
		!LINGMO_HOST_GCC_AT_LEAST_8 || !LINGMO_PACKAGE_PYTHON3
```

## package/s390-tools/Config.in
```kconfig
comment "s390-tools needs a glibc toolchain w/ C++, wchar, dynamic library"
	depends on LINGMO_s390x
	depends on !LINGMO_TOOLCHAIN_USES_GLIBC || !LINGMO_INSTALL_LIBSTDCPP

config LINGMO_PACKAGE_S390_TOOLS
	bool "s390-tools"
	depends on LINGMO_s390x
	depends on LINGMO_INSTALL_LIBSTDCPP
	depends on LINGMO_TOOLCHAIN_USES_GLIBC
	select LINGMO_PACKAGE_ZLIB
	help
	  Tools for use with the s390 Linux kernel and device drivers.

	  https://github.com/ibm-s390-linux/s390-tools
```

## package/s6-dns/Config.in
```kconfig
config LINGMO_PACKAGE_S6_DNS
	bool "s6-dns"
	depends on LINGMO_USE_MMU # skalibs
	select LINGMO_PACKAGE_SKALIBS
	help
	  s6-dns is a suite of DNS client programs and libraries for
	  Unix systems, as an alternative to the BIND, djbdns or other
	  DNS clients.

	  http://skarnet.org/software/s6-dns/
```

## package/s6-linux-utils/Config.in
```kconfig
config LINGMO_PACKAGE_S6_LINUX_UTILS
	bool "s6-linux-utils"
	depends on LINGMO_USE_MMU # skalibs
	select LINGMO_PACKAGE_SKALIBS
	help
	  s6-linux-utils is a set of minimalistic Linux-specific
	  system utilities.

	  http://skarnet.org/software/s6-linux-utils/
```
