## package/samba4/Config.in
```kconfig
comment "samba4 needs a uClibc or glibc toolchain w/ wchar, dynamic library, NPTL"
	depends on LINGMO_TOOLCHAIN_HAS_SYNC_4
	depends on !LINGMO_USE_WCHAR || LINGMO_TOOLCHAIN_USES_MUSL \
		|| LINGMO_STATIC_LIBS || !LINGMO_TOOLCHAIN_HAS_THREADS_NPTL
	depends on LINGMO_USE_MMU

config LINGMO_PACKAGE_SAMBA4
	bool "samba4"
	depends on LINGMO_USE_MMU # fork()
	depends on LINGMO_USE_WCHAR # python
	depends on LINGMO_TOOLCHAIN_HAS_THREADS_NPTL # python -> libffi
	depends on !LINGMO_STATIC_LIBS # cmocka, python, gnutls
	depends on !LINGMO_nios2 # binary too large, relocations don't fit
	depends on LINGMO_TOOLCHAIN_HAS_SYNC_4
	depends on !LINGMO_TOOLCHAIN_USES_MUSL
	select LINGMO_PACKAGE_CMOCKA
	select LINGMO_PACKAGE_E2FSPROGS
	select LINGMO_PACKAGE_GNUTLS
	select LINGMO_PACKAGE_LIBICONV if !LINGMO_ENABLE_LOCALE
	select LINGMO_PACKAGE_LIBTIRPC if !LINGMO_TOOLCHAIN_HAS_NATIVE_RPC
	select LINGMO_PACKAGE_POPT
	select LINGMO_PACKAGE_ZLIB
	help
	  Provides secure, stable and fast file and print services
	  for all clients using the SMB/CIFS protocol, such as all
	  versions of DOS, Windows, OS/2, Linux and many others.

	  http://www.samba.org/

if LINGMO_PACKAGE_SAMBA4

config LINGMO_PACKAGE_SAMBA4_AD_DC
	bool "AD DC"
	depends on LINGMO_PACKAGE_PYTHON3
	select LINGMO_PACKAGE_JANSSON
	select LINGMO_PACKAGE_PYTHON_DNSPYTHON
	select LINGMO_PACKAGE_PYTHON_MARKDOWN
	select LINGMO_PACKAGE_SAMBA4_ADS
	help
	  Enable Active Directory Domain Controller functionality.

comment "AD DC depends on python3"
	depends on !LINGMO_PACKAGE_PYTHON3

config LINGMO_PACKAGE_SAMBA4_ADS
	bool "ADS"
	select LINGMO_PACKAGE_OPENLDAP
	help
	  Enable Active Directory member Server functionality.

config LINGMO_PACKAGE_SAMBA4_SMBTORTURE
	bool "smbtorture"
	help
	  Install the smbtorture test suite.
	  It's normally used for validation and stress testing.
	  Approximately +5 MB of stripped uncompressed target space.

endif
```

## package/sane-backends/Config.in
```kconfig
config LINGMO_PACKAGE_SANE_BACKENDS
	bool "sane-backends"
	depends on LINGMO_USE_MMU # fork()
	depends on !LINGMO_STATIC_LIBS
	help
	  SANE - Scanner Access Now Easy

	  http://www.sane-project.org

	  Backends are included automatically based on the libraries
	  that have been selected: libusb, jpeg, tiff, avahi (with
	  dbus and libglib2), and netsnmp.

comment "sane-backends needs a toolchain w/ dynamic library"
	depends on LINGMO_USE_MMU
	depends on LINGMO_STATIC_LIBS
```

## package/sconeserver/Config.in
```kconfig
menuconfig LINGMO_PACKAGE_SCONESERVER
	bool "sconeserver"
	depends on LINGMO_INSTALL_LIBSTDCPP
	depends on LINGMO_TOOLCHAIN_HAS_THREADS_NPTL
	depends on !LINGMO_STATIC_LIBS # dlopen()
	select LINGMO_PACKAGE_PCRE
	select LINGMO_PACKAGE_ZLIB
	help
	  Sconeserver is a modular, object-orientated and extremely
	  versatile network server framework for GNU/Linux and
	  UNIX-like platforms.

	  http://www.sconemad.com/sconeserver/

if LINGMO_PACKAGE_SCONESERVER

comment "Sconeserver modules"

config LINGMO_PACKAGE_SCONESERVER_BLUETOOTH
	bool "bluetooth"
	depends on LINGMO_USE_WCHAR # bluez5_utils -> libglib2
	depends on LINGMO_USE_MMU # bluez5_utils -> dbus
	depends on LINGMO_TOOLCHAIN_HAS_THREADS # bluez5_utils -> dbus, libglib2
	depends on !LINGMO_STATIC_LIBS # bluez5_utils
	depends on LINGMO_TOOLCHAIN_HEADERS_AT_LEAST_3_4 # bluez5_utils
	depends on LINGMO_TOOLCHAIN_HAS_SYNC_4 # bluez5_utils
	select LINGMO_PACKAGE_BLUEZ5_UTILS
	help
	  Bluetooth module for Sconeserver

comment "bluetooth support needs a toolchain w/ wchar, threads, dynamic library, headers >= 3.4"
	depends on LINGMO_USE_MMU
	depends on LINGMO_TOOLCHAIN_HAS_SYNC_4
	depends on !LINGMO_USE_WCHAR || !LINGMO_TOOLCHAIN_HAS_THREADS || \
		LINGMO_STATIC_LIBS || !LINGMO_TOOLCHAIN_HEADERS_AT_LEAST_3_4

config LINGMO_PACKAGE_SCONESERVER_EXAMPLES
	bool "examples"
	help
	  Example modules for Sconeserver

config LINGMO_PACKAGE_SCONESERVER_HTTP_SCONESITE
	bool "http::sconesite"
	select LINGMO_PACKAGE_LIBXML2
	help
	  http::sconesite module for Sconeserver

config LINGMO_PACKAGE_SCONESERVER_LOCATION
	bool "location"
	depends on LINGMO_USE_MMU # gpsd
	depends on LINGMO_TOOLCHAIN_HAS_THREADS # gpsd
	depends on !LINGMO_STATIC_LIBS # gpsd
	select LINGMO_PACKAGE_GPSD
	help
	  Location module for Sconeserver

comment "location support needs a toolchain w/ theads, dynamic library"
	depends on LINGMO_USE_MMU
	depends on !LINGMO_TOOLCHAIN_HAS_THREADS || LINGMO_STATIC_LIBS

config LINGMO_PACKAGE_SCONESERVER_MATHS
	bool "maths"
	select LINGMO_PACKAGE_MPFR
	help
	  Mathematics module for Sconeserver

config LINGMO_PACKAGE_SCONESERVER_MYSQL
	bool "mysql"
	depends on LINGMO_USE_MMU # mysql
	select LINGMO_PACKAGE_MARIADB
	help
	  MySQL module for Sconeserver

config LINGMO_PACKAGE_SCONESERVER_RSS
	bool "rss"
	select LINGMO_PACKAGE_LIBXML2
	help
	  RSS module for Sconeserver

config LINGMO_PACKAGE_SCONESERVER_SQLITE
	bool "sqlite"
	select LINGMO_PACKAGE_SQLITE
	help
	  SQLite module for Sconeserver

config LINGMO_PACKAGE_SCONESERVER_TESTBUILDER
	bool "testbuilder"
	help
	  Testbuilder module for Sconeserver

endif # LINGMO_PACKAGE_SCONESERVER

comment "sconeserver needs a toolchain with dynamic library, C++, NPTL"
	depends on !LINGMO_INSTALL_LIBSTDCPP || !LINGMO_TOOLCHAIN_HAS_THREADS_NPTL \
		|| LINGMO_STATIC_LIBS
```

## package/screenfetch/Config.in
```kconfig
config LINGMO_PACKAGE_SCREENFETCH
	bool "screenfetch"
	depends on LINGMO_USE_MMU # bash
	depends on LINGMO_PACKAGE_BUSYBOX_SHOW_OTHERS # bash
	select LINGMO_PACKAGE_BASH # runtime dependency
	help
	  screenFetch is a bash script to display distro info.

	  https://github.com/KittyKatt/screenFetch
```

## package/sdbus-cpp/Config.in
```kconfig
config LINGMO_PACKAGE_SDBUS_CPP
	bool "sdbus-c++"
	depends on LINGMO_INSTALL_LIBSTDCPP
	depends on LINGMO_PACKAGE_SYSTEMD
	depends on LINGMO_TOOLCHAIN_GCC_AT_LEAST_7 # C++17
	help
	  sdbus-c++ is a high-level C++ D-Bus library for Linux
	  designed to provide expressive, easy-to-use API in modern C++.

	  This will build the target library.

	  https://github.com/Kistler-Group/sdbus-cpp

comment "sdbus-c++ needs systemd and a toolchain w/ C++, gcc >= 7"
	depends on !LINGMO_INSTALL_LIBSTDCPP || !LINGMO_PACKAGE_SYSTEMD || \
		!LINGMO_TOOLCHAIN_GCC_AT_LEAST_7
```

## package/sdbusplus/Config.in
```kconfig
config LINGMO_PACKAGE_SDBUSPLUS
	bool "sdbusplus"
	depends on LINGMO_INSTALL_LIBSTDCPP
	depends on LINGMO_PACKAGE_SYSTEMD
	depends on LINGMO_TOOLCHAIN_GCC_AT_LEAST_7 # C++17
	help
	  A C++ library for sd-bus with a bindings and doc generator.

	  This will build the target library.  See the host package for
	  the bindings and documentation generation program.

	  https://github.com/openbmc/sdbusplus

comment "sdbusplus needs systemd and a toolchain w/ C++, gcc >= 7"
	depends on !LINGMO_PACKAGE_SYSTEMD || !LINGMO_INSTALL_LIBSTDCPP || \
		!LINGMO_TOOLCHAIN_GCC_AT_LEAST_7
```

## package/sdl/Config.in
```kconfig
config LINGMO_PACKAGE_SDL
	bool "SDL"
	help
	  Simple DirectMedia Layer - SDL is a library that allows
	  programs portable low level access to a video framebuffer,
	  audio output, mouse, and keyboard.

	  http://www.libsdl.org/

if LINGMO_PACKAGE_SDL

config LINGMO_PACKAGE_SDL_FBCON
	bool "SDL framebuffer console video driver"
	default y

config LINGMO_PACKAGE_SDL_DIRECTFB
	bool "SDL DirectFB video driver"
	depends on LINGMO_PACKAGE_DIRECTFB

config LINGMO_PACKAGE_SDL_X11
	bool "SDL X11 video driver"
	depends on LINGMO_PACKAGE_XORG7
	select LINGMO_PACKAGE_XLIB_LIBX11
	select LINGMO_PACKAGE_XLIB_LIBXEXT

endif
```

## package/sdl2/Config.in
```kconfig
config LINGMO_PACKAGE_SDL2
	bool "sdl2"
	depends on !LINGMO_STATIC_LIBS
	help
	  Simple DirectMedia Layer 2 - SDL2 is a library that allows
	  programs portable low level access to a video framebuffer,
	  audio output, mouse, and keyboard. It is not compatible with
	  SDL1.

	  http://www.libsdl.org/

if LINGMO_PACKAGE_SDL2

config LINGMO_PACKAGE_SDL2_DIRECTFB
	bool "DirectFB video driver"
	depends on LINGMO_PACKAGE_DIRECTFB

comment "DirectFB video driver needs directfb"
	depends on !LINGMO_PACKAGE_DIRECTFB

config LINGMO_PACKAGE_SDL2_X11
	bool "X11 video driver"
	depends on LINGMO_PACKAGE_XORG7
	depends on LINGMO_USE_MMU # fork()
	select LINGMO_PACKAGE_XLIB_LIBX11
	select LINGMO_PACKAGE_XLIB_LIBXEXT

comment "X11 video driver needs X.org"
	depends on !LINGMO_PACKAGE_XORG7
	depends on LINGMO_USE_MMU

config LINGMO_PACKAGE_SDL2_KMSDRM
	bool "KMS/DRM video driver"
	depends on LINGMO_TOOLCHAIN_HAS_THREADS  # libdrm
	depends on LINGMO_PACKAGE_HAS_LIBGBM
	depends on LINGMO_PACKAGE_HAS_LIBEGL
	depends on LINGMO_PACKAGE_SDL2_OPENGL || LINGMO_PACKAGE_SDL2_OPENGLES
	select LINGMO_PACKAGE_LIBDRM

comment "KMS/DRM video driver needs a toolchain w/ threads"
	depends on !LINGMO_TOOLCHAIN_HAS_THREADS

comment "KMS/DRM video driver needs a GBM provider, and OpenGL or OpenGLES+EGL"
	depends on !LINGMO_PACKAGE_HAS_LIBGBM || \
		!LINGMO_PACKAGE_HAS_LIBEGL || \
		!(LINGMO_PACKAGE_SDL2_OPENGL || LINGMO_PACKAGE_SDL2_OPENGLES)

config LINGMO_PACKAGE_SDL2_OPENGL
	bool "OpenGL (GLX)"
	depends on LINGMO_PACKAGE_HAS_LIBGL
	depends on LINGMO_PACKAGE_XORG7
	depends on LINGMO_USE_MMU # X11 video driver
	select LINGMO_PACKAGE_SDL2_X11

comment "OpenGL support needs X11 and an OpenGL provider"
	depends on LINGMO_USE_MMU
	depends on !LINGMO_PACKAGE_HAS_LIBGL || !LINGMO_PACKAGE_XORG7

config LINGMO_PACKAGE_SDL2_OPENGLES
	bool "OpenGL ES"
	depends on LINGMO_PACKAGE_HAS_LIBGLES

comment "OpenGL ES support needs an OpenGL ES provider"
	depends on !LINGMO_PACKAGE_HAS_LIBGLES

endif

comment "sdl2 needs a toolchain w/ dynamic library"
	depends on LINGMO_STATIC_LIBS
```

## package/sdl2_ttf/Config.in
```kconfig
config LINGMO_PACKAGE_SDL2_TTF
	bool "sdl2_ttf"
	depends on LINGMO_PACKAGE_SDL2
	select LINGMO_PACKAGE_FREETYPE
	help
	  SDL2_ttf is a sample TrueType font library. It allows you to
	  use TrueType fonts in your SDL2 applications.

	  http://www.libsdl.org/projects/SDL_ttf/
```

## package/sdl_image/Config.in
```kconfig
menuconfig LINGMO_PACKAGE_SDL_IMAGE
	bool "SDL_image"
	depends on LINGMO_PACKAGE_SDL
	help
	  SDL_image is an image file loading library. It loads images
	  as SDL surfaces, and supports the following formats:
	  BMP, GIF, JPEG, LBM, PCX, PNG, PNM, TGA, TIFF, XCF, XPM, XV.

	  http://www.libsdl.org/projects/SDL_image/

if LINGMO_PACKAGE_SDL_IMAGE

config LINGMO_PACKAGE_SDL_IMAGE_BMP
	bool "BMP support"
	default y

config LINGMO_PACKAGE_SDL_IMAGE_GIF
	bool "GIF support"

config LINGMO_PACKAGE_SDL_IMAGE_JPEG
	bool "JPEG support"
	select LINGMO_PACKAGE_JPEG

config LINGMO_PACKAGE_SDL_IMAGE_LBM
	bool "LBM support"

config LINGMO_PACKAGE_SDL_IMAGE_PCX
	bool "PCX support"

config LINGMO_PACKAGE_SDL_IMAGE_PNG
	bool "PNG support"
	select LINGMO_PACKAGE_LIBPNG

config LINGMO_PACKAGE_SDL_IMAGE_PNM
	bool "PNM support"

config LINGMO_PACKAGE_SDL_IMAGE_TARGA
	bool "TARGA support"

config LINGMO_PACKAGE_SDL_IMAGE_TIFF
	bool "TIFF support"
	select LINGMO_PACKAGE_TIFF

config LINGMO_PACKAGE_SDL_IMAGE_WEBP
	bool "WEBP support"
	select LINGMO_PACKAGE_WEBP

config LINGMO_PACKAGE_SDL_IMAGE_XCF
	bool "XCF support"

config LINGMO_PACKAGE_SDL_IMAGE_XPM
	bool "XPM support"

config LINGMO_PACKAGE_SDL_IMAGE_XV
	bool "XV support"

endif
```

## package/sdl_ttf/Config.in
```kconfig
config LINGMO_PACKAGE_SDL_TTF
	bool "SDL_TTF"
	depends on LINGMO_PACKAGE_SDL
	select LINGMO_PACKAGE_FREETYPE
	help
	  SDL_ttf is a sample TrueType font library. It allows you to
	  use TrueType fonts in your SDL applications.

	  http://www.libsdl.org/projects/SDL_ttf/
```

## package/seatd/Config.in
```kconfig
menuconfig LINGMO_PACKAGE_SEATD
	bool "seatd"
	select LINGMO_PACKAGE_SEATD_BUILTIN \
		if !LINGMO_PACKAGE_SYSTEMD_LOGIND && !LINGMO_PACKAGE_SEATD_DAEMON
	help
	  Seat management daemon and support library.

	  https://git.sr.ht/~kennylevinsen/seatd

if LINGMO_PACKAGE_SEATD

config LINGMO_PACKAGE_SEATD_BUILTIN
	bool "builtin backend"
	help
	  Builtin in-process seatd implementation inside libseat.

config LINGMO_PACKAGE_SEATD_DAEMON
	bool "seatd daemon"
	depends on LINGMO_USE_MMU # fork()
	help
	  Build the seatd daemon and support for it inside libseat.

endif
```

## package/sed/Config.in
```kconfig
config LINGMO_PACKAGE_SED
	bool "sed"
	depends on LINGMO_USE_WCHAR
	depends on LINGMO_PACKAGE_BUSYBOX_SHOW_OTHERS
	help
	  sed (stream editor) is a non-interactive command-line text
	  editor.

	  https://www.gnu.org/software/sed/

comment "sed needs a toolchain w/ wchar"
	depends on !LINGMO_USE_WCHAR
	depends on LINGMO_PACKAGE_BUSYBOX_SHOW_OTHERS
```
