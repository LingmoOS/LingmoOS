## package/xmlstarlet/Config.in
```kconfig
config LINGMO_PACKAGE_XMLSTARLET
	bool "xmlstarlet"
	select LINGMO_PACKAGE_LIBXML2
	select LINGMO_PACKAGE_LIBXSLT
	select LINGMO_PACKAGE_LIBICONV if !LINGMO_ENABLE_LOCALE
	help
	  Command Line XML Toolkit

	  http://xmlstar.sourceforge.net/
```

## package/xmrig/Config.in
```kconfig
# archs officially supported by upstream
config LINGMO_PACKAGE_XMRIG_ARCH_SUPPORTS
	bool
	default y if LINGMO_ARM_CPU_ARMV7A
	default y if LINGMO_aarch64
	default y if LINGMO_x86_64
	default y if LINGMO_i386

config LINGMO_PACKAGE_XMRIG
	bool "xmrig"
	depends on LINGMO_PACKAGE_XMRIG_ARCH_SUPPORTS
	depends on LINGMO_USE_MMU # libuv
	depends on LINGMO_TOOLCHAIN_HAS_SYNC_4 # libuv
	depends on LINGMO_TOOLCHAIN_HAS_THREADS_NPTL # libuv
	# xmrig needs fenv.h which is not provided by uclibc
	depends on !LINGMO_TOOLCHAIN_USES_UCLIBC
	depends on !LINGMO_STATIC_LIBS # libuv
	depends on LINGMO_TOOLCHAIN_GCC_AT_LEAST_4_9 # libuv
	depends on LINGMO_INSTALL_LIBSTDCPP
	select LINGMO_PACKAGE_LIBUV
	help
	  RandomX, CryptoNight, AstroBWT and Argon2 CPU/GPU miner.

	  https://xmrig.com

comment "xmrig needs a glibc or musl toolchain w/ NPTL, dynamic library, C++, gcc >= 4.9"
	depends on LINGMO_PACKAGE_XMRIG_ARCH_SUPPORTS
	depends on LINGMO_USE_MMU
	depends on LINGMO_TOOLCHAIN_HAS_SYNC_4
	depends on !LINGMO_TOOLCHAIN_HAS_THREADS_NPTL || \
		LINGMO_TOOLCHAIN_USES_UCLIBC || LINGMO_STATIC_LIBS || \
		!LINGMO_INSTALL_LIBSTDCPP || \
		!LINGMO_TOOLCHAIN_GCC_AT_LEAST_4_9
```

## package/xorriso/Config.in
```kconfig
config LINGMO_PACKAGE_XORRISO
	bool "xorriso"
	depends on LINGMO_USE_WCHAR
	depends on LINGMO_TOOLCHAIN_HAS_THREADS
	depends on LINGMO_USE_MMU # fork()
	select LINGMO_PACKAGE_LIBICONV if !LINGMO_ENABLE_LOCALE
	help
	  xorriso copies file objects from POSIX compliant
	  filesystems into Rock Ridge enhanced ISO 9660 filesystems
	  and allows session-wise manipulation of such filesystems.
	  It can load the management information of existing ISO
	  images and it writes the session results to optical media
	  or to filesystem objects.

	  Vice versa xorriso is able to copy file objects out of ISO
	  9660 filesystems.

	  https://www.gnu.org/software/xorriso

comment "xorriso needs a toolchain w/ wchar, threads"
	depends on LINGMO_USE_MMU
	depends on !LINGMO_USE_WCHAR || !LINGMO_TOOLCHAIN_HAS_THREADS
```

## package/xr819-xradio/Config.in
```kconfig
config LINGMO_PACKAGE_XR819_XRADIO
	bool "xr819-xradio"
	depends on LINGMO_LINUX_KERNEL
	depends on LINGMO_arm || LINGMO_armeb || LINGMO_aarch64 || \
		LINGMO_aarch64_be || LINGMO_riscv
	help
	  Wireless driver for SDIO WiFi chip XR819

	  https://github.com/fifteenhex/xradio

comment "xr819-xradio driver needs a Linux kernel to be built"
	depends on !LINGMO_LINUX_KERNEL
```

## package/xscreensaver/Config.in
```kconfig
config LINGMO_PACKAGE_XSCREENSAVER
	bool "xscreensaver"
	depends on LINGMO_PACKAGE_XORG7
	depends on LINGMO_PACKAGE_HAS_LIBGL # libglu
	depends on LINGMO_INSTALL_LIBSTDCPP # libgtk2 -> pango
	depends on LINGMO_TOOLCHAIN_HAS_THREADS # gdk-pixbuf, libgtk2 -> glib2
	depends on LINGMO_USE_WCHAR # gdk-pixbuf, libgtk2 -> glib2
	depends on LINGMO_USE_MMU # gdk-pixbuf, libgtk2 -> glib2
	depends on LINGMO_TOOLCHAIN_HAS_SYNC_4 # libgtk2 -> pango -> harfbuzz
	depends on LINGMO_TOOLCHAIN_GCC_AT_LEAST_4_9 # libgtk2 -> pango -> harfbuzz
	select LINGMO_PACKAGE_GDK_PIXBUF
	select LINGMO_PACKAGE_GDK_PIXBUF_XLIB
	select LINGMO_PACKAGE_LIBGLU
	select LINGMO_PACKAGE_LIBGTK2
	select LINGMO_PACKAGE_LIBXML2
	select LINGMO_PACKAGE_JPEG
	select LINGMO_PACKAGE_XLIB_LIBX11
	select LINGMO_PACKAGE_XLIB_LIBXFT
	select LINGMO_PACKAGE_XLIB_LIBXI
	select LINGMO_PACKAGE_XLIB_LIBXT
	help
	  XScreenSaver is the standard screen saver collection shipped
	  on most Linux and Unix systems running the X11 Window
	  System.

	  On X11 systems, XScreenSaver is two things: it is both a
	  large collection of screen savers; and it is also the
	  framework for blanking and locking the screen.

	  http://www.jwz.org/xscreensaver/

comment "xscreensaver needs a toolchain w/ wchar, C++, threads, gcc >= 4.9, OpenGL backend"
	depends on LINGMO_PACKAGE_XORG7
	depends on LINGMO_USE_MMU
	depends on LINGMO_TOOLCHAIN_HAS_SYNC_4
	depends on !LINGMO_INSTALL_LIBSTDCPP || !LINGMO_TOOLCHAIN_HAS_THREADS || \
		!LINGMO_TOOLCHAIN_GCC_AT_LEAST_4_9 || \
		!LINGMO_USE_WCHAR || !LINGMO_PACKAGE_HAS_LIBGL
```

## package/xtables-addons/Config.in
```kconfig
comment "xtables-addons needs a Linux kernel to be built"
	depends on !LINGMO_LINUX_KERNEL

comment "xtables-addons needs a toolchain w/ dynamic library, threads"
	depends on LINGMO_STATIC_LIBS || !LINGMO_TOOLCHAIN_HAS_THREADS

config LINGMO_PACKAGE_XTABLES_ADDONS
	bool "xtables-addons"
	depends on LINGMO_LINUX_KERNEL
	depends on LINGMO_TOOLCHAIN_HAS_THREADS
	depends on !LINGMO_STATIC_LIBS # extensions are .so
	select LINGMO_PACKAGE_IPTABLES
	select LINGMO_LINUX_NEEDS_MODULES # not using kernel-module infra
	help
	  Xtables-addons is the successor to patch-o-matic(-ng).
	  Likewise, it contains extensions that were not, or are not
	  yet, accepted in the main kernel/iptables packages.

	  https://inai.de/projects/xtables-addons/
```

## package/xterm/Config.in
```kconfig
config LINGMO_PACKAGE_XTERM
	bool "xterm"
	depends on LINGMO_PACKAGE_XORG7
	depends on LINGMO_USE_MMU # fork()
	select LINGMO_PACKAGE_NCURSES
	select LINGMO_PACKAGE_XLIB_LIBXAW
	help
	  xterm terminal emulator

	  http://invisible-island.net/xterm/
```

## package/xvisor/Config.in
```kconfig
config LINGMO_PACKAGE_XVISOR_ARCH_SUPPORTS
	bool
	default y if LINGMO_aarch64
	default y if LINGMO_cortex_a7 || LINGMO_cortex_a12 || LINGMO_cortex_a15 || LINGMO_cortex_a17
	default y if LINGMO_riscv
	default y if LINGMO_x86_64
	depends on LINGMO_USE_MMU

menuconfig LINGMO_PACKAGE_XVISOR
	bool "xvisor"
	depends on LINGMO_PACKAGE_XVISOR_ARCH_SUPPORTS
	depends on LINGMO_TOOLCHAIN_GCC_AT_LEAST_4_9
	help
	  Xvisor is an open-source type-1 hypervisor, which aims at
	  providing a monolithic, light-weight, portable, and flexible
	  virtualization solution.

	  http://www.xhypervisor.org/

if LINGMO_PACKAGE_XVISOR

choice
	prompt "Xvisor configuration"
	default LINGMO_PACKAGE_XVISOR_USE_DEFCONFIG

config LINGMO_PACKAGE_XVISOR_USE_DEFCONFIG
	bool "Using an in-tree defconfig file"

config LINGMO_PACKAGE_XVISOR_USE_CUSTOM_CONFIG
	bool "Using a custom (def)config file"

endchoice

config LINGMO_PACKAGE_XVISOR_DEFCONFIG
	string "Defconfig name"
	default "generic-v7-ve" if LINGMO_ARM_CPU_ARMV7A
	default "generic-v8" if LINGMO_aarch64
	default "generic-32b" if LINGMO_RISCV_32
	default "generic-64b" if LINGMO_RISCV_64
	default "x86_64_generic" if LINGMO_x86_64
	depends on LINGMO_PACKAGE_XVISOR_USE_DEFCONFIG
	help
	  Name of the Xvisor defconfig file to use, without the
	  trailing -defconfig. The defconfig is located in
	  arch/<arch>/configs in the source tree.

config LINGMO_PACKAGE_XVISOR_CUSTOM_CONFIG_FILE
	string "Configuration file path"
	depends on LINGMO_PACKAGE_XVISOR_USE_CUSTOM_CONFIG
	help
	  Path to the Xvisor configuration file

config LINGMO_PACKAGE_XVISOR_CREATE_UBOOT_IMAGE
	bool "Create U-Boot image of Xvisor"
	depends on LINGMO_arm
	select LINGMO_PACKAGE_HOST_UBOOT_TOOLS
	help
	  Create an image file of Xvisor loadable from Das U-Boot.

config LINGMO_PACKAGE_XVISOR_BUILD_TEST_DTB
	bool "Build test device-tree blobs"
	help
	  Build test device-tree blobs for popular boards.

endif

comment "xvisor needs a toolchain w/ gcc >= 4.9"
	depends on !LINGMO_TOOLCHAIN_GCC_AT_LEAST_4_9
	depends on LINGMO_PACKAGE_XVISOR_ARCH_SUPPORTS
```

## package/xvkbd/Config.in
```kconfig
config LINGMO_PACKAGE_XVKBD
	bool "xvkbd"
	depends on LINGMO_PACKAGE_XORG7
	select LINGMO_PACKAGE_XLIB_LIBICE
	select LINGMO_PACKAGE_XLIB_LIBSM
	select LINGMO_PACKAGE_XLIB_LIBX11
	select LINGMO_PACKAGE_XLIB_LIBXAW
	select LINGMO_PACKAGE_XLIB_LIBXEXT
	select LINGMO_PACKAGE_XLIB_LIBXMU
	select LINGMO_PACKAGE_XLIB_LIBXPM
	select LINGMO_PACKAGE_XLIB_LIBXT
	select LINGMO_PACKAGE_XLIB_LIBXTST
	help
	  on-screen keyboard for X

	  http://t-sato.in.coocan.jp/xvkbd
```

## package/yad/Config.in
```kconfig
config LINGMO_PACKAGE_YAD
	bool "yad"
	depends on LINGMO_PACKAGE_XORG7
	depends on LINGMO_PACKAGE_LIBGTK2 || LINGMO_PACKAGE_LIBGTK3_X11
	help
	  YAD (yet another dialog) is a tool for create graphical
	  dialogs from shell scripts.

	  http://sourceforge.net/projects/yad-dialog/

comment "yad needs libgtk2 or libgtk3 w/ X11 backend"
	depends on LINGMO_PACKAGE_XORG7
	depends on !LINGMO_PACKAGE_LIBGTK2 && !LINGMO_PACKAGE_LIBGTK3_X11
```

## package/yaml-cpp/Config.in
```kconfig
config LINGMO_PACKAGE_YAML_CPP
	bool "yaml-cpp"
	depends on LINGMO_INSTALL_LIBSTDCPP
	depends on LINGMO_TOOLCHAIN_GCC_AT_LEAST_4_7 # C++11
	help
	  yaml-cpp is a YAML parser and emitter in C++ matching
	  the YAML 1.2 spec.

	  https://github.com/jbeder/yaml-cpp

comment "yaml-cpp needs a toolchain w/ C++, gcc >= 4.7"
	depends on !LINGMO_INSTALL_LIBSTDCPP || !LINGMO_TOOLCHAIN_GCC_AT_LEAST_4_7
```

## package/yasm/Config.in
```kconfig
config LINGMO_PACKAGE_YASM
	bool "yasm"
	depends on LINGMO_i386 || LINGMO_x86_64
	help
	  Yasm is a complete rewrite of the NASM-2.10.01 assembler.
	  It supports the x86 and AMD64 instruction sets, accepts NASM
	  and GAS assembler syntaxes and outputs binary, ELF32 and ELF64
	  object formats.

	  http://www.tortall.net/projects/yasm/
```

## package/ympd/Config.in
```kconfig
config LINGMO_PACKAGE_YMPD
	bool "ympd"
	depends on LINGMO_USE_MMU # fork()
	depends on LINGMO_TOOLCHAIN_HAS_THREADS
	depends on !LINGMO_STATIC_LIBS
	select LINGMO_PACKAGE_LIBMPDCLIENT
	help
	  ympd, a standalone MPD Web GUI written in C, utilizing
	  Websockets and Bootstrap/JS

	  https://www.ympd.org/

comment "ympd needs a toolchain w/ threads, dynamic library"
	depends on LINGMO_USE_MMU
	depends on !LINGMO_TOOLCHAIN_HAS_THREADS || LINGMO_STATIC_LIBS
```

## package/ytree/Config.in
```kconfig
config LINGMO_PACKAGE_YTREE
	bool "ytree"
	depends on LINGMO_USE_MMU # fork()
	select LINGMO_PACKAGE_NCURSES
	help
	  Ytree - a (curses-based) file manager similar to DOS Xtree(tm)

	  https://www.han.de/~werner/ytree.html
```

## package/z3/Config.in
```kconfig
# z3 supports arch for which libc fenv.h provides all four macros:
# FE_DOWNWARD, FE_TONEAREST, FE_TOWARDZERO, FE_UPWARD
# See for example in glibc https://sourceware.org/git/glibc.git
# git grep -E '^[[:space:]]*#[[:space:]]*define[[:space:]]+FE_(TONEAREST|UPWARD|DOWNWARD|TOWARDZERO)' sysdeps/
config LINGMO_PACKAGE_Z3_ARCH_SUPPORTS
	bool
	default y if LINGMO_aarch64 || LINGMO_aarch64_be
	default y if LINGMO_arceb || LINGMO_arcle
	default y if LINGMO_arm || LINGMO_armeb
	default y if LINGMO_i386
	default y if LINGMO_m68k
	# LINGMO_microblaze has only FE_TONEAREST
	default y if LINGMO_mips || LINGMO_mipsel || LINGMO_mips64 || LINGMO_mips64el
	# LINGMO_nios2 has only FE_TONEAREST
	default y if LINGMO_or1k
	default y if LINGMO_powerpc || LINGMO_powerpc64 || LINGMO_powerpc64le
	default y if LINGMO_riscv
	default y if LINGMO_s390x
	# LINGMO_sh has only FE_{TONEAREST,TOWARDZERO}
	default y if LINGMO_sparc || LINGMO_sparc64
	default y if LINGMO_x86_64
	# LINGMO_xtensa supports only uclibc which does not have fenv.h

config LINGMO_PACKAGE_Z3
	bool "z3"
	depends on LINGMO_INSTALL_LIBSTDCPP
	depends on LINGMO_TOOLCHAIN_GCC_AT_LEAST_7 # c++17
	# z3 needs fenv.h which is not provided by uclibc
	depends on !LINGMO_TOOLCHAIN_USES_UCLIBC
	depends on LINGMO_PACKAGE_Z3_ARCH_SUPPORTS
	help
	  Z3, also known as the Z3 Theorem Prover, is a cross-platform
	  satisfiability modulo theories (SMT) solver.

	  https://github.com/Z3Prover/z3

if LINGMO_PACKAGE_Z3

config LINGMO_PACKAGE_Z3_PYTHON
	bool "Python bindings"
	depends on LINGMO_PACKAGE_PYTHON3
	select LINGMO_PACKAGE_PYTHON3_PYEXPAT # runtime
	select LINGMO_PACKAGE_PYTHON_SETUPTOOLS # runtime

endif
```

## package/zabbix/Config.in
```kconfig
config LINGMO_PACKAGE_ZABBIX
	bool "zabbix"
	depends on LINGMO_TOOLCHAIN_USES_GLIBC
	select LINGMO_PACKAGE_PCRE2
	help
	  Zabbix is an enterprise-class open source distributed
	  monitoring solution. Zabbix is free of cost. Zabbix is
	  written and distributed under the GPL General Public License
	  version 2.

	  https://zabbix.com

comment "zabbix need glibc"
	depends on !LINGMO_TOOLCHAIN_USES_GLIBC

if LINGMO_PACKAGE_ZABBIX

comment "zabbix server needs C++ and threads or wchar and dynamic libs"
	depends on LINGMO_USE_MMU
	depends on \
		!(LINGMO_INSTALL_LIBSTDCPP && LINGMO_TOOLCHAIN_HAS_THREADS) && \
		!(LINGMO_USE_WCHAR && !LINGMO_STATIC_LIBS)

config LINGMO_PACKAGE_ZABBIX_SERVER
	bool "zabbix server"
	depends on LINGMO_USE_MMU # mysql, postgresql
	depends on \
		(LINGMO_INSTALL_LIBSTDCPP && LINGMO_TOOLCHAIN_HAS_THREADS) || \
		(LINGMO_USE_WCHAR && !LINGMO_STATIC_LIBS && !LINGMO_OPTIMIZE_FAST)
	select LINGMO_PACKAGE_ZLIB
	select LINGMO_PACKAGE_LIBEVENT

if LINGMO_PACKAGE_ZABBIX_SERVER

choice
	prompt "server database backend"

config LINGMO_PACKAGE_ZABBIX_SERVER_MYSQL
	bool "mysql"
	depends on LINGMO_INSTALL_LIBSTDCPP # mysql
	depends on LINGMO_TOOLCHAIN_HAS_THREADS # mysql
	select LINGMO_PACKAGE_MARIADB

config LINGMO_PACKAGE_ZABBIX_SERVER_POSTGRESQL
	bool "postgresql"
	depends on LINGMO_USE_WCHAR # postgresql
	depends on !LINGMO_STATIC_LIBS # postgresql
	depends on !LINGMO_OPTIMIZE_FAST # postgresql
	select LINGMO_PACKAGE_POSTGRESQL

endchoice

config LINGMO_PACKAGE_ZABBIX_SERVER_COPY_DUMPS
	bool "install SQL dumps"
	help
	  Copy initial database dumps to /var/lib/zabbix/schema

	  These still need to be imported into the database by hand.

config LINGMO_PACKAGE_ZABBIX_SERVER_COPY_FRONTEND
	bool "install web UI to target"
	depends on LINGMO_PACKAGE_PHP # runtime
	select LINGMO_PACKAGE_PHP_EXT_MYSQLI if LINGMO_PACKAGE_ZABBIX_SERVER_MYSQL
	select LINGMO_PACKAGE_PHP_EXT_PGSQL if LINGMO_PACKAGE_ZABBIX_SERVER_POSTGRESQL
	select LINGMO_PACKAGE_PHP_EXT_BCMATH
	select LINGMO_PACKAGE_PHP_EXT_SOCKETS
	select LINGMO_PACKAGE_PHP_EXT_MBSTRING
	select LINGMO_PACKAGE_PHP_EXT_GD
	select LINGMO_PACKAGE_PHP_EXT_LIBXML2
	select LINGMO_PACKAGE_PHP_EXT_CTYPE
	select LINGMO_PACKAGE_PHP_EXT_SESSION
	select LINGMO_PACKAGE_PHP_EXT_XMLREADER
	select LINGMO_PACKAGE_PHP_EXT_XMLWRITER
	help
	  Copy web-UI to /var/www/zabbix. You need to set up a web
	  server to access it.

comment "zabbix web UI requires PHP"
	depends on !LINGMO_PACKAGE_PHP

endif

endif
```

## package/zbar/Config.in
```kconfig
config LINGMO_PACKAGE_ZBAR
	bool "zbar"
	depends on LINGMO_TOOLCHAIN_HAS_THREADS # libv4l
	depends on LINGMO_USE_MMU # libv4l
	depends on LINGMO_INSTALL_LIBSTDCPP # libv4l
	depends on LINGMO_TOOLCHAIN_HEADERS_AT_LEAST_3_0 # libv4l
	select LINGMO_PACKAGE_JPEG
	select LINGMO_PACKAGE_LIBV4L
	help
	  QR and barcode scanner

	  https://git.linuxtv.org/zbar.git/about/

comment "zbar needs a toolchain w/ threads, C++ and headers >= 3.0"
	depends on LINGMO_USE_MMU
	depends on !LINGMO_TOOLCHAIN_HAS_THREADS \
		|| !LINGMO_INSTALL_LIBSTDCPP || !LINGMO_TOOLCHAIN_HEADERS_AT_LEAST_3_0
```

## package/zchunk/Config.in
```kconfig
config LINGMO_PACKAGE_ZCHUNK
	bool "zchunk"
	depends on LINGMO_USE_MMU # fork()
	select LINGMO_PACKAGE_ARGP_STANDALONE if LINGMO_TOOLCHAIN_USES_UCLIBC || LINGMO_TOOLCHAIN_USES_MUSL
	help
	  A file format designed for highly efficient deltas while
	  maintaining good compression.

	  https://github.com/zchunk/zchunk
```
