## package/zeek/Config.in
```kconfig
config LINGMO_PACKAGE_ZEEK
	bool "zeek"
	depends on LINGMO_USE_MMU # fork()
	depends on LINGMO_INSTALL_LIBSTDCPP
	depends on !LINGMO_STATIC_LIBS
	depends on LINGMO_TOOLCHAIN_HAS_THREADS
	depends on LINGMO_USE_WCHAR
	depends on LINGMO_TOOLCHAIN_GCC_AT_LEAST_7 # C++17
	depends on LINGMO_HOST_GCC_AT_LEAST_7 # host-zeek
	select LINGMO_PACKAGE_LIBPCAP
	select LINGMO_PACKAGE_MUSL_FTS if !LINGMO_TOOLCHAIN_USES_GLIBC
	select LINGMO_PACKAGE_OPENSSL
	select LINGMO_PACKAGE_OPENSSL_FORCE_LIBOPENSSL
	select LINGMO_PACKAGE_ZLIB
	help
	  The Zeek Network Security Monitor

	  Zeek is a powerful network analysis framework that is much
	  different from the typical IDS you may know. (Zeek is the new
	  name for the long-established Bro system.)

	  https://www.zeek.org

if LINGMO_PACKAGE_ZEEK

config LINGMO_PACKAGE_ZEEK_ZEEKCTL
	bool "zeekctl"
	select LINGMO_PACKAGE_BASH # runtime
	select LINGMO_PACKAGE_BUSYBOX_SHOW_OTHERS # bash
	select LINGMO_PACKAGE_PYTHON3
	select LINGMO_PACKAGE_PYTHON3_CURSES
	select LINGMO_PACKAGE_PYTHON3_SQLITE
	select LINGMO_PACKAGE_PYTHON3_ZLIB
	help
	  Tool for managing Zeek deployments

endif

comment "zeek needs a toolchain w/ C++, wchar, threads, dynamic library, gcc >= 7, host gcc >= 7"
	depends on LINGMO_USE_MMU
	depends on !LINGMO_INSTALL_LIBSTDCPP || !LINGMO_USE_WCHAR || \
		!LINGMO_TOOLCHAIN_HAS_THREADS || LINGMO_STATIC_LIBS || \
		!LINGMO_TOOLCHAIN_GCC_AT_LEAST_7 || \
		!LINGMO_HOST_GCC_AT_LEAST_7
```

## package/zerofree/Config.in
```kconfig
config LINGMO_PACKAGE_ZEROFREE
	bool "zerofree"
	depends on LINGMO_USE_MMU # e2fsprogs
	depends on !LINGMO_STATIC_LIBS
	select LINGMO_PACKAGE_E2FSPROGS
	help
	  zerofree is a utility which scans the free blocks in an ext2
	  filesystem and fills any non-zero blocks with zeroes.

	  https://frippery.org/uml/

comment "zerofree needs a toolchain w/ dynamic library"
	depends on LINGMO_USE_MMU
	depends on LINGMO_STATIC_LIBS
```

## package/zeromq/Config.in
```kconfig
comment "zeromq needs a toolchain w/ C++, threads"
	depends on !(LINGMO_INSTALL_LIBSTDCPP && LINGMO_TOOLCHAIN_HAS_THREADS)

config LINGMO_PACKAGE_ZEROMQ
	bool "zeromq"
	depends on LINGMO_INSTALL_LIBSTDCPP
	depends on LINGMO_TOOLCHAIN_HAS_THREADS
	help
	  ØMQ (ZeroMQ, 0MQ, zmq) looks like an embeddable networking
	  library but acts like a concurrency framework. It gives you
	  sockets that carry whole messages across various transports
	  like in-process, inter- process, TCP, and multicast. You can
	  connect sockets N-to-N with patterns like fanout, pub-sub,
	  task distribution, and request-reply. It's fast enough to
	  be the fabric for clustered products. Its asynchronous I/O
	  model gives you scalable multicore applications, built as
	  asynchronous message-processing tasks. It has a score of
	  language APIs and runs on most operating systems.

	  ØMQ is from iMatix and is LGPL open source.

	  http://www.zeromq.org/

if LINGMO_PACKAGE_ZEROMQ

comment "norm support needs a toolchain w/ dynamic library"
	depends on LINGMO_STATIC_LIBS

config LINGMO_PACKAGE_ZEROMQ_NORM
	bool "NORM support"
	depends on !LINGMO_STATIC_LIBS
	select LINGMO_PACKAGE_NORM
	help
	  Add support for NACK-Oriented Reliable Multicast (RFC 5740)
	  protocol.

comment "PGM/EPGM support needs a toolchain w/ wchar"
	depends on LINGMO_TOOLCHAIN_HAS_SYNC_2
	depends on LINGMO_TOOLCHAIN_HAS_SYNC_4
	depends on !LINGMO_USE_WCHAR

config LINGMO_PACKAGE_ZEROMQ_PGM
	bool "PGM/EPGM support"
	depends on LINGMO_TOOLCHAIN_HAS_SYNC_2
	depends on LINGMO_TOOLCHAIN_HAS_SYNC_4
	depends on LINGMO_USE_WCHAR # openpgm
	select LINGMO_PACKAGE_OPENPGM
	help
	  Add support for Pragmatic General Multicast protocol (RFC
	  3208) implemented either over raw IP packets or UDP
	  datagrams (encapsulated PGM).

config LINGMO_PACKAGE_ZEROMQ_DRAFTS
	bool "Draft APIs support"
	help
	  Enable unstable draft ZeroMQ APIs

	  https://pyzmq.readthedocs.io/en/latest/draft.html

config LINGMO_PACKAGE_ZEROMQ_WEBSOCKET
	bool "WebSocket support"
	help
	  Enable WebSocket transport

endif
```

## package/zfs/Config.in
```kconfig
comment "zfs needs a Linux kernel to be built"
	depends on !LINGMO_LINUX_KERNEL

comment "zfs needs udev /dev management"
	depends on LINGMO_LINUX_KERNEL
	depends on !LINGMO_PACKAGE_HAS_UDEV

config LINGMO_PACKAGE_ZFS
	bool "zfs"
	depends on LINGMO_LINUX_KERNEL
	depends on LINGMO_PACKAGE_HAS_UDEV
	depends on LINGMO_USE_MMU  # util-linux (libblkid)
	depends on LINGMO_TOOLCHAIN_HAS_THREADS  # libtirpc
	select LINGMO_LINUX_NEEDS_MODULES
	select LINGMO_PACKAGE_UTIL_LINUX
	select LINGMO_PACKAGE_UTIL_LINUX_LIBBLKID
	select LINGMO_PACKAGE_UTIL_LINUX_LIBUUID
	select LINGMO_PACKAGE_LIBTIRPC if !LINGMO_TOOLCHAIN_HAS_NATIVE_RPC
	select LINGMO_PACKAGE_LIBAIO
	select LINGMO_PACKAGE_OPENSSL
	select LINGMO_PACKAGE_ZLIB
	select LINGMO_PACKAGE_LIBCURL
	help
	  OpenZFS on Linux and FreeBSD

	  OpenZFS is an advanced file system and volume manager which
	  was originally developed for Solaris and is now maintained by
	  the OpenZFS community. This repository contains the code for
	  running OpenZFS on Linux and FreeBSD.

	  This package builds the kernel modules and userland utils
	  required to operates with ZFS volumes.

	  http://zfsonlinux.org/
```

## package/zlib/Config.in
```kconfig
config LINGMO_PACKAGE_ZLIB_FORCE_LIBZLIB
	bool

config LINGMO_PACKAGE_ZLIB_NG_ARCH_SUPPORTS
	bool
	default y if LINGMO_arm
	default y if LINGMO_aarch64
	default y if LINGMO_i386
	default y if LINGMO_powerpc || LINGMO_powerpc64 || LINGMO_powerpc64le
	default y if LINGMO_riscv
	default y if LINGMO_s390x
	default y if LINGMO_x86_64

config LINGMO_PACKAGE_ZLIB
	bool "zlib support"
	help
	  Select the desired Zlib library provider.

if LINGMO_PACKAGE_ZLIB

choice
	prompt "zlib variant"
	default LINGMO_PACKAGE_LIBZLIB
	help
	  Select the desired Zlib library provider.

config LINGMO_PACKAGE_LIBZLIB
	bool "zlib"
	select LINGMO_PACKAGE_HAS_ZLIB
	help
	  Standard (de)compression library. Used by things like
	  gzip and libpng.

	  http://www.zlib.net

config LINGMO_PACKAGE_ZLIB_NG
	bool "zlib-ng"
	depends on LINGMO_PACKAGE_ZLIB_NG_ARCH_SUPPORTS
	depends on !LINGMO_PACKAGE_ZLIB_FORCE_LIBZLIB
	select LINGMO_PACKAGE_HAS_ZLIB
	help
	  Zlib replacement with optimizations for
	  "next generation" systems.

	  https://github.com/zlib-ng/zlib-ng

endchoice

config LINGMO_PACKAGE_HAS_ZLIB
	bool

config LINGMO_PACKAGE_PROVIDES_ZLIB
	string
	default "libzlib" if LINGMO_PACKAGE_LIBZLIB
	default "zlib-ng" if LINGMO_PACKAGE_ZLIB_NG

endif

# ensure libzlib is used for the host variant
config LINGMO_PACKAGE_PROVIDES_HOST_ZLIB
	string
	default "host-libzlib"
```

## package/zmqpp/Config.in
```kconfig
config LINGMO_PACKAGE_ZMQPP
	bool "zmqpp"
	# c++1x support
	depends on LINGMO_TOOLCHAIN_GCC_AT_LEAST_4_7
	depends on LINGMO_INSTALL_LIBSTDCPP
	depends on LINGMO_TOOLCHAIN_HAS_THREADS # zeromq
	depends on !LINGMO_TOOLCHAIN_HAS_GCC_BUG_64735 # exception_ptr
	select LINGMO_PACKAGE_ZEROMQ
	help
	  C++ binding for zeromq (ZeroMQ, 0MQ, zmq).

	  This C++ binding is a 'high-level' library that hides most
	  of the C-style interface core zeromq provides.

	  http://github.com/benjamg/zmqpp

comment "zmqpp needs a toolchain w/ C++, threads, gcc >= 4.7"
	depends on !LINGMO_INSTALL_LIBSTDCPP || !LINGMO_TOOLCHAIN_HAS_THREADS || \
		!LINGMO_TOOLCHAIN_GCC_AT_LEAST_4_7

comment "zmqpp needs exception_ptr"
	depends on LINGMO_TOOLCHAIN_HAS_GCC_BUG_64735

if LINGMO_PACKAGE_ZMQPP

config LINGMO_PACKAGE_ZMQPP_CLIENT
	bool "zmqpp client"
	depends on !LINGMO_STATIC_LIBS
	depends on LINGMO_TOOLCHAIN_HAS_THREADS # boost
	depends on LINGMO_USE_WCHAR # boost
	select LINGMO_PACKAGE_BOOST
	select LINGMO_PACKAGE_BOOST_PROGRAM_OPTIONS
	help
	  Build and install the zmqpp client, a command line tool that
	  can be used to listen or send to zeromq sockets.

comment "zmqpp client needs a toolchain w/ dynamic library, threads, wchar"
	depends on LINGMO_STATIC_LIBS || !LINGMO_TOOLCHAIN_HAS_THREADS \
		|| !LINGMO_USE_WCHAR

endif
```

## package/znc/Config.in
```kconfig
config LINGMO_PACKAGE_ZNC
	bool "znc"
	depends on LINGMO_INSTALL_LIBSTDCPP
	depends on LINGMO_USE_MMU # fork()
	depends on !LINGMO_STATIC_LIBS
	depends on LINGMO_TOOLCHAIN_GCC_AT_LEAST_8
	depends on LINGMO_TOOLCHAIN_HAS_THREADS
	select LINGMO_PACKAGE_LIBOPENSSL_ENABLE_BLOWFISH if LINGMO_PACKAGE_LIBOPENSSL
	help
	  Advanced IRC bouncer

	  http://www.znc.in

comment "znc needs a toolchain w/ C++, dynamic library, gcc >= 8, threads"
	depends on !LINGMO_INSTALL_LIBSTDCPP || LINGMO_STATIC_LIBS || \
		!LINGMO_TOOLCHAIN_GCC_AT_LEAST_8 || !LINGMO_TOOLCHAIN_HAS_THREADS
	depends on LINGMO_USE_MMU
```
