## package/powerpc-utils/Config.in
```kconfig
comment "powerpc-utils tools needs a toolchain w/ dynamic library"
	depends on LINGMO_powerpc || LINGMO_powerpc64 || LINGMO_powerpc64le
	depends on LINGMO_STATIC_LIBS
	depends on LINGMO_USE_MMU
	depends on LINGMO_TOOLCHAIN_HAS_ATOMIC

config LINGMO_PACKAGE_POWERPC_UTILS
	bool "powerpc-utils"
	depends on !LINGMO_STATIC_LIBS # dlfcn.h
	depends on LINGMO_powerpc || LINGMO_powerpc64 || LINGMO_powerpc64le
	depends on LINGMO_USE_MMU # numactl
	depends on LINGMO_TOOLCHAIN_HAS_ATOMIC # numactl
	select LINGMO_PACKAGE_ZLIB
	select LINGMO_PACKAGE_NUMACTL
	help
	  System utilities for PowerPC machines.

	  https://github.com/ibm-power-utilities/powerpc-utils.git

if LINGMO_PACKAGE_POWERPC_UTILS

config LINGMO_PACKAGE_POWERPC_UTILS_RTAS
	bool "RTAS support"
	select LINGMO_PACKAGE_LIBRTAS
	help
	  Enable support for functions that require RTAS.

	  This adds a dependency on librtas and provides the following
	  additional features at the cost of increasing the installed
	  package size from about 0.5MB to about 2MB:
	  ppc64_cpu --run-mode, uesensor, set_poweron_time, drmgr,
	  lsslot, activate_firmware, rtas_ibm_get_vpd, serv_config,
	  rtas_event_decode, sys_ident.

endif
```

## package/powertop/Config.in
```kconfig
config LINGMO_PACKAGE_POWERTOP
	bool "powertop"
	depends on LINGMO_INSTALL_LIBSTDCPP
	depends on LINGMO_TOOLCHAIN_HAS_THREADS # libnl
	depends on LINGMO_USE_WCHAR
	select LINGMO_PACKAGE_NCURSES
	select LINGMO_PACKAGE_LIBNL
	help
	  A tool to diagnose issues with power consumption and power
	  management

	  https://github.com/fenrus75/powertop/

comment "powertop needs a toolchain w/ C++, threads, wchar"
	depends on !LINGMO_INSTALL_LIBSTDCPP || !LINGMO_TOOLCHAIN_HAS_THREADS || \
		!LINGMO_USE_WCHAR
```

## package/powervr/Config.in
```kconfig
config LINGMO_PACKAGE_HAS_POWERVR
	bool

config LINGMO_PACKAGE_PROVIDES_POWERVR
	string
	depends on LINGMO_PACKAGE_HAS_POWERVR
```

## package/pppd/Config.in
```kconfig
config LINGMO_PACKAGE_PPPD
	bool "pppd"
	depends on !LINGMO_STATIC_LIBS
	depends on LINGMO_USE_MMU
	select LINGMO_PACKAGE_OPENSSL if LINGMO_TOOLCHAIN_USES_GLIBC
	select LINGMO_PACKAGE_LIBOPENSSL_ENABLE_DES if LINGMO_PACKAGE_LIBOPENSSL
	help
	  An implementation of the Point-to-point protocol.

	  http://www.samba.org/ppp/

if LINGMO_PACKAGE_PPPD

config LINGMO_PACKAGE_PPPD_FILTER
	bool "filtering"
	select LINGMO_PACKAGE_LIBPCAP
	help
	  Packet filtering abilities for pppd. If enabled,
	  the pppd active-filter and pass-filter options
	  are available.

endif

comment "pppd needs a toolchain w/ dynamic library"
	depends on LINGMO_STATIC_LIBS
	depends on LINGMO_USE_MMU
```

## package/pptp-linux/Config.in
```kconfig
config LINGMO_PACKAGE_PPTP_LINUX
	bool "pptp-linux"
	depends on LINGMO_USE_MMU # fork()
	help
	  An implementation of the Point-to-point protocol client.

	  http://pptpclient.sourceforge.net/
```

## package/prboom/Config.in
```kconfig
config LINGMO_PACKAGE_PRBOOM
	bool "prboom"
	select LINGMO_PACKAGE_SDL
	select LINGMO_PACKAGE_SDL_MIXER
	select LINGMO_PACKAGE_SDL_NET
	help
	  PrBoom is a Doom client which allows you to play the good
	  old game on newer hardware. It even supports higher
	  resolution and better rendering, while still keeping the old
	  style alive.

	  http://prboom.sourceforge.net/
```

## package/privoxy/Config.in
```kconfig
config LINGMO_PACKAGE_PRIVOXY
	bool "privoxy"
	depends on LINGMO_USE_MMU # fork()
	depends on LINGMO_TOOLCHAIN_HAS_THREADS
	select LINGMO_PACKAGE_PCRE
	select LINGMO_PACKAGE_ZLIB
	help
	  A non-caching web proxy with advanced filtering capabilities
	  for enhancing privacy, modifying web page data and HTTP
	  headers, controlling access, and removing ads and other
	  obnoxious Internet junk.

	  http://www.privoxy.org/

comment "privoxy needs a toolchain w/ threads"
	depends on LINGMO_USE_MMU
	depends on !LINGMO_TOOLCHAIN_HAS_THREADS
```

## package/procps-ng/Config.in
```kconfig
config LINGMO_PACKAGE_PROCPS_NG
	bool "procps-ng"
	depends on LINGMO_USE_MMU # fork()
	depends on LINGMO_PACKAGE_BUSYBOX_SHOW_OTHERS
	select LINGMO_PACKAGE_NCURSES
	help
	  Standard informational utilities and process-handling tools.
	  Provides things like kill, ps, uptime, free, top, etc...

	  http://sourceforge.net/projects/procps-ng/
```

## package/procs/Config.in
```kconfig
config LINGMO_PACKAGE_PROCS
	bool "procs"
	depends on LINGMO_PACKAGE_HOST_RUSTC_TARGET_ARCH_SUPPORTS
	select LINGMO_PACKAGE_HOST_RUSTC
	help
	  procs is a modern replacement for ps written in Rust

	  https://github.com/dalance/procs.git
```

## package/proj/Config.in
```kconfig
config LINGMO_PACKAGE_PROJ
	bool "proj"
	depends on LINGMO_INSTALL_LIBSTDCPP
	depends on LINGMO_TOOLCHAIN_GCC_AT_LEAST_4_7 # C++11
	depends on LINGMO_TOOLCHAIN_HAS_THREADS_NPTL
	depends on LINGMO_USE_WCHAR
	select LINGMO_PACKAGE_SQLITE
	help
	  proj.4 is a standard UNIX filter function which converts
	  geographic longitude and latitude coordinates into cartesian
	  coordinates (and vice versa), and it is a C API for software
	  developers to include coordinate transformation in their own
	  software.

	  http://proj4.org/

comment "proj needs a toolchain w/ C++, gcc >= 4.7, NPTL, wchar"
	depends on !LINGMO_INSTALL_LIBSTDCPP || \
		!LINGMO_TOOLCHAIN_GCC_AT_LEAST_4_7 || \
		!LINGMO_TOOLCHAIN_HAS_THREADS_NPTL || !LINGMO_USE_WCHAR
```

## package/prosody/Config.in
```kconfig
config LINGMO_PACKAGE_PROSODY
	bool "prosody"
	depends on LINGMO_USE_MMU # fork
	depends on LINGMO_PACKAGE_HAS_LUAINTERPRETER
	depends on !LINGMO_PACKAGE_LUA_5_4
	depends on !LINGMO_STATIC_LIBS # luaexpat, luasec, luasocket, luafilesystem
	select LINGMO_PACKAGE_LUABITOP if LINGMO_PACKAGE_LUA_5_1 # runtime
	select LINGMO_PACKAGE_LUAEXPAT # runtime
	select LINGMO_PACKAGE_LUASEC # runtime
	select LINGMO_PACKAGE_LUASOCKET # runtime
	select LINGMO_PACKAGE_OPENSSL
	select LINGMO_PACKAGE_LIBIDN
	select LINGMO_PACKAGE_LUAFILESYSTEM # runtime
	help
	  Prosody is a modern XMPP communication server. It aims to be
	  easy to set up and configure, and efficient with system
	  resources.

	  https://prosody.im

comment "prosody needs the lua interpreter, dynamic library"
	depends on !LINGMO_PACKAGE_HAS_LUAINTERPRETER || LINGMO_STATIC_LIBS
	depends on LINGMO_USE_MMU

comment "prosody needs a Lua <= 5.3"
	depends on LINGMO_PACKAGE_LUA_5_4
```
