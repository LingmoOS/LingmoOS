## package/pipewire/Config.in
```kconfig
config LINGMO_PACKAGE_PIPEWIRE
	bool "pipewire"
	depends on !LINGMO_STATIC_LIBS
	depends on LINGMO_TOOLCHAIN_HAS_THREADS_NPTL # pthread_setname_np()
	depends on LINGMO_USE_MMU # fork()
	depends on LINGMO_TOOLCHAIN_GCC_AT_LEAST_5
	select LINGMO_PACKAGE_ALSA_LIB_UCM if LINGMO_PACKAGE_ALSA_LIB
	select LINGMO_PACKAGE_ALSA_LIB_SEQ if LINGMO_PACKAGE_ALSA_LIB
	select LINGMO_PACKAGE_BLUEZ5_UTILS_PLUGINS_AUDIO if LINGMO_PACKAGE_BLUEZ5_UTILS # runtime
	help
	  PipeWire is a server and user space API to deal with
	  multimedia pipelines.

	  https://pipewire.org/

if LINGMO_PACKAGE_PIPEWIRE

config LINGMO_PACKAGE_PIPEWIRE_COMPRESS_OFFLOAD
	bool "pipewire Compress-Offload"
	depends on !LINGMO_STATIC_LIBS # tinycompress
	depends on LINGMO_TOOLCHAIN_HEADERS_AT_LEAST_5_7
	select LINGMO_PACKAGE_TINYCOMPRESS
	help
	  Enable ALSA Compress-Offload support

comment "pipewire Compress-Offload needs a toolchain w/ dynamic library, headers >= 5.7"
	depends on LINGMO_STATIC_LIBS || \
		!LINGMO_TOOLCHAIN_HEADERS_AT_LEAST_5_7

config LINGMO_PACKAGE_PIPEWIRE_EXAMPLES
	bool "pipewire examples"
	help
	  Build pipewire examples

config LINGMO_PACKAGE_PIPEWIRE_GSTREAMER
	bool "pipewire gstreamer plugins"
	depends on LINGMO_USE_WCHAR # libglib2
	depends on LINGMO_TOOLCHAIN_HAS_THREADS # libglib2
	depends on LINGMO_USE_MMU # libglib2
	select LINGMO_PACKAGE_LIBGLIB2
	select LINGMO_PACKAGE_GSTREAMER1
	select LINGMO_PACKAGE_GST1_PLUGINS_BASE
	help
	  Build GStreamer plugins

comment "pipewire gstreamer support needs a toolchain w/ wchar, threads"
	depends on LINGMO_USE_MMU
	depends on !LINGMO_USE_WCHAR || !LINGMO_TOOLCHAIN_HAS_THREADS

config LINGMO_PACKAGE_PIPEWIRE_V4L2
	bool "pipewire v4l2 plugin"
	depends on LINGMO_PACKAGE_HAS_UDEV
	depends on LINGMO_TOOLCHAIN_HEADERS_AT_LEAST_3_18
	help
	  Build v4l2 plugin

comment "pipewire v4l2 support needs udev and a toolchain w/ headers >= 3.18"
	depends on !LINGMO_PACKAGE_HAS_UDEV || \
		!LINGMO_TOOLCHAIN_HEADERS_AT_LEAST_3_18

endif

comment "pipewire needs a toolchain w/ dynamic library, NPTL, gcc >= 5"
	depends on LINGMO_USE_MMU
	depends on LINGMO_STATIC_LIBS || \
		!LINGMO_TOOLCHAIN_HAS_THREADS_NPTL || \
		!LINGMO_TOOLCHAIN_GCC_AT_LEAST_5
```

## package/pistache/Config.in
```kconfig
config LINGMO_PACKAGE_PISTACHE
	bool "pistache"
	depends on LINGMO_TOOLCHAIN_GCC_AT_LEAST_7 # C++17, std::optional
	depends on LINGMO_USE_WCHAR
	depends on LINGMO_TOOLCHAIN_HAS_THREADS
	depends on LINGMO_INSTALL_LIBSTDCPP
	depends on !LINGMO_TOOLCHAIN_HAS_BINUTILS_BUG_27597
	select LINGMO_PACKAGE_RAPIDJSON
	help
	  Pistache is a modern and elegant HTTP and REST framework
	  for C++. It is entirely written in pure C++17 and provides
	  a clear and pleasant API.

	  https://github.com/oktal/pistache

comment "pistache needs a toolchain w/ C++, gcc >= 7, threads, wchar, not binutils bug 27597"
	depends on !LINGMO_INSTALL_LIBSTDCPP || \
		   !LINGMO_TOOLCHAIN_GCC_AT_LEAST_7 || \
		   !LINGMO_TOOLCHAIN_HAS_THREADS || \
		   !LINGMO_USE_WCHAR || \
		   LINGMO_TOOLCHAIN_HAS_BINUTILS_BUG_27597
```

## package/pixiewps/Config.in
```kconfig
config LINGMO_PACKAGE_PIXIEWPS
	bool "pixiewps"
	depends on LINGMO_TOOLCHAIN_HAS_THREADS
	help
	  Pixie WPS is a C based tool to audit networks against the so
	  called "Pixie Dust" attack.

	  https://github.com/wiire-a/pixiewps/wiki

comment "pixiewps needs a toolchain w/ threads"
	depends on !LINGMO_TOOLCHAIN_HAS_THREADS
```

## package/pixman/Config.in
```kconfig
config LINGMO_PACKAGE_PIXMAN
	bool "pixman"
	help
	  Cairo pixel manager

	  http://cairographics.org/releases/
```

## package/pixz/Config.in
```kconfig
config LINGMO_PACKAGE_PIXZ
	bool "pixz"
	depends on LINGMO_TOOLCHAIN_HAS_THREADS
	depends on LINGMO_USE_WCHAR # libarchive
	select LINGMO_PACKAGE_LIBARCHIVE
	select LINGMO_PACKAGE_XZ
	help
	  Pixz (pronounced pixie) is a parallel, indexing version of xz.

	  https://github.com/vasi/pixz

comment "pixz needs a toolchain w/ threads, wchar"
	depends on !LINGMO_TOOLCHAIN_HAS_THREADS || !LINGMO_USE_WCHAR
```

## package/ply/Config.in
```kconfig
config LINGMO_PACKAGE_PLY_ARCH_SUPPORTS
	bool
	default y if LINGMO_aarch64
	default y if LINGMO_arm
	default y if LINGMO_powerpc
	default y if LINGMO_x86_64

comment "ply needs a toolchain w/ dynamic library, headers >= 5.5"
	depends on LINGMO_PACKAGE_PLY_ARCH_SUPPORTS
	depends on LINGMO_USE_MMU
	depends on !LINGMO_TOOLCHAIN_HEADERS_AT_LEAST_5_5 || LINGMO_STATIC_LIBS

config LINGMO_PACKAGE_PLY
	bool "ply"
	depends on LINGMO_PACKAGE_PLY_ARCH_SUPPORTS
	depends on LINGMO_USE_MMU # fork()
	depends on LINGMO_TOOLCHAIN_HEADERS_AT_LEAST_5_5 # BPF_JLT
	depends on !LINGMO_STATIC_LIBS
	help
	  ply is a light-weight dynamic tracer for Linux. By means of
	  using the BPF it can attach probes to the linux kernel
	  (e. g. kprobes).

	  It's a small alternative to LLVM based tracers for embedded
	  systems.

	  When using debugfs needs to be mounted on /sys/kernel/debug.

	  https://wkz.github.io/ply/
```

## package/pngquant/Config.in
```kconfig
config LINGMO_PACKAGE_PNGQUANT
	bool "pngquant"
	select LINGMO_PACKAGE_LIBPNG
	select LINGMO_PACKAGE_ZLIB
	help
	  Lossy PNG compressor - pngquant command and libimagequant
	  library

	  https://pngquant.org
```

## package/poco/Config.in
```kconfig
config LINGMO_PACKAGE_POCO_ARCH_SUPPORTS
	bool
	default y
	depends on !LINGMO_arc
	depends on !LINGMO_microblaze
	depends on !LINGMO_mipsel
	depends on !LINGMO_or1k
	depends on !LINGMO_RISCV_32
	depends on !LINGMO_xtensa

config LINGMO_PACKAGE_POCO
	bool "poco"
	depends on LINGMO_INSTALL_LIBSTDCPP
	depends on LINGMO_USE_WCHAR
	depends on LINGMO_TOOLCHAIN_GCC_AT_LEAST_8 # C++17
	# pthread_condattr_setclock
	depends on LINGMO_TOOLCHAIN_HAS_THREADS_NPTL
	depends on !LINGMO_STATIC_LIBS # dlopen()
	depends on LINGMO_PACKAGE_POCO_ARCH_SUPPORTS
	select LINGMO_PACKAGE_PCRE2
	select LINGMO_PACKAGE_ZLIB
	help
	  The C++ Portable Components Libraries

	  http://pocoproject.org

if LINGMO_PACKAGE_POCO

comment "poco components"

config LINGMO_PACKAGE_POCO_ACTIVERECORD
	bool "ActiveRecord"
	select LINGMO_PACKAGE_POCO_XML

config LINGMO_PACKAGE_POCO_CPP_PARSER
	bool "CppParser"

config LINGMO_PACKAGE_POCO_CRYPTO
	bool "Crypto"
	select LINGMO_PACKAGE_LIBOPENSSL_ENABLE_DES if LINGMO_PACKAGE_LIBOPENSSL
	select LINGMO_PACKAGE_OPENSSL

config LINGMO_PACKAGE_POCO_DATA
	bool

config LINGMO_PACKAGE_POCO_DATA_MYSQL
	bool "Data/MySQL"
	depends on LINGMO_USE_MMU # mysql
	select LINGMO_PACKAGE_MARIADB
	select LINGMO_PACKAGE_POCO_DATA

config LINGMO_PACKAGE_POCO_DATA_PGSQL
	bool "Data/PostgreSQL"
	depends on LINGMO_USE_MMU # postgresql
	depends on !LINGMO_OPTIMIZE_FAST # postgresql
	select LINGMO_PACKAGE_POCO_DATA
	select LINGMO_PACKAGE_POSTGRESQL

comment "Data/PostgreSQL can't be built with Optimize for fast"
	depends on LINGMO_OPTIMIZE_FAST

config LINGMO_PACKAGE_POCO_DATA_SQLITE
	bool "Data/SQLite"
	select LINGMO_PACKAGE_POCO_DATA
	select LINGMO_PACKAGE_SQLITE

config LINGMO_PACKAGE_POCO_JSON
	bool "JSON"

config LINGMO_PACKAGE_POCO_JWT
	bool "JWT"
	select LINGMO_PACKAGE_POCO_CRYPTO
	select LINGMO_PACKAGE_POCO_JSON

config LINGMO_PACKAGE_POCO_MONGODB
	bool "MongoDB"
	select LINGMO_PACKAGE_POCO_NET

config LINGMO_PACKAGE_POCO_NET
	bool "Net"

config LINGMO_PACKAGE_POCO_NETSSL_OPENSSL
	bool "NetSSL_OpenSSL"
	select LINGMO_PACKAGE_OPENSSL
	select LINGMO_PACKAGE_POCO_CRYPTO
	select LINGMO_PACKAGE_POCO_NET
	select LINGMO_PACKAGE_POCO_UTIL

config LINGMO_PACKAGE_POCO_PDF
	bool "PDF"
	select LINGMO_PACKAGE_POCO_JSON
	select LINGMO_PACKAGE_POCO_UTIL
	select LINGMO_PACKAGE_POCO_XML

config LINGMO_PACKAGE_POCO_PROMETHEUS
	bool "Prometheus"
	select LINGMO_PACKAGE_POCO_NET

config LINGMO_PACKAGE_POCO_REDIS
	bool "Redis"
	select LINGMO_PACKAGE_POCO_NET

config LINGMO_PACKAGE_POCO_UTIL
	bool "Util"
	select LINGMO_PACKAGE_POCO_XML

config LINGMO_PACKAGE_POCO_XML
	bool "XML"
	select LINGMO_PACKAGE_EXPAT

config LINGMO_PACKAGE_POCO_ZIP
	bool "Zip"
	select LINGMO_PACKAGE_POCO_NET
	select LINGMO_PACKAGE_POCO_UTIL
	select LINGMO_PACKAGE_POCO_XML

endif # LINGMO_PACKAGE_POCO

comment "poco needs a toolchain w/ wchar, NPTL, C++, dynamic library, gcc >= 8"
	depends on !LINGMO_USE_WCHAR || !LINGMO_INSTALL_LIBSTDCPP \
		|| !LINGMO_TOOLCHAIN_HAS_THREADS_NPTL || LINGMO_STATIC_LIBS \
		|| !LINGMO_TOOLCHAIN_GCC_AT_LEAST_8
	depends on LINGMO_PACKAGE_POCO_ARCH_SUPPORTS
```

## package/poke/Config.in
```kconfig
config LINGMO_PACKAGE_POKE
	bool "poke"
	depends on LINGMO_PACKAGE_LIBATOMIC_OPS_ARCH_SUPPORTS # bdwgc
	depends on LINGMO_USE_WCHAR # needs wctomb
	depends on LINGMO_TOOLCHAIN_HAS_THREADS_NPTL
	depends on LINGMO_USE_MMU # bdwgc
	select LINGMO_PACKAGE_BUSYBOX_SHOW_OTHERS # less
	select LINGMO_PACKAGE_BDWGC
	select LINGMO_PACKAGE_LESS # runtime
	select LINGMO_PACKAGE_READLINE
	help
	  GNU poke is a new interactive editor for binary data. Not
	  limited to editing basic entities such as bits and bytes,
	  it provides a full-fledged procedural, interactive
	  programming language designed to describe data structures
	  and to operate on them. Once a user has defined a structure
	  for binary data (usually matching some file format) she can
	  search, inspect, create, shuffle and modify abstract entities
	  such as ELF relocations, MP3 tags, DWARF expressions,
	  partition table entries, and so on, with primitives
	  resembling simple editing of bits and bytes. The program
	  comes with a library of already written descriptions (or
	  "pickles" in poke parlance) for many binary formats.

	  https://www.gnu.org/software/poke/

comment "poke needs a toolchain w/ NPTL, wchar"
	depends on LINGMO_PACKAGE_LIBATOMIC_OPS_ARCH_SUPPORTS
	depends on LINGMO_USE_MMU
	depends on !LINGMO_TOOLCHAIN_HAS_THREADS_NPTL || !LINGMO_USE_WCHAR
```

## package/polkit/Config.in
```kconfig
config LINGMO_PACKAGE_POLKIT
	bool "polkit"
	depends on LINGMO_TOOLCHAIN_GCC_AT_LEAST_7 # C++17
	depends on LINGMO_TOOLCHAIN_HAS_THREADS # libglib2, dbus
	depends on LINGMO_USE_MMU # libglib2, dbus
	depends on LINGMO_USE_WCHAR # libglib2
	depends on !LINGMO_STATIC_LIBS # duktape
	depends on !LINGMO_OPTIMIZE_FAST # duktape
	select LINGMO_PACKAGE_DBUS # runtime
	select LINGMO_PACKAGE_DUKTAPE
	select LINGMO_PACKAGE_EXPAT
	select LINGMO_PACKAGE_LIBGLIB2
	help
	  PolicyKit is a toolkit for defining and handling
	  authorizations. It is used for allowing unprivileged
	  processes to speak to privileged processes.

	  http://www.freedesktop.org/wiki/Software/polkit

comment "polkit needs a toolchain with dynamic library, wchar, threads, gcc >= 7"
	depends on LINGMO_USE_MMU
	depends on !LINGMO_USE_WCHAR || !LINGMO_TOOLCHAIN_GCC_AT_LEAST_7 || \
		LINGMO_STATIC_LIBS || !LINGMO_TOOLCHAIN_HAS_THREADS

comment "polkit can't be built with Optimize for fast"
	depends on LINGMO_OPTIMIZE_FAST
```

## package/poppler/Config.in
```kconfig
config LINGMO_PACKAGE_POPPLER
	bool "poppler"
	depends on LINGMO_USE_WCHAR
	depends on LINGMO_INSTALL_LIBSTDCPP
	depends on LINGMO_TOOLCHAIN_HAS_THREADS
	depends on !LINGMO_STATIC_LIBS
	depends on LINGMO_TOOLCHAIN_GCC_AT_LEAST_7 # C++17
	select LINGMO_PACKAGE_FONTCONFIG
	help
	  Poppler is a PDF rendering library based on the xpdf-3.0
	  code base.

	  https://poppler.freedesktop.org/

if LINGMO_PACKAGE_POPPLER

config LINGMO_PACKAGE_POPPLER_QT5
	bool "Qt5 support"
	depends on LINGMO_PACKAGE_QT5
	select LINGMO_PACKAGE_QT5BASE_GUI
	select LINGMO_PACKAGE_QT5BASE_WIDGETS
	select LINGMO_PACKAGE_QT5BASE_XML
	help
	  Build Qt support into the Poppler library

config LINGMO_PACKAGE_POPPLER_UTILS
	bool "command line utils"
	help
	  Compile poppler command line utils.

endif

comment "poppler needs a toolchain w/ wchar, C++, threads, dynamic library, gcc >= 7"
	depends on !LINGMO_USE_WCHAR || !LINGMO_INSTALL_LIBSTDCPP || \
		!LINGMO_TOOLCHAIN_HAS_THREADS || LINGMO_STATIC_LIBS || \
		!LINGMO_TOOLCHAIN_GCC_AT_LEAST_5
```

## package/postgis/Config.in
```kconfig
config LINGMO_PACKAGE_POSTGIS
	bool "postgis"
	depends on LINGMO_PACKAGE_POSTGRESQL_FULL
	depends on LINGMO_INSTALL_LIBSTDCPP # libgeos, proj
	depends on LINGMO_TOOLCHAIN_GCC_AT_LEAST_4_9 # libgeos
	depends on LINGMO_TOOLCHAIN_HAS_THREADS_NPTL # proj
	depends on LINGMO_USE_WCHAR # libgeos, proj
	depends on !LINGMO_TOOLCHAIN_HAS_BINUTILS_BUG_27597 # libgeos
	select LINGMO_PACKAGE_LIBGEOS
	select LINGMO_PACKAGE_PROJ
	select LINGMO_PACKAGE_LIBXML2
	select LINGMO_PACKAGE_LIBICONV if !LINGMO_ENABLE_LOCALE
	help
	  PostGIS is a spatial database extender for PostgreSQL
	  object-relational database. It adds support for
	  geographic objects allowing location queries
	  to be run in SQL.

	  https://postgis.net/

comment "postgis needs a toolchain w/ C++, NPTL, wchar, gcc >= 4.9, not binutils bug 27597"
	depends on !LINGMO_INSTALL_LIBSTDCPP || !LINGMO_TOOLCHAIN_GCC_AT_LEAST_4_9 || \
		!LINGMO_TOOLCHAIN_HAS_THREADS_NPTL || !LINGMO_USE_WCHAR || \
		LINGMO_TOOLCHAIN_HAS_BINUTILS_BUG_27597
```

## package/postgresql/Config.in
```kconfig
config LINGMO_PACKAGE_POSTGRESQL
	bool "postgresql"
	depends on LINGMO_USE_MMU # fork()
	depends on LINGMO_USE_WCHAR
	# fails to build in a pure static linking scenario, and
	# postgresql is unlikely to be used in a pure statically
	# linked environment.
	depends on !LINGMO_STATIC_LIBS
	depends on !LINGMO_OPTIMIZE_FAST
	select LINGMO_PACKAGE_LIBOPENSSL_ENABLE_BLOWFISH if LINGMO_PACKAGE_LIBOPENSSL
	select LINGMO_PACKAGE_LIBOPENSSL_ENABLE_CAST if LINGMO_PACKAGE_LIBOPENSSL
	select LINGMO_PACKAGE_LIBOPENSSL_ENABLE_DES if LINGMO_PACKAGE_LIBOPENSSL
	help
	  PostgreSQL is a powerful, open source object-relational
	  database system.

	  Enable the readline package to gain readline support in
	  psql (the command line interpreter), which offers
	  command history and edit functions.

	  Enable the zlib package to gain builtin compression for
	  archives with pg_dump and pg_restore.

	  http://www.postgresql.org

if LINGMO_PACKAGE_POSTGRESQL

config LINGMO_PACKAGE_POSTGRESQL_FULL
	bool "postgresql-full"
	help
	  Build PostgreSQL, contrib, and documentation.

endif

comment "postgresql needs a toolchain w/ dynamic library, wchar"
	depends on LINGMO_USE_MMU
	depends on LINGMO_STATIC_LIBS || !LINGMO_USE_WCHAR

comment "postgresql can't be built with Optimize for fast"
	depends on LINGMO_OPTIMIZE_FAST
```

## package/pound/Config.in
```kconfig
config LINGMO_PACKAGE_POUND
	bool "pound"
	depends on !LINGMO_STATIC_LIBS
	depends on LINGMO_TOOLCHAIN_HAS_THREADS
	depends on LINGMO_USE_MMU # fork()
	select LINGMO_PACKAGE_OPENSSL
	select LINGMO_PACKAGE_OPENSSL_FORCE_LIBOPENSSL
	help
	  The Pound program is a reverse proxy, load balancer and HTTPS
	  front-end for Web server(s). Pound was developed to enable
	  distributing the load among several Web-servers and to allow
	  for a convenient SSL wrapper for those Web servers that do not
	  offer it natively.

	  https://github.com/graygnuorg/pound

comment "pound needs a toolchain w/ dynamic library, threads"
	depends on LINGMO_STATIC_LIBS || !LINGMO_TOOLCHAIN_HAS_THREADS
	depends on LINGMO_USE_MMU
```
