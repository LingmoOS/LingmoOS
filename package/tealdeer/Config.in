## package/tinyproxy/Config.in
```kconfig
config LINGMO_PACKAGE_TINYPROXY
	bool "tinyproxy"
	depends on LINGMO_USE_WCHAR
	depends on LINGMO_TOOLCHAIN_HAS_THREADS
	depends on LINGMO_USE_MMU # fork()
	help
	  Tinyproxy is a small, efficient HTTP/SSL proxy daemon released
	  under the GNU General Public License. Tinyproxy is very
	  useful in a small network setting, where a larger proxy would
	  be too resource intensive.

	  https://tinyproxy.github.io

comment "tinyproxy needs a toolchain w/ threads, wchar"
	depends on !LINGMO_TOOLCHAIN_HAS_THREADS || !LINGMO_USE_WCHAR
	depends on LINGMO_USE_MMU
```

## package/tinyssh/Config.in
```kconfig
config LINGMO_PACKAGE_TINYSSH
	bool "tinyssh"
	depends on LINGMO_USE_MMU # fork()
	help
	  TinySSH is a minimalistic SSH server which implements only
	  a subset of SSHv2 features.

	  https://tinyssh.org
```

## package/tinyxml/Config.in
```kconfig
config LINGMO_PACKAGE_TINYXML
	bool "tinyxml"
	depends on LINGMO_INSTALL_LIBSTDCPP
	help
	  TinyXML is a simple, small, C++ XML parser that can be
	  easily integrating into other programs.

	  https://github.com/leethomason/tinyxml2

comment "tinyxml needs a toolchain w/ C++"
	depends on !LINGMO_INSTALL_LIBSTDCPP
```

## package/tio/Config.in
```kconfig
config LINGMO_PACKAGE_TIO
	bool "tio"
	depends on !LINGMO_sparc64 && !LINGMO_sparc
	depends on LINGMO_TOOLCHAIN_HAS_THREADS
	select LINGMO_PACKAGE_INIH
	help
	  "tio" is a simple TTY terminal application which features a
	  straightforward commandline interface to easily connect to
	  TTY devices for basic input/output.

	  https://tio.github.io/

# tio is disabled for sparc and sparc64 architectures because it fails
# to build with a redefinition of 'struct termio' error, with no proper
# fix or workaround for now
comment "tio is disabled for sparc and sparc64 architectures"
	depends on LINGMO_sparc64 || LINGMO_sparc

comment "tio needs a toolchain w/ threads"
	depends on !LINGMO_sparc64 && !LINGMO_sparc
	depends on !LINGMO_TOOLCHAIN_HAS_THREADS
```

## package/tk/Config.in
```kconfig
config LINGMO_PACKAGE_TK
	bool "tk"
	depends on LINGMO_USE_MMU # tcl
	depends on LINGMO_TOOLCHAIN_HAS_THREADS # tcl
	depends on !LINGMO_STATIC_LIBS # tcl
	depends on LINGMO_PACKAGE_XORG7
	select LINGMO_PACKAGE_TCL
	select LINGMO_PACKAGE_XLIB_LIBX11
	select LINGMO_PACKAGE_XLIB_LIBXFT
	help
	  A windowing toolkit for use with tcl

	  http://www.tcl.tk

comment "tk needs a toolchain w/ threads, dynamic library"
	depends on LINGMO_USE_MMU
	depends on LINGMO_PACKAGE_XORG7
	depends on !LINGMO_TOOLCHAIN_HAS_THREADS || LINGMO_STATIC_LIBS
```
