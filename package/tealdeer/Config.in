## package/tealdeer/Config.in
```kconfig
config LINGMO_PACKAGE_TEALDEER
	bool "tealdeer"
	depends on LINGMO_PACKAGE_HOST_RUSTC_TARGET_ARCH_SUPPORTS
	# Crypto dependency (ring) not available for mips, PowerPC, Sparc, s390x
	depends on !(LINGMO_mips || LINGMO_mipsel || LINGMO_mips64 || LINGMO_mips64el)
	depends on !(LINGMO_powerpc || LINGMO_powerpc64 || LINGMO_powerpc64le)
	depends on !(LINGMO_sparc || LINGMO_sparc64)
	depends on !LINGMO_s390x
	select LINGMO_PACKAGE_HOST_RUSTC
	help
	  A fast and full-featured tldr client. tldr pages are
	  simplified and community-driven man pages, see
	  https://tldr.sh/ for more information.

	  https://github.com/dbrgn/tealdeer/
```

## package/tekui/Config.in
```kconfig
config LINGMO_PACKAGE_TEKUI
	bool "tekui"
	depends on !LINGMO_STATIC_LIBS
	depends on LINGMO_PACKAGE_HAS_LUAINTERPRETER
	depends on LINGMO_TOOLCHAIN_HAS_THREADS
	select LINGMO_PACKAGE_FREETYPE
	select LINGMO_PACKAGE_LUAFILESYSTEM	# runtime only
	select LINGMO_PACKAGE_LUAEXPAT		# runtime only
	select LINGMO_PACKAGE_LUASOCKET		# runtime only
	select LINGMO_PACKAGE_LUAPOSIX		# runtime only
	help
	  TekUI is a small, freestanding and portable graphical user
	  interface (GUI) toolkit written in Lua and C. It was
	  initially developed for the X Window System and has been
	  ported to DirectFB, Windows, Nano-X and a raw framebuffer
	  since

	  http://tekui.neoscientists.org/

comment "tekui needs a Lua interpreter and a toolchain w/ threads, dynamic library"
	depends on !LINGMO_PACKAGE_HAS_LUAINTERPRETER || !LINGMO_TOOLCHAIN_HAS_THREADS || \
		LINGMO_STATIC_LIBS
```

## package/terminology/Config.in
```kconfig
config LINGMO_PACKAGE_TERMINOLOGY
	bool "terminology"
	depends on LINGMO_PACKAGE_EFL
	help
	  Terminology is an EFL terminal emulator with some extra
	  bells and whistles.

	  https://www.enlightenment.org/about-terminology
```

## package/tesseract-ocr/Config.in
```kconfig
comment "tesseract-ocr needs a toolchain w/ threads, C++, gcc >= 7, dynamic library, wchar"
	depends on LINGMO_USE_MMU
	depends on !LINGMO_INSTALL_LIBSTDCPP || !LINGMO_TOOLCHAIN_HAS_THREADS || \
		!LINGMO_TOOLCHAIN_GCC_AT_LEAST_7 || LINGMO_STATIC_LIBS || !LINGMO_USE_WCHAR

menuconfig LINGMO_PACKAGE_TESSERACT_OCR
	bool "tesseract-ocr"
	depends on LINGMO_INSTALL_LIBSTDCPP
	depends on LINGMO_TOOLCHAIN_HAS_THREADS
	depends on LINGMO_TOOLCHAIN_GCC_AT_LEAST_7 # C++17
	depends on LINGMO_USE_MMU # fork()
	depends on !LINGMO_STATIC_LIBS
	depends on LINGMO_USE_WCHAR
	select LINGMO_PACKAGE_LEPTONICA
	help
	  Tesseract is an OCR (Optical Character Recognition) engine,
	  It can be used directly, or (for programmers) using an API.
	  It supports a wide variety of languages.

	  https://github.com/tesseract-ocr/tesseract

if LINGMO_PACKAGE_TESSERACT_OCR

comment "tesseract-ocr languages support"

config LINGMO_PACKAGE_TESSERACT_OCR_LANG_ENG
	bool "English"

config LINGMO_PACKAGE_TESSERACT_OCR_LANG_FRA
	bool "French"

config LINGMO_PACKAGE_TESSERACT_OCR_LANG_GER
	bool "German"

config LINGMO_PACKAGE_TESSERACT_OCR_LANG_SPA
	bool "Spanish"

config LINGMO_PACKAGE_TESSERACT_OCR_LANG_CHI_SIM
	bool "Simplified Chinese"

config LINGMO_PACKAGE_TESSERACT_OCR_LANG_CHI_TRA
	bool "Traditional Chinese"

endif
```

## package/tftpd/Config.in
```kconfig
config LINGMO_PACKAGE_TFTPD
	bool "tftpd"
	# linker issue with pre-6.x toolchains
	depends on !(LINGMO_nios2 && !LINGMO_TOOLCHAIN_GCC_AT_LEAST_6)
	depends on LINGMO_USE_MMU # fork()
	depends on LINGMO_PACKAGE_BUSYBOX_SHOW_OTHERS
	help
	  HPA's Trivial File Transfer Protocol (tftp) server.

	  https://git.kernel.org/pub/scm/network/tftp/tftp-hpa.git
```

## package/thermald/Config.in
```kconfig
config LINGMO_PACKAGE_THERMALD
	bool "thermald"
	depends on LINGMO_i386 || LINGMO_x86_64 # needs <cpuid.h>
	depends on LINGMO_USE_MMU # uses fork()
	depends on LINGMO_USE_WCHAR # upower -> libgudev
	depends on LINGMO_INSTALL_LIBSTDCPP
	depends on LINGMO_TOOLCHAIN_HAS_THREADS # dbus-glib -> glib2, dbus, upower
	depends on LINGMO_USE_WCHAR # dbus-glib -> glib2
	depends on LINGMO_PACKAGE_HAS_UDEV # upower
	select LINGMO_PACKAGE_DBUS
	select LINGMO_PACKAGE_DBUS_GLIB
	select LINGMO_PACKAGE_LIBEVDEV
	select LINGMO_PACKAGE_LIBXML2
	select LINGMO_PACKAGE_UPOWER
	select LINGMO_PACKAGE_XZ
	help
	  Thermal Daemon is a Linux daemon for monitoring and
	  controlling platform temperatures. Once the system temperature
	  reaches a certain threshold, the Linux daemon activates
	  various cooling methods to try to cool the system.

	  https://github.com/intel/thermal_daemon

comment "thermald needs a toolchain w/ C++, wchar, threads"
	depends on LINGMO_i386 || LINGMO_x86_64
	depends on LINGMO_USE_MMU
	depends on !LINGMO_USE_WCHAR || !LINGMO_TOOLCHAIN_HAS_THREADS || \
		!LINGMO_INSTALL_LIBSTDCPP

comment "thermald needs udev /dev management"
	depends on LINGMO_i386 || LINGMO_x86_64
	depends on LINGMO_USE_MMU
	depends on !LINGMO_PACKAGE_HAS_UDEV
```

## package/thrift/Config.in
```kconfig
config LINGMO_PACKAGE_THRIFT
	bool "thrift"
	depends on LINGMO_INSTALL_LIBSTDCPP
	depends on LINGMO_USE_WCHAR
	depends on LINGMO_TOOLCHAIN_HAS_THREADS
	select LINGMO_PACKAGE_BOOST
	select LINGMO_PACKAGE_LIBEVENT
	select LINGMO_PACKAGE_OPENSSL
	select LINGMO_PACKAGE_ZLIB
	help
	  The Apache Thrift software framework, for scalable
	  cross-language services development, combines a software
	  stack with a code generation engine to build services that
	  work efficiently and seamlessly between C++, Java, Python,
	  PHP, Ruby, Erlang, Perl, Haskell, C#, Cocoa, JavaScript,
	  Node.js, Smalltalk, OCaml and Delphi and other languages.

	  http://thrift.apache.org/

comment "thrift needs a toolchain w/ C++, wchar, threads"
	depends on !LINGMO_USE_WCHAR || \
		!LINGMO_TOOLCHAIN_HAS_THREADS || !LINGMO_INSTALL_LIBSTDCPP
```

## package/thttpd/Config.in
```kconfig
config LINGMO_PACKAGE_THTTPD
	bool "thttpd"
	depends on LINGMO_USE_MMU # fork()
	help
	  thttpd is a simple, small, portable, fast, and secure HTTP
	  server

	  http://www.acme.com/software/thttpd/
```

## package/ti-cgt-pru/Config.in.host
```kconfig
config LINGMO_PACKAGE_HOST_TI_CGT_PRU_ARCH_SUPPORTS
	bool
	default y
	depends on LINGMO_HOSTARCH = "x86_64" || LINGMO_HOSTARCH = "x86"
	depends on LINGMO_arm

config LINGMO_PACKAGE_HOST_TI_CGT_PRU
	bool "host ti-cgt-pru"
	depends on LINGMO_PACKAGE_HOST_TI_CGT_PRU_ARCH_SUPPORTS
	select LINGMO_HOSTARCH_NEEDS_IA32_LIBS
	help
	  This package provides the Code Generation Tools for the PRU
	  unit found on some TI processors e.g. AM3358.

	  Note: this is a binary cross toolchain that runs on x86 hosts
	  targeting PRU cores found alongside some ARM processors.

	  http://processors.wiki.ti.com/index.php/Programmable_Realtime_Unit_Software_Development
```

## package/ti-gfx/Config.in
```kconfig
config LINGMO_PACKAGE_TI_GFX
	bool "ti-gfx"
	depends on LINGMO_LINUX_KERNEL && LINGMO_TOOLCHAIN_USES_GLIBC && LINGMO_arm
	depends on LINGMO_HOSTARCH = "x86_64" || LINGMO_HOSTARCH = "x86"
	select LINGMO_HOSTARCH_NEEDS_IA32_LIBS
	select LINGMO_PACKAGE_HAS_LIBEGL
	select LINGMO_PACKAGE_HAS_LIBGLES
	select LINGMO_PACKAGE_HAS_POWERVR
	select LINGMO_PACKAGE_FBSET if !LINGMO_PACKAGE_BUSYBOX # Runtime dependency only
	select LINGMO_LINUX_NEEDS_MODULES # not using kernel-module infra
	help
	  Graphics libraries for TI boards using SGX acceleration.

	  Supports OMAP35xx, DM37xx/AM37xx, DM816x, DM814x, AM335x and
	  AM43xx.

	  For newer CPUs or kernels use the ti-sgx-{km,um} packages.

	  http://downloads.ti.com/dsps/dsps_public_sw/gfxsdk/

if LINGMO_PACKAGE_TI_GFX

config LINGMO_PACKAGE_PROVIDES_LIBEGL
	default "ti-gfx"

config LINGMO_PACKAGE_PROVIDES_LIBGLES
	default "ti-gfx"

config LINGMO_PACKAGE_PROVIDES_POWERVR
	default "ti-gfx"

config LINGMO_PACKAGE_TI_GFX_DEBUG
	bool "enable debug support"
	help
	  Turns on debugging in the kernel module, install libraries
	  built with debugging enabled, installs various tests and
	  installs esrev script.

config LINGMO_PACKAGE_TI_GFX_DEMOS
	bool "install demos"
	default y
	help
	  Install the OGLES2ChameleonMan and OGLES2MagicLantern demos

config LINGMO_PACKAGE_TI_GFX_EGLIMAGE
	bool "install eglimage version of libraries"
	help
	  Installs OpenGL libraries which support the eglimage api.

choice
	prompt "Target"
	default LINGMO_PACKAGE_TI_GFX_ES3
	help
	  Select the SOC for which you would like to install
	  drivers. Please use the chart at
	  http://processors.wiki.ti.com/index.php/OMAP35x_Graphics_SDK_Getting_Started_Guide

config LINGMO_PACKAGE_TI_GFX_ES3
	bool "es3.x (OMAP35xx, AM35xx Rev 3.1+)"
	help
	  OMAP35xx, AM35xx Rev 3.1+

config LINGMO_PACKAGE_TI_GFX_ES5
	bool "es5.x (AM37xx, DM37xx)"
	help
	  AM37xx, DM37xx

config LINGMO_PACKAGE_TI_GFX_ES6
	bool "es6.x (AM387x, DMA814x, AM389x, DM816x)"
	help
	  AM387x, DM814x, AM389x, DM816x

config LINGMO_PACKAGE_TI_GFX_ES8
	bool "es8.x (AM335x)"
	help
	  AM335x

endchoice

endif

comment "ti-gfx needs a glibc toolchain and a Linux kernel to be built"
	depends on LINGMO_arm
	depends on !(LINGMO_LINUX_KERNEL && LINGMO_TOOLCHAIN_USES_GLIBC)
```

## package/ti-sgx-km/Config.in
```kconfig
comment "ti-sgx-km needs a Linux kernel to be built"
	depends on LINGMO_ARM_EABIHF
	depends on !LINGMO_LINUX_KERNEL

config LINGMO_PACKAGE_TI_SGX_KM
	bool "ti-sgx-km"
	depends on LINGMO_LINUX_KERNEL && LINGMO_ARM_EABIHF
	select LINGMO_LINUX_NEEDS_MODULES
	help
	  Kernel modules for TI CPUs with SGX GPU.
	  This package supports AM335x only.
	  It builds the kernel module and the user space binaries.
	  For older CPUs or kernels use the ti-gfx package.

	  Note: it needs a TI specific kernel to build properly.

	  https://git.ti.com/cgit/graphics/omap5-sgx-ddk-linux
```

## package/ti-sgx-um/Config.in
```kconfig
comment "ti-sgx-um needs udev and a glibc toolchain w/ threads"
	depends on LINGMO_arm
	depends on !LINGMO_PACKAGE_HAS_UDEV || !LINGMO_TOOLCHAIN_USES_GLIBC \
		|| !LINGMO_TOOLCHAIN_HAS_THREADS

config LINGMO_PACKAGE_TI_SGX_UM
	bool "ti-sgx-um"
	depends on LINGMO_TOOLCHAIN_HAS_THREADS # libdrm
	depends on LINGMO_PACKAGE_HAS_UDEV
	# pre-built binaries
	depends on LINGMO_TOOLCHAIN_USES_GLIBC
	depends on LINGMO_arm
	select LINGMO_PACKAGE_LIBDRM
	select LINGMO_PACKAGE_LIBDRM_OMAP
	select LINGMO_PACKAGE_HAS_LIBEGL
	select LINGMO_PACKAGE_HAS_LIBGBM
	select LINGMO_PACKAGE_LIBGBM_HAS_FEATURE_DMA_BUF
	select LINGMO_PACKAGE_HAS_LIBGLES
	select LINGMO_PACKAGE_HAS_POWERVR
	select LINGMO_PACKAGE_LIBFFI
	select LINGMO_PACKAGE_WAYLAND
	select LINGMO_PACKAGE_TI_SGX_KM if LINGMO_LINUX_KERNEL
	help
	  Graphics libraries for TI CPUs with SGX5xx GPU.
	  This package supports AM335x, AM437x, AM4430 and AM5430.
	  For older CPUs or kernels use the ti-gfx package.

	  https://git.ti.com/cgit/graphics/omap5-sgx-ddk-um-linux

if LINGMO_PACKAGE_TI_SGX_UM

config LINGMO_PACKAGE_PROVIDES_LIBEGL
	default "ti-sgx-um"

config LINGMO_PACKAGE_PROVIDES_LIBGBM
	default "ti-sgx-um"

config LINGMO_PACKAGE_PROVIDES_LIBGLES
	default "ti-sgx-um"

config LINGMO_PACKAGE_PROVIDES_POWERVR
	default "ti-sgx-um"

endif
```

## package/ti-utils/Config.in
```kconfig
config LINGMO_PACKAGE_TI_UTILS
	bool "ti-utils"
	depends on LINGMO_TOOLCHAIN_HAS_THREADS # libnl
	select LINGMO_PACKAGE_LIBNL
	help
	  The calibrator and other useful utilities for TI wireless
	  solution, based on wl12xx driver.

	  http://linuxwireless.sipsolutions.net/en/users/Drivers/wl12xx/calibrator/

comment "ti-utils needs a toolchain w/ threads"
	depends on !LINGMO_TOOLCHAIN_HAS_THREADS
```

## package/tiff/Config.in
```kconfig
menuconfig LINGMO_PACKAGE_TIFF
	bool "tiff"
	help
	  Library for handling TIFF (Tag Image File Format) images.

	  http://simplesystems.org/libtiff/

if LINGMO_PACKAGE_TIFF

config LINGMO_PACKAGE_TIFF_CCITT
	bool "CCITT Group 3 & 4 support"
	default y

config LINGMO_PACKAGE_TIFF_LIBDEFLATE
	bool "Libdeflate usage (still requires Zlib)"
	select LINGMO_PACKAGE_LIBDEFLATE
	select LINGMO_PACKAGE_TIFF_ZLIB

config LINGMO_PACKAGE_TIFF_PACKBITS
	bool "Macintosh PackBits algorithm"
	default y

config LINGMO_PACKAGE_TIFF_LZW
	bool "LZW algorithm"
	default y

config LINGMO_PACKAGE_TIFF_THUNDER
	bool "ThunderScan 4-bit RLE algorithm"
	default y

config LINGMO_PACKAGE_TIFF_NEXT
	bool "NeXT 2-bit RLE algorithm"
	default y

config LINGMO_PACKAGE_TIFF_LOGLUV
	bool "LogLuv high dynamic range encoding"
	default y

config LINGMO_PACKAGE_TIFF_MDI
	bool "Microsoft Document Imaging"
	default y

config LINGMO_PACKAGE_TIFF_ZLIB
	bool "Zlib usage (required for Deflate compression)"
	default y
	select LINGMO_PACKAGE_ZLIB

config LINGMO_PACKAGE_TIFF_XZ
	bool "XZ compression"
	select LINGMO_PACKAGE_XZ

config LINGMO_PACKAGE_TIFF_PIXARLOG
	bool "Pixar log-format algorithm (requires Zlib)"
	default y
	select LINGMO_PACKAGE_TIFF_ZLIB

config LINGMO_PACKAGE_TIFF_JPEG
	bool "JPEG compression"
	default y
	select LINGMO_PACKAGE_JPEG

config LINGMO_PACKAGE_TIFF_OLD_JPEG
	bool "Old JPEG decompression"
	default y

config LINGMO_PACKAGE_TIFF_UTILITIES
	bool "tiff utilities"
	help
	  Install all tiff utilities.

config LINGMO_PACKAGE_TIFF_ZSTD
	bool "ZSTD compression"
	select LINGMO_PACKAGE_ZSTD

endif
```

## package/time/Config.in
```kconfig
config LINGMO_PACKAGE_TIME
	bool "time"
	depends on LINGMO_USE_MMU # fork()
	# See https://savannah.gnu.org/bugs/index.php?48000
	depends on !LINGMO_STATIC_LIBS
	depends on LINGMO_PACKAGE_BUSYBOX_SHOW_OTHERS
	help
	  The GNU time utility.

	  http://savannah.gnu.org/projects/time/

comment "time needs a toolchain w/ dynamic library"
	depends on LINGMO_USE_MMU
	depends on LINGMO_STATIC_LIBS
```

## package/tinc/Config.in
```kconfig
config LINGMO_PACKAGE_TINC
	bool "tinc"
	depends on !LINGMO_STATIC_LIBS # tinc requires libdl for OpenSSL
	depends on LINGMO_USE_MMU # fork()
	select LINGMO_PACKAGE_LZO
	select LINGMO_PACKAGE_OPENSSL
	select LINGMO_PACKAGE_ZLIB
	help
	  tinc is a Virtual Private Network (VPN) daemon that uses
	  tunnelling and encryption to create a secure private network
	  between hosts on the Internet.

	  http://www.tinc-vpn.org/

comment "tinc needs a toolchain w/ dynamic library"
	depends on LINGMO_STATIC_LIBS
```

## package/tini/Config.in
```kconfig
config LINGMO_PACKAGE_TINI
	bool "tini"
	depends on LINGMO_USE_MMU # fork()
	help
	  tini is a simple but valid init binary to
	  act as PID 1 for containers.

	  https://github.com/krallin/tini

if LINGMO_PACKAGE_TINI

config LINGMO_PACKAGE_TINI_MINIMAL
	bool "build minimal variant"
	help
	  Disables argument parsing and verbose output.

endif
```

## package/tinyalsa/Config.in
```kconfig
config LINGMO_PACKAGE_TINYALSA
	bool "tinyalsa"
	depends on !LINGMO_STATIC_LIBS
	help
	  a small library to interface with ALSA in the Linux kernel

	  The aims are:

	  - Provide a basic pcm and mixer API
	  - If it's not absolutely needed, don't add it to the API
	  - Avoid supporting complex and unnecessary operations that
	    could be dealt with at a higher level

	  https://github.com/tinyalsa/tinyalsa

if LINGMO_PACKAGE_TINYALSA

config LINGMO_PACKAGE_TINYALSA_TOOLS
	bool "tinyalsa tools"
	help
	  Build utility tools (tinyplay, tinycap, tinymix, tinypcminfo)

endif #LINGMO_PACKAGE_TINYALSA

comment "tinyalsa needs a toolchain w/ dynamic library"
	depends on LINGMO_STATIC_LIBS
```

## package/tinycompress/Config.in
```kconfig
config LINGMO_PACKAGE_TINYCOMPRESS
	bool "tinycompress"
	depends on !LINGMO_STATIC_LIBS # dlfcn.h
	help
	  tinycompress is a library for compress audio offload in alsa.

	  https://www.alsa-project.org/

comment "tinycompress needs a toolchain w/ dynamic library"
	depends on LINGMO_STATIC_LIBS
```

## package/tinydtls/Config.in
```kconfig
config LINGMO_PACKAGE_TINYDTLS
	bool "tinydtls"
	depends on LINGMO_TOOLCHAIN_HAS_THREADS
	help
	  tinydtls is a library for Datagram Transport Layer Security
	  (DTLS) covering both the client and the server state
	  machine.  It is implemented in C and provides support for
	  the mandatory cipher suites specified in CoAP.

	  https://projects.eclipse.org/projects/iot.tinydtls

comment "tinydtls needs a toolchain w/ threads"
	depends on !LINGMO_TOOLCHAIN_HAS_THREADS
```
