## package/gitlab-runner/Config.in
```kconfig
config LINGMO_PACKAGE_GITLAB_RUNNER
	bool "gitlab-runner"
	depends on LINGMO_PACKAGE_HOST_GO_TARGET_ARCH_SUPPORTS
	depends on LINGMO_PACKAGE_HOST_GO_TARGET_CGO_LINKING_SUPPORTS
	depends on LINGMO_TOOLCHAIN_HAS_THREADS
	depends on LINGMO_USE_MMU # git
	depends on LINGMO_USE_WCHAR # tar
	select LINGMO_PACKAGE_BASH # runtime, shells/bash.go probably want to support bashism.
	select LINGMO_PACKAGE_BUSYBOX_SHOW_OTHERS # bash
	select LINGMO_PACKAGE_CA_CERTIFICATES # runtime
	select LINGMO_PACKAGE_GIT # runtime
	select LINGMO_PACKAGE_LIBCURL # runtime
	select LINGMO_PACKAGE_LIBCURL_CURL # runtime
	select LINGMO_PACKAGE_LIBCURL_FORCE_TLS # runtime
	select LINGMO_PACKAGE_OPENSSL # runtime
	select LINGMO_PACKAGE_OPENSSL_FORCE_LIBOPENSSL # runtime
	select LINGMO_PACKAGE_LIBOPENSSL_BIN # runtime
	select LINGMO_PACKAGE_TAR # runtime
	help
	  GitLab Runner is the open source project that is used to run
	  your jobs and send the results back to GitLab. It is used in
	  conjunction with GitLab CI/CD, the open-source continuous
	  integration service included with GitLab that coordinates the
	  jobs.

	  https://docs.gitlab.com/runner/

comment "gitlab-runner needs a toolchain w/ threads"
	depends on LINGMO_PACKAGE_HOST_GO_TARGET_ARCH_SUPPORTS
	depends on LINGMO_PACKAGE_HOST_GO_TARGET_CGO_LINKING_SUPPORTS
	depends on !LINGMO_TOOLCHAIN_HAS_THREADS
```

## package/gkrellm/Config.in
```kconfig
config LINGMO_PACKAGE_GKRELLM
	bool "gkrellm"
	depends on LINGMO_USE_WCHAR # libglib2
	depends on LINGMO_TOOLCHAIN_HAS_THREADS # libglib2
	depends on LINGMO_USE_MMU # libglib2
	select LINGMO_PACKAGE_GKRELLM_SERVER if !LINGMO_PACKAGE_GKRELLM_CLIENT
	select LINGMO_PACKAGE_LIBGLIB2
	help
	  GKrellM is a single process stack of system monitors which
	  supports applying themes to match its appearance to your
	  window manager, Gtk, or any other theme.

	  http://gkrellm.srcbox.net/

if LINGMO_PACKAGE_GKRELLM

config LINGMO_PACKAGE_GKRELLM_SERVER
	bool "server"
	help
	  Enable gkrellm server.

config LINGMO_PACKAGE_GKRELLM_CLIENT
	bool "client"
	depends on LINGMO_PACKAGE_XORG7 # libgtk2
	depends on LINGMO_INSTALL_LIBSTDCPP # libgtk2
	depends on LINGMO_TOOLCHAIN_HAS_SYNC_4 # libgtk2
	depends on LINGMO_TOOLCHAIN_GCC_AT_LEAST_4_8 # libgtk2
	select LINGMO_PACKAGE_LIBGTK2
	select LINGMO_PACKAGE_XLIB_LIBSM
	help
	  Enable gkrellm client.

comment "client needs a toolchain w/ C++, gcc >= 4.8"
	depends on LINGMO_TOOLCHAIN_HAS_SYNC_4
	depends on LINGMO_PACKAGE_XORG7
	depends on !LINGMO_INSTALL_LIBSTDCPP || \
		!LINGMO_TOOLCHAIN_GCC_AT_LEAST_4_8

endif # LINGMO_PACKAGE_GKRELLM

comment "gkrellm needs a toolchain w/ wchar, threads"
	depends on LINGMO_USE_MMU
	depends on !LINGMO_USE_WCHAR || !LINGMO_TOOLCHAIN_HAS_THREADS
```

## package/gli/Config.in
```kconfig
config LINGMO_PACKAGE_GLI
	bool "gli"
	depends on LINGMO_INSTALL_LIBSTDCPP
	help
	  OpenGL Image (GLI)

	  http://gli.g-truc.net

comment "gli needs a toolchain w/ C++"
	depends on !LINGMO_INSTALL_LIBSTDCPP
```

## package/glib-networking/Config.in
```kconfig
config LINGMO_PACKAGE_GLIB_NETWORKING
	bool "glib-networking"
	depends on LINGMO_USE_WCHAR # glib2
	depends on LINGMO_TOOLCHAIN_HAS_THREADS # glib2
	depends on LINGMO_USE_MMU # glib2
	depends on !LINGMO_STATIC_LIBS
	select LINGMO_PACKAGE_LIBGLIB2
	select LINGMO_PACKAGE_OPENSSL if !LINGMO_PACKAGE_GNUTLS
	select LINGMO_PACKAGE_OPENSSL_FORCE_LIBOPENSSL if !LINGMO_PACKAGE_GNUTLS
	select LINGMO_PACKAGE_P11_KIT if LINGMO_PACKAGE_GNUTLS
	help
	  Network-related GIO modules for glib.

	  https://gitlab.gnome.org/GNOME/glib-networking

comment "glib-networking needs a toolchain w/ wchar, threads, dynamic library"
	depends on LINGMO_USE_MMU
	depends on !LINGMO_USE_WCHAR || !LINGMO_TOOLCHAIN_HAS_THREADS || \
		LINGMO_STATIC_LIBS
```

## package/glibc/Config.in
```kconfig
config LINGMO_PACKAGE_GLIBC_ARCH_SUPPORTS
	bool
	default y if LINGMO_arm
	default y if LINGMO_armeb
	default y if LINGMO_aarch64
	default y if LINGMO_aarch64_be
	default y if LINGMO_i386
	default y if LINGMO_m68k_m68k
	default y if LINGMO_mips
	default y if LINGMO_mipsel
	default y if LINGMO_mips64
	default y if LINGMO_mips64el
	default y if LINGMO_or1k
	default y if LINGMO_powerpc
	default y if LINGMO_powerpc64
	default y if LINGMO_powerpc64le
	default y if LINGMO_riscv
	default y if LINGMO_s390x
	default y if LINGMO_sh
	default y if LINGMO_sparc64
	default y if LINGMO_x86_64
	default y if LINGMO_microblaze
	default y if LINGMO_nios2
	default y if LINGMO_arc && LINGMO_ARC_ATOMIC_EXT
	depends on !LINGMO_POWERPC_CPU_HAS_SPE
	depends on LINGMO_RISCV_ISA_RVA || !LINGMO_riscv
	depends on LINGMO_USE_MMU

config LINGMO_PACKAGE_GLIBC_SUPPORTS
	bool
	default y if LINGMO_PACKAGE_GLIBC_ARCH_SUPPORTS
	# Make sure to keep these dependencies in sync with the
	# Config.in comments in
	# toolchain/toolchain-buildroot/Config.in
	depends on LINGMO_TOOLCHAIN_HEADERS_AT_LEAST_3_2
	depends on LINGMO_TOOLCHAIN_HEADERS_AT_LEAST_3_10 || !LINGMO_powerpc64le
	depends on LINGMO_TOOLCHAIN_HEADERS_AT_LEAST_4_5 || !LINGMO_MIPS_NAN_2008
	depends on LINGMO_TOOLCHAIN_HEADERS_AT_LEAST_5_4 || !LINGMO_RISCV_32
	depends on LINGMO_TOOLCHAIN_HEADERS_AT_LEAST_5_0 || !LINGMO_RISCV_64
	depends on LINGMO_TOOLCHAIN_HEADERS_AT_LEAST_5_1 || !LINGMO_arc
	depends on LINGMO_TOOLCHAIN_HEADERS_AT_LEAST_5_4 || !LINGMO_or1k

if LINGMO_TOOLCHAIN_BUILDROOT_GLIBC

comment "Glibc Options"

config LINGMO_PACKAGE_GLIBC
	bool
	default y
	select LINGMO_PACKAGE_LINUX_HEADERS
	select LINGMO_TOOLCHAIN_HAS_SSP if LINGMO_PACKAGE_HOST_BINUTILS_SUPPORTS_CFI
	help
	  https://www.gnu.org/software/libc/

config LINGMO_PACKAGE_GLIBC_KERNEL_COMPAT
	bool "Enable compatibility shims to run on older kernels"
	help
	  Say 'y' here if you plan on running your system on a kernel
	  older than the version used for the toolchain headers.

	  Enabling those compatibility shims may generate a slightly
	  bigger and slightly slower glibc library.

	  The oldest supported kernel version depends on the
	  architecture.

config LINGMO_PACKAGE_GLIBC_UTILS
	bool "Install glibc utilities"
	help
	  Enabling this option will compile and install the getconf,
	  ldconfig, ldd and locale glibc utilities for the target.

endif # LINGMO_TOOLCHAIN_BUILDROOT_GLIBC
```

## package/glibmm/Config.in
```kconfig
config LINGMO_PACKAGE_GLIBMM
	bool "glibmm (latest)"
	depends on LINGMO_TOOLCHAIN_GCC_AT_LEAST_7 # libsigc
	depends on LINGMO_INSTALL_LIBSTDCPP
	depends on LINGMO_USE_WCHAR # libglib2
	depends on LINGMO_TOOLCHAIN_HAS_THREADS # libglib2
	depends on LINGMO_USE_MMU # libglib2
	select LINGMO_PACKAGE_LIBGLIB2
	select LINGMO_PACKAGE_LIBSIGC
	help
	  The GLibmm package is a set of C++ bindings for GLib.

	  http://www.gtkmm.org/

comment "glibmm needs a toolchain w/ C++, wchar, threads, gcc >= 7"
	depends on LINGMO_USE_MMU
	depends on !LINGMO_TOOLCHAIN_GCC_AT_LEAST_7 || !LINGMO_USE_WCHAR \
		|| !LINGMO_INSTALL_LIBSTDCPP || !LINGMO_TOOLCHAIN_HAS_THREADS
```

## package/glibmm2_66/Config.in
```kconfig
config LINGMO_PACKAGE_GLIBMM2_66
	bool "glibmm (2.66.x)"
	depends on LINGMO_TOOLCHAIN_GCC_AT_LEAST_4_9 # regex_replace
	depends on LINGMO_INSTALL_LIBSTDCPP
	depends on LINGMO_USE_WCHAR # libglib2
	depends on LINGMO_TOOLCHAIN_HAS_THREADS # libglib2
	depends on LINGMO_USE_MMU # libglib2
	select LINGMO_PACKAGE_LIBGLIB2
	select LINGMO_PACKAGE_LIBSIGC2
	help
	  The GLibmm package is a set of C++ bindings for GLib.

	  This is the last version before the API and ABI change
	  introduced in 2.68.0 which requires C++17.

	  http://www.gtkmm.org/

comment "glibmm (2.66.x) needs a toolchain w/ C++, wchar, threads, gcc >= 4.9"
	depends on LINGMO_USE_MMU
	depends on !LINGMO_TOOLCHAIN_GCC_AT_LEAST_4_9 || !LINGMO_USE_WCHAR \
		|| !LINGMO_INSTALL_LIBSTDCPP || !LINGMO_TOOLCHAIN_HAS_THREADS
```

## package/glm/Config.in
```kconfig
config LINGMO_PACKAGE_GLM
	bool "glm"
	depends on LINGMO_INSTALL_LIBSTDCPP
	help
	  OpenGL Mathematics (GLM)

	  http://glm.g-truc.net

comment "glm needs a toolchain w/ C++"
	depends on !LINGMO_INSTALL_LIBSTDCPP
```

## package/glmark2/Config.in
```kconfig
config LINGMO_PACKAGE_GLMARK2_FLAVOR_ANY
	bool

config LINGMO_PACKAGE_GLMARK2_FLAVOR_DRM_GLESV2
	bool
	default y
	depends on LINGMO_PACKAGE_HAS_LIBEGL
	depends on LINGMO_PACKAGE_HAS_LIBGBM
	depends on LINGMO_PACKAGE_HAS_LIBGLES
	depends on LINGMO_PACKAGE_HAS_UDEV
	depends on LINGMO_TOOLCHAIN_HAS_THREADS  # libpthread-stubs -> libdrm
	select LINGMO_PACKAGE_GLMARK2_FLAVOR_ANY

config LINGMO_PACKAGE_GLMARK2_FLAVOR_DRM_GL
	bool
	default y
	depends on LINGMO_PACKAGE_HAS_LIBEGL
	depends on LINGMO_PACKAGE_HAS_LIBGL
	depends on LINGMO_PACKAGE_HAS_UDEV
	select LINGMO_PACKAGE_GLMARK2_FLAVOR_ANY

config LINGMO_PACKAGE_GLMARK2_FLAVOR_WAYLAND_GLESV2
	bool
	default y
	depends on LINGMO_PACKAGE_HAS_LIBEGL
	depends on LINGMO_PACKAGE_HAS_LIBGLES
	depends on LINGMO_PACKAGE_WAYLAND
	select LINGMO_PACKAGE_GLMARK2_FLAVOR_ANY

config LINGMO_PACKAGE_GLMARK2_FLAVOR_WAYLAND_GL
	bool
	default y
	depends on LINGMO_PACKAGE_HAS_LIBEGL
	depends on LINGMO_PACKAGE_HAS_LIBGL
	depends on LINGMO_PACKAGE_WAYLAND
	select LINGMO_PACKAGE_GLMARK2_FLAVOR_ANY

config LINGMO_PACKAGE_GLMARK2_FLAVOR_X11_GLESV2
	bool
	default y
	depends on LINGMO_PACKAGE_HAS_LIBEGL
	depends on LINGMO_PACKAGE_HAS_LIBGLES
	depends on LINGMO_PACKAGE_XLIB_LIBX11
	select LINGMO_PACKAGE_GLMARK2_FLAVOR_ANY

config LINGMO_PACKAGE_GLMARK2_FLAVOR_X11_GL
	bool
	default y
	depends on LINGMO_PACKAGE_HAS_LIBGL
	depends on LINGMO_PACKAGE_XLIB_LIBX11
	select LINGMO_PACKAGE_GLMARK2_FLAVOR_ANY

comment "glmark2 needs a toolchain w/ C++, gcc >= 4.9"
	depends on !LINGMO_INSTALL_LIBSTDCPP || !LINGMO_TOOLCHAIN_GCC_AT_LEAST_4_9

comment "glmark2 needs an OpenGL or an openGL ES and EGL backend"
	depends on LINGMO_TOOLCHAIN_GCC_AT_LEAST_4_9 && LINGMO_INSTALL_LIBSTDCPP
	depends on !LINGMO_PACKAGE_GLMARK2_FLAVOR_ANY

config LINGMO_PACKAGE_GLMARK2
	bool "glmark2"
	depends on LINGMO_INSTALL_LIBSTDCPP
	depends on LINGMO_TOOLCHAIN_GCC_AT_LEAST_4_9 # C++14
	depends on LINGMO_PACKAGE_GLMARK2_FLAVOR_ANY
	select LINGMO_PACKAGE_JPEG
	select LINGMO_PACKAGE_LIBDRM if LINGMO_PACKAGE_GLMARK2_FLAVOR_DRM_GLESV2
	select LINGMO_PACKAGE_LIBPNG
	select LINGMO_PACKAGE_WAYLAND_PROTOCOLS if LINGMO_PACKAGE_GLMARK2_FLAVOR_WAYLAND_GL
	select LINGMO_PACKAGE_WAYLAND_PROTOCOLS if LINGMO_PACKAGE_GLMARK2_FLAVOR_WAYLAND_GLESV2
	help
	  glmark2 is an OpenGL 2.0 and ES 2.0 benchmark.

	  https://github.com/glmark2/glmark2
```

## package/glog/Config.in
```kconfig
config LINGMO_PACKAGE_GLOG
	bool "glog"
	# __ELF__ not defined on Microblaze
	depends on !LINGMO_microblaze
	depends on LINGMO_INSTALL_LIBSTDCPP
	help
	  C++ implementation of the Google logging module

	  https://github.com/google/glog

comment "glog needs a toolchain w/ C++"
	depends on !LINGMO_microblaze
	depends on !LINGMO_INSTALL_LIBSTDCPP
```

## package/gloox/Config.in
```kconfig
config LINGMO_PACKAGE_GLOOX
	bool "gloox"
	depends on LINGMO_INSTALL_LIBSTDCPP
	select LINGMO_PACKAGE_MPC
	help
	  gloox is a portable high-level Jabber/XMPP library for C++. It
	  is fully compliant with the XMPP RFCs, supports all of the
	  XMPP features (including SRV lookups, TLS, SASL, roster
	  management, and privacy lists), and implements several XEPs
	  that make it ideal for writing any kind of Jabber/XMPP client
	  or component.

	  https://camaya.net/gloox/

comment "gloox needs a toolchain w/ C++"
	depends on !LINGMO_INSTALL_LIBSTDCPP
```

## package/glorytun/Config.in
```kconfig
config LINGMO_PACKAGE_GLORYTUN
	bool "glorytun"
	select LINGMO_PACKAGE_LIBSODIUM
	help
	  A small, simple and secure VPN.

	  https://github.com/angt/glorytun
```

## package/glslsandbox-player/Config.in
```kconfig
config LINGMO_PACKAGE_GLSLSANDBOX_PLAYER
	bool "glslsandbox-player"
	depends on LINGMO_PACKAGE_HAS_LIBEGL
	depends on LINGMO_PACKAGE_HAS_LIBGLES
	help
	  GLSL Sandbox standalone player allow one to run and render
	  (most of) nice shaders available online on the
	  http://glslsandbox.com/ website, but without the need of an
	  Internet connection, a web browser or any of its
	  dependencies. Instead, the only requirement of
	  glslsandbox-player is a working EGL and GLESv2 libraries.

	  This package is useful for stressing and testing GLES shader
	  compiler in GPU drivers.

	  https://github.com/jolivain/glslsandbox-player

if LINGMO_PACKAGE_GLSLSANDBOX_PLAYER

config LINGMO_PACKAGE_GLSLSANDBOX_PLAYER_PNG
	bool "Enable PNG support"
	select LINGMO_PACKAGE_LIBPNG
	help
	  Enable PNG texture loading support

config LINGMO_PACKAGE_GLSLSANDBOX_PLAYER_TESTING
	bool "Enable testing"
	help
	  Generate and install test suite on target

config LINGMO_PACKAGE_GLSLSANDBOX_PLAYER_SCRIPTS
	bool "Install scripts"
	depends on !LINGMO_STATIC_LIBS # python3
	depends on LINGMO_TOOLCHAIN_HAS_THREADS # python3
	depends on LINGMO_USE_MMU # bash, python3
	depends on LINGMO_USE_WCHAR # python3
	select LINGMO_PACKAGE_BASH # runtime
	select LINGMO_PACKAGE_BUSYBOX_SHOW_OTHERS if LINGMO_PACKAGE_BUSYBOX # bash
	select LINGMO_PACKAGE_COREUTILS # runtime (timeout)
	select LINGMO_PACKAGE_LIBCURL_CURL # runtime
	select LINGMO_PACKAGE_IMAGEMAGICK # runtime
	select LINGMO_PACKAGE_JPEG # runtime
	select LINGMO_PACKAGE_LIBCURL # runtime
	select LINGMO_PACKAGE_LIBOPENSSL_BIN if LINGMO_PACKAGE_LIBOPENSSL # runtime
	select LINGMO_PACKAGE_LIBRESSL_BIN if LINGMO_PACKAGE_LIBRESSL # runtime
	select LINGMO_PACKAGE_MAKE # runtime
	select LINGMO_PACKAGE_OPENSSL # runtime
	select LINGMO_PACKAGE_PYTHON3 # runtime
	help
	  Install additional helper scripts

choice
	prompt "Native windowing system"
	default LINGMO_PACKAGE_GLSLSANDBOX_PLAYER_MALI  if LINGMO_PACKAGE_SUNXI_MALI_UTGARD
	default LINGMO_PACKAGE_GLSLSANDBOX_PLAYER_MALI_T76X if LINGMO_PACKAGE_MALI_T76X
	default LINGMO_PACKAGE_GLSLSANDBOX_PLAYER_RPI   if LINGMO_PACKAGE_RPI_USERLAND
	default LINGMO_PACKAGE_GLSLSANDBOX_PLAYER_SDL2  if LINGMO_PACKAGE_SDL2_OPENGLES
	default LINGMO_PACKAGE_GLSLSANDBOX_PLAYER_TISGX if LINGMO_PACKAGE_TI_SGX_UM
	default LINGMO_PACKAGE_GLSLSANDBOX_PLAYER_VIVFB if LINGMO_PACKAGE_IMX_GPU_VIV_OUTPUT_FB
	default LINGMO_PACKAGE_GLSLSANDBOX_PLAYER_WL    if LINGMO_PACKAGE_WAYLAND
	default LINGMO_PACKAGE_GLSLSANDBOX_PLAYER_X11   if LINGMO_PACKAGE_XORG7
	help
	  Select the native windowing system you wish to use.

config LINGMO_PACKAGE_GLSLSANDBOX_PLAYER_NULL
	bool "NullWS"
	help
	  Enable Null Windowing System

config LINGMO_PACKAGE_GLSLSANDBOX_PLAYER_KMS
	bool "KMS/DRM/GBM"
	depends on LINGMO_TOOLCHAIN_HAS_THREADS # libdrm
	depends on LINGMO_PACKAGE_HAS_LIBGBM
	select LINGMO_PACKAGE_LIBDRM

config LINGMO_PACKAGE_GLSLSANDBOX_PLAYER_MALI
	bool "Allwinner ARM/Mali Frame Buffer"
	depends on LINGMO_PACKAGE_SUNXI_MALI_UTGARD

config LINGMO_PACKAGE_GLSLSANDBOX_PLAYER_MALI_T76X
	bool "ARM/Mali T76x Frame Buffer"
	depends on LINGMO_PACKAGE_MALI_T76X

config LINGMO_PACKAGE_GLSLSANDBOX_PLAYER_RPI
	bool "RaspberryPI Frame Buffer"
	depends on LINGMO_PACKAGE_RPI_USERLAND

config LINGMO_PACKAGE_GLSLSANDBOX_PLAYER_SDL2
	bool "SDL2"
	depends on LINGMO_PACKAGE_SDL2_OPENGLES

config LINGMO_PACKAGE_GLSLSANDBOX_PLAYER_TISGX
	bool "TI/SGX Frame Buffer"
	depends on LINGMO_PACKAGE_TI_SGX_UM

config LINGMO_PACKAGE_GLSLSANDBOX_PLAYER_VIVFB
	bool "Vivante Frame Buffer"
	depends on LINGMO_PACKAGE_IMX_GPU_VIV

config LINGMO_PACKAGE_GLSLSANDBOX_PLAYER_WL
	bool "Wayland"
	depends on LINGMO_PACKAGE_WAYLAND

config LINGMO_PACKAGE_GLSLSANDBOX_PLAYER_X11
	bool "X11"
	depends on LINGMO_PACKAGE_XORG7
	select LINGMO_PACKAGE_XLIB_LIBX11

endchoice

if LINGMO_PACKAGE_GLSLSANDBOX_PLAYER_WL
config LINGMO_PACKAGE_GLSLSANDBOX_PLAYER_WL_IVI
	bool "Wayland IVI shell support"

config LINGMO_PACKAGE_GLSLSANDBOX_PLAYER_WL_XDG
	bool "Wayland XDG shell support"
	select LINGMO_PACKAGE_WAYLAND_PROTOCOLS
endif
endif

comment "glslsandbox-player needs openGL ES and EGL driver"
	depends on !LINGMO_PACKAGE_HAS_LIBEGL || !LINGMO_PACKAGE_HAS_LIBGLES
```
