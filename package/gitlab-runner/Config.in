## package/gmrender-resurrect/Config.in
```kconfig
config LINGMO_PACKAGE_GMRENDER_RESURRECT
	bool "gmrender-resurrect"
	depends on LINGMO_USE_WCHAR # gstreamer1 -> libglib2
	depends on LINGMO_TOOLCHAIN_HAS_THREADS
	depends on LINGMO_USE_MMU # gstreamer1
	select LINGMO_PACKAGE_GSTREAMER1
	select LINGMO_PACKAGE_GST1_PLUGINS_BASE # run-time only
	select LINGMO_PACKAGE_LIBUPNP
	help
	  UPnP (DLNA) media renderer based on gstreamer

	  https://github.com/hzeller/gmrender-resurrect

comment "gmrender-resurrect needs a toolchain w/ wchar, threads"
	depends on LINGMO_USE_MMU
	depends on !LINGMO_USE_WCHAR || !LINGMO_TOOLCHAIN_HAS_THREADS
```

## package/gnu-efi/Config.in
```kconfig
config LINGMO_PACKAGE_GNU_EFI_ARCH_SUPPORTS
	bool
	default y if LINGMO_ARM_CPU_HAS_ARM
	default y if LINGMO_aarch64
	default y if LINGMO_aarch64_be
	default y if LINGMO_i386
	default y if LINGMO_x86_64

config LINGMO_PACKAGE_GNU_EFI
	bool "gnu-efi"
	depends on LINGMO_PACKAGE_GNU_EFI_ARCH_SUPPORTS
	help
	  Develop EFI applications for ARM-64, ARM-32, x86_64, IA-64
	  (IPF), IA-32 (x86), and MIPS platforms using the GNU toolchain
	  and the EFI development environment.

	  http://gnu-efi.sourceforge.net/
```

## package/gnuchess/Config.in
```kconfig
config LINGMO_PACKAGE_GNUCHESS
	bool "gnuchess"
	depends on LINGMO_INSTALL_LIBSTDCPP
	depends on LINGMO_TOOLCHAIN_HAS_THREADS
	select LINGMO_PACKAGE_FLEX
	help
	  GNU Chess lets most modern computers play a full game of
	  chess.

	  http://ftp.gnu.org/pub/gnu/chess

comment "gnuchess needs a toolchain w/ C++, threads"
	depends on !LINGMO_INSTALL_LIBSTDCPP || !LINGMO_TOOLCHAIN_HAS_THREADS
```

## package/gnupg2/Config.in
```kconfig
comment "gnupg2 needs a toolchain w/ threads and dynamic library support"
	depends on LINGMO_USE_MMU
	depends on LINGMO_STATIC_LIBS || !LINGMO_TOOLCHAIN_HAS_THREADS

# helper to make it easier to select gnupg2 or gnupg; usage:
# select LINGMO_PACKAGE_GNUPG2 if LINGMO_PACKAGE_GNUPG2_DEPENDS && !LINGMO_PACKAGE_GNUPG
# select LINGMO_PACKAGE_GNUPG if !LINGMO_PACKAGE_GNUPG2_DEPENDS

config LINGMO_PACKAGE_GNUPG2_DEPENDS
	bool
	default y
	depends on LINGMO_PACKAGE_LIBGPG_ERROR_ARCH_SUPPORTS # libgpg-error
	depends on LINGMO_TOOLCHAIN_HAS_THREADS # libnpth
	depends on LINGMO_USE_MMU # libassuan, libnpth
	depends on !LINGMO_STATIC_LIBS

config LINGMO_PACKAGE_GNUPG2
	bool "gnupg2"
	depends on LINGMO_PACKAGE_GNUPG2_DEPENDS
	depends on !LINGMO_PACKAGE_GNUPG
	select LINGMO_PACKAGE_ZLIB
	select LINGMO_PACKAGE_LIBGPG_ERROR
	select LINGMO_PACKAGE_LIBGCRYPT
	select LINGMO_PACKAGE_LIBASSUAN
	select LINGMO_PACKAGE_LIBKSBA
	select LINGMO_PACKAGE_LIBNPTH
	select LINGMO_PACKAGE_LIBICONV if !LINGMO_ENABLE_LOCALE
	help
	  GnuPG is the GNU project's complete and free implementation
	  of the OpenPGP standard as defined by RFC4880. GnuPG allows
	  to encrypt and sign your data and communication, features a
	  versatile key management system as well as access modules
	  for all kinds of public key directories. GnuPG, also known
	  as GPG, is a command line tool with features for easy
	  integration with other applications.

	  http://gnupg.org/

if LINGMO_PACKAGE_GNUPG2

config LINGMO_PACKAGE_GNUPG2_GPGV
	bool "gpgv"
	help
	  gpgv is an OpenPGP signature verification tool.

	  This program is actually a stripped-down version of gpg
	  which is only able to check signatures. It is somewhat
	  smaller than the fully-blown gpg and uses a different (and
	  simpler) way to check that the public keys used to make the
	  signature are valid. There are no configuration files and
	  only a few options are implemented.

endif
```

## package/gnuplot/Config.in
```kconfig
config LINGMO_PACKAGE_GNUPLOT
	bool "gnuplot"
	select LINGMO_PACKAGE_READLINE if !LINGMO_PACKAGE_LIBEDIT
	help
	  A portable command-line driven graphing utility.

	  http://www.gnuplot.info/
```

## package/gnuradio/Config.in
```kconfig
comment "gnuradio needs a toolchain w/ C++, NPTL, wchar, dynamic library, gcc >= 8"
	depends on LINGMO_USE_MMU
	depends on LINGMO_TOOLCHAIN_SUPPORTS_ALWAYS_LOCKFREE_ATOMIC_INTS
	depends on !LINGMO_INSTALL_LIBSTDCPP || !LINGMO_USE_WCHAR || \
		!LINGMO_TOOLCHAIN_HAS_THREADS_NPTL || LINGMO_STATIC_LIBS || \
		!LINGMO_TOOLCHAIN_GCC_AT_LEAST_8

comment "gnuradio needs a toolchain not affected by GCC bug 43744"
	depends on LINGMO_TOOLCHAIN_HAS_GCC_BUG_43744

config LINGMO_PACKAGE_GNURADIO
	bool "gnuradio"
	depends on LINGMO_INSTALL_LIBSTDCPP
	depends on !LINGMO_STATIC_LIBS
	depends on LINGMO_TOOLCHAIN_HAS_THREADS_NPTL
	depends on LINGMO_USE_MMU # use fork()
	depends on LINGMO_USE_WCHAR # boost
	depends on LINGMO_TOOLCHAIN_SUPPORTS_ALWAYS_LOCKFREE_ATOMIC_INTS # boost-atomic, boost-thread
	depends on LINGMO_TOOLCHAIN_GCC_AT_LEAST_8
	depends on !LINGMO_TOOLCHAIN_HAS_GCC_BUG_43744
	select LINGMO_PACKAGE_BOOST
	select LINGMO_PACKAGE_BOOST_ATOMIC
	select LINGMO_PACKAGE_BOOST_DATE_TIME
	select LINGMO_PACKAGE_BOOST_PROGRAM_OPTIONS
	select LINGMO_PACKAGE_BOOST_REGEX
	select LINGMO_PACKAGE_BOOST_SYSTEM
	select LINGMO_PACKAGE_BOOST_THREAD
	select LINGMO_PACKAGE_LOG4CPP
	select LINGMO_PACKAGE_GMP
	select LINGMO_PACKAGE_SPDLOG
	select LINGMO_PACKAGE_VOLK
	help
	  GNU Radio is a free & open-source software development
	  toolkit that provides signal processing blocks to implement
	  software radios. It can be used with readily-available
	  low-cost external RF hardware to create software-defined
	  radios, or without hardware in a simulation-like
	  environment. It is widely used in hobbyist, academic and
	  commercial environments to support both wireless
	  communications research and real-world radio systems.

	  http://gnuradio.org/

if LINGMO_PACKAGE_GNURADIO

config LINGMO_PACKAGE_GNURADIO_AUDIO
	bool "gr-audio"
	select LINGMO_PACKAGE_ALSA_LIB if !LINGMO_PACKAGE_PORTAUDIO
	help
	  Add audio source/sink to GNU Radio

config LINGMO_PACKAGE_GNURADIO_BLOCKS
	bool "blocks support"
	help
	  GNU Radio basic block library

config LINGMO_PACKAGE_GNURADIO_CTRLPORT
	bool "ctrlport support"
	help
	  GNU Radio ctrlport block

config LINGMO_PACKAGE_GNURADIO_DTV
	bool "gr-dtv support"
	select LINGMO_PACKAGE_GNURADIO_ANALOG
	select LINGMO_PACKAGE_GNURADIO_FEC
	select LINGMO_PACKAGE_GNURADIO_FILTER
	help
	  various digital television standards blocks

config LINGMO_PACKAGE_GNURADIO_FEC
	bool "gr-fec support"
	select LINGMO_PACKAGE_GNURADIO_BLOCKS
	select LINGMO_PACKAGE_GSL
	help
	  FEC signal processing blocks

config LINGMO_PACKAGE_GNURADIO_PYTHON
	bool "python support"
	depends on LINGMO_PACKAGE_PYTHON3
	depends on LINGMO_PACKAGE_PYTHON_NUMPY_ARCH_SUPPORTS
	depends on LINGMO_TOOLCHAIN_USES_GLIBC || LINGMO_TOOLCHAIN_USES_MUSL # python-numpy
	depends on LINGMO_HOST_GCC_AT_LEAST_9 # host-python-numpy
	select LINGMO_PACKAGE_BOOST_PYTHON
	select LINGMO_PACKAGE_PYTHON_NUMPY # runtime
	select LINGMO_PACKAGE_PYTHON_PYBIND
	select LINGMO_PACKAGE_PYTHON_SIX # runtime
	help
	  Enable python component

comment "python support needs a glibc or musl toolchain w/ host gcc >= 9"
	depends on !LINGMO_HOST_GCC_AT_LEAST_9 || \
		!(LINGMO_TOOLCHAIN_USES_GLIBC || LINGMO_TOOLCHAIN_USES_MUSL)

config LINGMO_PACKAGE_GNURADIO_UTILS
	bool "gr-utils support"
	depends on LINGMO_PACKAGE_GNURADIO_PYTHON
	help
	  Misc python utilities

config LINGMO_PACKAGE_GNURADIO_ZEROMQ
	bool "gr-zeromq support"
	select LINGMO_PACKAGE_CPPZMQ
	select LINGMO_PACKAGE_PYTHON_PYZMQ if LINGMO_PACKAGE_GNURADIO_PYTHON
	help
	  zeromq communication support

config LINGMO_PACKAGE_GNURADIO_ANALOG
	bool "gr-analog support"
	select LINGMO_PACKAGE_GNURADIO_FILTER
	help
	  Analog communications blocks

config LINGMO_PACKAGE_GNURADIO_CHANNELS
	bool "gr-channels support"
	select LINGMO_PACKAGE_GNURADIO_ANALOG
	help
	  Channel model blocks

config LINGMO_PACKAGE_GNURADIO_DIGITAL
	bool "gr-digital support"
	select LINGMO_PACKAGE_GNURADIO_ANALOG
	help
	  Digital communications blocks

config LINGMO_PACKAGE_GNURADIO_FFT
	bool "gr-fft support"
	select LINGMO_PACKAGE_FFTW
	select LINGMO_PACKAGE_FFTW_SINGLE
	select LINGMO_PACKAGE_GNURADIO_BLOCKS
	help
	  FFT signal processing blocks

config LINGMO_PACKAGE_GNURADIO_FILTER
	bool "gr-filter support"
	select LINGMO_PACKAGE_GNURADIO_FFT
	help
	  Filter signal processing blocks

config LINGMO_PACKAGE_GNURADIO_NETWORK
	bool "gr-network support"
	select LINGMO_PACKAGE_GNURADIO_BLOCKS
	help
	  TCP and UDP source/sink blocks

config LINGMO_PACKAGE_GNURADIO_QTGUI
	bool "gr-qtgui"
	depends on LINGMO_PACKAGE_GNURADIO_PYTHON
	depends on LINGMO_PACKAGE_QT5
	select LINGMO_PACKAGE_GNURADIO_FFT
	select LINGMO_PACKAGE_GNURADIO_FILTER
	select LINGMO_PACKAGE_PYTHON_PYQT5
	select LINGMO_PACKAGE_QT5BASE_FONTCONFIG # runtime
	select LINGMO_PACKAGE_QT5BASE_GUI # runtime
	select LINGMO_PACKAGE_QT5BASE_WIDGETS # runtime
	select LINGMO_PACKAGE_QWT
	help
	  GNU Radio Qt scopes

config LINGMO_PACKAGE_GNURADIO_TRELLIS
	bool "gr-trellis support"
	select LINGMO_PACKAGE_GNURADIO_DIGITAL
	help
	  Trellis coded modulation blocks

config LINGMO_PACKAGE_GNURADIO_UHD
	bool "gr-uhd support"
	select LINGMO_PACKAGE_UHD
	select LINGMO_PACKAGE_GNURADIO_ANALOG
	select LINGMO_PACKAGE_GNURADIO_BLOCKS
	select LINGMO_PACKAGE_GNURADIO_FILTER
	help
	  UHD support

endif
```

## package/gnutls/Config.in
```kconfig
config LINGMO_PACKAGE_GNUTLS
	bool "gnutls"
	# https://gitlab.com/gnutls/gnutls/issues/203
	depends on !LINGMO_STATIC_LIBS
	depends on LINGMO_USE_WCHAR
	select LINGMO_PACKAGE_LIBTASN1
	select LINGMO_PACKAGE_LIBUNISTRING
	select LINGMO_PACKAGE_NETTLE
	help
	  GnuTLS is a secure communications library implementing the SSL
	  and TLS protocols and technologies around them.

	  https://www.gnutls.org/

if LINGMO_PACKAGE_GNUTLS

config LINGMO_PACKAGE_GNUTLS_OPENSSL
	bool "OpenSSL compatibility library"
	help
	  Install OpenSSL compatibility library.

config LINGMO_PACKAGE_GNUTLS_TOOLS
	bool "install tools"
	help
	  Install GnuTLS command line tools for various cryptographic
	  tasks.

config LINGMO_PACKAGE_GNUTLS_ENABLE_SSL2
	bool "enable SSLv2"
	help
	  Enable SSLv2 protocol.

config LINGMO_PACKAGE_GNUTLS_ENABLE_GOST
	bool "enable GOST"
	help
	  Enable GOST cipher.

endif

comment "gnutls needs a toolchain w/ wchar, dynamic library"
	depends on !LINGMO_USE_WCHAR || LINGMO_STATIC_LIBS
```

## package/go-bootstrap-stage1/Config.in.host
```kconfig
config LINGMO_PACKAGE_HOST_GO_BOOTSTRAP_STAGE1_ARCH_SUPPORTS
	bool
	# See src/cmd/dist/unix.c for the list of supported architectures
	default y if LINGMO_HOSTARCH = "x86"
	default y if LINGMO_HOSTARCH = "x86_64"
	default y if LINGMO_HOSTARCH = "arm"
```

## package/go-bootstrap-stage2/Config.in.host
```kconfig
config LINGMO_PACKAGE_HOST_GO_BOOTSTRAP_STAGE2_ARCH_SUPPORTS
	bool
	default y
	depends on LINGMO_PACKAGE_HOST_GO_BOOTSTRAP_STAGE1_ARCH_SUPPORTS
```

## package/go/Config.in.host
```kconfig
# Target go packages should depend on LINGMO_PACKAGE_HOST_GO_TARGET_ARCH_SUPPORTS
config LINGMO_PACKAGE_HOST_GO_TARGET_ARCH_SUPPORTS
	bool
	default y
	depends on LINGMO_PACKAGE_HOST_GO_BOOTSTRAP_STAGE2_ARCH_SUPPORTS
	# See https://go.dev/doc/install/source#environment
	# See src/go/build/syslist.go for the list of supported architectures
	depends on (LINGMO_arm && LINGMO_TOOLCHAIN_SUPPORTS_PIE) || LINGMO_aarch64 \
		|| LINGMO_i386 || LINGMO_x86_64 || LINGMO_powerpc64le \
		|| LINGMO_mips64 || LINGMO_mips64el || LINGMO_riscv || LINGMO_s390x
	depends on !LINGMO_ARM_CPU_ARMV4
	# MIPS R6 support in Go has not yet been developed.
	depends on !LINGMO_MIPS_CPU_MIPS64R6
	# Go doesn't support Risc-v 32-bit.
	depends on !LINGMO_RISCV_32
	# Go requires the following Risc-v General (G) features:
	depends on !LINGMO_riscv || (LINGMO_RISCV_ISA_RVI && \
		LINGMO_RISCV_ISA_RVM && LINGMO_RISCV_ISA_RVA && \
		LINGMO_RISCV_ISA_RVF && LINGMO_RISCV_ISA_RVD)

config LINGMO_PACKAGE_HOST_GO_TARGET_CGO_LINKING_SUPPORTS
	bool
	default y
	depends on LINGMO_PACKAGE_HOST_GO_TARGET_ARCH_SUPPORTS
	# Go doesn't support CGO linking on MIPS64x platforms
	# See: https://github.com/karalabe/xgo/issues/46
	depends on !LINGMO_mips64 && !LINGMO_mips64el

# Host go packages should depend on LINGMO_PACKAGE_HOST_GO_HOST_ARCH_SUPPORTS
config LINGMO_PACKAGE_HOST_GO_HOST_ARCH_SUPPORTS
	bool
	default y
	depends on LINGMO_PACKAGE_HOST_GO_BOOTSTRAP_STAGE2_ARCH_SUPPORTS
```

## package/gobject-introspection/Config.in
```kconfig
config LINGMO_PACKAGE_GOBJECT_INTROSPECTION_ARCH_SUPPORTS
	bool
	default y
	depends on LINGMO_PACKAGE_HOST_QEMU_ARCH_SUPPORTS

config LINGMO_PACKAGE_GOBJECT_INTROSPECTION
	bool "gobject-introspection"
	depends on LINGMO_USE_MMU # python3, libglib2
	depends on LINGMO_PACKAGE_GOBJECT_INTROSPECTION_ARCH_SUPPORTS
	# While gcc 4.8 might be compatible with gobject-introspection,
	# The autobuilders use some toolchains from codesourcery which
	# have gcc 4.8 and a very old version of glibc, which will cause
	# compile errors with locale.c. As such, require 4.9 until this
	# can be verified.
	depends on LINGMO_TOOLCHAIN_GCC_AT_LEAST_4_9
	depends on LINGMO_HOST_GCC_AT_LEAST_8 # host-qemu
	depends on LINGMO_TOOLCHAIN_USES_GLIBC
	# gobject-introspection does not require python3 to run on the
	# target; however, because the tools run in a qemu wrapper, a
	# cross-compiled python3 must be installed to staging. As there
	# is no current mechanism to tell Buildroot only to install
	# python to staging, then python must also be installed
	# unconditionally to the target when building
	# gobject-introspection.
	depends on LINGMO_PACKAGE_PYTHON3
	select LINGMO_PACKAGE_HOST_QEMU
	select LINGMO_PACKAGE_HOST_QEMU_LINUX_USER_MODE
	select LINGMO_PACKAGE_LIBFFI
	select LINGMO_PACKAGE_LIBGLIB2
	select LINGMO_PACKAGE_ZLIB
	help
	  GObject introspection is a middleware layer between C
	  libraries (using GObject) and language bindings. The C library
	  can be scanned at compile time and generate a metadata file,
	  in addition to the actual native C library. Then at runtime,
	  language bindings can read this metadata and automatically
	  provide bindings to call into the C library.

	  https://wiki.gnome.org/action/show/Projects/GObjectIntrospection

comment "gobject-introspection needs python3"
	depends on !LINGMO_PACKAGE_PYTHON3
	depends on LINGMO_PACKAGE_GOBJECT_INTROSPECTION_ARCH_SUPPORTS

comment "gobject-introspection needs a glibc toolchain, gcc >= 4.9, host gcc >= 8"
	depends on LINGMO_USE_MMU
	depends on LINGMO_PACKAGE_GOBJECT_INTROSPECTION_ARCH_SUPPORTS
	depends on !LINGMO_TOOLCHAIN_USES_GLIBC || \
		!LINGMO_TOOLCHAIN_GCC_AT_LEAST_4_9 || \
		!LINGMO_HOST_GCC_AT_LEAST_8
```

## package/gocryptfs/Config.in
```kconfig
config LINGMO_PACKAGE_GOCRYPTFS
	bool "gocryptfs"
	depends on LINGMO_PACKAGE_HOST_GO_TARGET_ARCH_SUPPORTS
	depends on LINGMO_TOOLCHAIN_HAS_THREADS
	help
	  gocryptfs is an encrypted FUSE overlay filesystem.

	  https://github.com/rfjakob/gocryptfs

comment "gocryptfs needs a toolchain w/ threads"
	depends on LINGMO_PACKAGE_HOST_GO_TARGET_ARCH_SUPPORTS
	depends on !LINGMO_TOOLCHAIN_HAS_THREADS
```
