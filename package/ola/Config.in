## package/openbox/Config.in
```kconfig
config LINGMO_PACKAGE_OPENBOX
	bool "openbox"
	depends on LINGMO_PACKAGE_XORG7
	depends on LINGMO_TOOLCHAIN_HAS_THREADS # glib2
	depends on LINGMO_USE_MMU # glib2
	depends on LINGMO_USE_WCHAR # glib2
	depends on LINGMO_TOOLCHAIN_HAS_SYNC_4 # pango -> harfbuzz
	depends on LINGMO_TOOLCHAIN_GCC_AT_LEAST_4_9 # pango -> harfbuzz
	depends on LINGMO_INSTALL_LIBSTDCPP # pango -> freetype
	select LINGMO_PACKAGE_LIBGLIB2
	select LINGMO_PACKAGE_LIBXML2
	select LINGMO_PACKAGE_PANGO
	select LINGMO_PACKAGE_XLIB_LIBX11
	# libxft and libxrender are needed to get xft support in pango
	select LINGMO_PACKAGE_XLIB_LIBXFT
	select LINGMO_PACKAGE_XLIB_LIBXRENDER
	help
	  Openbox is a highly configurable, next generation window
	  manager with extensive standards support.

	  http://openbox.org

comment "openbox needs a toolchain w/ C++, threads, wchar, gcc >= 4.9"
	depends on LINGMO_USE_MMU
	depends on LINGMO_TOOLCHAIN_HAS_SYNC_4
	depends on !LINGMO_TOOLCHAIN_HAS_THREADS || !LINGMO_USE_WCHAR || \
		!LINGMO_TOOLCHAIN_GCC_AT_LEAST_4_9 || \
		!LINGMO_INSTALL_LIBSTDCPP
	depends on LINGMO_PACKAGE_XORG7
```

## package/opencl-clhpp/Config.in
```kconfig
config LINGMO_PACKAGE_OPENCL_CLHPP
	bool "opencl-clhpp"
	# header only library, so there is no build per-se, but
	# packages depending on us will need C++ support
	depends on LINGMO_INSTALL_LIBSTDCPP
	depends on LINGMO_PACKAGE_HAS_LIBOPENCL
	help
	  opencl-clhpp are the OpenCL API C++ bindings

	  http://github.khronos.org/OpenCL-CLHPP/

comment "opencl-clhpp needs a toolchain w/ C++"
	depends on LINGMO_PACKAGE_HAS_LIBOPENCL
	depends on !LINGMO_INSTALL_LIBSTDCPP
```

## package/opencore-amr/Config.in
```kconfig
config LINGMO_PACKAGE_OPENCORE_AMR
	bool "opencore-amr"
	depends on LINGMO_INSTALL_LIBSTDCPP
	help
	  Library of OpenCORE Framework implementation of Adaptive
	  Multi Rate Narrowband and Wideband (AMR-NB and AMR-WB)
	  speech codec.

	  http://opencore-amr.sourceforge.net/

comment "opencore-amr needs a toolchain w/ C++"
	depends on !LINGMO_INSTALL_LIBSTDCPP
```

## package/opencsd/Config.in
```kconfig
config LINGMO_PACKAGE_OPENCSD_ARCH_SUPPORTS
	bool
	default y if LINGMO_arm
	default y if LINGMO_armeb
	default y if LINGMO_aarch64
	default y if LINGMO_aarch64_be

config LINGMO_PACKAGE_OPENCSD
	bool "opencsd"
	depends on LINGMO_PACKAGE_OPENCSD_ARCH_SUPPORTS
	depends on !LINGMO_STATIC_LIBS
	depends on LINGMO_INSTALL_LIBSTDCPP
	depends on LINGMO_TOOLCHAIN_GCC_AT_LEAST_4_8 # C++11
	help
	  This library provides an API suitable for the decode of
	  ARM(r) CoreSight(tm) trace streams.

	  OpenCSD is for example an optional dependency in the Linux
	  "perf" tool, starting from kernel version 5.1.

	  https://github.com/Linaro/OpenCSD

comment "opencsd needs a toolchain w/ C++11, gcc >= 4.8, dynamic library"
	depends on LINGMO_PACKAGE_OPENCSD_ARCH_SUPPORTS
	depends on LINGMO_STATIC_LIBS \
		|| !LINGMO_INSTALL_LIBSTDCPP \
		|| !LINGMO_TOOLCHAIN_GCC_AT_LEAST_4_8
```

## package/opencv3/Config.in
```kconfig
menuconfig LINGMO_PACKAGE_OPENCV3
	bool "opencv3"
	depends on LINGMO_TOOLCHAIN_HAS_ATOMIC
	depends on LINGMO_TOOLCHAIN_HAS_THREADS_NPTL
	depends on LINGMO_INSTALL_LIBSTDCPP
	depends on LINGMO_USE_WCHAR
	depends on !LINGMO_STATIC_LIBS # include dlfcn.h
	select LINGMO_PACKAGE_ZLIB
	help
	  OpenCV (Open Source Computer Vision) is a library of
	  programming functions for real time computer vision.

	  Note that the opencv_core module and the opencv_hal library
	  are always built and installed, not matter which other
	  modules are enabled below.

	  http://opencv.org/

if LINGMO_PACKAGE_OPENCV3

comment "OpenCV modules"

config LINGMO_PACKAGE_OPENCV3_LIB_CALIB3D
	bool "calib3d"
	select LINGMO_PACKAGE_OPENCV3_LIB_FEATURES2D
	select LINGMO_PACKAGE_OPENCV3_LIB_IMGPROC
	help
	  Include opencv_calib3d (camera calibration and 3d
	  reconstruction) module into the OpenCV build.

config LINGMO_PACKAGE_OPENCV3_LIB_FEATURES2D
	bool "features2d"
	select LINGMO_PACKAGE_OPENCV3_LIB_FLANN
	select LINGMO_PACKAGE_OPENCV3_LIB_IMGPROC
	select LINGMO_PACKAGE_OPENCV3_LIB_ML
	help
	  Include opencv_features2d (2d features framework) module
	  into the OpenCV build.

config LINGMO_PACKAGE_OPENCV3_LIB_FLANN
	bool "flann"
	# opencv_core dependency is already enabled
	help
	  Include opencv_flann (clustering and search in
	  multi-dimensional spaces) module into the OpenCV build.

config LINGMO_PACKAGE_OPENCV3_LIB_HIGHGUI
	bool "highgui"
	select LINGMO_PACKAGE_OPENCV3_LIB_IMGCODECS
	select LINGMO_PACKAGE_OPENCV3_LIB_IMGPROC
	select LINGMO_PACKAGE_OPENCV3_LIB_VIDEOIO
	help
	  Include opencv_highgui (high-level gui and media i/o) module
	  into the OpenCV build.

if LINGMO_PACKAGE_OPENCV3_LIB_HIGHGUI

choice
	prompt "gui toolkit"
	help
	  GUI toolkit to be used by the opencv_highgui module.

config LINGMO_PACKAGE_OPENCV3_GUI_NONE
	bool "none"

config LINGMO_PACKAGE_OPENCV3_WITH_GTK
	bool "gtk2"
	depends on LINGMO_PACKAGE_LIBGTK2

comment "gtk2 support needs libgtk2"
	depends on LINGMO_USE_MMU # libgtk2 -> glib2
	depends on LINGMO_TOOLCHAIN_HAS_SYNC_4
	depends on !LINGMO_PACKAGE_LIBGTK2

config LINGMO_PACKAGE_OPENCV3_WITH_GTK3
	bool "gtk3"
	depends on LINGMO_PACKAGE_LIBGTK3

comment "gtk3 support needs libgtk3"
	depends on LINGMO_USE_MMU # libgtk3 -> glib2
	depends on LINGMO_TOOLCHAIN_HAS_SYNC_4
	depends on !LINGMO_PACKAGE_LIBGTK3

config LINGMO_PACKAGE_OPENCV3_WITH_QT5
	bool "qt5"
	depends on LINGMO_PACKAGE_QT5
	select LINGMO_PACKAGE_QT5BASE_CONCURRENT
	select LINGMO_PACKAGE_QT5BASE_GUI
	select LINGMO_PACKAGE_QT5BASE_WIDGETS
	help
	  Use Qt5 with base, concurrent, test, gui and widgets
	  components, as GUI toolkit.

comment "qt5 support needs qt5"
	depends on !LINGMO_PACKAGE_QT5

endchoice

config LINGMO_PACKAGE_OPENCV3_WITH_OPENGL
	bool "opengl support"
	# OpenGL support done using Qt5OpenGL, so depends on WITH_QT5
	depends on LINGMO_PACKAGE_OPENCV3_WITH_QT5
	# OpenGL support requires Qt5OpenGL with GL support, not GLES
	depends on LINGMO_PACKAGE_QT5_GL_AVAILABLE
	depends on LINGMO_PACKAGE_HAS_LIBGL
	select LINGMO_PACKAGE_QT5BASE_OPENGL
	help
	  Enable OpenGL for UI.

comment "opengl support needs an OpenGL provider"
	depends on LINGMO_PACKAGE_OPENCV3_WITH_QT5
	depends on !LINGMO_PACKAGE_QT5_GL_AVAILABLE || \
		!LINGMO_PACKAGE_HAS_LIBGL

endif # LINGMO_PACKAGE_OPENCV3_LIB_HIGHGUI

config LINGMO_PACKAGE_OPENCV3_LIB_IMGCODECS
	bool "imgcodecs"
	select LINGMO_PACKAGE_OPENCV3_LIB_IMGPROC
	help
	  Include opencv_imgcodecs (image codecs) module into the
	  OpenCV build.

config LINGMO_PACKAGE_OPENCV3_LIB_IMGPROC
	bool "imgproc"
	# opencv_core dependency is already enabled
	help
	  Include opencv_imgproc (image processing) module into the
	  OpenCV build.

config LINGMO_PACKAGE_OPENCV3_LIB_ML
	bool "ml"
	# opencv_core dependency is already enabled
	help
	  Include opencv_ml (machine learning) module into the OpenCV
	  build.

config LINGMO_PACKAGE_OPENCV3_LIB_OBJDETECT
	bool "objdetect"
	# opencv_core dependency is already enabled
	select LINGMO_PACKAGE_OPENCV3_LIB_CALIB3D
	select LINGMO_PACKAGE_OPENCV3_LIB_IMGPROC
	select LINGMO_PACKAGE_OPENCV3_LIB_ML
	help
	  Include opencv_objdetect (object detection) module into the
	  OpenCV build.

config LINGMO_PACKAGE_OPENCV3_LIB_PHOTO
	bool "photo"
	select LINGMO_PACKAGE_OPENCV3_LIB_IMGPROC
	help
	  Include opencv_photo (computational photography) module into
	  the OpenCV build.

config LINGMO_PACKAGE_OPENCV3_LIB_PYTHON
	bool "python"
	depends on LINGMO_PACKAGE_PYTHON3
	depends on LINGMO_PACKAGE_PYTHON_NUMPY_ARCH_SUPPORTS
	depends on LINGMO_TOOLCHAIN_USES_GLIBC || LINGMO_TOOLCHAIN_USES_MUSL # python-numpy
	depends on LINGMO_TOOLCHAIN_GCC_AT_LEAST_9 # python-numpy
	select LINGMO_PACKAGE_PYTHON_NUMPY
	help
	  Include opencv_python module into the OpenCV build.  No
	  python example is installed.

comment "python support needs a glibc or musl toolchain w/ gcc >= 9"
	depends on LINGMO_PACKAGE_PYTHON3
	depends on LINGMO_PACKAGE_PYTHON_NUMPY_ARCH_SUPPORTS
	depends on !LINGMO_TOOLCHAIN_GCC_AT_LEAST_9 || \
		!(LINGMO_TOOLCHAIN_USES_GLIBC || LINGMO_TOOLCHAIN_USES_MUSL)

config LINGMO_PACKAGE_OPENCV3_LIB_SHAPE
	bool "shape"
	# opencv_core dependency is already enabled
	select LINGMO_PACKAGE_OPENCV3_LIB_IMGPROC
	select LINGMO_PACKAGE_OPENCV3_LIB_VIDEO
	help
	  Include opencv_shape (shape descriptors and matchers) module
	  into the OpenCV build.

config LINGMO_PACKAGE_OPENCV3_LIB_STITCHING
	bool "stitching"
	select LINGMO_PACKAGE_OPENCV3_LIB_CALIB3D
	select LINGMO_PACKAGE_OPENCV3_LIB_FEATURES2D
	select LINGMO_PACKAGE_OPENCV3_LIB_IMGPROC
	select LINGMO_PACKAGE_OPENCV3_LIB_OBJDETECT
	help
	  Include opencv_stitching (images stitching) module into the
	  OpenCV build.

config LINGMO_PACKAGE_OPENCV3_LIB_SUPERRES
	bool "superres"
	select LINGMO_PACKAGE_OPENCV3_LIB_IMGPROC
	select LINGMO_PACKAGE_OPENCV3_LIB_VIDEO
	help
	  Include opencv_superres (super resolution) module into the
	  OpenCV build.

config LINGMO_PACKAGE_OPENCV3_LIB_TS
	bool "ts"
	# opencv_core dependency is already enabled
	select LINGMO_PACKAGE_OPENCV3_LIB_HIGHGUI
	select LINGMO_PACKAGE_OPENCV3_LIB_IMGCODECS
	select LINGMO_PACKAGE_OPENCV3_LIB_IMGPROC
	select LINGMO_PACKAGE_OPENCV3_LIB_VIDEOIO
	help
	  Include opencv_ts (test) module into the OpenCV build.

config LINGMO_PACKAGE_OPENCV3_LIB_VIDEOIO
	bool "videoio"
	select LINGMO_PACKAGE_OPENCV3_LIB_IMGCODECS
	select LINGMO_PACKAGE_OPENCV3_LIB_IMGPROC
	help
	  Include opencv_videoio (media i/o) module into the OpenCV
	  build.

config LINGMO_PACKAGE_OPENCV3_LIB_VIDEO
	bool "video"
	select LINGMO_PACKAGE_OPENCV3_LIB_IMGPROC
	help
	  Include opencv_video (video analysis) module into the OpenCV
	  build.

config LINGMO_PACKAGE_OPENCV3_LIB_VIDEOSTAB
	bool "videostab"
	select LINGMO_PACKAGE_OPENCV3_LIB_CALIB3D
	select LINGMO_PACKAGE_OPENCV3_LIB_FEATURES2D
	select LINGMO_PACKAGE_OPENCV3_LIB_IMGPROC
	select LINGMO_PACKAGE_OPENCV3_LIB_PHOTO
	select LINGMO_PACKAGE_OPENCV3_LIB_VIDEO
	help
	  Include opencv_videostab (video stabilization) module into
	  the OpenCV build.

comment "Test sets"
config LINGMO_PACKAGE_OPENCV3_BUILD_TESTS
	bool "build tests"

config LINGMO_PACKAGE_OPENCV3_BUILD_PERF_TESTS
	bool "build performance tests"

comment "3rd party support"

config LINGMO_PACKAGE_OPENCV3_WITH_FFMPEG
	bool "ffmpeg support"
	depends on LINGMO_PACKAGE_FFMPEG_ARCH_SUPPORTS
	select LINGMO_PACKAGE_BZIP2
	select LINGMO_PACKAGE_FFMPEG
	select LINGMO_PACKAGE_FFMPEG_AVRESAMPLE
	select LINGMO_PACKAGE_FFMPEG_SWSCALE
	help
	  Use ffmpeg from the target system.

config LINGMO_PACKAGE_OPENCV3_WITH_GSTREAMER1
	bool "gstreamer-1.x"
	depends on LINGMO_USE_MMU # gstreamer1 -> libglib2
	depends on LINGMO_USE_WCHAR # gstreamer1 -> libglib2
	depends on LINGMO_TOOLCHAIN_HAS_THREADS # gstreamer1 -> libglib2
	select LINGMO_PACKAGE_GSTREAMER1
	select LINGMO_PACKAGE_GST1_PLUGINS_BASE
	select LINGMO_PACKAGE_GST1_PLUGINS_BASE_PLUGIN_APP
	help
	  Enable gstreamer support.

comment "gstreamer support needs a toolchain w/ wchar, threads"
	depends on LINGMO_USE_MMU
	depends on !LINGMO_USE_WCHAR || !LINGMO_TOOLCHAIN_HAS_THREADS

config LINGMO_PACKAGE_OPENCV3_WITH_JASPER
	bool "jpeg2000 support"
	select LINGMO_PACKAGE_JASPER
	help
	  Enable jpeg2000 support.

	  Note: this does not use the libjasper bundled with opencv,
	  but uses the libjasper package installed system-wide by
	  Buildroot.

config LINGMO_PACKAGE_OPENCV3_WITH_JPEG
	bool "jpeg support"
	select LINGMO_PACKAGE_JPEG
	help
	  Use shared libjpeg from the target system.

config LINGMO_PACKAGE_OPENCV3_WITH_PNG
	bool "png support"
	select LINGMO_PACKAGE_LIBPNG
	help
	  Use shared libpng from the target system.

config LINGMO_PACKAGE_OPENCV3_WITH_PROTOBUF
	bool "protobuf support"
	depends on LINGMO_PACKAGE_PROTOBUF_ARCH_SUPPORTS # protobuf
	depends on LINGMO_TOOLCHAIN_GCC_AT_LEAST_4_8 # protobuf
	select LINGMO_PACKAGE_PROTOBUF
	help
	  Use shared protobuf from the target system.

comment "protobuf support needs a toolchain w/ gcc >= 4.8"
	depends on LINGMO_PACKAGE_PROTOBUF_ARCH_SUPPORTS
	depends on !LINGMO_TOOLCHAIN_GCC_AT_LEAST_4_8

config LINGMO_PACKAGE_OPENCV3_WITH_TIFF
	bool "tiff support"
	select LINGMO_PACKAGE_TIFF
	help
	  Use shared libtiff from the target system.

config LINGMO_PACKAGE_OPENCV3_WITH_V4L
	bool "v4l support"
	help
	  Enable Video 4 Linux support.

	  If the package libv4l is enabled, its support is
	  automatically enabled.

config LINGMO_PACKAGE_OPENCV3_WITH_WEBP
	bool "webp support"
	select LINGMO_PACKAGE_WEBP
	help
	  Enable WebP support.

	  Use shared libwebp from the target system.

comment "Install options"

config LINGMO_PACKAGE_OPENCV3_INSTALL_DATA
	bool "install extra data"
	help
	  Install various data that is used by cv libraries and/or
	  demo applications, specifically for haarcascades and
	  lbpcascades features.

	  For further information: see OpenCV documentation.

endif # LINGMO_PACKAGE_OPENCV3

comment "opencv3 needs a toolchain w/ C++, NPTL, wchar, dynamic library"
	depends on LINGMO_TOOLCHAIN_HAS_ATOMIC
	depends on !LINGMO_INSTALL_LIBSTDCPP || \
		!LINGMO_USE_WCHAR || \
		!LINGMO_TOOLCHAIN_HAS_THREADS_NPTL || \
		LINGMO_STATIC_LIBS
```
