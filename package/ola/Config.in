## package/opencv4-contrib/Config.in
```kconfig
menuconfig LINGMO_PACKAGE_OPENCV4_CONTRIB
	bool "opencv4-contrib"
	depends on LINGMO_PACKAGE_OPENCV4
	help
	  OpenCV (Open Source Computer Vision) is a library of
	  programming functions for real time computer vision.

	  http://opencv.org/

if LINGMO_PACKAGE_OPENCV4_CONTRIB

config LINGMO_PACKAGE_OPENCV4_CONTRIB_LIB_ALPHAMAT
	bool "alphamat"
	help
	  Computer Vision based Alpha Matting -- Given an input image
	  and a trimap, generate an alpha matte.

config LINGMO_PACKAGE_OPENCV4_CONTRIB_LIB_ARUCO
	bool "aruco"
	select LINGMO_PACKAGE_OPENCV4_LIB_CALIB3D
	help
	  ArUco and ChArUco Markers -- Augmented reality ArUco marker
	  and "ChARUco" markers where ArUco markers embedded inside the
	  white areas of the checker board.

config LINGMO_PACKAGE_OPENCV4_CONTRIB_LIB_BARCODE
	bool "barcode"
	help
	  Barcode detecting and decoding methods.

config LINGMO_PACKAGE_OPENCV4_CONTRIB_LIB_BGSEGM
	bool "bgsegm"
	select LINGMO_PACKAGE_OPENCV4_LIB_VIDEO
	help
	  Background segmentation algorithm combining statistical
	  background image estimation and per-pixel Bayesian
	  segmentation.

config LINGMO_PACKAGE_OPENCV4_CONTRIB_LIB_BIOINSPIRED
	bool "bioinspired"
	help
	  Biological Vision -- Biologically inspired vision model:
	  minimize noise and luminance variance, transient event
	  segmentation, high dynamic range tone mapping methods.

config LINGMO_PACKAGE_OPENCV4_CONTRIB_LIB_CCALIB
	bool "ccalib"
	select LINGMO_PACKAGE_OPENCV4_LIB_HIGHGUI
	help
	  Custom Calibration -- Patterns for 3D reconstruction,
	  omnidirectional camera calibration, random pattern calibration
	  and multi-camera calibration.

config LINGMO_PACKAGE_OPENCV4_CONTRIB_LIB_CNN_3DOBJ
	bool "cnn_3dobj"
	help
	  Deep Object Recognition and Pose -- Uses Caffe Deep Neural Net
	  library to build, train and test a CNN model of visual object
	  recognition and pose.

config LINGMO_PACKAGE_OPENCV4_CONTRIB_LIB_CVV
	bool "cvv"
	help
	  Computer Vision Debugger -- Simple code that you can add
	  to your program that pops up a GUI allowing you to
	  interactively and visually debug computer vision programs.

config LINGMO_PACKAGE_OPENCV4_CONTRIB_LIB_DATASETS
	bool "datasets"
	help
	  Datasets Reader -- Code for reading existing computer vision
	  databases and samples of using the readers to train, test and
	  run using that dataset's data.

config LINGMO_PACKAGE_OPENCV4_CONTRIB_LIB_DNN_OBJDETECT
	bool "dnn_objdetect"
	depends on LINGMO_PACKAGE_PROTOBUF_ARCH_SUPPORTS # opencv4 dnn
	depends on !LINGMO_TOOLCHAIN_USES_UCLIBC # opencv4 dnn
	select LINGMO_PACKAGE_OPENCV4_LIB_DNN
	help
	  Object Detection using CNNs -- Implements compact CNN Model
	  for object detection. Trained using Caffe but uses
	  opencv_dnn module.

comment "dnn_objdetect needs a glibc or musl toolchain"
	depends on LINGMO_PACKAGE_PROTOBUF_ARCH_SUPPORTS
	depends on !LINGMO_TOOLCHAIN_USES_UCLIBC

config LINGMO_PACKAGE_OPENCV4_CONTRIB_LIB_DNN_SUPERRES
	bool "dnn_superres"
	depends on LINGMO_PACKAGE_PROTOBUF_ARCH_SUPPORTS # opencv4 dnn
	depends on !LINGMO_TOOLCHAIN_USES_UCLIBC # opencv4 dnn
	select LINGMO_PACKAGE_OPENCV4_LIB_DNN
	help
	  Superresolution using CNNs -- Contains four trained
	  convolutional neural networks to upscale images.

comment "dnn_superres needs a glibc or musl toolchain"
	depends on LINGMO_PACKAGE_PROTOBUF_ARCH_SUPPORTS
	depends on !LINGMO_TOOLCHAIN_USES_UCLIBC

config LINGMO_PACKAGE_OPENCV4_CONTRIB_LIB_DNNS_EASILY_FOOLED
	bool "dnns_easily_fooled"
	help
	  Subvert DNNs -- This code can use the activations in a
	  network to fool the networks into recognizing something else.

config LINGMO_PACKAGE_OPENCV4_CONTRIB_LIB_DPM
	bool "dpm"
	depends on LINGMO_PACKAGE_PROTOBUF_ARCH_SUPPORTS # opencv4 objdetect
	depends on !LINGMO_TOOLCHAIN_USES_UCLIBC # opencv4 objdetect
	select LINGMO_PACKAGE_OPENCV4_LIB_OBJDETECT
	help
	  Deformable Part Model -- Felzenszwalb's Cascade with
	  deformable parts object recognition code.

comment "dpm needs a glibc or musl toolchain"
	depends on LINGMO_PACKAGE_PROTOBUF_ARCH_SUPPORTS # opencv4 objdetect
	depends on LINGMO_TOOLCHAIN_USES_UCLIBC # opencv4 objdetect

config LINGMO_PACKAGE_OPENCV4_CONTRIB_LIB_FACE
	bool "face"
	depends on LINGMO_PACKAGE_PROTOBUF_ARCH_SUPPORTS # opencv4 objdetect
	depends on !LINGMO_TOOLCHAIN_USES_UCLIBC # opencv4 objdetect
	select LINGMO_PACKAGE_OPENCV4_LIB_OBJDETECT
	help
	  Face Recognition -- Face recognition techniques: Eigen, Fisher
	  and Local Binary Pattern Histograms LBPH methods.

comment "face needs a glibc or musl toolchain"
	depends on LINGMO_PACKAGE_PROTOBUF_ARCH_SUPPORTS # opencv4 objdetect
	depends on LINGMO_TOOLCHAIN_USES_UCLIBC # opencv4 objdetect

config LINGMO_PACKAGE_OPENCV4_CONTRIB_LIB_FREETYPE
	bool "freetype"
	help
	  Drawing text using freetype and harfbuzz.

config LINGMO_PACKAGE_OPENCV4_CONTRIB_LIB_FUZZY
	bool "fuzzy"
	help
	  Fuzzy Logic in Vision -- Fuzzy logic image transform and
	  inverse; Fuzzy image processing.

config LINGMO_PACKAGE_OPENCV4_CONTRIB_LIB_HDF
	bool "hdf"
	help
	  Hierarchical Data Storage -- This module contains I/O
	  routines for Hierarchical Data Format:
	  https://en.m.wikipedia.org/wiki/Hierarchical_Data_Format
	  meant to store large amounts of data.

config LINGMO_PACKAGE_OPENCV4_CONTRIB_LIB_HFS
	bool "hfs"
	help
	  Hierarchical Feature Selection for Efficient Image
	  Segmentation -- This module contains an efficient
	  algorithm to segment an image.

config LINGMO_PACKAGE_OPENCV4_CONTRIB_LIB_IMG_HASH
	bool "img_hash"
	help
	  This module contains algorithms to extract hash of an
	  image allowing to efficiently estimate similarity between
	  images.

config LINGMO_PACKAGE_OPENCV4_CONTRIB_LIB_INTENSITY_TRANSFORM
	bool "intensity_transform"
	help
	  The module brings implementations of intensity transformation
	  algorithms to adjust image contrast.

config LINGMO_PACKAGE_OPENCV4_CONTRIB_LIB_JULIA
	bool "julia"
	help
	  Julia language wrappers with samples and tests.

config LINGMO_PACKAGE_OPENCV4_CONTRIB_LIB_LINE_DESCRIPTOR
	bool "line_descriptor"
	help
	  Line Segment Extract and Match -- Methods of extracting,
	  describing and matching line segments using binary
	  descriptors.

config LINGMO_PACKAGE_OPENCV4_CONTRIB_LIB_MATLAB
	bool "matlab"
	help
	  Matlab Interface -- OpenCV Matlab Mex wrapper code generator
	  for certain opencv core modules.

config LINGMO_PACKAGE_OPENCV4_CONTRIB_LIB_MCC
	bool "mcc"
	help
	  Macbeth Color Chart detector -- Find and return color patch
	  location in MacBeth color calibration charts.

config LINGMO_PACKAGE_OPENCV4_CONTRIB_LIB_OPTFLOW
	bool "optflow"
	select LINGMO_PACKAGE_OPENCV4_LIB_VIDEO
	help
	  Optical Flow -- Algorithms for running and evaluating
	  deepflow, simpleflow, sparsetodenseflow and motion
	  templates (silhouette flow).

config LINGMO_PACKAGE_OPENCV4_CONTRIB_LIB_OVIS
	bool "ovis"
	help
	  OGRE 3D Visualiser -- allows you to render 3D data using
	  the OGRE 3D engine.

config LINGMO_PACKAGE_OPENCV4_CONTRIB_LIB_PHASE_UNWRAPPING
	bool "phase_unwrapping"
	help
	  Quality-guided phase unwrapping.

config LINGMO_PACKAGE_OPENCV4_CONTRIB_LIB_PLOT
	bool "plot"
	help
	  Plotting -- The plot module allows you to easily plot data
	  in 1D or 2D.

config LINGMO_PACKAGE_OPENCV4_CONTRIB_LIB_QUALITY
	bool "quality"
	help
	  Image Quality Analysis (IQA) API.

config LINGMO_PACKAGE_OPENCV4_CONTRIB_LIB_RAPID
	bool "rapid"
	help
	  Silhouette based 3D object tracking.

config LINGMO_PACKAGE_OPENCV4_CONTRIB_LIB_REG
	bool "reg"
	help
	  Image Registration -- Pixels based image registration for
	  precise alignment. Follows the paper "Image Alignment and
	  Stitching: A Tutorial", by Richard Szeliski.

config LINGMO_PACKAGE_OPENCV4_CONTRIB_LIB_RGBD
	bool "rgbd"
	help
	  RGB-Depth Processing module -- Linemod 3D object recognition;
	  Fast surface normals and 3D plane finding. 3D visual odometry.
	  3d reconstruction using KinectFusion.

config LINGMO_PACKAGE_OPENCV4_CONTRIB_LIB_SALIENCY
	bool "saliency"
	help
	  Saliency API -- Where humans would look in a scene. Has
	  routines for static, motion and "objectness" saliency.

config LINGMO_PACKAGE_OPENCV4_CONTRIB_LIB_SFM
	bool "sfm"
	select LINGMO_PACKAGE_OPENCV4_LIB_IMGPROC
	select LINGMO_PACKAGE_OPENCV4_LIB_IMGCODECS
	select LINGMO_PACKAGE_EIGEN
	select LINGMO_PACKAGE_GLOG
	select LINGMO_PACKAGE_GFLAGS
	help
	  Structure from Motion -- This module contains algorithms
	  to perform 3d reconstruction from 2d images. The core of
	  the module is a light version of Libmv.

config LINGMO_PACKAGE_OPENCV4_CONTRIB_LIB_SHAPE
	bool "shape"
	help
	  Shape Distance and Matching

config LINGMO_PACKAGE_OPENCV4_CONTRIB_LIB_STEREO
	bool "stereo"
	select LINGMO_PACKAGE_OPENCV4_CONTRIB_LIB_TRACKING
	help
	  Stereo Correspondence -- Stereo matching done with different
	  descriptors: Census / CS-Census / MCT / BRIEF / MV and dense
	  stereo correspondence using Quasi Dense Stereo method.

config LINGMO_PACKAGE_OPENCV4_CONTRIB_LIB_STRUCTURED_LIGHT
	bool "structured_light"
	help
	  Structured Light Use -- How to generate and project gray code
	  patterns and use them to find dense depth in a scene.

config LINGMO_PACKAGE_OPENCV4_CONTRIB_LIB_SUPERRES
	bool "superres"
	select LINGMO_PACKAGE_OPENCV4_LIB_VIDEO
	help
	  Super Resolution

config LINGMO_PACKAGE_OPENCV4_CONTRIB_LIB_SURFACE_MATCHING
	bool "surface_matching"
	help
	  Point Pair Features -- Implements 3d object detection and
	  localization using multimodal point pair features.

config LINGMO_PACKAGE_OPENCV4_CONTRIB_LIB_TEXT
	bool "text"
	help
	  Scene Text Detection and Recognition -- This module contains
	  algorithms to perform text detection, words segmentation and
	  text recognition in a visual scene.

config LINGMO_PACKAGE_OPENCV4_CONTRIB_LIB_TRACKING
	bool "tracking"
	select LINGMO_PACKAGE_OPENCV4_LIB_VIDEO
	help
	  Vision Based Object Tracking -- Use and/or evaluate different
	  visual object tracking techniques.

config LINGMO_PACKAGE_OPENCV4_CONTRIB_LIB_VIDEOSTAB
	bool "videostab"
	select LINGMO_PACKAGE_OPENCV4_LIB_VIDEO
	select LINGMO_PACKAGE_OPENCV4_LIB_PHOTO
	help
	  Video Stabilization

config LINGMO_PACKAGE_OPENCV4_CONTRIB_LIB_VIZ
	bool "viz"
	help
	  3D Visualizer

config LINGMO_PACKAGE_OPENCV4_CONTRIB_LIB_WECHAT_QRCODE
	bool "wechat_qrcode"
	help
	  WeChat QR code detector for detecting and parsing QR code.

config LINGMO_PACKAGE_OPENCV4_CONTRIB_LIB_XFEATURES2D
	bool "xfeatures2d"
	help
	  Features2D extra -- Extra 2D Features Framework containing
	  experimental and non-free 2D feature detector/descriptor
	  algorithms. SURF, BRIEF, Censure, Freak, LUCID, Daisy,
	  Self-similar.

config LINGMO_PACKAGE_OPENCV4_CONTRIB_LIB_XIMGPROC
	bool "ximgproc"
	help
	  Extended Image Processing -- Structured Forests / Domain
	  Transform Filter / Guided Filter / Adaptive Manifold Filter
	  / Joint Bilateral Filter / Superpixels / Ridge Detection
	  Filter.

config LINGMO_PACKAGE_OPENCV4_CONTRIB_LIB_XOBJDETECT
	bool "xobjdetect"
	depends on LINGMO_PACKAGE_PROTOBUF_ARCH_SUPPORTS # opencv4 objdetect
	depends on !LINGMO_TOOLCHAIN_USES_UCLIBC # opencv4 objdetect
	select LINGMO_PACKAGE_OPENCV4_LIB_OBJDETECT
	help
	  Boosted 2D Object Detection -- Uses a Waldboost cascade and
	  local binary patterns computed as integral features for 2D
	  object detection.

comment "xobjdetect needs a glibc or musl toolchain"
	depends on LINGMO_PACKAGE_PROTOBUF_ARCH_SUPPORTS # opencv4 objdetect
	depends on LINGMO_TOOLCHAIN_USES_UCLIBC # opencv4 objdetect

config LINGMO_PACKAGE_OPENCV4_CONTRIB_LIB_XPHOTO
	bool "xphoto"
	select LINGMO_PACKAGE_OPENCV4_LIB_PHOTO
	help
	  Extra Computational Photography -- Additional photo processing
	  algorithms: Color balance / Denoising / Inpainting.

endif
```

## package/openfpgaloader/Config.in
```kconfig
config LINGMO_PACKAGE_OPENFPGALOADER
	bool "openfpgaloader"
	depends on LINGMO_TOOLCHAIN_HAS_THREADS # libftdi1
	depends on LINGMO_TOOLCHAIN_GCC_AT_LEAST_4_9 # libftdi1 -> libusb
	depends on LINGMO_INSTALL_LIBSTDCPP
	select LINGMO_PACKAGE_LIBFTDI1
	select LINGMO_PACKAGE_ZLIB
	help
	  Universal utility for programming FPGA

	  https://github.com/trabucayre/openFPGALoader/

if LINGMO_PACKAGE_OPENFPGALOADER

config LINGMO_PACKAGE_OPENFPGALOADER_CMSIS
	bool "CMSIS-DAP support"
	depends on LINGMO_PACKAGE_HAS_UDEV # hidapi
	depends on LINGMO_TOOLCHAIN_HAS_THREADS_NPTL # hidapi
	depends on LINGMO_TOOLCHAIN_GCC_AT_LEAST_4_9 # hidapi -> libusb
	select LINGMO_PACKAGE_HIDAPI
	help
	  openfpgaloader CMSIS-DAP support

comment "openfpgaloader CMSIS-DAP needs udev /dev management and a toolchain w/ NPTL threads"
	depends on !LINGMO_PACKAGE_HAS_UDEV || !LINGMO_TOOLCHAIN_HAS_THREADS_NPTL

config LINGMO_PACKAGE_OPENFPGALOADER_LIBGPIOD
	bool "libgpiod support"
	depends on LINGMO_TOOLCHAIN_HEADERS_AT_LEAST_4_8 # libgpiod
	select LINGMO_PACKAGE_LIBGPIOD
	help
	  openfpgaloader libgpiod support

comment "openfpgaloader libgpiod needs kernel headers >= 4.8"
	depends on !LINGMO_TOOLCHAIN_HEADERS_AT_LEAST_4_8

endif

comment "openfpgaloader needs a toolchain w/ threads, C++, gcc >= 4.9"
	depends on !LINGMO_TOOLCHAIN_HAS_THREADS || \
		!LINGMO_INSTALL_LIBSTDCPP || \
		!LINGMO_TOOLCHAIN_GCC_AT_LEAST_4_9
```

## package/opengl/libegl/Config.in
```kconfig
config LINGMO_PACKAGE_HAS_LIBEGL
	bool

config LINGMO_PACKAGE_HAS_LIBEGL_WAYLAND
	bool
	depends on LINGMO_PACKAGE_HAS_LIBEGL

config LINGMO_PACKAGE_PROVIDES_LIBEGL
	string
	depends on LINGMO_PACKAGE_HAS_LIBEGL
```

## package/opengl/libgbm/Config.in
```kconfig
config LINGMO_PACKAGE_HAS_LIBGBM
	bool

config LINGMO_PACKAGE_PROVIDES_LIBGBM
	string
	depends on LINGMO_PACKAGE_HAS_LIBGBM

# gbm implementations should select
# LINGMO_PACKAGE_LIBGBM_HAS_FEATURE_FORMAT_MODIFIER_PLANE_COUNT if they
# provide the format modifier plane count feature. This API was
# initially introduced in mesa3d version 17. A gbm implementation
# provides this feature if it is implement function
# gbm_device_get_format_modifier_plane_count.
config LINGMO_PACKAGE_LIBGBM_HAS_FEATURE_FORMAT_MODIFIER_PLANE_COUNT
	bool
	depends on LINGMO_PACKAGE_HAS_LIBGBM

# gbm implementations should select
# LINGMO_PACKAGE_LIBGBM_HAS_FEATURE_DMA_BUF if they provide the dma
# buffer feature. This API was initially introduced in mesa3d version
# 10. A gbm implementation provides this feature if it is implement
# function gbm_bo_get_fd.
config LINGMO_PACKAGE_LIBGBM_HAS_FEATURE_DMA_BUF
	bool
	depends on LINGMO_PACKAGE_HAS_LIBGBM
```

## package/opengl/libgl/Config.in
```kconfig
config LINGMO_PACKAGE_HAS_LIBGL
	bool

config LINGMO_PACKAGE_PROVIDES_LIBGL
	string
	depends on LINGMO_PACKAGE_HAS_LIBGL
```

## package/opengl/libgles/Config.in
```kconfig
config LINGMO_PACKAGE_HAS_LIBGLES
	bool

config LINGMO_PACKAGE_PROVIDES_LIBGLES
	string
	depends on LINGMO_PACKAGE_HAS_LIBGLES
```

## package/opengl/libopencl/Config.in
```kconfig
config LINGMO_PACKAGE_HAS_LIBOPENCL
	bool

config LINGMO_PACKAGE_PROVIDES_LIBOPENCL
	string
	depends on LINGMO_PACKAGE_HAS_LIBOPENCL
```

## package/opengl/libopenmax/Config.in
```kconfig
config LINGMO_PACKAGE_HAS_LIBOPENMAX
	bool

config LINGMO_PACKAGE_PROVIDES_LIBOPENMAX
	string
	depends on LINGMO_PACKAGE_HAS_LIBOPENMAX
```

## package/opengl/libopenvg/Config.in
```kconfig
config LINGMO_PACKAGE_HAS_LIBOPENVG
	bool

config LINGMO_PACKAGE_PROVIDES_LIBOPENVG
	string
	depends on LINGMO_PACKAGE_HAS_LIBOPENVG
```
