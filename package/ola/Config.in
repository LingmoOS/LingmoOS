## package/ola/Config.in
```kconfig
comment "ola needs a toolchain w/ C++, threads, dynamic library, gcc >= 4.8"
	depends on !LINGMO_INSTALL_LIBSTDCPP || !LINGMO_TOOLCHAIN_HAS_THREADS \
		|| LINGMO_STATIC_LIBS \
		|| !LINGMO_TOOLCHAIN_GCC_AT_LEAST_4_8
	depends on LINGMO_PACKAGE_PROTOBUF_ARCH_SUPPORTS

menuconfig LINGMO_PACKAGE_OLA
	bool "ola (open lighting architecture)"
	depends on LINGMO_INSTALL_LIBSTDCPP # protobuf
	depends on !LINGMO_STATIC_LIBS # protobuf
	depends on LINGMO_TOOLCHAIN_HAS_THREADS
	depends on LINGMO_PACKAGE_PROTOBUF_ARCH_SUPPORTS
	depends on LINGMO_TOOLCHAIN_GCC_AT_LEAST_4_8 # protobuf
	select LINGMO_PACKAGE_PROTOBUF
	select LINGMO_PACKAGE_UTIL_LINUX
	select LINGMO_PACKAGE_UTIL_LINUX_LIBUUID
	help
	  Open Lighting Architecture provides applications
	  with a mechanism to send and receive DMX512 & RDM
	  commands using hardware devices and DMX over IP protocols.

	  https://www.openlighting.org/ola/

if LINGMO_PACKAGE_OLA

comment "bindings and interface"

config LINGMO_PACKAGE_OLA_WEB
	bool "http interface"
	depends on LINGMO_PACKAGE_LIBGPG_ERROR_ARCH_SUPPORTS # libgcrypt, libmicrohttpd
	select LINGMO_PACKAGE_LIBMICROHTTPD
	help
	  Build OLA with browser interface.

config LINGMO_PACKAGE_OLA_PYTHON_BINDINGS
	bool "python bindings"
	depends on LINGMO_PACKAGE_PROTOBUF_ARCH_SUPPORTS # protobuf
	depends on LINGMO_PACKAGE_PYTHON3
	select LINGMO_PACKAGE_PYTHON_PROTOBUF
	help
	  Build OLA with support for the Python language.

comment "tests and examples"

config LINGMO_PACKAGE_OLA_EXAMPLES
	bool "examples"
	select LINGMO_PACKAGE_NCURSES
	help
	  Build OLA examples.

config LINGMO_PACKAGE_OLA_RDM_TESTS
	bool "rdm tests"
	depends on LINGMO_PACKAGE_OLA_PYTHON_BINDINGS
	depends on LINGMO_PACKAGE_PYTHON_NUMPY_ARCH_SUPPORTS
	depends on LINGMO_TOOLCHAIN_USES_GLIBC || LINGMO_TOOLCHAIN_USES_MUSL # python-numpy
	depends on LINGMO_TOOLCHAIN_GCC_AT_LEAST_9 # python-numpy
	select LINGMO_PACKAGE_PYTHON_NUMPY
	help
	  Build OLA RDM tests.

comment "rdm tests needs a glibc or musl toolchain w/ gcc >= 9"
	depends on LINGMO_PACKAGE_OLA_PYTHON_BINDINGS
	depends on LINGMO_PACKAGE_PYTHON_NUMPY_ARCH_SUPPORTS
	depends on !LINGMO_TOOLCHAIN_GCC_AT_LEAST_9 || \
		!LINGMO_TOOLCHAIN_USES_GLIBC && !LINGMO_TOOLCHAIN_USES_MUSL

comment "plugin selections"

config LINGMO_PACKAGE_OLA_PLUGIN_ARTNET
	bool "artnet"
	help
	  Build Artnet plugin for OLA.

config LINGMO_PACKAGE_OLA_PLUGIN_DUMMY
	bool "dummy"
	help
	  Build Dummy plugin for OLA.

config LINGMO_PACKAGE_OLA_PLUGIN_E131
	bool "acn E131"
	help
	  Build ACN E131 plugin for OLA.

config LINGMO_PACKAGE_OLA_PLUGIN_ESPNET
	bool "espnet"
	help
	  Build EspNet plugin for OLA.

config LINGMO_PACKAGE_OLA_PLUGIN_FTDIDMX
	bool "ftdidmx"
	depends on LINGMO_TOOLCHAIN_GCC_AT_LEAST_4_9 # libftdi1 -> libusb
	select LINGMO_PACKAGE_LIBFTDI1
	help
	  Build FTDI USB DMX plugin for OLA.

comment "ftdidmx needs a toolchain w/ gcc >= 4.9"
	depends on !LINGMO_TOOLCHAIN_GCC_AT_LEAST_4_9

config LINGMO_PACKAGE_OLA_PLUGIN_GPIO
	bool "GPIO"
	help
	  Build GPIO plugin for OLA.

config LINGMO_PACKAGE_OLA_PLUGIN_KARATE
	bool "karate"
	help
	  Build Karate plugin for OLA.

config LINGMO_PACKAGE_OLA_PLUGIN_KINET
	bool "kinet"
	help
	  Build KiNet plugin for OLA.

config LINGMO_PACKAGE_OLA_PLUGIN_MILINT
	bool "Milford Instruments"
	help
	  Build Milford Instruments 1-463 plugin for OLA.

config LINGMO_PACKAGE_OLA_PLUGIN_OPENDMX
	bool "Enttec Open DMX"
	help
	  Build Enttec Open DMX plugin for OLA.

config LINGMO_PACKAGE_OLA_PLUGIN_OPENPIXELCONTROL
	bool "Open Pixel Control"
	help
	  Build Open Pixel Control (OPC) plugin for OLA.

config LINGMO_PACKAGE_OLA_PLUGIN_OSC
	bool "osc"
	select LINGMO_PACKAGE_LIBLO
	help
	  Build Open Sound Control (OSC) plugin for OLA.

config LINGMO_PACKAGE_OLA_PLUGIN_PATHPORT
	bool "pathport"
	help
	  Build Pathport plugin for OLA.

config LINGMO_PACKAGE_OLA_PLUGIN_RENARD
	bool "renard"
	help
	  Build Renard plugin for OLA.

config LINGMO_PACKAGE_OLA_PLUGIN_SANDNET
	bool "sandnet"
	help
	  Build SandNet plugin for OLA.

config LINGMO_PACKAGE_OLA_PLUGIN_SHOWNET
	bool "shownet"
	help
	  Build ShowNet plugin for OLA.

config LINGMO_PACKAGE_OLA_PLUGIN_SPI
	bool "spi"
	help
	  Build SPI plugin for OLA.

config LINGMO_PACKAGE_OLA_PLUGIN_STAGEPROFI
	bool "stageprofi"
	depends on LINGMO_TOOLCHAIN_GCC_AT_LEAST_4_9 # libusb
	select LINGMO_PACKAGE_LIBUSB
	help
	  Build StageProfi plugin for OLA.

comment "stageprofi needs a toolchain w/ gcc >= 4.9"
	depends on !LINGMO_TOOLCHAIN_GCC_AT_LEAST_4_9

config LINGMO_PACKAGE_OLA_PLUGIN_UARTDMX
	bool "uartdmx"
	help
	  Build UART Native DMX plugin for OLA.

config LINGMO_PACKAGE_OLA_PLUGIN_USBDMX
	bool "usbdmx"
	depends on LINGMO_TOOLCHAIN_GCC_AT_LEAST_4_9 # libusb
	select LINGMO_PACKAGE_LIBUSB
	help
	  Build USB DMX plugin for OLA.

comment "usbdmx needs a toolchain w/ gcc >= 4.9"
	depends on !LINGMO_TOOLCHAIN_GCC_AT_LEAST_4_9

config LINGMO_PACKAGE_OLA_PLUGIN_USBPRO
	bool "usbpro"
	depends on LINGMO_TOOLCHAIN_GCC_AT_LEAST_4_9 # libusb
	select LINGMO_PACKAGE_LIBUSB
	help
	  Build UsbPro plugin for OLA.

comment "usbpro needs a toolchain w/ gcc >= 4.9"
	depends on !LINGMO_TOOLCHAIN_GCC_AT_LEAST_4_9

endif
```

## package/olsr/Config.in
```kconfig
config LINGMO_PACKAGE_OLSR
	bool "olsr"
	depends on LINGMO_USE_MMU # fork()
	depends on LINGMO_TOOLCHAIN_HAS_THREADS
	depends on !LINGMO_STATIC_LIBS
	# https://github.com/OLSR/olsrd/issues/6
	depends on !LINGMO_TOOLCHAIN_USES_MUSL || LINGMO_TOOLCHAIN_HEADERS_AT_LEAST_4_15
	help
	  The Optimized Link State Routing protocol (OLSR) is a
	  routing protocol that is optimised for mobile ad-hoc
	  networks, sometimes called wireless mesh networks. It is a
	  proactive link-state routing protocol that floods a full
	  topology table to all nodes in the network which then
	  compute optimal forwarding paths locally.

	  http://www.olsr.org/

comment "olsr needs a toolchain w/ threads, dynamic library"
	depends on LINGMO_USE_MMU
	depends on !LINGMO_TOOLCHAIN_HAS_THREADS || LINGMO_STATIC_LIBS

comment "olsr needs a musl toolchain w/ headers >= 4.15"
	depends on LINGMO_TOOLCHAIN_USES_MUSL
	depends on !LINGMO_TOOLCHAIN_HEADERS_AT_LEAST_4_15
```

## package/omxplayer/Config.in
```kconfig
config LINGMO_PACKAGE_OMXPLAYER
	bool "omxplayer"
	depends on LINGMO_arm
	depends on LINGMO_USE_MMU # dbus
	depends on LINGMO_PACKAGE_FFMPEG_ARCH_SUPPORTS # ffmpeg
	depends on LINGMO_INSTALL_LIBSTDCPP # boost
	depends on LINGMO_TOOLCHAIN_HAS_THREADS # alsa-lib, boost, libusb
	depends on LINGMO_TOOLCHAIN_GCC_AT_LEAST_4_9 # libusb
	depends on LINGMO_USE_WCHAR # boost
	depends on LINGMO_PACKAGE_RPI_USERLAND
	select LINGMO_PACKAGE_ALSA_LIB
	select LINGMO_PACKAGE_BOOST
	select LINGMO_PACKAGE_DBUS
	select LINGMO_PACKAGE_FFMPEG
	select LINGMO_PACKAGE_FFMPEG_AVRESAMPLE
	select LINGMO_PACKAGE_FFMPEG_SWSCALE
	select LINGMO_PACKAGE_FREETYPE
	select LINGMO_PACKAGE_LIBIDN
	select LINGMO_PACKAGE_LIBUSB
	select LINGMO_PACKAGE_PCRE
	select LINGMO_PACKAGE_ZLIB
	help
	  OMXPlayer is a commandline OMX player for the Raspberry
	  Pi. It was developed as a testbed for the XBMC Raspberry PI
	  implementation and is quite handy to use standalone.

	  https://github.com/popcornmix/omxplayer

comment "omxplayer needs rpi-userland and a toolchain w/ C++, threads, wchar, dynamic library, gcc >= 4.9"
	depends on LINGMO_arm
	depends on LINGMO_USE_MMU
	depends on LINGMO_PACKAGE_FFMPEG_ARCH_SUPPORTS
	depends on !LINGMO_PACKAGE_RPI_USERLAND
	depends on !LINGMO_INSTALL_LIBSTDCPP || !LINGMO_TOOLCHAIN_HAS_THREADS \
		|| !LINGMO_USE_WCHAR || LINGMO_STATIC_LIBS \
		|| !LINGMO_TOOLCHAIN_GCC_AT_LEAST_4_9
```

## package/on2-8170-libs/Config.in
```kconfig
config LINGMO_PACKAGE_ON2_8170_LIBS
	bool "on2-8170-libs"
	#This is a binary only package which has been compiled for glibc
	depends on LINGMO_arm926t
	depends on LINGMO_TOOLCHAIN_USES_GLIBC
	depends on LINGMO_LINUX_KERNEL # on2-8170-modules
	select LINGMO_PACKAGE_ON2_8170_MODULES # runtime
	help
	  Libraries for Hantro X170 video decoder

	  http://www.at91.com/linux4sam/bin/view/Linux4SAM/SAM9M10Gstreamer

comment "on2-8170-libs needs a glibc toolchain and a Linux kernel to be built"
	depends on LINGMO_arm926t
	depends on !LINGMO_LINUX_KERNEL || !LINGMO_TOOLCHAIN_USES_GLIBC
```

## package/on2-8170-modules/Config.in
```kconfig
config LINGMO_PACKAGE_ON2_8170_MODULES
	bool "on2-8170-modules"
	depends on LINGMO_LINUX_KERNEL
	depends on LINGMO_arm926t
	help
	  Kernel modules for Hantro x170 hardware video decompression
	  support.

	  http://www.at91.com/linux4sam/bin/view/Linux4SAM/SAM9M10Gstreamer

comment "on2-8170-modules needs a Linux kernel to be built"
	depends on LINGMO_arm926t
	depends on !LINGMO_LINUX_KERNEL
```

## package/onevpl-intel-gpu/Config.in
```kconfig
config LINGMO_PACKAGE_ONEVPL_INTEL_GPU
	bool "onevpl-intel-gpu"
	depends on LINGMO_x86_64 # intel-mediadriver
	depends on LINGMO_PACKAGE_LIBVPL_ARCH_SUPPORTS # libvpl
	depends on LINGMO_INSTALL_LIBSTDCPP # libvpl
	depends on !LINGMO_STATIC_LIBS # libvpl
	depends on LINGMO_TOOLCHAIN_GCC_AT_LEAST_7 # libvpl
	depends on LINGMO_TOOLCHAIN_HAS_SYNC_1 # intel-mediadriver
	depends on LINGMO_TOOLCHAIN_HAS_THREADS # libvpl
	depends on LINGMO_TOOLCHAIN_HAS_THREADS_NPTL # intel-mediadriver
	select LINGMO_PACKAGE_INTEL_MEDIADRIVER # runtime
	select LINGMO_PACKAGE_LIBVA
	select LINGMO_PACKAGE_LIBVPL
	help
	  Intel® oneVPL GPU Runtime is a Runtime implementation of
	  oneVPL API for Intel Gen GPUs, starting with Tiger Lake.

	  https://github.com/oneapi-src/oneVPL-intel-gpu

comment "onevpl-intel-gpu needs a toolchain w/ dynamic library, gcc >= 7, C++, NPTL"
	depends on LINGMO_x86_64
	depends on LINGMO_PACKAGE_LIBVPL_ARCH_SUPPORTS
	depends on LINGMO_TOOLCHAIN_HAS_SYNC_1
	depends on LINGMO_STATIC_LIBS || !LINGMO_TOOLCHAIN_GCC_AT_LEAST_7 || \
		!LINGMO_INSTALL_LIBSTDCPP || !LINGMO_TOOLCHAIN_HAS_THREADS
```

## package/open-iscsi/Config.in
```kconfig
config LINGMO_PACKAGE_OPEN_ISCSI
	bool "open-iscsi"
	depends on LINGMO_USE_MMU # fork()
	depends on LINGMO_TOOLCHAIN_HAS_THREADS # pthread
	depends on !LINGMO_STATIC_LIBS # kmod
	select LINGMO_PACKAGE_KMOD
	select LINGMO_PACKAGE_OPENSSL
	select LINGMO_PACKAGE_OPEN_ISNS
	select LINGMO_PACKAGE_UTIL_LINUX
	select LINGMO_PACKAGE_UTIL_LINUX_LIBMOUNT
	help
	  iSCSI tools for Linux.

	  https://www.open-iscsi.com

comment "open-iscsi needs a toolchain w/ threads, dynamic library"
	depends on LINGMO_USE_MMU
	depends on !LINGMO_TOOLCHAIN_HAS_THREADS || LINGMO_STATIC_LIBS
```

## package/open-isns/Config.in
```kconfig
config LINGMO_PACKAGE_OPEN_ISNS
	bool "open-isns"
	depends on LINGMO_USE_MMU # fork()
	help
	  iSNS server and client for Linux.

	  https://github.com/open-iscsi/open-isns
```

## package/open-lldp/Config.in
```kconfig
config LINGMO_PACKAGE_OPEN_LLDP
	bool "open-lldp"
	depends on !LINGMO_STATIC_LIBS # dlfcn.h
	depends on LINGMO_TOOLCHAIN_HAS_THREADS # libnl
	select LINGMO_PACKAGE_LIBCONFIG
	select LINGMO_PACKAGE_LIBNL
	select LINGMO_PACKAGE_READLINE
	help
	  This package contains the Linux user space daemon and
	  configuration tool for Intel LLDP Agent with Enhanced Ethernet
	  support for the Data Center.

	  https://github.com/intel/openlldp/

comment "open-lldp needs a toolchain w/ dynamic library, threads"
	depends on LINGMO_STATIC_LIBS || !LINGMO_TOOLCHAIN_HAS_THREADS
```

## package/open-plc-utils/Config.in
```kconfig
config LINGMO_PACKAGE_OPEN_PLC_UTILS
	bool "open-plc-utils"
	depends on LINGMO_USE_MMU # fork()
	help
	  Open version of the Qualcomm Atheros Powerline Toolkit

	  https://github.com/qca/open-plc-utils
```

## package/openblas/Config.in
```kconfig
config LINGMO_PACKAGE_OPENBLAS_DEFAULT_TARGET
	string
	default "P2"              if LINGMO_x86_pentium2
	default "KATMAI"          if LINGMO_x86_pentium3
	default "NORTHWOOD"       if LINGMO_x86_pentium4
	default "PRESCOTT"        if LINGMO_x86_prescott || LINGMO_x86_nocona
	default "BANIAS"          if LINGMO_x86_pentium_m
	default "CORE2"           if LINGMO_x86_core2
	default "NEHALEM"         if LINGMO_x86_corei7 || LINGMO_x86_silvermont || LINGMO_x86_westmere
	default "SANDYBRIDGE"     if LINGMO_x86_corei7_avx
	default "HASWELL"         if LINGMO_x86_core_avx2
	default "ATOM"            if LINGMO_x86_atom
	default "ATHLON"          if LINGMO_x86_athlon || LINGMO_x86_athlon_4
	default "OPTERON"         if LINGMO_x86_opteron
	default "OPTERON_SSE3"    if LINGMO_x86_opteron_sse3
	default "BARCELONA"       if LINGMO_x86_barcelona
	default "BOBCAT"          if LINGMO_x86_jaguar
	default "STEAMROLLER"     if LINGMO_x86_steamroller
	default "VIAC3"           if LINGMO_x86_c3 || LINGMO_x86_c32
	default "POWER4"          if LINGMO_powerpc_power4
	default "POWER5"          if LINGMO_powerpc_power5
	default "POWER6"          if LINGMO_powerpc_power6
	default "POWER7"          if LINGMO_powerpc_power7
	default "POWER8"          if LINGMO_powerpc_power8
	default "PPCG4"           if LINGMO_powerpc_7400 || LINGMO_powerpc_7450
	default "PPC970"          if LINGMO_powerpc_970
	default "PPC440"          if LINGMO_powerpc_440
	default "PPC440FP2"       if LINGMO_powerpc_440fp
	default "MIPS64_GENERIC"  if LINGMO_MIPS_CPU_MIPS64
	# OpenBLAS assumes SPARC=Sparc v9
	default "SPARC"           if LINGMO_sparc_v9
	# Cortex-A15 always have a VFPv4
	default "CORTEXA15"       if (LINGMO_cortex_a15 && LINGMO_ARM_EABIHF)
	# Cortex-A9 have an optional VFPv3, so we need to make sure it
	# is available
	default "CORTEXA9"        if (LINGMO_cortex_a9 && LINGMO_ARM_EABIHF && \
				   LINGMO_ARM_CPU_HAS_VFPV3)
	default "ARMV5"           if LINGMO_ARM_CPU_ARMV5
	# On ARMv6, OpenBLAS assumes that a VFP is available, and
	# EABIhf is used
	default "ARMV6"           if (LINGMO_ARM_CPU_ARMV6 && LINGMO_ARM_EABIHF && \
				   LINGMO_ARM_CPU_HAS_VFPV2)
	# On ARMv7, OpenBLAS assumes that a full VFPv3+ is available
	# (and not the more limited D16 variant), and that EABIhf is
	# used.
	default "ARMV7"           if (LINGMO_ARM_CPU_ARMV7A && LINGMO_ARM_EABIHF && \
				   LINGMO_ARM_CPU_HAS_VFPV3)
	default "ARMV8"           if LINGMO_aarch64 || LINGMO_aarch64_be
	default "RISCV64_GENERIC" if LINGMO_RISCV_64
	help
	  OpenBLAS target CPU. See TargetList.txt in the source tree for
	  the possible target strings. A possible value is set
	  automatically based on your Target Architecture Variant.

config LINGMO_PACKAGE_OPENBLAS_ARCH_SUPPORTS
	bool
	default y if LINGMO_PACKAGE_OPENBLAS_DEFAULT_TARGET != ""

config LINGMO_PACKAGE_OPENBLAS
	bool "openblas"
	depends on LINGMO_PACKAGE_OPENBLAS_ARCH_SUPPORTS
	help
	  An optimized BLAS library based on GotoBLAS2 1.13 BSD version.

	  https://www.openblas.net/

if LINGMO_PACKAGE_OPENBLAS

config LINGMO_PACKAGE_OPENBLAS_TARGET
	string "OpenBLAS target CPU"
	default LINGMO_PACKAGE_OPENBLAS_DEFAULT_TARGET

config LINGMO_PACKAGE_OPENBLAS_USE_THREAD
	bool "use multithreading"
	default y
	depends on LINGMO_TOOLCHAIN_HAS_THREADS
	depends on !LINGMO_STATIC_LIBS
	help
	  Tell OpenBLAS to use multithreading, by passing USE_THREAD=1.

config LINGMO_PACKAGE_OPENBLAS_USE_LOCKING
	bool "use locking"
	default y
	depends on LINGMO_TOOLCHAIN_HAS_THREADS
	depends on !LINGMO_PACKAGE_OPENBLAS_USE_THREAD
	help
	  Tell OpenBLAS to use locking, by passing USE_LOCKING=1.
	  Locking is implicitly enabled when USE_THREAD=1.
	  However, if USE_THREAD=0 (i.e. OpenBLAS itself will run in
	  single-threaded mode) but an application makes OpenBLAS
	  function calls from multiple threads, then locking is
	  mandatory for correct operation.

config LINGMO_PACKAGE_OPENBLAS_INSTALL_TESTS
	bool "install tests"
	help
	  Install C test programs on target.

endif
```
