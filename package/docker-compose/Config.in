## package/dvdrw-tools/Config.in
```kconfig
comment "dvdrw-tools needs a toolchain w/ threads, C++, wchar"
	depends on LINGMO_USE_MMU
	depends on !LINGMO_TOOLCHAIN_HAS_THREADS || !LINGMO_INSTALL_LIBSTDCPP || \
		!LINGMO_USE_WCHAR

config LINGMO_PACKAGE_DVDRW_TOOLS
	bool "dvdrw-tools"
	depends on LINGMO_USE_MMU # fork()
	depends on LINGMO_TOOLCHAIN_HAS_THREADS
	depends on LINGMO_INSTALL_LIBSTDCPP
	depends on LINGMO_USE_WCHAR
	help
	  The dvd+rw-tools are used to master Blu-ray Disc
	  and DVD Disc media, both +RW/+R and -RW/-R. Note:
	  The +RW in the name is a historical artifact. This
	  package contains the widely used growisofs program.

	  Buildroot does not support packages with a '+' sign
	  in their name, which explains why it is named
	  dvdrw-tools and not dvd+rw-tools.

	  Because dvd+rw-tools does not directly interact with
	  disc media it uses a separate media backend program.
	  The usual backend is mkisofs from the cdrtools package.
	  However, cdrtools is not currently part of buildroot.

	  The Linux From Scratch project uses uses xorriso for the
	  media backend and Ubuntu uses cdrkit for the backend.
	  Choose the one which seems most appropriate for your use.
	  NOTE: xorriso does not currently support UDF.

	  http://fy.chalmers.se/~appro/linux/DVD+RW/tools

if LINGMO_PACKAGE_DVDRW_TOOLS
choice
	prompt "Media Backend"
	help
	  Choose which media backend program to use.

config LINGMO_PACKAGE_DVDRW_TOOLS_CDRKIT_BACKEND
	bool "cdrkit"
	select LINGMO_PACKAGE_CDRKIT
	help
	  Symlink mkisofs to genisoimage from the cdrkit package.

config LINGMO_PACKAGE_DVDRW_TOOLS_XORRISO_BACKEND
	bool "xorriso"
	select LINGMO_PACKAGE_XORRISO
	help
	  Symlink mkisofs to xorrisofs from the xorriso package.

endchoice
endif
```

## package/e2fsprogs/Config.in
```kconfig
menuconfig LINGMO_PACKAGE_E2FSPROGS
	bool "e2fsprogs"
	depends on LINGMO_USE_MMU # util-linux/libblkid
	select LINGMO_PACKAGE_UTIL_LINUX
	select LINGMO_PACKAGE_UTIL_LINUX_LIBBLKID
	select LINGMO_PACKAGE_UTIL_LINUX_LIBUUID
	help
	  The EXT2 file system utilities.

	  The following programs are always built and installed:
	  badblocks chattr debugfs dumpe2fs e2freefrag e2fsck e2image
	  e2undo e4crypt e4defrag filefrag fsck fuse2fs logsave lsattr
	  mke2fs mklost+found resize2fs tune2fs

	  The uuid utilities (uuidd, uuidgen) are not built. Use the
	  ones from util-linux, instead.

	  Other programs can be selected individually.

	  http://e2fsprogs.sourceforge.net

if LINGMO_PACKAGE_E2FSPROGS

config LINGMO_PACKAGE_E2FSPROGS_DEBUGFS
	bool "debugfs"
	help
	  ext2/ext3/ext4 file system debugger

config LINGMO_PACKAGE_E2FSPROGS_E2IMAGE
	bool "e2image"
	help
	  Save critical ext2/ext3/ext4 filesystem metadata to a file

config LINGMO_PACKAGE_E2FSPROGS_E2SCRUB
	bool "e2scrub"
	depends on LINGMO_PACKAGE_BASH  # runtime
	depends on LINGMO_PACKAGE_COREUTILS  # runtime
	depends on LINGMO_PACKAGE_LVM2  # runtime
	depends on LINGMO_PACKAGE_UTIL_LINUX  # runtime
	help
	  Check the contents of a mounted ext[234] filesystem

comment "e2scrub needs bash, coreutils, lvm2, and util-linux"
	depends on !LINGMO_PACKAGE_BASH || !LINGMO_PACKAGE_COREUTILS \
		|| !LINGMO_PACKAGE_LVM2 || !LINGMO_PACKAGE_UTIL_LINUX

config LINGMO_PACKAGE_E2FSPROGS_E4DEFRAG
	bool "e4defrag"
	depends on !LINGMO_nios2 # fallocate not implemented
	depends on !LINGMO_TOOLCHAIN_USES_UCLIBC # sync_file_range not impl
	help
	  Online defragmenter for ext4 filesystem

comment "e4defrag needs a glibc or musl toolchain"
	depends on !LINGMO_nios2
	depends on LINGMO_TOOLCHAIN_USES_UCLIBC

config LINGMO_PACKAGE_E2FSPROGS_FSCK
	bool "fsck"
	default y
	depends on !LINGMO_PACKAGE_UTIL_LINUX_FSCK
	help
	  Check and repair a Linux file system. This is a wrapper around
	  the filesystem-specific fsck tools.

config LINGMO_PACKAGE_E2FSPROGS_FUSE2FS
	bool "fuse2fs"
	depends on !LINGMO_STATIC_LIBS # libfuse
	depends on LINGMO_TOOLCHAIN_HAS_THREADS # libfuse
	select LINGMO_PACKAGE_LIBFUSE
	help
	  FUSE file system client for ext2/ext3/ext4 file systems

comment "fuse2fs needs a toolchain w/ threads, dynamic library"
	depends on !LINGMO_TOOLCHAIN_HAS_THREADS || LINGMO_STATIC_LIBS

config LINGMO_PACKAGE_E2FSPROGS_RESIZE2FS
	bool "resize2fs"
	help
	  ext2/ext3/ext4 file system resizer

endif
```

## package/e2tools/Config.in
```kconfig
config LINGMO_PACKAGE_E2TOOLS
	bool "e2tools"
	depends on LINGMO_TOOLCHAIN_HAS_THREADS
	depends on LINGMO_USE_WCHAR # uses wchar_t
	depends on LINGMO_USE_MMU # e2fsprogs
	select LINGMO_PACKAGE_E2FSPROGS
	help
	  E2tools is a simple set of GPL'ed utilities to read, write,
	  and manipulate files in an ext2/ext3 filesystem. These
	  utilities access a filesystem directly using the ext2fs
	  library.

	  https://github.com/ndim/e2tools

comment "e2tools needs a toolchain w/ threads, wchar"
	depends on !LINGMO_TOOLCHAIN_HAS_THREADS || !LINGMO_USE_WCHAR
	depends on LINGMO_USE_MMU
```
