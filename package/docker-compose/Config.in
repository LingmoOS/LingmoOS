## package/docker-compose/Config.in
```kconfig
config LINGMO_PACKAGE_DOCKER_COMPOSE
	bool "docker-compose"
	depends on LINGMO_PACKAGE_HOST_GO_TARGET_ARCH_SUPPORTS
	depends on LINGMO_PACKAGE_HOST_GO_TARGET_CGO_LINKING_SUPPORTS
	depends on LINGMO_TOOLCHAIN_HAS_THREADS
	depends on LINGMO_PACKAGE_DOCKER_CLI
	help
	  Multi-container applications with the Docker CLI.

	  https://github.com/docker/compose

comment "docker-compose needs docker-cli and a toolchain w/ threads"
	depends on LINGMO_PACKAGE_HOST_GO_TARGET_ARCH_SUPPORTS
	depends on LINGMO_PACKAGE_HOST_GO_TARGET_CGO_LINKING_SUPPORTS
	depends on !LINGMO_TOOLCHAIN_HAS_THREADS || !LINGMO_PACKAGE_DOCKER_CLI
```

## package/docker-engine/Config.in
```kconfig
config LINGMO_PACKAGE_DOCKER_ENGINE
	bool "docker-engine"
	depends on LINGMO_PACKAGE_HOST_GO_TARGET_ARCH_SUPPORTS
	depends on LINGMO_PACKAGE_HOST_GO_TARGET_CGO_LINKING_SUPPORTS
	depends on LINGMO_TOOLCHAIN_HAS_THREADS
	depends on !LINGMO_TOOLCHAIN_USES_UCLIBC # containerd -> runc
	depends on LINGMO_USE_MMU # containerd
	depends on LINGMO_PACKAGE_LIBSECCOMP_ARCH_SUPPORTS # libseccomp
	depends on LINGMO_TOOLCHAIN_HEADERS_AT_LEAST_3_17 # libseccomp
	select LINGMO_PACKAGE_CGROUPFS_MOUNT if !LINGMO_PACKAGE_SYSTEMD # runtime dependency
	select LINGMO_PACKAGE_CONTAINERD # runtime dependency
	select LINGMO_PACKAGE_IPTABLES # runtime dependency
	select LINGMO_PACKAGE_LIBSECCOMP
	help
	  Docker is a platform to build, ship,
	  and run applications as lightweight containers.

	  https://github.com/docker/docker

if LINGMO_PACKAGE_DOCKER_ENGINE

config LINGMO_PACKAGE_DOCKER_ENGINE_DRIVER_BTRFS
	bool "btrfs filesystem driver"
	depends on LINGMO_TOOLCHAIN_HEADERS_AT_LEAST_4_12
	help
	  Build the btrfs filesystem driver for Docker.

comment "brtfs filesystem driver needs headers >= 4.12"
	depends on !LINGMO_TOOLCHAIN_HEADERS_AT_LEAST_4_12

config LINGMO_PACKAGE_DOCKER_ENGINE_DRIVER_DEVICEMAPPER
	bool "devicemapper filesystem driver"
	depends on LINGMO_TOOLCHAIN_HAS_THREADS # lvm2
	depends on LINGMO_USE_MMU # lvm2
	depends on !LINGMO_STATIC_LIBS # lvm2
	select LINGMO_PACKAGE_LVM2
	help
	  Build the devicemapper filesystem driver for Docker.

config LINGMO_PACKAGE_DOCKER_ENGINE_DRIVER_VFS
	bool "vfs filesystem driver"
	depends on LINGMO_USE_WCHAR # gvfs
	depends on LINGMO_USE_MMU # gvfs
	depends on LINGMO_TOOLCHAIN_HAS_THREADS # gvfs
	depends on !LINGMO_STATIC_LIBS # gvfs
	select LINGMO_PACKAGE_GVFS
	help
	  Build the vfs filesystem driver for Docker.

endif

comment "docker-engine needs a glibc or musl toolchain w/ threads, headers >= 3.17"
	depends on LINGMO_PACKAGE_HOST_GO_TARGET_ARCH_SUPPORTS
	depends on LINGMO_PACKAGE_HOST_GO_TARGET_CGO_LINKING_SUPPORTS
	depends on LINGMO_PACKAGE_LIBSECCOMP_ARCH_SUPPORTS
	depends on !LINGMO_TOOLCHAIN_HAS_THREADS || \
		LINGMO_TOOLCHAIN_USES_UCLIBC || \
		!LINGMO_TOOLCHAIN_HEADERS_AT_LEAST_3_17
	depends on LINGMO_USE_MMU
```

## package/docker/Config.in
```kconfig
config LINGMO_PACKAGE_DOCKER
	bool "docker"
	depends on LINGMO_PACKAGE_XORG7
	depends on LINGMO_USE_WCHAR # glib2
	depends on LINGMO_TOOLCHAIN_HAS_THREADS # glib2
	depends on LINGMO_USE_MMU # glib2
	select LINGMO_PACKAGE_LIBGLIB2
	select LINGMO_PACKAGE_XLIB_LIBX11
	help
	  a system tray dock for X

	  http://icculus.org/openbox/2/docker

comment "docker needs a toolchain w/ wchar, threads"
	depends on LINGMO_USE_MMU
	depends on LINGMO_PACKAGE_XORG7
	depends on !LINGMO_USE_WCHAR || !LINGMO_TOOLCHAIN_HAS_THREADS
```

## package/domoticz/Config.in
```kconfig
config LINGMO_PACKAGE_DOMOTICZ
	bool "domoticz"
	depends on LINGMO_USE_MMU # fork()
	depends on !LINGMO_STATIC_LIBS
	depends on LINGMO_TOOLCHAIN_GCC_AT_LEAST_6 # C++14
	# pthread_condattr_setclock
	depends on LINGMO_TOOLCHAIN_HAS_THREADS_NPTL # mosquitto
	depends on LINGMO_INSTALL_LIBSTDCPP
	depends on LINGMO_USE_WCHAR
	depends on LINGMO_PACKAGE_LUA_5_3
	depends on LINGMO_TOOLCHAIN_SUPPORTS_ALWAYS_LOCKFREE_ATOMIC_INTS # boost-thread
	depends on !LINGMO_TOOLCHAIN_HAS_GCC_BUG_64735 # exception_ptr
	select LINGMO_PACKAGE_BOOST
	select LINGMO_PACKAGE_BOOST_ATOMIC
	select LINGMO_PACKAGE_BOOST_DATE_TIME
	select LINGMO_PACKAGE_BOOST_SYSTEM
	select LINGMO_PACKAGE_BOOST_THREAD
	select LINGMO_PACKAGE_CEREAL
	select LINGMO_PACKAGE_JSONCPP
	select LINGMO_PACKAGE_LIBCURL
	select LINGMO_PACKAGE_MINIZIP_ZLIB
	select LINGMO_PACKAGE_MOSQUITTO
	select LINGMO_PACKAGE_OPENSSL
	select LINGMO_PACKAGE_SQLITE
	select LINGMO_PACKAGE_ZLIB
	help
	  Domoticz is a Home Automation System that lets you monitor
	  and configure various devices like: Lights, Switches,
	  various sensors/meters like Temperature, Rain, Wind, UV,
	  Electra, Gas, Water and much more. Notifications/Alerts can
	  be sent to any mobile device.

	  http://domoticz.com

comment "domoticz needs lua 5.3 and a toolchain w/ C++, gcc >= 6, NPTL, wchar, dynamic library"
	depends on LINGMO_USE_MMU
	depends on LINGMO_TOOLCHAIN_SUPPORTS_ALWAYS_LOCKFREE_ATOMIC_INTS
	depends on !LINGMO_INSTALL_LIBSTDCPP || \
		!LINGMO_TOOLCHAIN_GCC_AT_LEAST_6 || \
		!LINGMO_TOOLCHAIN_HAS_THREADS_NPTL || \
		!LINGMO_USE_WCHAR || LINGMO_STATIC_LIBS || \
		!LINGMO_PACKAGE_LUA_5_3

comment "domoticz needs exception_ptr"
	depends on LINGMO_TOOLCHAIN_HAS_GCC_BUG_64735
```

## package/doom-wad/Config.in
```kconfig
config LINGMO_PACKAGE_DOOM_WAD
	bool "shareware Doom WAD file"
	depends on LINGMO_PACKAGE_CHOCOLATE_DOOM || LINGMO_PACKAGE_PRBOOM
	help
	  This will install the shareware wad data file for the doom
	  game.

	  The wad file will be placed in the /usr/share/games/doom
	  directory.

	  https://doomwiki.org/wiki/DOOM1.WAD
```

## package/dos2unix/Config.in
```kconfig
config LINGMO_PACKAGE_DOS2UNIX
	bool "dos2unix"
	depends on LINGMO_PACKAGE_BUSYBOX_SHOW_OTHERS
	help
	  dos2unix converts text file line endings between CRLF and LF

	  http://waterlan.home.xs4all.nl/dos2unix.html
```

## package/dosfstools/Config.in
```kconfig
config LINGMO_PACKAGE_DOSFSTOOLS
	bool "dosfstools"
	depends on LINGMO_USE_WCHAR
	select LINGMO_PACKAGE_LIBICONV if !LINGMO_ENABLE_LOCALE
	help
	  Tools for creating and checking DOS FAT filesystems.

	  https://github.com/dosfstools/dosfstools

if LINGMO_PACKAGE_DOSFSTOOLS

config LINGMO_PACKAGE_DOSFSTOOLS_FATLABEL
	bool "fatlabel"
	help
	  Get or set the DOS FAT filesystem label.

config LINGMO_PACKAGE_DOSFSTOOLS_FSCK_FAT
	bool "fsck.fat"
	help
	  Check a DOS FAT filesystem.

config LINGMO_PACKAGE_DOSFSTOOLS_MKFS_FAT
	bool "mkfs.fat"
	help
	  Creates a DOS FAT filesystem on a device.

endif

comment "dosfstools needs a toolchain w/ wchar"
	depends on !LINGMO_USE_WCHAR
```

## package/dotconf/Config.in
```kconfig
config LINGMO_PACKAGE_DOTCONF
	bool "dotconf"
	help
	  Configuration file parser.

	  https://github.com/williamh/dotconf
```

## package/double-conversion/Config.in
```kconfig
config LINGMO_PACKAGE_DOUBLE_CONVERSION
	bool "double-conversion"
	depends on LINGMO_INSTALL_LIBSTDCPP
	help
	  Provides binary-decimal and decimal-binary routines for
	  IEEE doubles.

	  https://github.com/google/double-conversion

comment "double-conversion needs a toolchain w/ C++"
	depends on !LINGMO_INSTALL_LIBSTDCPP
```

## package/dovecot/Config.in
```kconfig
config LINGMO_PACKAGE_DOVECOT
	bool "dovecot"
	depends on !LINGMO_STATIC_LIBS
	depends on LINGMO_USE_MMU # fork()
	select LINGMO_PACKAGE_OPENSSL
	select LINGMO_PACKAGE_ZLIB
	help
	  Dovecot is an open source IMAP and POP3 email server for
	  Linux/UNIX- like systems, written with security primarily in
	  mind. Dovecot is an excellent choice for both small and large
	  installations. It's fast, simple to set up, requires no
	  special administration and it uses very little memory.

	  http://www.dovecot.org

if LINGMO_PACKAGE_DOVECOT

config LINGMO_PACKAGE_DOVECOT_MYSQL
	bool "mysql support"
	depends on LINGMO_INSTALL_LIBSTDCPP # mariadb
	depends on LINGMO_TOOLCHAIN_HAS_THREADS # mariadb
	select LINGMO_PACKAGE_MARIADB
	help
	  Enable MySQL support.

comment "mysql support needs a toolchain w/ C++, threads"
	depends on !LINGMO_INSTALL_LIBSTDCPP || !LINGMO_TOOLCHAIN_HAS_THREADS

config LINGMO_PACKAGE_DOVECOT_SQLITE
	bool "sqlite support"
	select LINGMO_PACKAGE_SQLITE
	help
	  Enable SQLite support.

source "package/dovecot-pigeonhole/Config.in"

endif # LINGMO_PACKAGE_DOVECOT

comment "dovecot needs a toolchain w/ dynamic library"
	depends on LINGMO_USE_MMU
	depends on LINGMO_STATIC_LIBS
```

## package/drbd-utils/Config.in
```kconfig
config LINGMO_PACKAGE_DRBD_UTILS
	bool "drbd-utils"
	depends on LINGMO_USE_MMU # needs fork()
	help
	  DRBD utilities to manage the DRBD kernel module.

	  http://oss.linbit.com/drbd/
```

## package/dropwatch/Config.in
```kconfig
config LINGMO_PACKAGE_DROPWATCH
	bool "dropwatch"
	depends on LINGMO_TOOLCHAIN_HAS_THREADS # libnl
	select LINGMO_PACKAGE_READLINE
	select LINGMO_PACKAGE_LIBNL
	select LINGMO_PACKAGE_LIBPCAP
	help
	  Dropwatch is an interactive utility for monitoring and
	  recording packets that are dropped by the kernel

	  https://github.com/nhorman/dropwatch

comment "dropwatch needs a toolchain w/ threads"
	depends on !LINGMO_TOOLCHAIN_HAS_THREADS
```

## package/dstat/Config.in
```kconfig
config LINGMO_PACKAGE_DSTAT
	bool "dstat"
	depends on LINGMO_USE_WCHAR # python3
	depends on LINGMO_USE_MMU # python3
	depends on LINGMO_TOOLCHAIN_HAS_THREADS # python3
	depends on !LINGMO_STATIC_LIBS # python3
	select LINGMO_PACKAGE_PYTHON3 # runtime
	help
	  Dstat, written in Python, is a versatile replacement for
	  vmstat, iostat, netstat and ifstat. Dstat overcomes some of
	  their limitations and adds some extra features, more counters
	  and flexibility. Dstat is handy for monitoring systems during
	  performance tuning tests, benchmarks or troubleshooting.
	  Dstat allows you to view all of your system resources in
	  real-time, you can e.g. compare disk utilization in
	  combination with interrupts from your IDE controller, or
	  compare the network bandwidth numbers directly with the disk
	  throughput (in the same interval).

	  Note that to get proper output, your terminal size should be
	  known by the termios subsystem. This can be done by running
	  the 'resize' utility of busybox.

	  http://dag.wieers.com/home-made/dstat/

comment "dstat needs a toolchain w/ wchar, threads, dynamic library"
	depends on LINGMO_USE_MMU
	depends on !LINGMO_USE_WCHAR || !LINGMO_TOOLCHAIN_HAS_THREADS || LINGMO_STATIC_LIBS
```

## package/dt-utils/Config.in
```kconfig
config LINGMO_PACKAGE_DT_UTILS
	bool "dt-utils"
	depends on LINGMO_PACKAGE_HAS_UDEV
	help
	  Tools for flattened device-tree dumping and barebox state
	  manipulation.

	  https://git.pengutronix.de/cgit/tools/dt-utils/

comment "dt-utils needs udev /dev management"
	depends on !LINGMO_PACKAGE_HAS_UDEV
```

## package/dtbocfg/Config.in
```kconfig
config LINGMO_PACKAGE_DTBOCFG
	bool "dtbocfg"
	depends on LINGMO_LINUX_KERNEL
	help
	  dtbocfg, which stands for Device Tree Blob Overlay
	  Configuration File System, was developed to serve
	  as a userspace API of Device Tree Overlay.

	  https://github.com/ikwzm/dtbocfg

comment "dtbocfg needs a Linux kernel to be built"
	depends on !LINGMO_LINUX_KERNEL
```

## package/duktape/Config.in
```kconfig
config LINGMO_PACKAGE_DUKTAPE
	bool "duktape"
	depends on !LINGMO_STATIC_LIBS
	depends on !LINGMO_OPTIMIZE_FAST
	help
	  Duktape is an embeddable Javascript engine, with a focus on
	  portability and compact footprint.

	  Duktape is easy to integrate into a C/C++ project: add
	  duktape.c, duktape.h, and duk_config.h to your build, and use
	  the Duktape API to call Ecmascript functions from C code and
	  vice versa.

	  http://www.duktape.org

comment "duktape needs a toolchain w/ dynamic library"
	depends on LINGMO_STATIC_LIBS

comment "duktape can't be built with Optimize for fast"
	depends on LINGMO_OPTIMIZE_FAST
```

## package/duma/Config.in
```kconfig
config LINGMO_PACKAGE_DUMA
	bool "duma"
	depends on LINGMO_INSTALL_LIBSTDCPP
	depends on LINGMO_TOOLCHAIN_HAS_THREADS
	# By design, duma uses page mapping to isolate
	# allocations. Non-MMU platforms cannot perform such
	# things.
	depends on LINGMO_USE_MMU
	# duma works using LD_PRELOAD, so it always needs to build a
	# shared library
	depends on !LINGMO_STATIC_LIBS
	help
	  D.U.M.A. - Detect Unintended Memory Access. A fork of the
	  Electric Fence library. Detects buffer overflow and
	  underflow, and also memory leaks.

	  https://github.com/johnsonjh/duma

if LINGMO_PACKAGE_DUMA

config LINGMO_PACKAGE_DUMA_NO_LEAKDETECTION
	bool "disable memory leak detection"

endif # LINGMO_PACKAGE_DUMA

comment "duma needs a toolchain w/ C++, threads, dynamic library"
	depends on LINGMO_USE_MMU
	depends on !LINGMO_INSTALL_LIBSTDCPP || !LINGMO_TOOLCHAIN_HAS_THREADS || \
		LINGMO_STATIC_LIBS
```

## package/dump1090/Config.in
```kconfig
config LINGMO_PACKAGE_DUMP1090
	bool "dump1090"
	depends on LINGMO_TOOLCHAIN_HAS_THREADS
	depends on LINGMO_TOOLCHAIN_GCC_AT_LEAST_4_9 # C11/stdatomic.h
	select LINGMO_PACKAGE_NCURSES
	help
	  Dump1090 is a simple Mode S decoder for RTLSDR devices

	  https://github.com/flightaware/dump1090

comment "dump1090 needs a toolchain w/ threads, gcc >= 4.9"
	depends on !LINGMO_TOOLCHAIN_HAS_THREADS || \
		!LINGMO_TOOLCHAIN_GCC_AT_LEAST_4_9
```

## package/dust/Config.in
```kconfig
config LINGMO_PACKAGE_DUST
	bool "dust"
	depends on LINGMO_PACKAGE_HOST_RUSTC_TARGET_ARCH_SUPPORTS
	select LINGMO_PACKAGE_HOST_RUSTC
	help
	  dust is an alternative written in Rust of the command "du"
	  from the Linux kernel. It aims to be more intuitive and visual
	  in order to give the user a better view of his system's
	  current storage capacity.

	  https://github.com/bootandy/dust.git
```

## package/dvb-apps/Config.in
```kconfig
config LINGMO_PACKAGE_DVB_APPS
	bool "dvb-apps"
	depends on LINGMO_TOOLCHAIN_HAS_THREADS
	depends on LINGMO_TOOLCHAIN_HEADERS_AT_LEAST_3_3
	select LINGMO_PACKAGE_LIBICONV if !LINGMO_ENABLE_LOCALE
	help
	  Install a small number of DVB test and utility programs,
	  including szap and dvbscan.

	  http://linuxtv.org/projects.php
	  http://linuxtv.org/hg/dvb-apps

comment "dvb-apps utils needs a toolchain w/ threads, headers >= 3.3"
	depends on !LINGMO_TOOLCHAIN_HAS_THREADS || !LINGMO_TOOLCHAIN_HEADERS_AT_LEAST_3_3
```

## package/dvblast/Config.in
```kconfig
config LINGMO_PACKAGE_DVBLAST
	bool "dvblast"
	depends on LINGMO_TOOLCHAIN_HAS_THREADS
	select LINGMO_PACKAGE_BITSTREAM
	select LINGMO_PACKAGE_LIBEV
	select LINGMO_PACKAGE_LIBICONV if !LINGMO_ENABLE_LOCALE
	help
	  DVBlast is a simple and powerful MPEG-2/TS demux and
	  streaming application.

	  http://www.videolan.org/projects/dvblast.html

comment "dvblast needs a toolchain w/ threads"
	depends on !LINGMO_TOOLCHAIN_HAS_THREADS
```

## package/dvdauthor/Config.in
```kconfig
config LINGMO_PACKAGE_DVDAUTHOR
	bool "dvdauthor"
	select LINGMO_PACKAGE_LIBXML2
	select LINGMO_PACKAGE_FREETYPE
	select LINGMO_PACKAGE_LIBPNG
	help
	  DVDAuthor is a set of tools to help you author the file and
	  directory structure of a DVD-Video disc, including
	  programmatic commands for implementing interactive behaviour.
	  It is driven by command lines and XML control files, though
	  there are other programs that provide GUI-based front ends
	  if you prefer

	  http://dvdauthor.sourceforge.net

if LINGMO_PACKAGE_DVDAUTHOR

config LINGMO_PACKAGE_DVDAUTHOR_DVDUNAUTHOR
	bool "dvdunauthor"
	select LINGMO_PACKAGE_LIBDVDREAD
	help
	  This option enables the dvdunauthor program, which requires
	  libdvdread.

endif
```
