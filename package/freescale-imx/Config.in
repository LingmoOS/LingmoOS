## package/freescale-imx/Config.in
```kconfig
menuconfig LINGMO_PACKAGE_FREESCALE_IMX
	bool "Freescale i.MX libraries"
	depends on LINGMO_arm || LINGMO_aarch64
	help
	  Those packages provide hardware acceleration for GPU or VPU,
	  hardware optimization or some hardware tools for Freescale
	  i.MX platforms.

if LINGMO_PACKAGE_FREESCALE_IMX
choice
	prompt "i.MX platform"

config LINGMO_PACKAGE_FREESCALE_IMX_PLATFORM_IMX25_3STACK
	bool "imx25-3stack"

config LINGMO_PACKAGE_FREESCALE_IMX_PLATFORM_IMX27ADS
	bool "imx27ads"

config LINGMO_PACKAGE_FREESCALE_IMX_PLATFORM_IMX37_3STACK
	bool "imx37-3stack"

config LINGMO_PACKAGE_FREESCALE_IMX_PLATFORM_IMX50
	bool "imx50"

config LINGMO_PACKAGE_FREESCALE_IMX_PLATFORM_IMX51
	bool "imx51"

config LINGMO_PACKAGE_FREESCALE_IMX_PLATFORM_IMX53
	bool "imx53"

config LINGMO_PACKAGE_FREESCALE_IMX_PLATFORM_IMX6Q
	bool "imx6q/imx6dl"

config LINGMO_PACKAGE_FREESCALE_IMX_PLATFORM_IMX6S
	bool "imx6sl/imx6sx"

config LINGMO_PACKAGE_FREESCALE_IMX_PLATFORM_IMX6UL
	bool "imx6ul/imx6ull/imx6ulz"

config LINGMO_PACKAGE_FREESCALE_IMX_PLATFORM_IMX7
	bool "imx7d/imx7ulp"

config LINGMO_PACKAGE_FREESCALE_IMX_PLATFORM_IMX8
	bool "imx8"

config LINGMO_PACKAGE_FREESCALE_IMX_PLATFORM_IMX8M
	bool "imx8m"

config LINGMO_PACKAGE_FREESCALE_IMX_PLATFORM_IMX8MM
	bool "imx8mm"

config LINGMO_PACKAGE_FREESCALE_IMX_PLATFORM_IMX8MN
	bool "imx8mn"

config LINGMO_PACKAGE_FREESCALE_IMX_PLATFORM_IMX8MP
	bool "imx8mp"

config LINGMO_PACKAGE_FREESCALE_IMX_PLATFORM_IMX8X
	bool "imx8x"

config LINGMO_PACKAGE_FREESCALE_IMX_PLATFORM_IMX8DXL
	bool "imx8dxl"

config LINGMO_PACKAGE_FREESCALE_IMX_PLATFORM_IMX91
	bool "imx91"

config LINGMO_PACKAGE_FREESCALE_IMX_PLATFORM_IMX93
	bool "imx93"

endchoice

choice
	prompt "i.MX Silicon Revision"
	default LINGMO_PACKAGE_FREESCALE_IMX_PLATFORM_IMX93A1
	depends on LINGMO_PACKAGE_FREESCALE_IMX_PLATFORM_IMX93
	help
	  Some packages related to the selected i.MX platform need to
	  know the silicon revision of the platform they will run on.

	  Note - mismatches may result in a failure to boot!

config LINGMO_PACKAGE_FREESCALE_IMX_PLATFORM_IMX93A0
	bool "imx93a0"

config LINGMO_PACKAGE_FREESCALE_IMX_PLATFORM_IMX93A1
	bool "imx93a1"

endchoice

config LINGMO_PACKAGE_FREESCALE_IMX_PLATFORM
	string
	default "IMX25_3STACK" if LINGMO_PACKAGE_FREESCALE_IMX_PLATFORM_IMX25_3STACK
	default "IMX27ADS" if LINGMO_PACKAGE_FREESCALE_IMX_PLATFORM_IMX27ADS
	default "IMX37_3STACK" if LINGMO_PACKAGE_FREESCALE_IMX_PLATFORM_IMX37_3STACK
	default "IMX50" if LINGMO_PACKAGE_FREESCALE_IMX_PLATFORM_IMX50
	default "IMX51" if LINGMO_PACKAGE_FREESCALE_IMX_PLATFORM_IMX51
	default "IMX53" if LINGMO_PACKAGE_FREESCALE_IMX_PLATFORM_IMX53
	default "IMX6Q" if LINGMO_PACKAGE_FREESCALE_IMX_PLATFORM_IMX6Q
	default "IMX6S" if LINGMO_PACKAGE_FREESCALE_IMX_PLATFORM_IMX6S
	default "IMX6UL" if LINGMO_PACKAGE_FREESCALE_IMX_PLATFORM_IMX6UL
	default "IMX7" if LINGMO_PACKAGE_FREESCALE_IMX_PLATFORM_IMX7
	default "IMX8" if LINGMO_PACKAGE_FREESCALE_IMX_PLATFORM_IMX8
	default "IMX8MQ" if LINGMO_PACKAGE_FREESCALE_IMX_PLATFORM_IMX8M
	default "IMX8MM" if LINGMO_PACKAGE_FREESCALE_IMX_PLATFORM_IMX8MM
	default "IMX8MN" if LINGMO_PACKAGE_FREESCALE_IMX_PLATFORM_IMX8MN
	default "IMX8MP" if LINGMO_PACKAGE_FREESCALE_IMX_PLATFORM_IMX8MP
	default "IMX91" if LINGMO_PACKAGE_FREESCALE_IMX_PLATFORM_IMX91
	default "IMX93" if LINGMO_PACKAGE_FREESCALE_IMX_PLATFORM_IMX93

config LINGMO_PACKAGE_FREESCALE_IMX_HAS_VPU
	bool
	default y if LINGMO_PACKAGE_FREESCALE_IMX_PLATFORM_IMX27ADS || \
		LINGMO_PACKAGE_FREESCALE_IMX_PLATFORM_IMX51 || \
		LINGMO_PACKAGE_FREESCALE_IMX_PLATFORM_IMX53 || \
		LINGMO_PACKAGE_FREESCALE_IMX_PLATFORM_IMX6Q

config LINGMO_PACKAGE_FREESCALE_IMX_HAS_VPU_HANTRO
	bool
	default y if LINGMO_PACKAGE_FREESCALE_IMX_PLATFORM_IMX8M || \
		LINGMO_PACKAGE_FREESCALE_IMX_PLATFORM_IMX8MM || \
		LINGMO_PACKAGE_FREESCALE_IMX_PLATFORM_IMX8MP

config LINGMO_PACKAGE_FREESCALE_IMX_HAS_VIV_GPU
	bool
	default y if LINGMO_PACKAGE_FREESCALE_IMX_PLATFORM_IMX6Q || \
		LINGMO_PACKAGE_FREESCALE_IMX_PLATFORM_IMX6S || \
		LINGMO_PACKAGE_FREESCALE_IMX_PLATFORM_IMX7 || \
		LINGMO_PACKAGE_FREESCALE_IMX_PLATFORM_IMX8 || \
		LINGMO_PACKAGE_FREESCALE_IMX_PLATFORM_IMX8M || \
		LINGMO_PACKAGE_FREESCALE_IMX_PLATFORM_IMX8MM || \
		LINGMO_PACKAGE_FREESCALE_IMX_PLATFORM_IMX8MN || \
		LINGMO_PACKAGE_FREESCALE_IMX_PLATFORM_IMX8MP || \
		LINGMO_PACKAGE_FREESCALE_IMX_PLATFORM_IMX8X || \
		LINGMO_PACKAGE_FREESCALE_IMX_PLATFORM_IMX8DXL

config LINGMO_PACKAGE_FREESCALE_IMX_HAS_ELE
	bool
	default y if LINGMO_PACKAGE_FREESCALE_IMX_PLATFORM_IMX91 || \
		LINGMO_PACKAGE_FREESCALE_IMX_PLATFORM_IMX93

source "package/freescale-imx/imx-alsa-plugins/Config.in"
source "package/freescale-imx/imx-codec/Config.in"
source "package/freescale-imx/imx-kobs/Config.in"
source "package/freescale-imx/imx-lib/Config.in"
source "package/freescale-imx/imx-m4fwloader/Config.in"
source "package/freescale-imx/imx-parser/Config.in"
source "package/freescale-imx/imx-uuc/Config.in"
source "package/freescale-imx/imx-vpu/Config.in"
source "package/freescale-imx/imx-vpu-hantro/Config.in"
source "package/freescale-imx/imx-vpuwrap/Config.in"
source "package/freescale-imx/firmware-ele-imx/Config.in"
source "package/freescale-imx/firmware-imx/Config.in"
source "package/freescale-imx/imx-sc-firmware/Config.in"
source "package/freescale-imx/imx-seco/Config.in"
source "package/freescale-imx/imx-vpu-hantro-daemon/Config.in"
source "package/freescale-imx/imx-vpu-hantro-vc/Config.in"
if (LINGMO_PACKAGE_FREESCALE_IMX_PLATFORM_IMX51 || LINGMO_PACKAGE_FREESCALE_IMX_PLATFORM_IMX53)
source "package/freescale-imx/gpu-amd-bin-mx51/Config.in"
source "package/freescale-imx/libz160/Config.in"
endif
if LINGMO_PACKAGE_FREESCALE_IMX_HAS_VIV_GPU
source "package/freescale-imx/imx-gpu-g2d/Config.in"
source "package/freescale-imx/imx-gpu-viv/Config.in"
source "package/freescale-imx/kernel-module-imx-gpu-viv/Config.in"
endif

endif
```

## package/freescale-imx/firmware-ele-imx/Config.in
```kconfig
comment "firmware-ele-imx needs an i.MX platform with EdgeLock Secure Enclave"
	depends on !LINGMO_PACKAGE_FREESCALE_IMX_HAS_ELE

config LINGMO_PACKAGE_FIRMWARE_ELE_IMX
	bool "firmware-ele-imx"
	depends on LINGMO_PACKAGE_FREESCALE_IMX_HAS_ELE
	help
	  Firmware blobs for the EdgeLock Secure Enclave (ELE)
	  present on i.MX8ULP and i.MX9 SoCs.

	  This library is provided by NXP as-is and doesn't have an
	  upstream.

if LINGMO_PACKAGE_FIRMWARE_ELE_IMX

config LINGMO_PACKAGE_FIRMWARE_ELE_IMX_AHAB_CONTAINER_IMAGE
	string
	default "mx93a0-ahab-container.img" if LINGMO_PACKAGE_FREESCALE_IMX_PLATFORM_IMX93A0
	default "mx93a1-ahab-container.img" if \
		LINGMO_PACKAGE_FREESCALE_IMX_PLATFORM_IMX91 || \
		LINGMO_PACKAGE_FREESCALE_IMX_PLATFORM_IMX93A1

endif # LINGMO_PACKAGE_FIRMWARE_ELE_IMX
```

## package/freescale-imx/firmware-imx/Config.in
```kconfig
config LINGMO_PACKAGE_FIRMWARE_IMX
	bool "firmware-imx"
	depends on LINGMO_arm || LINGMO_aarch64 # Only relevant for i.MX
	help
	  Firmware blobs for the Freescale i.MX SoCs.

	  It contains blobs for SDMA, VPU, HDMI, EDPC, and DDR
	  training.

	  This library is provided by Freescale as-is and doesn't have
	  an upstream.

if LINGMO_PACKAGE_FIRMWARE_IMX

config LINGMO_PACKAGE_FIRMWARE_IMX_SDMA_FW_NAME
	string
	default "imx25" if LINGMO_PACKAGE_FREESCALE_IMX_PLATFORM_IMX25_3STACK
	default "imx51" if LINGMO_PACKAGE_FREESCALE_IMX_PLATFORM_IMX51
	default "imx53" if LINGMO_PACKAGE_FREESCALE_IMX_PLATFORM_IMX53
	default "imx6q" if LINGMO_PACKAGE_FREESCALE_IMX_PLATFORM_IMX6Q
	default "imx6q" if LINGMO_PACKAGE_FREESCALE_IMX_PLATFORM_IMX6S
	default "imx6q" if LINGMO_PACKAGE_FREESCALE_IMX_PLATFORM_IMX6UL
	default "imx7d" if LINGMO_PACKAGE_FREESCALE_IMX_PLATFORM_IMX7
	default "imx7d" if LINGMO_PACKAGE_FREESCALE_IMX_PLATFORM_IMX8M
	default "imx7d" if LINGMO_PACKAGE_FREESCALE_IMX_PLATFORM_IMX8MM
	default "imx7d" if LINGMO_PACKAGE_FREESCALE_IMX_PLATFORM_IMX8MN
	default "imx7d" if LINGMO_PACKAGE_FREESCALE_IMX_PLATFORM_IMX8MP

config LINGMO_PACKAGE_FIRMWARE_IMX_VPU_FW_NAME
	string
	default "imx27" if LINGMO_PACKAGE_FREESCALE_IMX_PLATFORM_IMX27ADS
	default "imx51" if LINGMO_PACKAGE_FREESCALE_IMX_PLATFORM_IMX51
	default "imx53" if LINGMO_PACKAGE_FREESCALE_IMX_PLATFORM_IMX53
	default "imx6"  if LINGMO_PACKAGE_FREESCALE_IMX_PLATFORM_IMX6Q
	default "imx8"  if LINGMO_PACKAGE_FREESCALE_IMX_PLATFORM_IMX8
	default "imx8"  if LINGMO_PACKAGE_FREESCALE_IMX_PLATFORM_IMX8X
	default "imx8"  if LINGMO_PACKAGE_FREESCALE_IMX_PLATFORM_IMX8DXL

config LINGMO_PACKAGE_FIRMWARE_IMX_NEEDS_HDMI_FW
	bool
	default y if LINGMO_PACKAGE_FREESCALE_IMX_PLATFORM_IMX8M

config LINGMO_PACKAGE_FIRMWARE_IMX_NEEDS_EASRC_FW
	bool
	default y if LINGMO_PACKAGE_FREESCALE_IMX_PLATFORM_IMX8MN

config LINGMO_PACKAGE_FIRMWARE_IMX_NEEDS_EPDC_FW
	bool
	default y if LINGMO_PACKAGE_FREESCALE_IMX_PLATFORM_IMX6Q
	default y if LINGMO_PACKAGE_FREESCALE_IMX_PLATFORM_IMX6S

config LINGMO_PACKAGE_FIRMWARE_IMX_NEEDS_DDR_FW
	bool
	default y if LINGMO_PACKAGE_FREESCALE_IMX_PLATFORM_IMX8M
	default y if LINGMO_PACKAGE_FREESCALE_IMX_PLATFORM_IMX8MM
	default y if LINGMO_PACKAGE_FREESCALE_IMX_PLATFORM_IMX8MN
	default y if LINGMO_PACKAGE_FREESCALE_IMX_PLATFORM_IMX8MP

config LINGMO_PACKAGE_FIRMWARE_IMX_NEEDS_DDR_FW_IMX9
	bool
	default y if LINGMO_PACKAGE_FREESCALE_IMX_PLATFORM_IMX91
	default y if LINGMO_PACKAGE_FREESCALE_IMX_PLATFORM_IMX93

if LINGMO_PACKAGE_FIRMWARE_IMX_NEEDS_DDR_FW

choice
	bool "DDR training binaries"
	default LINGMO_PACKAGE_FIRMWARE_IMX_LPDDR4
	help
	  Choose the DDR training binaries to be used depending on the
	  kind of memory that is available on the target board (DDR4,
	  LPDDR4, etc...).

config LINGMO_PACKAGE_FIRMWARE_IMX_LPDDR4
	bool "lpddr4"
	help
	  Use LPDDR4 binaries (i.e.: lpddr4_pmu_train_*.bin)

config LINGMO_PACKAGE_FIRMWARE_IMX_DDR4
	bool "DDR4"
	help
	  Use DDR4 binaries (i.e.: ddr4_*_201810.bin).

config LINGMO_PACKAGE_FIRMWARE_IMX_DDR3
	bool "DDR3"
	help
	  Use DDR3 binaries (i.e.: ddr3_*_201810.bin).

endchoice # DDR training FW

config LINGMO_PACKAGE_FIRMWARE_IMX_DDR_VERSION
	string "DDR3/DDR4/LPDDR4 firmware version"
	# Needed for backward compatibility, the package used to
	# unconditionally use HW version 201810 when DDR3/DDR4 was
	# selected
	default "201810" if LINGMO_PACKAGE_FIRMWARE_IMX_DDR3 || LINGMO_PACKAGE_FIRMWARE_IMX_DDR4
	help
	  Use a specific version of the imx ddr binaries. Leaving this
	  field empty will select the default version.

endif # LINGMO_PACKAGE_FIRMWARE_IMX_NEEDS_DDR_FW

if LINGMO_PACKAGE_FIRMWARE_IMX_NEEDS_DDR_FW || LINGMO_PACKAGE_FIRMWARE_IMX_NEEDS_DDR_FW_IMX9

config LINGMO_PACKAGE_FIRMWARE_IMX_IMEM_LEN
	hex "(LP)DDR IMEM padding length"
	default 0x8000
	help
	  The IMEM firmware will be padded to this length

config LINGMO_PACKAGE_FIRMWARE_IMX_DMEM_LEN
	hex "(LP)DDR DMEM padding length"
	default 0x4000
	help
	  The DMEM firmware will be padded to this length

endif # LINGMO_PACKAGE_FIRMWARE_IMX_NEEDS_DDR_FW || LINGMO_PACKAGE_FIRMWARE_IMX_NEEDS_DDR_FW_IMX9

endif # LINGMO_PACKAGE_FIRMWARE_IMX
```

## package/freescale-imx/gpu-amd-bin-mx51/Config.in
```kconfig
comment "gpu-amd-bin-mx51 needs a glibc EABI toolchain w/ C++"
	depends on LINGMO_arm
	depends on !LINGMO_ARM_EABI || !LINGMO_TOOLCHAIN_USES_GLIBC || \
		!LINGMO_INSTALL_LIBSTDCPP

config LINGMO_PACKAGE_GPU_AMD_BIN_MX51
	bool "gpu-amd-bin-mx51 (also imx53)"
	depends on LINGMO_ARM_EABI
	depends on LINGMO_TOOLCHAIN_USES_GLIBC
	depends on LINGMO_INSTALL_LIBSTDCPP
	select LINGMO_PACKAGE_HAS_LIBEGL
	select LINGMO_PACKAGE_HAS_LIBGLES
	select LINGMO_PACKAGE_HAS_LIBOPENVG
	help
	  Freescale libraries, headers and executables for the
	  AMD GPU on i.MX5x, containing OpenGL/ES, OpenVG
	  and EGL support.

if LINGMO_PACKAGE_GPU_AMD_BIN_MX51

choice
	prompt "Output option"
	help
	  There are two versions of this library: one for
	  direct framebuffer access, one for X11 rendering.
	  Choose here which version to install.

config LINGMO_PACKAGE_GPU_AMD_BIN_MX51_OUTPUT_X11
	bool "X11"
	depends on LINGMO_PACKAGE_XORG7
	select LINGMO_PACKAGE_LIBXCB
	select LINGMO_PACKAGE_XLIB_LIBX11
	select LINGMO_PACKAGE_XLIB_LIBXEXT
	select LINGMO_PACKAGE_XLIB_LIBXRENDER
	select LINGMO_PACKAGE_XLIB_LIBXDMCP
	select LINGMO_PACKAGE_XLIB_LIBXAU

comment "X11 backend needs X.org enabled"
	depends on !LINGMO_PACKAGE_XORG7

config LINGMO_PACKAGE_GPU_AMD_BIN_MX51_OUTPUT_FB
	bool "Framebuffer"

endchoice

config LINGMO_PACKAGE_PROVIDES_LIBEGL
	default "gpu-amd-bin-mx51"

config LINGMO_PACKAGE_PROVIDES_LIBGLES
	default "gpu-amd-bin-mx51"

config LINGMO_PACKAGE_PROVIDES_LIBOPENVG
	default "gpu-amd-bin-mx51"

config LINGMO_PACKAGE_GPU_AMD_BIN_MX51_EXAMPLES
	bool "install examples"
	help
	  Copy the examples to the target.

endif
```

## package/freescale-imx/imx-alsa-plugins/Config.in
```kconfig
config LINGMO_PACKAGE_IMX_ALSA_PLUGINS
	bool "imx-alsa-plugins"
	depends on LINGMO_arm # Only relevant for i.MX
	depends on LINGMO_LINUX_KERNEL
	depends on LINGMO_TOOLCHAIN_HAS_THREADS # alsa-lib
	select LINGMO_PACKAGE_ALSA_LIB
	help
	  ALSA plugins specific for the Freescale i.MX platform. It
	  requires a kernel that includes the i.MX specific headers
	  to be built.

	  The following plugins are provided so far:
	    * Rate Converter Plugin Using Freescale ASRC Hardware
	      Resampler (i.MX53 and most i.MX6)

	  https://github.com/nxp-imx/imx-alsa-plugins

comment "imx-alsa-libs needs an imx-specific Linux kernel to be built"
	depends on LINGMO_arm
	depends on !LINGMO_LINUX_KERNEL

comment "imx-alsa-libs needs a toolchain w/ threads"
	depends on LINGMO_arm
	depends on LINGMO_LINUX_KERNEL && !LINGMO_TOOLCHAIN_HAS_THREADS
```

## package/freescale-imx/imx-gpu-g2d/Config.in
```kconfig
comment "imx-gpu-g2d needs a glibc toolchain with armhf enabled"
	depends on LINGMO_arm
	depends on !LINGMO_TOOLCHAIN_USES_GLIBC || !LINGMO_ARM_EABIHF

comment "imx-gpu-g2d needs a glibc toolchain"
	depends on LINGMO_aarch64
	depends on !LINGMO_TOOLCHAIN_USES_GLIBC

config LINGMO_PACKAGE_IMX_GPU_G2D
	bool "imx-gpu-g2d"
	# Pre-built binaries only available for ARM EABIhf
	depends on (LINGMO_arm && LINGMO_ARM_EABIHF) || LINGMO_aarch64
	# Library binaries are linked against libc.so.6
	depends on LINGMO_TOOLCHAIN_USES_GLIBC
	select LINGMO_PACKAGE_IMX_GPU_VIV
	help
	  Userspace 2D libraries for Vivante GPU on i.MX platforms.

	  This library is provided by NXP as-is and doesn't have an
	  upstream.
```
