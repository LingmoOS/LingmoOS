## package/fwup/Config.in
```kconfig
config LINGMO_PACKAGE_FWUP
	bool "fwup"
	depends on LINGMO_USE_MMU
	depends on LINGMO_USE_WCHAR
	select LINGMO_PACKAGE_LIBARCHIVE
	# required by libarchive to include zip compression
	select LINGMO_PACKAGE_ZLIB
	select LINGMO_PACKAGE_LIBCONFUSE
	help
	  Fwup is a scriptable embedded Linux firmware update creator
	  and runner.

	  https://github.com/fhunleth/fwup

comment "fwup needs a toolchain w/ wchar"
	depends on LINGMO_USE_MMU
	depends on !LINGMO_USE_WCHAR
```
