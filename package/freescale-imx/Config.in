## package/freescale-imx/imx-gpu-viv/Config.in
```kconfig
comment "imx-gpu-viv needs a glibc toolchain with armhf enabled"
	depends on LINGMO_arm
	depends on !LINGMO_TOOLCHAIN_USES_GLIBC || !LINGMO_ARM_EABIHF

comment "imx-gpu-viv needs a glibc toolchain"
	depends on LINGMO_aarch64
	depends on !LINGMO_TOOLCHAIN_USES_GLIBC

config LINGMO_PACKAGE_IMX_GPU_VIV
	bool "imx-gpu-viv"
	# Pre-built binaries only available for ARM EABIhf
	depends on (LINGMO_arm && LINGMO_ARM_EABIHF) || LINGMO_aarch64
	# Library binaries are linked against libc.so.6
	depends on LINGMO_TOOLCHAIN_USES_GLIBC
	# Library binaries are linked against libdrm.so.2, except framebuffer
	# output on ARM
	select LINGMO_PACKAGE_LIBDRM if !(LINGMO_arm && LINGMO_PACKAGE_IMX_GPU_VIV_OUTPUT_FB)
	select LINGMO_PACKAGE_HAS_LIBEGL
	select LINGMO_PACKAGE_HAS_LIBGLES
	# gbm is only available in the aarch64 blobs
	select LINGMO_PACKAGE_HAS_LIBGBM if LINGMO_aarch64
	select LINGMO_PACKAGE_LIBGBM_HAS_FEATURE_DMA_BUF if LINGMO_aarch64
	select LINGMO_PACKAGE_LIBGBM_HAS_FEATURE_FORMAT_MODIFIER_PLANE_COUNT if LINGMO_aarch64
	select LINGMO_PACKAGE_HAS_LIBOPENCL
	select LINGMO_PACKAGE_HAS_LIBOPENVG
	help
	  Userspace libraries for Vivante GPU on i.MX platforms

	  It contains libraries and headers for GLES, OpenCL, and
	  OpenVG. It also contains a plugin for DirectFB-1.4.0, but
	  that doesn't work together with buildroot's DirectFB
	  version.

	  This library is provided by Freescale as-is and doesn't have
	  an upstream.

if LINGMO_PACKAGE_IMX_GPU_VIV

choice
	prompt "Output option"
	help
	  There are two versions of this library: one for
	  direct framebuffer access, one for wayland rendering.
	  Choose here which version to install.

config LINGMO_PACKAGE_IMX_GPU_VIV_OUTPUT_FB
	bool "Framebuffer"
	# The i.MX8 aarch64 blob doesn't support FB output
	depends on LINGMO_arm

config LINGMO_PACKAGE_IMX_GPU_VIV_OUTPUT_WL
	bool "Wayland"
	select LINGMO_PACKAGE_WAYLAND
	select LINGMO_PACKAGE_HAS_LIBEGL_WAYLAND

endchoice

config LINGMO_PACKAGE_IMX_GPU_VIV_OUTPUT
	string
	default "fb" if LINGMO_PACKAGE_IMX_GPU_VIV_OUTPUT_FB
	default "wayland" if LINGMO_PACKAGE_IMX_GPU_VIV_OUTPUT_WL

config LINGMO_PACKAGE_PROVIDES_LIBEGL
	default "imx-gpu-viv"

config LINGMO_PACKAGE_PROVIDES_LIBGLES
	default "imx-gpu-viv"

config LINGMO_PACKAGE_PROVIDES_LIBOPENCL
	default "imx-gpu-viv"

config LINGMO_PACKAGE_PROVIDES_LIBOPENVG
	default "imx-gpu-viv"

if LINGMO_aarch64

config LINGMO_PACKAGE_PROVIDES_LIBGBM
	default "imx-gpu-viv"

config LINGMO_PACKAGE_IMX_GPU_VIV_PLATFORM
	string
	default "mx8mn" if LINGMO_PACKAGE_FREESCALE_IMX_PLATFORM_IMX8MN
	default "mx8mp" if LINGMO_PACKAGE_FREESCALE_IMX_PLATFORM_IMX8MP
	default "mx8mq" if LINGMO_PACKAGE_FREESCALE_IMX_PLATFORM_IMX8M
	default "mx8qm" if LINGMO_PACKAGE_FREESCALE_IMX_PLATFORM_IMX8
	default "mx8qxp" if LINGMO_PACKAGE_FREESCALE_IMX_PLATFORM_IMX8X

endif

config LINGMO_PACKAGE_IMX_GPU_VIV_EXAMPLES
	bool "install examples"
	# example binaries are linked against libstdc++.so.6
	depends on LINGMO_INSTALL_LIBSTDCPP
	help
	  Copy the Vivante examples to the target.

	  Warning: examples take approximately 150 MB of disk space.

comment "imx-gpu-viv-examples need a toolchain w/ C++ support"
	depends on !LINGMO_INSTALL_LIBSTDCPP

config LINGMO_PACKAGE_IMX_GPU_VIV_GMEM_INFO
	bool "install gmem_info tool"
	help
	  Copy the gmem_info tool to the target which provides
	  information about GPU memory consumption.

endif
```

## package/freescale-imx/imx-kobs/Config.in
```kconfig
config LINGMO_PACKAGE_IMX_KOBS
	bool "imx-kobs"
	depends on LINGMO_arm # Only relevant for i.MX
	help
	  The imx-kobs tool is used for writing images to NAND on i.MX
	  platforms.

	  https://github.com/NXPmicro/imx-kobs
```

## package/freescale-imx/imx-lib/Config.in
```kconfig
comment "imx-lib needs an imx-specific Linux kernel to be built"
	depends on LINGMO_arm && !LINGMO_LINUX_KERNEL

config LINGMO_PACKAGE_IMX_LIB
	bool "imx-lib"
	depends on LINGMO_LINUX_KERNEL
	depends on LINGMO_arm # Only relevant for i.MX
	help
	  Library of userspace helpers specific for the Freescale i.MX
	  platform. It wraps the kernel interfaces for some i.MX
	  platform specific drivers. It requires a kernel that
	  includes the i.MX specific headers to be built.

	  https://github.com/nxp-imx/imx-lib
```

## package/freescale-imx/imx-parser/Config.in
```kconfig
config LINGMO_PACKAGE_IMX_PARSER
	bool "imx-parser"
	depends on LINGMO_arm || LINGMO_aarch64 # Only relevant for i.MX
	help
	  Binary parser libraries for the NXP i.MX SoCs.

	  This library is provided by NXP as-is and doesn't have
	  an upstream.
```

## package/freescale-imx/imx-sc-firmware/Config.in
```kconfig
config LINGMO_PACKAGE_IMX_SC_FIRMWARE
	bool "imx-sc-firmware"
	depends on LINGMO_PACKAGE_FREESCALE_IMX_PLATFORM_IMX8 || \
		LINGMO_PACKAGE_FREESCALE_IMX_PLATFORM_IMX8X || \
		LINGMO_PACKAGE_FREESCALE_IMX_PLATFORM_IMX8DXL
	help
	  System Control Unit Firmware blobs for the Freescale i.MX8
	  SoCs.

	  This library is provided by Freescale as-is and doesn't have
	  an upstream.
```

## package/freescale-imx/imx-uuc/Config.in
```kconfig
config LINGMO_PACKAGE_IMX_UUC
	bool "imx-uuc"
	depends on LINGMO_TOOLCHAIN_HAS_THREADS
	depends on LINGMO_arm || LINGMO_aarch64 # Only relevant for i.MX
	depends on LINGMO_USE_MMU # fork()
	depends on LINGMO_TOOLCHAIN_HEADERS_AT_LEAST_3_18 # usb_functionfs_descs_head_v2
	select LINGMO_PACKAGE_HOST_DOSFSTOOLS
	help
	  This package provides the Universal Adapter user-space
	  utility that is used to receive commands from the
	  Manufacturing Tool using the Freescale UTP Protocol.

	  It requires a Freescale/NXP kernel whose configuration
	  contains the CONFIG_FSL_UTP option.

	  This package is provided by Freescale/NXP as-is and doesn't
	  have an upstream.

comment "imx-uuc needs a toolchain w/ threads, headers >= 3.18"
	depends on LINGMO_arm
	depends on LINGMO_USE_MMU
	depends on !LINGMO_TOOLCHAIN_HAS_THREADS || \
		!LINGMO_TOOLCHAIN_HEADERS_AT_LEAST_3_18
```

## package/freescale-imx/imx-vpu-hantro-daemon/Config.in
```kconfig
comment "imx-vpu-hantro-daemon needs an i.MX-specific Linux kernel to be built"
	depends on !LINGMO_LINUX_KERNEL

comment "imx-vpu-hantro-daemon needs an i.MX platform with Hantro VPU"
	depends on LINGMO_LINUX_KERNEL
	depends on !LINGMO_PACKAGE_FREESCALE_IMX_HAS_VPU_HANTRO

config LINGMO_PACKAGE_IMX_VPU_HANTRO_DAEMON
	bool "imx-vpu-hantro-daemon"
	depends on LINGMO_LINUX_KERNEL
	depends on LINGMO_PACKAGE_FREESCALE_IMX_HAS_VPU_HANTRO
	select LINGMO_PACKAGE_IMX_VPU_HANTRO
	select LINGMO_PACKAGE_IMX_VPU_HANTRO_VC if LINGMO_PACKAGE_FREESCALE_IMX_PLATFORM_IMX8MP
	help
	  i.MX Hantro V4L2 Daemon specific for the NXP i.MX SoC
	  integrating a Hantro Video Processing Unit (VPU) such as the
	  i.MX8MQ/i.MX8MM/i.MX8MP.
```

## package/freescale-imx/imx-vpu-hantro-vc/Config.in
```kconfig
comment "imx-vpu-hantro-vc needs an i.MX-specific Linux kernel to be built"
	depends on !LINGMO_LINUX_KERNEL

comment "imx-vpu-hantro-vc needs an i.MX platform with Hantro VPU"
	depends on LINGMO_LINUX_KERNEL
	depends on !LINGMO_PACKAGE_FREESCALE_IMX_HAS_VPU_HANTRO

config LINGMO_PACKAGE_IMX_VPU_HANTRO_VC
	bool "imx-vpu-hantro-vc"
	depends on LINGMO_LINUX_KERNEL
	depends on LINGMO_PACKAGE_FREESCALE_IMX_HAS_VPU_HANTRO
	help
	  i.MX VC8000E Encoder library. Intended for the i.MX 8M Plus
	  processor.
```

## package/freescale-imx/imx-vpuwrap/Config.in
```kconfig
comment "imx-vpuwrap needs an imx-specific Linux kernel to be built"
	depends on !LINGMO_LINUX_KERNEL

comment "imx-vpuwrap needs an i.MX platform with VPU support"
	depends on LINGMO_LINUX_KERNEL
	depends on !LINGMO_PACKAGE_FREESCALE_IMX_HAS_VPU && !LINGMO_PACKAGE_FREESCALE_IMX_HAS_VPU_HANTRO

config LINGMO_PACKAGE_IMX_VPUWRAP
	bool "imx-vpuwrap"
	depends on LINGMO_LINUX_KERNEL
	depends on LINGMO_PACKAGE_FREESCALE_IMX_HAS_VPU || LINGMO_PACKAGE_FREESCALE_IMX_HAS_VPU_HANTRO
	select LINGMO_PACKAGE_IMX_VPU if LINGMO_PACKAGE_FREESCALE_IMX_HAS_VPU
	select LINGMO_PACKAGE_IMX_VPU_HANTRO if LINGMO_PACKAGE_FREESCALE_IMX_HAS_VPU_HANTRO
	help
	  Wrapper library for the vpu library, giving it a different
	  API.

	  This library is provided by NXP as-is and doesn't have
	  an upstream.
```

## package/freescale-imx/kernel-module-imx-gpu-viv/Config.in
```kconfig
comment "kernel-module-imx-gpu-viv needs a Linux kernel to be built"
	depends on !LINGMO_LINUX_KERNEL

config LINGMO_PACKAGE_KERNEL_MODULE_IMX_GPU_VIV
	bool "kernel-module-imx-gpu-viv"
	depends on LINGMO_LINUX_KERNEL
	help
	  Kernel loadable module for Vivante GPU.

	  This package uses an exact copy of the GPU kernel driver
	  source code of the same version as base and include fixes
	  and improvements developed by FSL Community.

	  This module is only meant for NXP-based kernel.

	  https://github.com/Freescale/kernel-module-imx-gpu-viv
```

## package/freescale-imx/libz160/Config.in
```kconfig
config LINGMO_PACKAGE_LIBZ160
	bool "libz160"
	depends on LINGMO_ARM_EABI
	depends on LINGMO_TOOLCHAIN_USES_GLIBC
	help
	  An API for user space programs to perform 2D accelerated
	  graphics operations on AMD GPU (included for examples in
	  iMX5x chipsets)

comment "libz160 needs an EABI toolchain w/ glibc"
	depends on !LINGMO_ARM_EABI || !LINGMO_TOOLCHAIN_USES_GLIBC
```

## package/freeswitch-mod-bcg729/Config.in
```kconfig
config LINGMO_PACKAGE_FREESWITCH_MOD_BCG729
	bool "freeswitch-mod-bcg729"
	depends on LINGMO_PACKAGE_FREESWITCH
	depends on !LINGMO_STATIC_LIBS # freeswitch
	select LINGMO_PACKAGE_BCG729
	help
	  FreeSWITCH G.729A module using the opensource bcg729
	  implementation by Belledonne Communications.

	  https://github.com/xadhoom/mod_bcg729
```

## package/freeswitch/Config.in
```kconfig
config LINGMO_PACKAGE_FREESWITCH
	bool "freeswitch"
	depends on LINGMO_INSTALL_LIBSTDCPP
	depends on !LINGMO_STATIC_LIBS # apr, included in freeswitch source
	depends on LINGMO_TOOLCHAIN_HAS_THREADS
	depends on LINGMO_USE_MMU # apr, included in freeswitch source
	depends on LINGMO_USE_WCHAR # uses wchar_t
	select LINGMO_PACKAGE_FFMPEG_SWSCALE if LINGMO_PACKAGE_FFMPEG
	select LINGMO_PACKAGE_LIBCURL
	select LINGMO_PACKAGE_JPEG
	# src/mod/applications/mod_cv/mod_cv.cpp includes
	# highgui.h, imgproc.hpp & objdetect.hpp
	select LINGMO_PACKAGE_OPENCV3_LIB_HIGHGUI if LINGMO_PACKAGE_OPENCV3
	select LINGMO_PACKAGE_OPENCV3_LIB_IMGPROC if LINGMO_PACKAGE_OPENCV3
	select LINGMO_PACKAGE_OPENCV3_LIB_OBJDETECT if LINGMO_PACKAGE_OPENCV3
	select LINGMO_PACKAGE_OPENSSL
	select LINGMO_PACKAGE_PCRE
	select LINGMO_PACKAGE_SOFIA_SIP
	select LINGMO_PACKAGE_SPANDSP
	select LINGMO_PACKAGE_SPEEX
	select LINGMO_PACKAGE_SPEEXDSP
	select LINGMO_PACKAGE_SQLITE
	select LINGMO_PACKAGE_TIFF
	select LINGMO_PACKAGE_UTIL_LINUX
	select LINGMO_PACKAGE_UTIL_LINUX_LIBUUID
	select LINGMO_PACKAGE_ZLIB
	help
	  FreeSWITCH is a scalable open source cross-platform
	  telephony platform designed to route and interconnect
	  popular communication protocols using audio, video, text or
	  any other form of media.

	  https://www.freeswitch.org

comment "freeswitch needs a toolchain w/ C++, dynamic library, threads, wchar"
	depends on LINGMO_USE_MMU
	depends on !LINGMO_INSTALL_LIBSTDCPP || LINGMO_STATIC_LIBS \
		|| !LINGMO_TOOLCHAIN_HAS_THREADS || !LINGMO_USE_WCHAR
```

## package/frr/Config.in
```kconfig
config LINGMO_PACKAGE_FRR
	bool "frr"
	depends on LINGMO_TOOLCHAIN_HAS_THREADS
	depends on !LINGMO_STATIC_LIBS # libyang
	depends on LINGMO_USE_MMU # fork()
	depends on LINGMO_TOOLCHAIN_HAS_SYNC_4 # json-c, libyang
	select LINGMO_PACKAGE_BASH
	select LINGMO_PACKAGE_BUSYBOX_SHOW_OTHERS # bash
	select LINGMO_PACKAGE_LIBYANG
	select LINGMO_PACKAGE_READLINE
	select LINGMO_PACKAGE_JSON_C
	help
	  The FRRouting Protocol Suite.

	  FRR is free software that implements and manages various
	  IPv4 and IPv6 routing protocols.

	  https://frrouting.org

if LINGMO_PACKAGE_FRR

config LINGMO_PACKAGE_FRR_BMP
	bool "BMP protocol"
	select LINGMO_PACKAGE_C_ARES
	help
	  Build BGP Monitoring Protocol daemon.

config LINGMO_PACKAGE_FRR_NHRPD
	bool "NHRPD protocol"
	select LINGMO_PACKAGE_C_ARES
	help
	  Build Next Hop Routing Protocol daemon.

endif

comment "frr needs a toolchain w/ threads, dynamic library"
	depends on LINGMO_TOOLCHAIN_HAS_SYNC_4
	depends on LINGMO_USE_MMU
	depends on !LINGMO_TOOLCHAIN_HAS_THREADS || LINGMO_STATIC_LIBS
```

## package/fstrcmp/Config.in
```kconfig
config LINGMO_PACKAGE_FSTRCMP
	bool "fstrcmp"
	depends on LINGMO_USE_WCHAR
	help
	  The fstrcmp project provides a library that is used to make
	  fuzzy comparisons of strings and byte arrays, including multi-
	  byte character strings.

	  http://fstrcmp.sourceforge.net/

comment "fstrcmp needs a toolchain w/ wchar"
	depends on !LINGMO_USE_WCHAR
```

## package/fswebcam/Config.in
```kconfig
config LINGMO_PACKAGE_FSWEBCAM
	bool "fswebcam"
	depends on LINGMO_USE_MMU # fork()
	depends on !LINGMO_STATIC_LIBS
	select LINGMO_PACKAGE_GD
	select LINGMO_PACKAGE_FREETYPE
	select LINGMO_PACKAGE_JPEG
	select LINGMO_PACKAGE_LIBPNG
	help
	  fswebcam is a neat and simple webcam app. It captures images
	  from a V4L1/V4L2 compatible device or file, averages them to
	  reduce noise and draws a caption using the GD Graphics
	  Library which also handles compressing the image to PNG or
	  JPEG. The resulting image is saved to a file or sent to
	  stdio where it can be piped to something like ncftpput or
	  scp.

	  https://www.sanslogic.co.uk/fswebcam/

comment "fswebcam needs a toolchain w/ dynamic library"
	depends on LINGMO_USE_MMU
	depends on LINGMO_STATIC_LIBS
```

## package/fuse-overlayfs/Config.in
```kconfig
config LINGMO_PACKAGE_FUSE_OVERLAYFS
	bool "fuse-overlayfs"
	depends on LINGMO_USE_MMU # libfuse3
	depends on !LINGMO_STATIC_LIBS # libfuse3
	depends on LINGMO_TOOLCHAIN_HAS_THREADS # libfuse3
	depends on LINGMO_TOOLCHAIN_HEADERS_AT_LEAST_3_15
	select LINGMO_PACKAGE_LIBFUSE3
	help
	  FUSE-overlayfs is an implementation of overlay+shiftfs in
	  FUSE, intended to be used for rootless containers.

	  http://github.com/containers/fuse-overlayfs

comment "fuse-overlayfs needs a toolchain w/ threads, dynamic library, headers >= 3.15"
	depends on LINGMO_USE_MMU
	depends on !LINGMO_TOOLCHAIN_HAS_THREADS || LINGMO_STATIC_LIBS || \
		!LINGMO_TOOLCHAIN_HEADERS_AT_LEAST_3_15
```

## package/fwts/Config.in
```kconfig
config LINGMO_PACKAGE_FWTS_ARCH_SUPPORTS
	bool
	default y if LINGMO_aarch64
	default y if LINGMO_arm
	default y if LINGMO_i386
	default y if LINGMO_x86_64

config LINGMO_PACKAGE_FWTS
	bool "fwts"
	depends on LINGMO_PACKAGE_FWTS_ARCH_SUPPORTS
	depends on LINGMO_PACKAGE_LIBBSD_ARCH_SUPPORTS # libbsd
	depends on LINGMO_USE_MMU # libglib2
	depends on LINGMO_USE_WCHAR # libglib2, libbsd
	depends on LINGMO_TOOLCHAIN_HAS_THREADS # libglib2, libbsd
	depends on !LINGMO_STATIC_LIBS # libbsd
	depends on LINGMO_TOOLCHAIN_USES_GLIBC # execinfo.h
	select LINGMO_PACKAGE_LIBGLIB2
	select LINGMO_PACKAGE_LIBBSD
	help
	  Firmware Test Suite (FWTS) is a test suite that performs
	  sanity checks on firmware. It is intended to identify BIOS and
	  ACPI errors and if appropriate it will try to explain the
	  errors and give advice to help workaround or fix firmware
	  bugs.

	  dtc (libfdt) is an optional dependency for fdt related tests.

	  https://wiki.ubuntu.com/FirmwareTestSuite

if LINGMO_PACKAGE_FWTS
config LINGMO_PACKAGE_FWTS_EFI_RUNTIME_MODULE
	bool "efi_runtime module"
	depends on LINGMO_LINUX_KERNEL
	help
	  Firmware Test Suite (FWTS) provides a EFI runtime kernel
	  module required to run UEFI tests.

comment "efi_runtime module needs a Linux kernel to be built"
	depends on !LINGMO_LINUX_KERNEL
endif

comment "fwts needs a glibc toolchain w/ wchar, threads, dynamic library"
	depends on LINGMO_PACKAGE_FWTS_ARCH_SUPPORTS
	depends on LINGMO_PACKAGE_LIBBSD_ARCH_SUPPORTS # libbsd
	depends on LINGMO_USE_MMU
	depends on !LINGMO_USE_WCHAR || !LINGMO_TOOLCHAIN_HAS_THREADS || \
		!LINGMO_TOOLCHAIN_USES_GLIBC || LINGMO_STATIC_LIBS
```
