## package/python-pytest/Config.in
```kconfig
config LINGMO_PACKAGE_PYTHON_PYTEST
	bool "python-pytest"
	select LINGMO_PACKAGE_PYTHON_ATTRS # runtime
	select LINGMO_PACKAGE_PYTHON_INICONFIG # runtime
	select LINGMO_PACKAGE_PYTHON_PACKAGING # runtime
	select LINGMO_PACKAGE_PYTHON_PLUGGY # runtime
	select LINGMO_PACKAGE_PYTHON3_PYEXPAT # runtime
	select LINGMO_PACKAGE_PYTHON3_ZLIB # runtime
	help
	  pytest is a framework that makes building simple and scalable
	  tests easy. Tests are expressive and readable—no boilerplate
	  code required.

	  https://docs.pytest.org/en/latest/
```

## package/python-pytrie/Config.in
```kconfig
config LINGMO_PACKAGE_PYTHON_PYTRIE
	bool "python-pytrie"
	select LINGMO_PACKAGE_PYTHON_SORTEDCONTAINERS # runtime
	help
	  A pure Python implementation of the trie data structure.

	  https://pypi.python.org/pypi/PyTrie
```

## package/python-pyudev/Config.in
```kconfig
config LINGMO_PACKAGE_PYTHON_PYUDEV
	bool "python-pyudev"
	depends on LINGMO_PACKAGE_HAS_UDEV
	select LINGMO_PACKAGE_PYTHON3_ZLIB # runtime
	help
	  pyudev is a LGPL licenced, pure Python 2/3 binding to
	  libudev, the device and hardware management and information
	  library of Linux.

	  https://github.com/pyudev/pyudev

comment "python-pyudev needs udev /dev management"
	depends on !LINGMO_PACKAGE_HAS_UDEV
```

## package/python-pyusb/Config.in
```kconfig
config LINGMO_PACKAGE_PYTHON_PYUSB
	bool "python-pyusb"
	depends on LINGMO_TOOLCHAIN_HAS_THREADS # libusb
	depends on LINGMO_TOOLCHAIN_GCC_AT_LEAST_4_9 # libusb
	select LINGMO_PACKAGE_LIBUSB
	help
	  The PyUSB module provides easy access to the Universal
	  Serial Bus (USB) from Python.

	  http://sourceforge.net/apps/trac/pyusb/

comment "python-pyusb needs a toolchain w/ threads, gcc >= 4.9"
	depends on !LINGMO_TOOLCHAIN_HAS_THREADS || \
		!LINGMO_TOOLCHAIN_GCC_AT_LEAST_4_9
```

## package/python-pyyaml/Config.in
```kconfig
config LINGMO_PACKAGE_PYTHON_PYYAML
	bool "python-pyyaml"
	select LINGMO_PACKAGE_LIBYAML
	help
	  The PyYAML package contains binding to the libyaml API.

	  http://pyyaml.org/
```

## package/python-pyzmq/Config.in
```kconfig
config LINGMO_PACKAGE_PYTHON_PYZMQ
	bool "python-pyzmq"
	depends on LINGMO_INSTALL_LIBSTDCPP # zeromq
	depends on LINGMO_TOOLCHAIN_HAS_THREADS # zeromq
	select LINGMO_PACKAGE_ZEROMQ
	help
	  This package contains the python language binding for zeromq.

	  http://zeromq.org/bindings:python

comment "python-pyzmq needs a toolchain w/ C++, threads"
	depends on !(LINGMO_INSTALL_LIBSTDCPP && LINGMO_TOOLCHAIN_HAS_THREADS)
```

## package/python-qrcode/Config.in
```kconfig
config LINGMO_PACKAGE_PYTHON_QRCODE
	bool "python-qrcode"
	select LINGMO_PACKAGE_PYTHON_PYPNG # runtime
	select LINGMO_PACKAGE_PYTHON_TYPING_EXTENSIONS # runtime
	help
	  Pure python QR Code generator

	  https://github.com/lincolnloop/python-qrcode

if LINGMO_PACKAGE_PYTHON_QRCODE

config LINGMO_PACKAGE_PYTHON_QRCODE_SVG
	bool "SVG support"
	select LINGMO_PACKAGE_PYTHON3_PYEXPAT

config LINGMO_PACKAGE_PYTHON_QRCODE_PIL
	bool "PIL support"
	select LINGMO_PACKAGE_PYTHON_PILLOW

endif
```

## package/python-raven/Config.in
```kconfig
config LINGMO_PACKAGE_PYTHON_RAVEN
	bool "python-raven"
	select LINGMO_PACKAGE_PYTHON3_ZLIB
	select LINGMO_PACKAGE_PYTHON3_SSL
	select LINGMO_PACKAGE_PYTHON3_UNICODEDATA
	help
	  Raven is a client for Sentry (https://getsentry.com).

	  https://github.com/getsentry/raven-python
```

## package/python-reentry/Config.in
```kconfig
config LINGMO_PACKAGE_PYTHON_REENTRY
	bool "python-reentry"
	select LINGMO_PACKAGE_PYTHON_SETUPTOOLS # runtime
	select LINGMO_PACKAGE_PYTHON_CLICK # runtime
	select LINGMO_PACKAGE_PYTHON_SIX # runtime
	help
	  A plugin manager based on setuptools entry points mechanism.

	  https://pypi.org/project/reentry/
```

## package/python-referencing/Config.in
```kconfig
config LINGMO_PACKAGE_PYTHON_REFERENCING
	bool "python-referencing"
	depends on LINGMO_PACKAGE_HOST_RUSTC_TARGET_ARCH_SUPPORTS # python-rpds-py
	select LINGMO_PACKAGE_PYTHON_ATTRS # runtime
	select LINGMO_PACKAGE_PYTHON_RPDS_PY # runtime
	help
	  JSON Referencing + Python.

	  https://github.com/python-jsonschema/referencing
```

## package/python-regex/Config.in
```kconfig
config LINGMO_PACKAGE_PYTHON_REGEX
	bool "python-regex"
	help
	  Alternative regular expression module, to replace re.

	  https://github.com/mrabarnett/mrab-regex
```

## package/python-requests-oauthlib/Config.in
```kconfig
config LINGMO_PACKAGE_PYTHON_REQUESTS_OAUTHLIB
	bool "python-requests-oauthlib"
	select LINGMO_PACKAGE_PYTHON_OAUTHLIB # runtime
	select LINGMO_PACKAGE_PYTHON_REQUESTS # runtime
	help
	  OAuthlib authentication support for Requests.

	  https://github.com/requests/requests-oauthlib
```

## package/python-requests/Config.in
```kconfig
config LINGMO_PACKAGE_PYTHON_REQUESTS
	bool "python-requests"
	select LINGMO_PACKAGE_PYTHON_CERTIFI # runtime
	select LINGMO_PACKAGE_PYTHON_CHARSET_NORMALIZER # runtime
	select LINGMO_PACKAGE_PYTHON_IDNA # runtime
	select LINGMO_PACKAGE_PYTHON_URLLIB3 # runtime
	select LINGMO_PACKAGE_PYTHON3_SSL # runtime
	select LINGMO_PACKAGE_PYTHON3_ZLIB # runtime
	help
	  Requests is an Apache2 Licensed HTTP library, written in
	  Python, for human beings.

	  http://www.python-requests.org/
```

## package/python-rpi-gpio/Config.in
```kconfig
config LINGMO_PACKAGE_PYTHON_RPI_GPIO
	bool "python-rpi-gpio"
	depends on LINGMO_arm || LINGMO_aarch64
	help
	  A Python module to control the GPIO on a Raspberry Pi.

	  http://sourceforge.net/p/raspberry-gpio-python
```

## package/python-rtoml/Config.in
```kconfig
config LINGMO_PACKAGE_PYTHON_RTOML
	bool "python-rtoml"
	depends on LINGMO_PACKAGE_HOST_RUSTC_TARGET_ARCH_SUPPORTS
	help
	  A better TOML library for python implemented in rust.

	  https://github.com/samuelcolvin/rtoml
```

## package/python-s3transfer/Config.in
```kconfig
config LINGMO_PACKAGE_PYTHON_S3TRANSFER
	bool "python-s3transfer"
	select LINGMO_PACKAGE_PYTHON_BOTOCORE # runtime
	help
	  An Amazon S3 Transfer Manager.

	  https://github.com/boto/s3transfer
```

## package/python-scapy/Config.in
```kconfig
config LINGMO_PACKAGE_PYTHON_SCAPY
	bool "python-scapy"
	select LINGMO_PACKAGE_PYTHON3_ZLIB
	help
	  Scapy: interactive packet manipulation tool.

	  http://www.secdev.org/projects/scapy
```

## package/python-secretstorage/Config.in
```kconfig
config LINGMO_PACKAGE_PYTHON_SECRETSTORAGE
	bool "python-secretstorage"
	depends on LINGMO_PACKAGE_HOST_RUSTC_TARGET_ARCH_SUPPORTS # python-cryptography
	select LINGMO_PACKAGE_PYTHON_CRYPTOGRAPHY # runtime
	help
	  Python bindings to FreeDesktop.org Secret Service API.

	  https://github.com/mitya57/secretstorage
```

## package/python-see/Config.in
```kconfig
config LINGMO_PACKAGE_PYTHON_SEE
	bool "python-see"
	help
	  dir for humans.

	  https://ljcooke.github.io/see/
```

## package/python-segno/Config.in
```kconfig
config LINGMO_PACKAGE_PYTHON_SEGNO
	bool "python-segno"
	select LINGMO_PACKAGE_PYTHON3_PYEXPAT # runtime
	select LINGMO_PACKAGE_PYTHON3_ZLIB # runtime
	help
	  QR Code and Micro QR Code generator for Python.

	  https://github.com/heuer/segno/
```

## package/python-selenium/Config.in
```kconfig
config LINGMO_PACKAGE_PYTHON_SELENIUM
	bool "python-selenium"
	select LINGMO_PACKAGE_PYTHON_CERTIFI # runtime
	select LINGMO_PACKAGE_PYTHON_PYSOCKS # runtime
	select LINGMO_PACKAGE_PYTHON_TRIO # runtime
	select LINGMO_PACKAGE_PYTHON_TRIO_WEBSOCKET # runtime
	select LINGMO_PACKAGE_PYTHON_URLLIB3 # runtime
	help
	  Python language bindings for Selenium WebDriver.

	  https://www.selenium.dev
```

## package/python-sentry-sdk/Config.in
```kconfig
config LINGMO_PACKAGE_PYTHON_SENTRY_SDK
	bool "python-sentry-sdk"
	select LINGMO_PACKAGE_PYTHON_CERTIFI # runtime
	select LINGMO_PACKAGE_PYTHON_URLLIB3 # runtime
	help
	  Python client for Sentry (https://sentry.io).

	  https://github.com/getsentry/sentry-python
```

## package/python-serial-asyncio/Config.in
```kconfig
config LINGMO_PACKAGE_PYTHON_SERIAL_ASYNCIO
	bool "python-serial-asyncio"
	select LINGMO_PACKAGE_PYTHON_SERIAL
	help
	  asyncio extension package for pyserial.

	  https://github.com/pyserial/pyserial-asyncio
```

## package/python-service-identity/Config.in
```kconfig
config LINGMO_PACKAGE_PYTHON_SERVICE_IDENTITY
	bool "python-service-identity"
	depends on LINGMO_PACKAGE_HOST_RUSTC_TARGET_ARCH_SUPPORTS # python-cryptography
	select LINGMO_PACKAGE_PYTHON_ATTRS # runtime
	select LINGMO_PACKAGE_PYTHON_CRYPTOGRAPHY # runtime
	select LINGMO_PACKAGE_PYTHON_PYASN1 # runtime
	select LINGMO_PACKAGE_PYTHON_PYASN1_MODULES # runtime
	help
	  Service identity verification for pyOpenSSL.

	  https://pypi.python.org/pypi/service_identity
```

## package/python-setuptools/Config.in
```kconfig
config LINGMO_PACKAGE_PYTHON_SETUPTOOLS
	bool "python-setuptools"
	select LINGMO_PACKAGE_PYTHON3_PYEXPAT # runtime
	select LINGMO_PACKAGE_PYTHON3_ZLIB # runtime
	help
	  Download, build, install, upgrade, and uninstall Python
	  packages.

	  http://pypi.python.org/pypi/setuptools
```
