## package/rpm/Config.in
```kconfig
comment "rpm needs a toolchain w/ dynamic library, threads and lua >= 5.3"
	depends on !LINGMO_TOOLCHAIN_HAS_THREADS || LINGMO_STATIC_LIBS \
		|| !LINGMO_PACKAGE_LUA || LINGMO_PACKAGE_LUA_5_1
	depends on LINGMO_PACKAGE_BUSYBOX_SHOW_OTHERS
	depends on LINGMO_USE_MMU

config LINGMO_PACKAGE_RPM
	bool "rpm"
	depends on !LINGMO_STATIC_LIBS # dlfcn.h
	depends on LINGMO_PACKAGE_BUSYBOX_SHOW_OTHERS
	depends on LINGMO_PACKAGE_LUA && !LINGMO_PACKAGE_LUA_5_1
	depends on LINGMO_TOOLCHAIN_HAS_THREADS
	depends on LINGMO_USE_MMU # fork()
	select LINGMO_PACKAGE_OPENSSL if !LINGMO_PACKAGE_LIBGCRYPT
	select LINGMO_PACKAGE_FILE
	select LINGMO_PACKAGE_POPT
	select LINGMO_PACKAGE_ZLIB
	help
	  The RPM Package Manager (RPM).

	  http://www.rpm.org/

if LINGMO_PACKAGE_RPM

comment "rpm2archive support needs a toolchain w/ wchar"
	depends on !LINGMO_USE_WCHAR

config LINGMO_PACKAGE_RPM_RPM2ARCHIVE
	bool "rpm2archive command"
	default y
	depends on LINGMO_USE_WCHAR
	select LINGMO_PACKAGE_LIBARCHIVE
	help
	  Enable rpm2archive

endif
```

## package/rrdtool/Config.in
```kconfig
config LINGMO_PACKAGE_RRDTOOL
	bool "rrdtool"
	depends on LINGMO_USE_WCHAR # libglib2
	depends on LINGMO_TOOLCHAIN_HAS_THREADS # libglib2
	depends on LINGMO_USE_MMU # libglib2
	select LINGMO_PACKAGE_LIBGLIB2
	help
	  RRDtool is the OpenSource industry standard, high performance
	  data logging and graphing system for time series data.

	  http://oss.oetiker.ch/rrdtool/

if LINGMO_PACKAGE_RRDTOOL

config LINGMO_PACKAGE_RRDTOOL_RRDGRAPH
	bool "rrd_graph"
	default y
	depends on LINGMO_TOOLCHAIN_HAS_SYNC_4 # pango -> harfbuzz
	depends on LINGMO_TOOLCHAIN_GCC_AT_LEAST_4_9 # pango -> harfbuzz
	depends on LINGMO_INSTALL_LIBSTDCPP # freetype support from pango
	select LINGMO_PACKAGE_CAIRO
	select LINGMO_PACKAGE_CAIRO_PDF
	select LINGMO_PACKAGE_CAIRO_PNG
	select LINGMO_PACKAGE_CAIRO_PS
	select LINGMO_PACKAGE_CAIRO_SVG
	select LINGMO_PACKAGE_PANGO
	help
	  This enables the graphing capabilities ('rrdgraph').
	  Without this it will only act as a database backend.

comment "rrd_graph support needs a toolchain w/ C++, gcc >= 4.9"
	depends on !LINGMO_INSTALL_LIBSTDCPP || \
		!LINGMO_TOOLCHAIN_GCC_AT_LEAST_4_9
	depends on LINGMO_TOOLCHAIN_HAS_SYNC_4

endif

comment "rrdtool needs a toolchain w/ wchar, threads"
	depends on LINGMO_USE_MMU
	depends on !LINGMO_USE_WCHAR || !LINGMO_TOOLCHAIN_HAS_THREADS
```

## package/rsh-redone/Config.in
```kconfig
config LINGMO_PACKAGE_RSH_REDONE
	bool "rsh-redone"
	help
	  Rsh-redone is a reimplementation of the remote shell clients
	  and servers. It is written from the ground up to avoid the
	  bugs found in the standard clients and servers. It also
	  fully supports IPv6.

	  http://packages.debian.org/source/sid/rsh-redone

if LINGMO_PACKAGE_RSH_REDONE

config LINGMO_PACKAGE_RSH_REDONE_RLOGIN
	bool "rlogin"

config LINGMO_PACKAGE_RSH_REDONE_RLOGIND
	bool "rlogind"
	depends on !LINGMO_STATIC_LIBS
	depends on LINGMO_ENABLE_LOCALE && LINGMO_USE_WCHAR
	depends on !LINGMO_TOOLCHAIN_USES_MUSL
	depends on LINGMO_USE_MMU # linux-pam
	depends on LINGMO_TOOLCHAIN_GCC_AT_LEAST_4_9 # linux-pam
	select LINGMO_PACKAGE_LINUX_PAM

comment "rlogind needs a uClibc or glibc toolchain w/ wchar, locale, dynamic library, gcc >= 4.9"
	depends on !(LINGMO_ENABLE_LOCALE && LINGMO_USE_WCHAR) \
		|| LINGMO_STATIC_LIBS || LINGMO_TOOLCHAIN_USES_MUSL || \
		!LINGMO_TOOLCHAIN_GCC_AT_LEAST_4_9

config LINGMO_PACKAGE_RSH_REDONE_RSH
	bool "rsh"

config LINGMO_PACKAGE_RSH_REDONE_RSHD
	bool "rshd"
	depends on LINGMO_ENABLE_LOCALE && LINGMO_USE_WCHAR
	depends on !LINGMO_STATIC_LIBS
	depends on LINGMO_USE_MMU # linux-pam
	depends on LINGMO_TOOLCHAIN_GCC_AT_LEAST_4_9 # linux-pam
	select LINGMO_PACKAGE_LINUX_PAM

comment "rshd needs a toolchain w/ wchar, locale, dynamic library, gcc >= 4.9"
	depends on !(LINGMO_ENABLE_LOCALE && LINGMO_USE_WCHAR) \
		|| LINGMO_STATIC_LIBS || !LINGMO_TOOLCHAIN_GCC_AT_LEAST_4_9

endif
```

## package/rsync/Config.in
```kconfig
config LINGMO_PACKAGE_RSYNC
	bool "rsync"
	# fork()
	depends on LINGMO_USE_MMU
	select LINGMO_PACKAGE_ZLIB
	select LINGMO_PACKAGE_POPT
	help
	  File transfer program to keep remote files in sync.

	  https://rsync.samba.org/
```

## package/rsyslog/Config.in
```kconfig
config LINGMO_PACKAGE_RSYSLOG
	bool "rsyslog"
	depends on LINGMO_TOOLCHAIN_HAS_THREADS
	depends on LINGMO_USE_MMU # fork()
	depends on !LINGMO_STATIC_LIBS # modules
	depends on !LINGMO_TOOLCHAIN_USES_MUSL # GLOB_BRACE
	# Propagate the exact same dependency from libfastjson,
	# even though rsyslog already depends on threads for itself:
	depends on LINGMO_TOOLCHAIN_HAS_SYNC_4 || LINGMO_TOOLCHAIN_HAS_THREADS
	depends on LINGMO_PACKAGE_BUSYBOX_SHOW_OTHERS
	select LINGMO_PACKAGE_APR_UTIL if LINGMO_PACKAGE_CIVETWEB_LIB
	select LINGMO_PACKAGE_ZLIB
	select LINGMO_PACKAGE_LIBESTR
	select LINGMO_PACKAGE_LIBLOGGING
	select LINGMO_PACKAGE_LIBFASTJSON
	help
	  Rsyslog is a powerful and flexible syslog implementation

	  http://www.rsyslog.com

comment "rsyslog needs a uClibc or glibc toolchain w/ threads, dynamic library"
	depends on LINGMO_USE_MMU
	depends on LINGMO_TOOLCHAIN_HAS_SYNC_4
	depends on !LINGMO_TOOLCHAIN_HAS_THREADS || LINGMO_STATIC_LIBS \
		|| LINGMO_TOOLCHAIN_USES_MUSL
	depends on LINGMO_PACKAGE_BUSYBOX_SHOW_OTHERS
```

## package/rt-tests/Config.in
```kconfig
config LINGMO_PACKAGE_RT_TESTS
	bool "rt-tests"
	depends on LINGMO_TOOLCHAIN_HAS_SYNC_4 # __sync_*_4 intrisics
	depends on LINGMO_TOOLCHAIN_HAS_ATOMIC # numactl
	depends on LINGMO_TOOLCHAIN_HAS_THREADS_NPTL
	depends on LINGMO_TOOLCHAIN_HEADERS_AT_LEAST_4_5
	depends on LINGMO_USE_MMU # fork(), numactl
	depends on !LINGMO_STATIC_LIBS # dlopen
	depends on !LINGMO_TOOLCHAIN_USES_MUSL # cyclictest
	select LINGMO_PACKAGE_NUMACTL
	help
	  Set of utilities for testing the real-time behaviour of a
	  Linux system.

	  All tools are simple C programs with no dependencies, except
	  the hwlatdetect utility, which is a Python script and
	  therefore requires the Python interpreter. It will only be
	  installed if a Python interpreter has been selected in the
	  Buildroot configuration.

	  Note that this package requires a toolchain built with the
	  NPTL implementation of the pthread API (this is always the
	  case with glibc toolchains, but may not necessarily be the
	  case with uClibc toolchains, since the thread implementation
	  is configurable).

	  https://wiki.linuxfoundation.org/realtime/documentation/howto/tools/rt-tests

comment "rt-tests may not work on MIPS with an external uClibc toolchain"
	depends on LINGMO_PACKAGE_RT_TESTS
	depends on LINGMO_TOOLCHAIN_EXTERNAL_UCLIBC
	depends on LINGMO_mips || LINGMO_mipsel || LINGMO_mips64 || LINGMO_mips64el

comment "rt-tests needs a uClibc or glibc toolchain w/ NPTL, headers >= 4.5, dynamic library"
	depends on LINGMO_TOOLCHAIN_HAS_SYNC_4
	depends on LINGMO_TOOLCHAIN_HAS_ATOMIC
	depends on !LINGMO_TOOLCHAIN_HAS_THREADS_NPTL || LINGMO_STATIC_LIBS \
		|| LINGMO_TOOLCHAIN_USES_MUSL || !LINGMO_TOOLCHAIN_HEADERS_AT_LEAST_4_5
	depends on LINGMO_USE_MMU
```

## package/rtai/Config.in
```kconfig
config LINGMO_PACKAGE_RTAI
	bool "rtai"
	depends on LINGMO_LINUX_KERNEL_EXT_RTAI
	select LINGMO_LINUX_NEEDS_MODULES # not using kernel-module infra
	help
	  RTAI - the RealTime Application Interface for Linux.

	  http://www.rtai.org
```

## package/rtl8192eu/Config.in
```kconfig
config LINGMO_PACKAGE_RTL8192EU
	bool "rtl8192eu"
	depends on !LINGMO_s390x
	depends on LINGMO_LINUX_KERNEL
	help
	  A standalone driver for the RTL8192EU USB Wi-Fi adapter.

	  Make sure your target kernel has the CONFIG_WIRELESS_EXT
	  config option enabled.

	  https://github.com/clnhub/rtl8192eu-linux

comment "rtl8192eu needs a Linux kernel to be built"
	depends on !LINGMO_s390x
	depends on !LINGMO_LINUX_KERNEL
```

## package/rtl8723bu/Config.in
```kconfig
config LINGMO_PACKAGE_RTL8723BU
	bool "rtl8723bu"
	depends on !LINGMO_s390x
	depends on LINGMO_LINUX_KERNEL
	help
	  rtl8723bu wifi driver

	  https://github.com/lwfinger/rtl8723bu

comment "rtl8723bu needs a Linux kernel to be built"
	depends on !LINGMO_s390x
	depends on !LINGMO_LINUX_KERNEL
```

## package/rtl8812au-aircrack-ng/Config.in
```kconfig
comment "rtl8812au-aircrack-ng needs a Linux kernel to be built"
	depends on !LINGMO_s390x
	depends on !LINGMO_LINUX_KERNEL

config LINGMO_PACKAGE_RTL8812AU_AIRCRACK_NG
	bool "rtl8812au-aircrack-ng"
	depends on !LINGMO_s390x
	depends on LINGMO_LINUX_KERNEL
	help
	  rtl8812au wifi driver (aircrack-ng repository)

	  https://github.com/aircrack-ng/rtl8812au
```

## package/rtl8821au/Config.in
```kconfig
comment "rtl8821au needs a Linux kernel to be built"
	depends on !LINGMO_s390x
	depends on !LINGMO_LINUX_KERNEL

config LINGMO_PACKAGE_RTL8821AU
	bool "rtl8821au"
	depends on !LINGMO_s390x
	depends on LINGMO_LINUX_KERNEL
	help
	  rtl8821au wifi driver

	  https://github.com/abperiasamy/rtl8812AU_8821AU_linux
```

## package/rtl8821cu/Config.in
```kconfig
comment "rtl8821cu needs a Linux kernel to be built"
	depends on !LINGMO_s390x
	depends on !LINGMO_LINUX_KERNEL

config LINGMO_PACKAGE_RTL8821CU
	bool "rtl8821cu"
	depends on !LINGMO_s390x
	depends on LINGMO_LINUX_KERNEL
	help
	  rtl8821cu wifi driver

	  https://github.com/brektrou/rtl8821CU
```

## package/rtl8822cs/Config.in
```kconfig
comment "rl8822cs needs a Linux kernel to be built"
	depends on !LINGMO_s390x
	depends on !LINGMO_LINUX_KERNEL

config LINGMO_PACKAGE_RTL8822CS
	bool "rtl8822cs"
	depends on !LINGMO_s390x
	depends on LINGMO_LINUX_KERNEL
	help
	  Realtek RTL8822CS Wi-Fi driver as a kernel module (JetHome
	  repository)

          https://github.com/jethome-ru/rtl88x2cs/
```
