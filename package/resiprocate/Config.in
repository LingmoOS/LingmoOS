## package/resiprocate/Config.in
```kconfig
comment "resiprocate needs a toolchain w/ C++, threads, wchar"
	depends on LINGMO_USE_MMU
	depends on !LINGMO_INSTALL_LIBSTDCPP || !LINGMO_TOOLCHAIN_HAS_THREADS || !LINGMO_USE_WCHAR

config LINGMO_PACKAGE_RESIPROCATE
	bool "resiprocate"
	depends on LINGMO_INSTALL_LIBSTDCPP
	depends on LINGMO_TOOLCHAIN_HAS_THREADS
	depends on LINGMO_USE_WCHAR
	depends on LINGMO_USE_MMU # fork()
	select LINGMO_PACKAGE_C_ARES
	select LINGMO_PACKAGE_LIBOPENSSL_ENABLE_DES if LINGMO_PACKAGE_LIBOPENSSL
	help
	  reSIProcate is a framework that aims to fully implement the
	  SIP protocol in first class C++. It is intended for use in
	  other applications, such as the repro SIP proxy.

	  By default this package provides the core libraries: librutil
	  (utilities), libresip (SIP stack/RFC compliant message
	  parsing) and libdum (SIP Dialog Usage Manager, a state
	  machine for SIP dialogs).

	  https://www.resiprocate.org/

if LINGMO_PACKAGE_RESIPROCATE

config LINGMO_PACKAGE_RESIPROCATE_DTLS_SUPPORT
	bool "DTLS support"
	select LINGMO_PACKAGE_OPENSSL
	help
	  Enable DTLS support (requires OpenSSL)

config LINGMO_PACKAGE_RESIPROCATE_REND
	bool "resiprocate-rend"
	select LINGMO_PACKAGE_BOOST
	select LINGMO_PACKAGE_BOOST_SYSTEM
	select LINGMO_PACKAGE_OPENSSL
	select LINGMO_PACKAGE_POPT
	help
	  Rend is tool that is was created specifically to load test
	  gtSIP based presence servers.

config LINGMO_PACKAGE_RESIPROCATE_APPS
	bool "resiprocate-apps"
	select LINGMO_PACKAGE_OPENSSL
	select LINGMO_PACKAGE_PCRE
	help
	  Build apps clicktocall and sipdial

endif # LINGMO_PACKAGE_RESIPROCATE
```

## package/restclient-cpp/Config.in
```kconfig
config LINGMO_PACKAGE_RESTCLIENT_CPP
	bool "restclient-cpp"
	depends on LINGMO_INSTALL_LIBSTDCPP
	depends on LINGMO_TOOLCHAIN_GCC_AT_LEAST_4_8 # C++11
	select LINGMO_PACKAGE_LIBCURL
	help
	  restclient-cpp is a C++ client library for
	  making HTTP/REST requests

	  http://code.mrtazz.com/restclient-cpp/

comment "restclient-cpp needs a toolchain w/ C++, gcc >= 4.8"
	depends on !LINGMO_INSTALL_LIBSTDCPP || !LINGMO_TOOLCHAIN_GCC_AT_LEAST_4_8
```

## package/restorecond/Config.in
```kconfig
config LINGMO_PACKAGE_RESTORECOND
	bool "restorecond"
	depends on LINGMO_USE_MMU # libglib2
	depends on LINGMO_USE_WCHAR # libglib2
	depends on LINGMO_TOOLCHAIN_HAS_THREADS # libglib2
	depends on !LINGMO_STATIC_LIBS # libselinux
	depends on LINGMO_TOOLCHAIN_GCC_AT_LEAST_5 # libsepol
	select LINGMO_PACKAGE_DBUS
	select LINGMO_PACKAGE_DBUS_GLIB
	select LINGMO_PACKAGE_LIBGLIB2
	select LINGMO_PACKAGE_LIBSELINUX
	select LINGMO_PACKAGE_LIBSEPOL
	help
	  restorecond is a daemon that watches for file creation and
	  then sets the default SELinux file context for that file.

	  https://github.com/SELinuxProject/selinux/wiki/Releases

comment "restorecond needs a toolchain w/ wchar, threads, dynamic library, gcc >= 5"
	depends on LINGMO_USE_MMU
	depends on !LINGMO_TOOLCHAIN_HAS_THREADS || !LINGMO_USE_WCHAR || \
		LINGMO_STATIC_LIBS || !LINGMO_TOOLCHAIN_GCC_AT_LEAST_5
```

## package/riemann-c-client/Config.in
```kconfig
config LINGMO_PACKAGE_RIEMANN_C_CLIENT
	bool "riemann-c-client"
	depends on LINGMO_INSTALL_LIBSTDCPP # protobuf-c
	depends on LINGMO_TOOLCHAIN_HAS_THREADS # protobuf-c
	depends on LINGMO_PACKAGE_HOST_PROTOBUF_ARCH_SUPPORTS # protobuf-c
	depends on LINGMO_HOST_GCC_AT_LEAST_7 # protobuf-c
	select LINGMO_PACKAGE_PROTOBUF_C
	help
	  Riemann-c-client is a C client library for the Riemann
	  monitoring system, providing a convenient and simple API,
	  high test coverage and a copyleft license, along with API
	  and ABI stability.

	  https://github.com/algernon/riemann-c-client

comment "riemann-c-client needs a toolchain w/ C++, threads, host gcc >= 7"
	depends on !LINGMO_INSTALL_LIBSTDCPP || !LINGMO_TOOLCHAIN_HAS_THREADS || \
		!LINGMO_HOST_GCC_AT_LEAST_7
	depends on LINGMO_PACKAGE_HOST_PROTOBUF_ARCH_SUPPORTS
```

## package/ripgrep/Config.in
```kconfig
config LINGMO_PACKAGE_RIPGREP
	bool "ripgrep"
	depends on LINGMO_PACKAGE_HOST_RUSTC_TARGET_ARCH_SUPPORTS
	select LINGMO_PACKAGE_HOST_RUSTC
	help
	  ripgrep is a line-oriented search tool that
	  recursively searches your current directory
	  for a regex pattern while respecting your gitignore
	  rules.

	  ripgrep is similar to other popular search tools like
	  The Silver Searcher, ack and grep.

	  https://github.com/BurntSushi/ripgrep
```

## package/rockchip-mali/Config.in
```kconfig
config LINGMO_PACKAGE_ROCKCHIP_MALI
	bool "rockchip-mali"
	depends on LINGMO_INSTALL_LIBSTDCPP
	depends on LINGMO_TOOLCHAIN_USES_GLIBC
	depends on LINGMO_ARM_EABIHF || LINGMO_aarch64
	# lidbrm. This would normally need a Config.in comment, but
	# these blobs are linked against glibc, so we are sure to have
	# thread support, so don't bother.
	depends on LINGMO_TOOLCHAIN_HAS_THREADS
	select LINGMO_PACKAGE_HAS_LIBEGL
	select LINGMO_PACKAGE_HAS_LIBGLES
	select LINGMO_PACKAGE_HAS_LIBGBM
	select LINGMO_PACKAGE_LIBGBM_HAS_FEATURE_DMA_BUF
	select LINGMO_PACKAGE_LIBDRM
	select LINGMO_PACKAGE_MALI_DRIVER if LINGMO_LINUX_KERNEL
	help
	  Install the binary user-space libraries for the ARM Mali GPU
	  suitable for Rockchip platforms. This package requires a
	  kernel with the ARM Mali GPU kernel driver enabled, as found
	  in the 'mali-driver' package.

if LINGMO_PACKAGE_ROCKCHIP_MALI

config LINGMO_PACKAGE_PROVIDES_LIBEGL
	default "rockchip-mali"

config LINGMO_PACKAGE_PROVIDES_LIBGLES
	default "rockchip-mali"

config LINGMO_PACKAGE_PROVIDES_LIBGBM
	default "rockchip-mali"

endif

comment "rockchip-mali needs a glibc toolchain w/ C++, threads"
	depends on LINGMO_ARM_EABIHF || LINGMO_aarch64
	depends on !LINGMO_INSTALL_LIBSTDCPP || \
		!LINGMO_TOOLCHAIN_USES_GLIBC || !LINGMO_TOOLCHAIN_HAS_THREADS
```

## package/rockchip-rkbin/Config.in
```kconfig
config LINGMO_PACKAGE_ROCKCHIP_RKBIN
	bool "rockchip-rkbin"
	depends on LINGMO_arm || LINGMO_aarch64
	help
	  This package provides Rockchip SoC binary blobs for U-Boot.

if LINGMO_PACKAGE_ROCKCHIP_RKBIN

config LINGMO_PACKAGE_ROCKCHIP_RKBIN_TPL_FILENAME
	string "Rockchip rkbin tpl file path"
	help
	  Path to the tpl file inside the rkbin repository. The
	  specified file will be copied and used by U-Boot as tpl.

config LINGMO_PACKAGE_ROCKCHIP_RKBIN_BL31_FILENAME
	string "Rockchip rkbin bl31 file path"
	help
	  Path to the bl31 file inside the rkbin repository. The
	  specified file will be copied and used by U-Boot as bl31.

config LINGMO_PACKAGE_ROCKCHIP_RKBIN_TEE_FILENAME
	string "Rockchip rkbin tee file path"
	help
	  Path to the TEE file inside the rkbin repository. The
	  specified file will be copied and used by U-Boot as TEE.

endif # LINGMO_PACKAGE_ROCKCHIP_RKBIN
```

## package/rocksdb/Config.in
```kconfig
config LINGMO_PACKAGE_ROCKSDB_ARCH_SUPPORTS
	bool
	# see utilities/transactions/lock/range/range_tree/lib/portability/toku_time.h
	default y if LINGMO_aarch64 || LINGMO_aarch64_be
	default y if LINGMO_i386 || LINGMO_x86_64
	default y if LINGMO_powerpc64 || LINGMO_powerpc64le

config LINGMO_PACKAGE_ROCKSDB
	bool "rocksdb"
	depends on LINGMO_PACKAGE_ROCKSDB_ARCH_SUPPORTS
	depends on LINGMO_INSTALL_LIBSTDCPP
	depends on LINGMO_TOOLCHAIN_GCC_AT_LEAST_4_8 # C++11
	depends on LINGMO_TOOLCHAIN_HAS_THREADS
	depends on LINGMO_USE_WCHAR
	depends on !LINGMO_TOOLCHAIN_HAS_GCC_BUG_64735 # std::future
	help
	  The RocksDB library provides a persistent key value store.
	  Keys and values are arbitrary byte arrays. The keys are
	  ordered within the key value store according to a
	  user-specified comparator function.

	  The library is maintained by the Facebook Database Engineering
	  Team, and is based on LevelDB, by Sanjay Ghemawat and Jeff
	  Dean at Google.

	  http://rocksdb.org

comment "rocksdb needs a toolchain w/ C++, threads, wchar, gcc >= 4.8"
	depends on LINGMO_PACKAGE_ROCKSDB_ARCH_SUPPORTS
	depends on !LINGMO_INSTALL_LIBSTDCPP || \
		!LINGMO_TOOLCHAIN_HAS_THREADS || !LINGMO_USE_WCHAR || \
		!LINGMO_TOOLCHAIN_GCC_AT_LEAST_4_8

comment "rocksdb needs a toolchain not affected by GCC bug 64735"
	depends on LINGMO_PACKAGE_ROCKSDB_ARCH_SUPPORTS
	depends on LINGMO_TOOLCHAIN_HAS_GCC_BUG_64735
```

## package/rpcbind/Config.in
```kconfig
config LINGMO_PACKAGE_RPCBIND
	bool "rpcbind"
	# We really need libtirpc and can't work with the native RPC
	# implementation of toolchains.
	depends on LINGMO_TOOLCHAIN_HAS_THREADS # libtirpc
	depends on LINGMO_USE_MMU 	# fork()
	select LINGMO_PACKAGE_LIBTIRPC
	help
	  The rpcbind utility is a server that converts RPC program
	  numbers into universal addresses.

	  https://sourceforge.net/projects/rpcbind/

comment "rpcbind needs a toolchain w/ threads"
	depends on !LINGMO_TOOLCHAIN_HAS_THREADS
	depends on LINGMO_USE_MMU
```

## package/rpi-firmware/Config.in
```kconfig
config LINGMO_PACKAGE_RPI_FIRMWARE
	bool "rpi-firmware"
	depends on LINGMO_arm || LINGMO_aarch64
	help
	  RaspberryPi Firmware

	  Pre-compiled binaries of the current bootloader and GPU
	  firmware

	  https://github.com/raspberrypi/firmware

if LINGMO_PACKAGE_RPI_FIRMWARE

config LINGMO_PACKAGE_RPI_FIRMWARE_BOOTCODE_BIN
	bool "rpi 0/1/2/3 bootcode.bin"
	help
	  The bootcode.bin for versions Zero/1/2/3 (not needed on rpi4,
	  because it has been replaced by boot code in the onboard
	  EEPROM).

config LINGMO_PACKAGE_RPI_FIRMWARE_VARIANT_PI
	bool "rpi 0/1/2/3 (default)"
	help
	  The default set of files for versions Zero/1/2/3.

config LINGMO_PACKAGE_RPI_FIRMWARE_VARIANT_PI_X
	bool "rpi 0/1/2/3 (extended)"
	help
	  The extended set of files for versions Zero/1/2/3 (additional
	  GPU features, eg. more audio/video codecs).

config LINGMO_PACKAGE_RPI_FIRMWARE_VARIANT_PI_CD
	bool "rpi 0/1/2/3 (cut-down)"
	help
	  The cut-down set of files for versions Zero/1/2/3 (only
	  features required to boot a Linux kernel).

config LINGMO_PACKAGE_RPI_FIRMWARE_VARIANT_PI_DB
	bool "rpi 0/1/2/3 (debug)"
	help
	  The debug set of files for versions Zero/1/2/3.

config LINGMO_PACKAGE_RPI_FIRMWARE_VARIANT_PI4
	bool "rpi 4 (default)"
	help
	  The default set of files for versions 4 (standard GPU
	  features).

config LINGMO_PACKAGE_RPI_FIRMWARE_VARIANT_PI4_X
	bool "rpi 4 (extended)"
	help
	  The extended set of files for versions 4 (additional GPU
	  features, eg. more audio/video codecs).

config LINGMO_PACKAGE_RPI_FIRMWARE_VARIANT_PI4_CD
	bool "rpi 4 (cut-down)"
	help
	  The cut-down set of files for versions 4 (only features
	  required to boot a Linux kernel).

config LINGMO_PACKAGE_RPI_FIRMWARE_VARIANT_PI4_DB
	bool "rpi 4 (debug)"
	help
	  The debug set of files for versions 4.

config LINGMO_PACKAGE_RPI_FIRMWARE_CONFIG_FILE
	string "Path to a file stored as boot/config.txt"
	help
	  Path to a file stored as config.txt in the boot partiton
	  of the generated SD card image.

config LINGMO_PACKAGE_RPI_FIRMWARE_CMDLINE_FILE
	string "Path to a file stored as boot/cmdline.txt"
	default "board/raspberrypi/cmdline.txt"  # legacy
	help
	  Path to a file stored as cmdline.txt in the boot partiton
	  of the generated SD card image.

config LINGMO_PACKAGE_RPI_FIRMWARE_INSTALL_DTBS
	bool "Install Device Tree Blobs (DTBs)"
	default y
	depends on !LINGMO_LINUX_KERNEL_DTS_SUPPORT
	help
	  If you are using a Linux kernel <= 3.18, you should say 'y'
	  here.

	  If you are using a Linux kernel >= 3.19, you should say 'n'
	  here, and enable LINGMO_LINUX_KERNEL_DTS_SUPPORT to let the
	  kernel build the DTB.

config LINGMO_PACKAGE_RPI_FIRMWARE_INSTALL_DTB_OVERLAYS
	bool "Install DTB overlays"
	default y
	depends on LINGMO_PACKAGE_RPI_FIRMWARE_INSTALL_DTBS \
		|| LINGMO_LINUX_KERNEL_DTS_SUPPORT
	select LINGMO_LINUX_KERNEL_DTB_OVERLAY_SUPPORT \
		if LINGMO_LINUX_KERNEL_DTS_SUPPORT
	help
	  Say 'y' here if you need to load one or more of the DTB
	  overlays, to support HATs (Hardware Attached on Top, add-on
	  modules).

config LINGMO_PACKAGE_RPI_FIRMWARE_INSTALL_VCDBG
	bool "vcdbg"
	depends on LINGMO_arm # prebuilt arm binary, rpi-userland
	depends on LINGMO_TOOLCHAIN_USES_GLIBC
	depends on LINGMO_INSTALL_LIBSTDCPP # rpi-userland
	help
	  Install vcdbg, to help debug communication with the GPU.

comment "vcdbg needs a glibc toolchain w/ C++"
	depends on LINGMO_arm
	depends on !LINGMO_TOOLCHAIN_USES_GLIBC || !LINGMO_INSTALL_LIBSTDCPP

endif # LINGMO_PACKAGE_RPI_FIRMWARE
```

## package/rpi-rgb-led-matrix/Config.in
```kconfig
config LINGMO_PACKAGE_RPI_RGB_LED_MATRIX
	bool "rpi-rgb-led-matrix"
	depends on LINGMO_aarch64 || LINGMO_arm
	depends on LINGMO_INSTALL_LIBSTDCPP
	depends on LINGMO_TOOLCHAIN_HAS_THREADS
	depends on !LINGMO_STATIC_LIBS
	help
	  A library to control commonly available 64x64, 32x32 or 16x32
	  RGB LED panels with the Raspberry Pi. Can support PWM up to
	  11Bit per channel, providing true 24bpp color with CIE1931
	  profile.

	  https://github.com/hzeller/rpi-rgb-led-matrix

if LINGMO_PACKAGE_RPI_RGB_LED_MATRIX

config LINGMO_PACKAGE_RPI_RGB_LED_MATRIX_IMAGE_VIEWER
	bool "Build led-image-viewer"
	select LINGMO_PACKAGE_GRAPHICSMAGICK
	help
	  The image viewer reads all kinds of image formats,
	  including animated gifs.

config LINGMO_PACKAGE_RPI_RGB_LED_MATRIX_TEXT_SCROLLER
	bool "Build text-scroller"
	help
	  The text scroller allows to show some scrolling text.

config LINGMO_PACKAGE_RPI_RGB_LED_MATRIX_VIDEO_VIEWER
	bool "Build video-viewer"
	select LINGMO_PACKAGE_FFMPEG
	select LINGMO_PACKAGE_FFMPEG_SWSCALE
	help
	  The video viewer allows to play common video formats
	  on the RGB matrix (just the picture, no sound).

endif

comment "rpi-rgb-led-matrix needs a toolchain w/ C++, threads, dynamic library"
	depends on LINGMO_aarch64 || LINGMO_arm
	depends on !LINGMO_INSTALL_LIBSTDCPP || \
		!LINGMO_TOOLCHAIN_HAS_THREADS || \
		LINGMO_STATIC_LIBS
```

## package/rpi-userland/Config.in
```kconfig
config LINGMO_PACKAGE_RPI_USERLAND
	bool "rpi-userland"
	depends on LINGMO_arm || LINGMO_aarch64
	depends on LINGMO_INSTALL_LIBSTDCPP
	depends on LINGMO_TOOLCHAIN_HAS_THREADS
	depends on !LINGMO_STATIC_LIBS
	select LINGMO_PACKAGE_HAS_LIBEGL if LINGMO_arm
	select LINGMO_PACKAGE_HAS_LIBGLES if LINGMO_arm
	select LINGMO_PACKAGE_HAS_LIBOPENVG if LINGMO_arm
	select LINGMO_PACKAGE_HAS_LIBOPENMAX if LINGMO_arm
	help
	  Raspberry Pi Userland contains the necessary library to use
	  the VideoCore driver.

	  Includes source for the ARM side code to interface to: EGL,
	  mmal, GLESv2, vcos, openmaxil, vchiq_arm, bcm_host, WFC,
	  OpenVG.

	  https://github.com/raspberrypi/userland/

if LINGMO_PACKAGE_RPI_USERLAND && LINGMO_arm

config LINGMO_PACKAGE_PROVIDES_LIBEGL
	default "rpi-userland"

config LINGMO_PACKAGE_PROVIDES_LIBGLES
	default "rpi-userland"

config LINGMO_PACKAGE_PROVIDES_LIBOPENVG
	default "rpi-userland"

config LINGMO_PACKAGE_PROVIDES_LIBOPENMAX
	default "rpi-userland"

config LINGMO_PACKAGE_RPI_USERLAND_HELLO
	bool "hello_pi examples"
	help
	  Install the hello-pi examples to test the HW (GPU, camera...)

endif

comment "rpi-userland needs a toolchain w/ C++, threads, dynamic library"
	depends on LINGMO_arm || LINGMO_aarch64
	depends on !LINGMO_INSTALL_LIBSTDCPP || !LINGMO_TOOLCHAIN_HAS_THREADS || \
		LINGMO_STATIC_LIBS
```
