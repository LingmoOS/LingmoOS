## package/ortp/Config.in
```kconfig
config LINGMO_PACKAGE_ORTP
	bool "oRTP"
	depends on LINGMO_INSTALL_LIBSTDCPP
	depends on LINGMO_TOOLCHAIN_HAS_THREADS
	depends on !LINGMO_TOOLCHAIN_HAS_GCC_BUG_64735 # bctoolbox
	select LINGMO_PACKAGE_BCTOOLBOX
	help
	  oRTP, a Real-time Transport Protocol (RTP,RFC3550) library

	  https://www.linphone.org/technical-corner/ortp

comment "ortp needs a toolchain w/ C++, threads"
	depends on !LINGMO_INSTALL_LIBSTDCPP || !LINGMO_TOOLCHAIN_HAS_THREADS

comment "ortp needs a toolchain not affected by GCC bug 64735"
	depends on LINGMO_TOOLCHAIN_HAS_GCC_BUG_64735
```

## package/osm2pgsql/Config.in
```kconfig
config LINGMO_PACKAGE_OSM2PGSQL
	bool "osm2pgsql"
	depends on LINGMO_ARCH_IS_64
	depends on LINGMO_INSTALL_LIBSTDCPP # boost, libosmium, protozero
	depends on LINGMO_TOOLCHAIN_GCC_AT_LEAST_4_9 # C++14
	depends on LINGMO_TOOLCHAIN_HAS_THREADS # boost, libosmium
	depends on LINGMO_TOOLCHAIN_SUPPORTS_ALWAYS_LOCKFREE_ATOMIC_INTS # boost-filesystem
	depends on LINGMO_USE_WCHAR # boost, libosmium
	depends on !LINGMO_TOOLCHAIN_HAS_GCC_BUG_64735 # std::future
	select LINGMO_PACKAGE_BOOST
	select LINGMO_PACKAGE_BOOST_SYSTEM
	select LINGMO_PACKAGE_BOOST_FILESYSTEM
	select LINGMO_PACKAGE_BZIP2
	select LINGMO_PACKAGE_EXPAT
	select LINGMO_PACKAGE_JSON_FOR_MODERN_CPP
	select LINGMO_PACKAGE_LIBOSMIUM
	select LINGMO_PACKAGE_PROTOZERO
	select LINGMO_PACKAGE_ZLIB
	help
	  osm2pgsql is a tool for loading OpenStreetMap data into a
	  PostgreSQL / PostGIS database suitable for applications like
	  rendering into a map, geocoding with Nominatim,
	  or general analysis.

	  https://osm2pgsql.org

comment "osm2pgsql needs a toolchain w/ C++, wchar, threads, gcc >= 4.9"
	depends on LINGMO_ARCH_IS_64
	depends on LINGMO_TOOLCHAIN_SUPPORTS_ALWAYS_LOCKFREE_ATOMIC_INTS
	depends on !LINGMO_INSTALL_LIBSTDCPP || !LINGMO_USE_WCHAR || \
		!LINGMO_TOOLCHAIN_GCC_AT_LEAST_4_9 || !LINGMO_TOOLCHAIN_HAS_THREADS

comment "osm2pgsql needs a toolchain not affected by GCC bug 64735"
	depends on LINGMO_ARCH_IS_64
	depends on LINGMO_TOOLCHAIN_HAS_GCC_BUG_64735
```

## package/owl-linux/Config.in
```kconfig
config LINGMO_PACKAGE_OWL_LINUX
	bool "owl-linux"
	depends on LINGMO_LINUX_KERNEL
	depends on (LINGMO_arm920t || LINGMO_arm922t || LINGMO_arm926t)
	help
	  Linux kernel driver for the H&D Wireless SPB104 SD-card WiFi
	  SIP.

	  owl-linux requires the hidden kernel option WIRELESS_EXT
	  enabled.

	  http://linux.hd-wireless.se/bin/view/Linux/GettingStarted

comment "owl-linux needs a Linux kernel to be built"
	depends on !LINGMO_LINUX_KERNEL
	depends on LINGMO_arm || LINGMO_armeb

comment "owl-linux is only supported on ARM9 architecture"
	depends on !(LINGMO_arm920t || LINGMO_arm922t || LINGMO_arm926t)
	depends on LINGMO_arm || LINGMO_armeb
```

## package/p11-kit/Config.in
```kconfig
config LINGMO_PACKAGE_P11_KIT
	bool "p11-kit"
	depends on !LINGMO_STATIC_LIBS
	depends on LINGMO_USE_MMU
	depends on LINGMO_TOOLCHAIN_HAS_THREADS
	help
	  Provides a way to load and enumerate PKCS#11 modules.
	  Provides a standard configuration setup for installing PKCS#11
	  modules in such a way that they're discoverable.

	  http://p11-glue.freedesktop.org/p11-kit.html

comment "p11-kit needs a toolchain w/ threads, dynamic library"
	depends on LINGMO_USE_MMU
	depends on !LINGMO_TOOLCHAIN_HAS_THREADS || LINGMO_STATIC_LIBS
```

## package/p7zip/Config.in
```kconfig
config LINGMO_PACKAGE_P7ZIP
	bool "p7zip"
	depends on LINGMO_TOOLCHAIN_HAS_SYNC_4 # __sync_*_4 intrisics
	depends on LINGMO_INSTALL_LIBSTDCPP
	depends on LINGMO_TOOLCHAIN_HAS_THREADS
	depends on LINGMO_USE_WCHAR
	help
	  p7zip is a quick port of the command line version of 7-zip
	  for Unix (see http://www.7-zip.org)

	  7-Zip is a file archiver with highest compression ratio.

	  http://sourceforge.net/projects/p7zip

if LINGMO_PACKAGE_P7ZIP

choice
	prompt "p7zip binary"
	default LINGMO_PACKAGE_P7ZIP_7ZR

config LINGMO_PACKAGE_P7ZIP_7ZA
	bool "7za"
	help
	  Full 7za archiver. The program supports 7z, ZIP, CAB, ARJ,
	  GZIP, BZIP2, TAR, CPIO, RPM and DEB formats

config LINGMO_PACKAGE_P7ZIP_7ZR
	bool "7zr"
	help
	  Lightweight 7zr archiver. The program only handles 7z archives
	  and cannot handle encrypted archives

endchoice

endif

comment "p7zip needs a toolchain w/ threads, wchar, C++"
	depends on LINGMO_TOOLCHAIN_HAS_SYNC_4
	depends on !LINGMO_TOOLCHAIN_HAS_THREADS || !LINGMO_USE_WCHAR || !LINGMO_INSTALL_LIBSTDCPP
```

## package/paho-mqtt-c/Config.in
```kconfig
config LINGMO_PACKAGE_PAHO_MQTT_C
	bool "paho-mqtt-c"
	depends on LINGMO_TOOLCHAIN_HAS_THREADS
	help
	  MQTT client C library

	  https://eclipse.org/paho/clients/c/

comment "paho-mqtt-c needs a toolchain w/ threads"
	depends on !LINGMO_TOOLCHAIN_HAS_THREADS
```

## package/paho-mqtt-cpp/Config.in
```kconfig
config LINGMO_PACKAGE_PAHO_MQTT_CPP
	bool "paho-mqtt-cpp"
	depends on LINGMO_TOOLCHAIN_HAS_THREADS
	depends on !LINGMO_TOOLCHAIN_HAS_GCC_BUG_64735 # std::future
	depends on LINGMO_INSTALL_LIBSTDCPP
	select LINGMO_PACKAGE_PAHO_MQTT_C
	help
	  MQTT client C++ library

	  https://eclipse.org/paho/clients/cpp/

comment "paho-mqtt-cpp needs a toolchain w/ threads, C++"
	depends on !LINGMO_TOOLCHAIN_HAS_THREADS || !LINGMO_INSTALL_LIBSTDCPP
	depends on !LINGMO_TOOLCHAIN_HAS_GCC_BUG_64735

comment "paho-mqtt-cpp needs a toolchain not affected by GCC bug 64735"
	depends on LINGMO_TOOLCHAIN_HAS_GCC_BUG_64735
```

## package/pango/Config.in
```kconfig
config LINGMO_PACKAGE_PANGO
	bool "pango"
	depends on LINGMO_USE_WCHAR # glib2
	depends on LINGMO_TOOLCHAIN_HAS_THREADS # glib2
	depends on LINGMO_USE_MMU # glib2
	depends on LINGMO_INSTALL_LIBSTDCPP # freetype support
	depends on LINGMO_TOOLCHAIN_HAS_SYNC_4 # harfbuzz
	depends on LINGMO_TOOLCHAIN_GCC_AT_LEAST_4_9 # harfbuzz
	select LINGMO_PACKAGE_LIBGLIB2
	select LINGMO_PACKAGE_LIBFRIBIDI
	select LINGMO_PACKAGE_EXPAT
	select LINGMO_PACKAGE_CAIRO
	select LINGMO_PACKAGE_FONTCONFIG
	select LINGMO_PACKAGE_FREETYPE
	select LINGMO_PACKAGE_HARFBUZZ
	select LINGMO_PACKAGE_XLIB_LIBX11 if LINGMO_PACKAGE_XORG7
	help
	  Pango is a library for laying out and rendering of text,
	  with an emphasis on internationalization. Pango can be used
	  anywhere that text layout is needed, though most of the work
	  on Pango so far has been done in the context of the GTK+
	  widget toolkit. Pango forms the core of text and font
	  handling for GTK+-2.x.

	  https://pango.gnome.org/

comment "pango needs a toolchain w/ wchar, threads, C++, gcc >= 4.9"
	depends on LINGMO_USE_MMU
	depends on LINGMO_TOOLCHAIN_HAS_SYNC_4
	depends on !LINGMO_USE_WCHAR || !LINGMO_TOOLCHAIN_HAS_THREADS || \
		!LINGMO_TOOLCHAIN_GCC_AT_LEAST_4_9 || \
		!LINGMO_INSTALL_LIBSTDCPP
```

## package/pangomm/Config.in
```kconfig
config LINGMO_PACKAGE_PANGOMM
	bool "pangomm (latest)"
	depends on LINGMO_TOOLCHAIN_HAS_SYNC_4 # pango -> harfbuzz
	depends on LINGMO_INSTALL_LIBSTDCPP # glibmm/pango
	depends on LINGMO_TOOLCHAIN_GCC_AT_LEAST_7 # libsigc
	depends on LINGMO_TOOLCHAIN_HAS_THREADS # *mm/pango -> libglib2
	depends on LINGMO_USE_MMU # *mm/pango -> libglib2
	depends on LINGMO_USE_WCHAR # *mm/pango -> libglib2
	select LINGMO_PACKAGE_CAIROMM
	select LINGMO_PACKAGE_GLIBMM
	select LINGMO_PACKAGE_PANGO
	select LINGMO_PACKAGE_LIBSIGC
	help
	  The pangomm package is a set of C++ bindings for Pango.

	  http://www.gtkmm.org/

comment "pangomm needs a toolchain w/ C++, wchar, threads, gcc >= 7"
	depends on LINGMO_USE_MMU
	depends on LINGMO_TOOLCHAIN_HAS_SYNC_4
	depends on !LINGMO_TOOLCHAIN_GCC_AT_LEAST_7 || !LINGMO_USE_WCHAR \
		|| !LINGMO_INSTALL_LIBSTDCPP || !LINGMO_TOOLCHAIN_HAS_THREADS
```

## package/pangomm2_46/Config.in
```kconfig
config LINGMO_PACKAGE_PANGOMM2_46
	bool "pangomm (2.46.x)"
	depends on LINGMO_TOOLCHAIN_HAS_SYNC_4 # pango -> harfbuzz
	depends on LINGMO_INSTALL_LIBSTDCPP # glibmm/pango
	depends on LINGMO_TOOLCHAIN_GCC_AT_LEAST_4_9 # C++11
	depends on LINGMO_TOOLCHAIN_HAS_THREADS # *mm/pango -> libglib2
	depends on LINGMO_USE_MMU # *mm/pango -> libglib2
	depends on LINGMO_USE_WCHAR # *mm/pango -> libglib2
	select LINGMO_PACKAGE_CAIROMM1_14
	select LINGMO_PACKAGE_GLIBMM2_66
	select LINGMO_PACKAGE_PANGO
	select LINGMO_PACKAGE_LIBSIGC2
	help
	  The pangomm package is a set of C++ bindings for Pango.

	  This is the last version before the API and ABI change
	  introduced in 2.48.0 which requires C++17.

	  http://www.gtkmm.org/

comment "pangomm (2.46.x) needs a toolchain w/ C++, wchar, threads, gcc >= 4.9"
	depends on LINGMO_USE_MMU
	depends on LINGMO_TOOLCHAIN_HAS_SYNC_4
	depends on !LINGMO_TOOLCHAIN_GCC_AT_LEAST_4_9 || !LINGMO_USE_WCHAR \
		|| !LINGMO_INSTALL_LIBSTDCPP || !LINGMO_TOOLCHAIN_HAS_THREADS
```

## package/parprouted/Config.in
```kconfig
config LINGMO_PACKAGE_PARPROUTED
	bool "parprouted"
	depends on LINGMO_USE_MMU # fork()
	depends on LINGMO_TOOLCHAIN_HAS_THREADS
	help
	  parprouted is a daemon for transparent IP (Layer 3) proxy ARP
	  bridging. This is useful for creation of transparent firewalls
	  and bridging networks with different MAC protocols. Also,
	  unlike standard bridging, proxy ARP bridging allows to bridge
	  Ethernet networks behind wireless nodes without using WDS or
	  layer 2 bridging.

	  https://www.hazard.maks.net/parprouted

comment "parprouted needs a toolchain w/ threads"
	depends on LINGMO_USE_MMU
	depends on !LINGMO_TOOLCHAIN_HAS_THREADS
```

## package/parted/Config.in
```kconfig
config LINGMO_PACKAGE_PARTED
	bool "parted"
	depends on LINGMO_ENABLE_LOCALE
	depends on LINGMO_USE_WCHAR
	depends on LINGMO_TOOLCHAIN_GCC_AT_LEAST_5
	select LINGMO_PACKAGE_UTIL_LINUX
	select LINGMO_PACKAGE_UTIL_LINUX_LIBUUID
	help
	  parted, the GNU partition resizing program

	  http://www.gnu.org/software/parted/

comment "parted needs a toolchain w/ locale, wchar, gcc >=5"
	depends on !LINGMO_ENABLE_LOCALE || !LINGMO_USE_WCHAR || \
		!LINGMO_TOOLCHAIN_GCC_AT_LEAST_5
```

## package/patch/Config.in
```kconfig
config LINGMO_PACKAGE_PATCH
	bool "patch"
	depends on LINGMO_USE_MMU # fork()
	depends on LINGMO_USE_WCHAR
	depends on LINGMO_PACKAGE_BUSYBOX_SHOW_OTHERS
	help
	  Take patch files (containing difference listings) and apply
	  them to original files, producing patched versions.

	  http://www.gnu.org/software/patch/

comment "patch needs a toolchain w/ wchar"
	depends on !LINGMO_USE_WCHAR
	depends on LINGMO_USE_MMU
	depends on LINGMO_PACKAGE_BUSYBOX_SHOW_OTHERS
```

## package/pax-utils/Config.in
```kconfig
config LINGMO_PACKAGE_PAX_UTILS
	bool "pax-utils"
	depends on LINGMO_USE_WCHAR
	help
	  ELF related utils for ELF 32/64 binaries that can check files
	  for security relevant properties.

	  http://www.gentoo.org/proj/en/hardened/pax-utils.xml

comment "pax-utils needs a toolchain w/ wchar"
	depends on !LINGMO_USE_WCHAR
```

## package/paxtest/Config.in
```kconfig
config LINGMO_PACKAGE_PAXTEST
	bool "paxtest"
	depends on !LINGMO_microblaze
	# No UCLIBC or MUSL because __NO_A_OUT_SUPPORT
	depends on LINGMO_TOOLCHAIN_USES_GLIBC
	help
	  PaX regression test suite

	  http://pax.grsecurity.net/docs

comment "paxtest needs a glibc toolchain"
	depends on !LINGMO_microblaze
	depends on !LINGMO_TOOLCHAIN_USES_GLIBC
```

## package/pcm-tools/Config.in
```kconfig
comment "pcm-tools needs a toolchain w/ C++, NPTL"
	depends on LINGMO_i386 || LINGMO_x86_64
	depends on !LINGMO_INSTALL_LIBSTDCPP || \
		!LINGMO_TOOLCHAIN_HAS_THREADS_NPTL

config LINGMO_PACKAGE_PCM_TOOLS
	bool "pcm-tools"
	depends on LINGMO_i386 || LINGMO_x86_64
	depends on LINGMO_INSTALL_LIBSTDCPP
	depends on LINGMO_TOOLCHAIN_HAS_THREADS_NPTL
	select LINGMO_PACKAGE_HWDATA
	select LINGMO_PACKAGE_HWDATA_PCI_IDS
	help
	  Processor Counter Monitor (PCM) is an application programming
	  interface (API) and a set of tools based on the API to monitor
	  performance and energy metrics of Intel(R) Core(TM), Xeon(R),
	  Atom(TM) and Xeon Phi(TM) processors.

	  https://github.com/opcm/pcm

if LINGMO_PACKAGE_PCM_TOOLS

config LINGMO_PACKAGE_PCM_TOOLS_PMU_QUERY
	bool "install the pmu-query script"
	default y
	depends on LINGMO_PACKAGE_PYTHON3
	select LINGMO_PACKAGE_CA_CERTIFICATES # https
	select LINGMO_PACKAGE_PYTHON3_SSL # urllib2

comment "pmu-query needs Python3"
	depends on !LINGMO_PACKAGE_PYTHON3

endif
```

## package/pcmanfm/Config.in
```kconfig
config LINGMO_PACKAGE_PCMANFM
	bool "pcmanfm"
	depends on LINGMO_PACKAGE_XORG7
	depends on LINGMO_USE_WCHAR # libglib2
	depends on LINGMO_TOOLCHAIN_HAS_THREADS # libglib2
	depends on LINGMO_USE_MMU # libglib2
	depends on LINGMO_INSTALL_LIBSTDCPP # libgtk2
	depends on LINGMO_TOOLCHAIN_HAS_SYNC_4 # libgtk2 -> pango -> harfbuzz
	depends on LINGMO_TOOLCHAIN_GCC_AT_LEAST_4_9 # libgtk2 -> pango -> harfbuzz
	select LINGMO_PACKAGE_LIBFM
	select LINGMO_PACKAGE_MENU_CACHE
	select LINGMO_PACKAGE_LIBGLIB2
	select LINGMO_PACKAGE_LIBGTK2 if !LINGMO_PACKAGE_LIBGTK3_X11
	help
	  PCMan File Manager (PCManFM) is a file manager application
	  developed by Hong Jen Yee from Taiwan which is meant to be a
	  replacement for Nautilus, Konqueror and Thunar.

	  http://wiki.lxde.org/en/PCManFM

comment "pcmanfm needs a toolchain w/ wchar, threads, C++, gcc >= 4.9"
	depends on LINGMO_USE_MMU
	depends on LINGMO_PACKAGE_XORG7
	depends on LINGMO_TOOLCHAIN_HAS_SYNC_4
	depends on !LINGMO_USE_WCHAR || !LINGMO_INSTALL_LIBSTDCPP || \
		!LINGMO_TOOLCHAIN_GCC_AT_LEAST_4_9 || \
		!LINGMO_TOOLCHAIN_HAS_THREADS
```

## package/pcre2/Config.in
```kconfig
config LINGMO_PACKAGE_PCRE2
	bool "pcre2"
	help
	  Perl Compatible Regular Expressions. By default, only the
	  8-bits libpcre2 is built. To get the 16-bits and/or 32-bits
	  variants libpcre2-16/libpcre2-32, use the package
	  sub-options.

	  http://www.pcre.org/

if LINGMO_PACKAGE_PCRE2

config LINGMO_PACKAGE_PCRE2_16
	bool "16-bit pcre2"
	help
	  This option builds the 16-bits pcre2 library, i.e
	  'libpcre2-16'

config LINGMO_PACKAGE_PCRE2_32
	bool "32-bit pcre2"
	help
	  This option builds the 32-bits pcre2 library, i.e
	  'libpcre2-32'

config LINGMO_PACKAGE_PCRE2_JIT_ARCH_SUPPORTS
	bool
	default y if LINGMO_aarch64
	default y if LINGMO_arm || LINGMO_armeb
	default y if LINGMO_i386 || LINGMO_x86_64
	default y if LINGMO_mips || LINGMO_mipsel || LINGMO_mips64 || LINGMO_mips64el
	default y if LINGMO_powerpc

config LINGMO_PACKAGE_PCRE2_JIT
	bool "enable JIT support"
	depends on LINGMO_PACKAGE_PCRE2_JIT_ARCH_SUPPORTS
	depends on LINGMO_TOOLCHAIN_HAS_THREADS
	help
	  This option enables JIT support

comment "JIT support needs a toolchain w/ threads"
	depends on LINGMO_PACKAGE_PCRE2_JIT_ARCH_SUPPORTS
	depends on !LINGMO_TOOLCHAIN_HAS_THREADS

endif
```

## package/pcsc-lite/Config.in
```kconfig
config LINGMO_PACKAGE_PCSC_LITE
	bool "pcsc-lite"
	depends on LINGMO_TOOLCHAIN_HAS_THREADS
	depends on LINGMO_USE_MMU # fork()
	depends on !LINGMO_STATIC_LIBS
	depends on LINGMO_TOOLCHAIN_GCC_AT_LEAST_4_9 # _Atomic keyword
	help
	  Middleware to access smart card using SCard API (PC/SC).

	  https://muscle.apdu.fr/

if LINGMO_PACKAGE_PCSC_LITE

config LINGMO_PACKAGE_PCSC_LITE_FORCE_LIBUSB
	bool "use libusb"
	depends on !LINGMO_PACKAGE_HAS_UDEV
	depends on LINGMO_TOOLCHAIN_GCC_AT_LEAST_4_9 # libusb
	select LINGMO_PACKAGE_LIBUSB
	help
	  Select Y if you want to support usb smart card readers.

comment "libusb support needs a toolchain w/ gcc >= 4.9"
	depends on !LINGMO_TOOLCHAIN_GCC_AT_LEAST_4_9

config LINGMO_PACKAGE_PCSC_LITE_DEBUGATR
	bool "enable ATR debug messages"
	help
	  Enable ATR debug messages from pcscd.

config LINGMO_PACKAGE_PCSC_LITE_EMBEDDED
	bool "enable embedded mode"
	help
	  Limit RAM and CPU resources by disabling logs.

endif

comment "pcsc-lite needs a toolchain w/ threads, dynamic library, gcc >= 4.9"
	depends on LINGMO_USE_MMU
	depends on !LINGMO_TOOLCHAIN_HAS_THREADS || LINGMO_STATIC_LIBS || \
		!LINGMO_TOOLCHAIN_GCC_AT_LEAST_4_9
```
