## package/perftest/Config.in
```kconfig
config LINGMO_PACKAGE_PERFTEST_ARCH_SUPPORTS
	bool
	# Accurate cycle measurement in perftest is implemented for a
	# limited set of architectures, see:
	# https://github.com/linux-rdma/perftest/blob/v4.5-0.20/src/get_clock.h
	# Note: the package has also a fallback to use "asm/timex.h"
	# from the Kernel, in
	# "$(LINUX_DIR)/arch/$(KERNEL_ARCH)/include". It is not
	# reflected here as this path is not well tested.
	default y if LINGMO_i386 || LINGMO_x86_64
	default y if LINGMO_arm && !LINGMO_ARM_CPU_ARMV4 && !LINGMO_ARM_CPU_ARMV5 && !LINGMO_ARM_CPU_ARMV6
	default y if LINGMO_aarch64
	default y if LINGMO_powerpc || LINGMO_powerpc64 || LINGMO_powerpc64le
	default y if LINGMO_s390x
	default y if LINGMO_sparc || LINGMO_sparc64
	default y if LINGMO_riscv
	depends on LINGMO_USE_MMU # rdma-core
	depends on LINGMO_TOOLCHAIN_HAS_SYNC_4 # rdma-core

config LINGMO_PACKAGE_PERFTEST
	bool "perftest"
	depends on LINGMO_PACKAGE_PERFTEST_ARCH_SUPPORTS
	depends on LINGMO_TOOLCHAIN_HEADERS_AT_LEAST_3_4 # rdma-core
	depends on LINGMO_TOOLCHAIN_HAS_THREADS_NPTL # rdma-core
	depends on !LINGMO_STATIC_LIBS # rdma-core
	# musl does not define sysconf(_SC_LEVEL1_DCACHE_LINESIZE)
	depends on !LINGMO_TOOLCHAIN_USES_MUSL
	select LINGMO_PACKAGE_PCIUTILS
	select LINGMO_PACKAGE_RDMA_CORE
	help
	  Open Fabrics Performance Tests.

	  This is a collection of tests written over uverbs intended
	  for use as a performance micro-benchmark. The tests may be
	  used for HW or SW tuning as well as for functional testing.

	  https://github.com/linux-rdma/perftest

comment "perftest needs a glibc or uClibc toolchain w/ threads, dynamic library"
	depends on LINGMO_PACKAGE_PERFTEST_ARCH_SUPPORTS
	depends on !LINGMO_TOOLCHAIN_HAS_THREADS || LINGMO_STATIC_LIBS \
		|| LINGMO_TOOLCHAIN_USES_MUSL
```

## package/perl-apache-logformat-compiler/Config.in
```kconfig
config LINGMO_PACKAGE_PERL_APACHE_LOGFORMAT_COMPILER
	bool "perl-apache-logformat-compiler"
	select LINGMO_PACKAGE_PERL_POSIX_STRFTIME_COMPILER # runtime
	help
	  Compile a log format string to perl-code.

	  https://github.com/kazeburo/Apache-LogFormat-Compiler
```

## package/perl-class-load/Config.in
```kconfig
config LINGMO_PACKAGE_PERL_CLASS_LOAD
	bool "perl-class-load"
	depends on !LINGMO_STATIC_LIBS
	select LINGMO_PACKAGE_PERL_DATA_OPTLIST # runtime
	select LINGMO_PACKAGE_PERL_MODULE_IMPLEMENTATION # runtime
	select LINGMO_PACKAGE_PERL_MODULE_RUNTIME # runtime
	select LINGMO_PACKAGE_PERL_PACKAGE_STASH # runtime
	select LINGMO_PACKAGE_PERL_TRY_TINY # runtime
	help
	  A working (require "Class::Name") and more.

	  https://github.com/moose/Class-Load

comment "perl-class-load needs a toolchain w/ dynamic library"
	depends on LINGMO_STATIC_LIBS
```

## package/perl-clone/Config.in
```kconfig
config LINGMO_PACKAGE_PERL_CLONE
	bool "perl-clone"
	depends on !LINGMO_STATIC_LIBS
	help
	  recursively copy Perl datatypes.

	  https://metacpan.org/release/Clone

comment "perl-clone needs a toolchain w/ dynamic library"
	depends on LINGMO_STATIC_LIBS
```

## package/perl-cookie-baker/Config.in
```kconfig
config LINGMO_PACKAGE_PERL_COOKIE_BAKER
	bool "perl-cookie-baker"
	select LINGMO_PACKAGE_PERL_URI # runtime
	help
	  Cookie string generator / parser.

	  https://github.com/kazeburo/Cookie-Baker
```

## package/perl-crypt-blowfish/Config.in
```kconfig
config LINGMO_PACKAGE_PERL_CRYPT_BLOWFISH
	bool "perl-crypt-blowfish"
	depends on !LINGMO_STATIC_LIBS
	help
	  Perl Blowfish encryption module.

	  https://metacpan.org/release/Crypt-Blowfish

comment "perl-crypt-blowfish needs a toolchain w/ dynamic library"
	depends on LINGMO_STATIC_LIBS
```
