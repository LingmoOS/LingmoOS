## package/sedutil/Config.in
```kconfig
config LINGMO_PACKAGE_SEDUTIL_ARCH_SUPPORTS
	bool
	# no big endian support
	default y if LINGMO_arcle || LINGMO_arm || LINGMO_aarch64 \
	       || LINGMO_i386 || LINGMO_microblazeel || LINGMO_mipsel \
	       || LINGMO_mips64el || LINGMO_nios2 || LINGMO_powerpc64le \
	       || LINGMO_sh4 || LINGMO_sh4a || LINGMO_x86_64 \
	       || LINGMO_XTENSA_LITTLE_ENDIAN

config LINGMO_PACKAGE_SEDUTIL
	bool "sedutil"
	depends on LINGMO_PACKAGE_SEDUTIL_ARCH_SUPPORTS
	depends on LINGMO_TOOLCHAIN_HEADERS_AT_LEAST_3_12 # linux/nvme.h
	depends on LINGMO_TOOLCHAIN_GCC_AT_LEAST_4_8 # C++11
	depends on !LINGMO_TOOLCHAIN_EXTERNAL_CODESOURCERY_MIPS # 4.4.1 headers
	depends on LINGMO_INSTALL_LIBSTDCPP
	help
	  The Drive Trust Alliance Self Encrypting Drive Utility,
	  allowing configuration the SEDs that comply with the
	  TCG OPAL 2.00 standard.

          https://github.com/Drive-Trust-Alliance/sedutil

comment "sedutil needs a toolchain w/ C++, gcc >= 4.8, headers >= 3.12"
	depends on LINGMO_PACKAGE_SEDUTIL_ARCH_SUPPORTS
	depends on !LINGMO_TOOLCHAIN_EXTERNAL_CODESOURCERY_MIPS
	depends on !LINGMO_INSTALL_LIBSTDCPP || \
		!LINGMO_TOOLCHAIN_GCC_AT_LEAST_4_8 || \
		!LINGMO_TOOLCHAIN_HEADERS_AT_LEAST_3_12
```

## package/selinux-python/Config.in
```kconfig
config LINGMO_PACKAGE_SELINUX_PYTHON
	bool "selinux-python"
	depends on LINGMO_USE_MMU
	depends on LINGMO_USE_WCHAR
	depends on LINGMO_TOOLCHAIN_HAS_THREADS
	depends on !LINGMO_STATIC_LIBS
	select LINGMO_PACKAGE_PYTHON3
	help
	  A set of SELinux tools written in python that help with
	  managing a system with SELinux enabled. If no packages are
	  selected nothing will actually be built.

	  https://github.com/SELinuxProject/selinux/wiki

if LINGMO_PACKAGE_SELINUX_PYTHON

config LINGMO_PACKAGE_SELINUX_PYTHON_AUDIT2ALLOW
	bool "audit2allow"
	depends on LINGMO_TOOLCHAIN_GCC_AT_LEAST_5 # semodule-utils -> libsepol
	select LINGMO_PACKAGE_CHECKPOLICY
	select LINGMO_PACKAGE_SELINUX_PYTHON_SEPOLGEN
	select LINGMO_PACKAGE_SEMODULE_UTILS
	help
	  This module installs two programs:

	  audit2allow - Generate SELinux policy allow/dontaudit rules
	  from logs of denied operations.

	  audit2why - translates SELinux audit messages into a
	  description of why the access was denied (audit2allow -w)

comment "audit2allow needs a toolchain w/ gcc 5"
	depends on !LINGMO_TOOLCHAIN_GCC_AT_LEAST_5

config LINGMO_PACKAGE_SELINUX_PYTHON_SEPOLGEN
	bool "sepolgen"
	depends on LINGMO_TOOLCHAIN_GCC_AT_LEAST_5 # semodule-utils -> libsepol
	select LINGMO_PACKAGE_SEMODULE_UTILS
	help
	  This package contains a Python module that allows you to
	  generate an initial SELinux policy module template.

comment "sepolgen needs a toolchain w/ gcc 5"
	depends on !LINGMO_TOOLCHAIN_GCC_AT_LEAST_5

endif

comment "selinux-python packages needs a toolchain w/ wchar, threads, dynamic library"
	depends on LINGMO_USE_MMU
	depends on !LINGMO_USE_WCHAR || !LINGMO_TOOLCHAIN_HAS_THREADS || \
		LINGMO_STATIC_LIBS
```

## package/semodule-utils/Config.in
```kconfig
config LINGMO_PACKAGE_SEMODULE_UTILS
	bool "semodule-utils"
	depends on LINGMO_TOOLCHAIN_HAS_THREADS # libsepol
	depends on LINGMO_TOOLCHAIN_GCC_AT_LEAST_5 # libsepol
	select LINGMO_PACKAGE_LIBSEPOL
	help
	  semodule-utils is a package that contains tools for handling
	  selinux modules.

	  The package will install the following utilities:
	  * semodule_deps - Show the dependencies between SELinux
	    policy packages.
	  * semodule_expand - Expand a SELinux policy module package.
	  * semodule_link - Link SELinux policy module packages together
	  * semodule_package - Create a SELinux policy module package.

	  https://github.com/SELinuxProject/selinux/wiki/Releases

comment "semodule-utils needs a toolchain w/ threads, gcc >= 5"
	depends on !LINGMO_TOOLCHAIN_HAS_THREADS || \
		!LINGMO_TOOLCHAIN_GCC_AT_LEAST_5
```

## package/sentry-cli/Config.in.host
```kconfig
config LINGMO_PACKAGE_HOST_SENTRY_CLI
	bool "host sentry-cli"
	depends on LINGMO_PACKAGE_HOST_RUSTC_ARCH_SUPPORTS
	select LINGMO_PACKAGE_HOST_RUSTC
	help
	  Official Sentry command line interface

	  For managing debug information files and source maps.

	  https://docs.sentry.io/cli/
```

## package/sentry-native/Config.in
```kconfig
config LINGMO_PACKAGE_SENTRY_NATIVE
	bool "sentry-native"
	depends on LINGMO_INSTALL_LIBSTDCPP # google-breakpad
	depends on LINGMO_TOOLCHAIN_GCC_AT_LEAST_7 # google-breakpad
	depends on LINGMO_USE_WCHAR # google-breakpad
	depends on LINGMO_TOOLCHAIN_HAS_THREADS # google-breakpad
	# google-breakpad is restricted to glibc or uClibc, but
	# sentry-native needs <execinfo.h>, so it restricts further to
	# just glibc.
	depends on LINGMO_TOOLCHAIN_USES_GLIBC
	depends on LINGMO_PACKAGE_GOOGLE_BREAKPAD_ARCH_SUPPORTS # google-breakpad
	depends on LINGMO_PACKAGE_HOST_GOOGLE_BREAKPAD_ARCH_SUPPORTS # google-breakpad
	select LINGMO_PACKAGE_GOOGLE_BREAKPAD
	select LINGMO_PACKAGE_LIBCURL
	help
	  The Sentry Native SDK is an error and crash
	  reporting client for native applications,
	  optimized for C and C++.

	  https://github.com/getsentry/sentry-native

comment "sentry-native needs a glibc toolchain with w/ wchar, threads, C++, gcc >= 7"
	depends on LINGMO_PACKAGE_GOOGLE_BREAKPAD_ARCH_SUPPORTS
	depends on LINGMO_PACKAGE_HOST_GOOGLE_BREAKPAD_ARCH_SUPPORTS
	depends on !LINGMO_INSTALL_LIBSTDCPP || !LINGMO_USE_WCHAR || \
		!LINGMO_TOOLCHAIN_HAS_THREADS || \
		!LINGMO_TOOLCHAIN_USES_GLIBC || \
		!LINGMO_TOOLCHAIN_GCC_AT_LEAST_7
```

## package/ser2net/Config.in
```kconfig
config LINGMO_PACKAGE_SER2NET
	bool "ser2net"
	depends on LINGMO_USE_MMU # fork()
	depends on LINGMO_TOOLCHAIN_HAS_ATOMIC # gensio
	select LINGMO_PACKAGE_GENSIO
	select LINGMO_PACKAGE_LIBYAML
	help
	  Ser2net provides a way for a user to connect from a network
	  connection to a serial port.

	  http://ser2net.sourceforge.net
```

## package/setools/Config.in
```kconfig
config LINGMO_PACKAGE_SETOOLS
	bool "setools"
	depends on !LINGMO_STATIC_LIBS
	depends on LINGMO_TOOLCHAIN_HAS_THREADS
	depends on LINGMO_USE_WCHAR
	depends on LINGMO_USE_MMU
	depends on LINGMO_PACKAGE_PYTHON3
	depends on LINGMO_TOOLCHAIN_GCC_AT_LEAST_5 # libselinux -> libsepol
	select LINGMO_PACKAGE_PYTHON_NETWORKX # runtime
	select LINGMO_PACKAGE_PYTHON_SETUPTOOLS
	select LINGMO_PACKAGE_LIBSELINUX
	help
	  SETools is an open source project designed to facilitate
	  SELinux policy analysis. The primary tools are:
	   * apol - analyze a SELinux policy. (requires python-qt5)
	   * sediff - semantic policy difference tool for SELinux.
	   * sedta - Perform domain transition analyses
	   * seinfoflow - information flow analysis for SELinux
	   * sesearch - Search rules (allow, type_transition, etc.)

	  https://github.com/SELinuxProject/setools/

comment "setools needs a toolchain w/ threads, wchar, dynamic library, gcc >= 5"
	depends on LINGMO_USE_MMU
	depends on !LINGMO_TOOLCHAIN_HAS_THREADS || LINGMO_STATIC_LIBS || \
		!LINGMO_USE_WCHAR || !LINGMO_TOOLCHAIN_GCC_AT_LEAST_5

comment "setools needs python3"
	depends on LINGMO_USE_MMU
	depends on !LINGMO_PACKAGE_PYTHON3
```

## package/setserial/Config.in
```kconfig
config LINGMO_PACKAGE_SETSERIAL
	bool "setserial"
	# Uses fork()
	depends on LINGMO_USE_MMU
	help
	  Setserial : configuration of serial ports

	  http://setserial.sourceforge.net/
```

## package/sexpect/Config.in
```kconfig
config LINGMO_PACKAGE_SEXPECT
	bool "sexpect"
	depends on LINGMO_USE_MMU # fork()
	help
	  sexpect is another implementation of Expect which is
	  specifically designed for Shell scripts
	  (sh, bash, ksh, zsh, ...)

	  https://github.com/clarkwang/sexpect
```

## package/sg3_utils/Config.in
```kconfig
config LINGMO_PACKAGE_SG3_UTILS
	bool "sg3-utils"
	depends on LINGMO_TOOLCHAIN_HAS_THREADS
	help
	  Low level utilities for devices that use a SCSI command set.
	  This option install only libsgutils2 library not programs.

	  http://sg.danny.cz/sg/sg3_utils.html

if LINGMO_PACKAGE_SG3_UTILS

config LINGMO_PACKAGE_SG3_UTILS_PROGS
	bool "install programs"

endif

comment "sg3-utils needs a toolchain w/ threads"
	depends on !LINGMO_TOOLCHAIN_HAS_THREADS
```

## package/shadow/Config.in
```kconfig
menuconfig LINGMO_PACKAGE_SHADOW
	bool "shadow"
	depends on !LINGMO_STATIC_LIBS
	depends on LINGMO_TOOLCHAIN_HEADERS_AT_LEAST_4_14
	depends on !LINGMO_TOOLCHAIN_USES_UCLIBC # reallocarray, explicit_bzero
	help
	  Utilities to deal with user accounts.

	  https://github.com/shadow-maint/shadow

if LINGMO_PACKAGE_SHADOW

config LINGMO_PACKAGE_SHADOW_SHADOWGRP
	bool "shadowgrp"
	help
	  Enable shadow group support.

config LINGMO_PACKAGE_SHADOW_ACCOUNT_TOOLS_SETUID
	bool "account-tools-setuid"
	depends on LINGMO_USE_MMU  # linux-pam
	depends on LINGMO_ENABLE_LOCALE  # linux-pam
	depends on LINGMO_USE_WCHAR  # linux-pam
	depends on !LINGMO_STATIC_LIBS  # linux-pam
	depends on LINGMO_TOOLCHAIN_GCC_AT_LEAST_4_9 # linux-pam
	select LINGMO_PACKAGE_LINUX_PAM
	help
	  Install the user and group management tools (e.g. groupadd)
	  with setuid and authenticate the callers via PAM.

comment "account-tools-setuid needs a toolchain w/ dynamic library, wchar, locale, gcc >= 4.9"
	depends on LINGMO_USE_MMU
	depends on LINGMO_STATIC_LIBS || !LINGMO_USE_WCHAR || \
		!LINGMO_ENABLE_LOCALE || !LINGMO_TOOLCHAIN_GCC_AT_LEAST_4_9

config LINGMO_PACKAGE_SHADOW_SUBORDINATE_IDS
	bool "subordinate-ids"
	help
	  Support subordinate ids. Helpful to use container solution
	  like podman without root.

config LINGMO_PACKAGE_SHADOW_SHA_CRYPT
	bool "sha-crypt"
	default y
	help
	  Allow the SHA256 and SHA512 password encryption algorithms.

config LINGMO_PACKAGE_SHADOW_BCRYPT
	bool "bcrypt"
	help
	  Allow the bcrypt password encryption algorithm.

config LINGMO_PACKAGE_SHADOW_YESCRYPT
	bool "yescrypt"
	help
	  Allow the yescrypt password encryption algorithm.

endif # LINGMO_PACKAGE_SHADOW

comment "shadow needs a glibc or musl toolchain w/ headers >= 4.14, dynamic library"
	depends on !LINGMO_TOOLCHAIN_HEADERS_AT_LEAST_4_14 || \
		LINGMO_STATIC_LIBS || LINGMO_TOOLCHAIN_USES_UCLIBC
```

## package/shadowsocks-libev/Config.in
```kconfig
config LINGMO_PACKAGE_SHADOWSOCKS_LIBEV
	bool "shadowsocks-libev"
	depends on LINGMO_TOOLCHAIN_HAS_SYNC_4 # for libcork
	depends on LINGMO_TOOLCHAIN_HAS_SYNC_8 || !LINGMO_ARCH_IS_64 # for libcork
	depends on LINGMO_TOOLCHAIN_HAS_THREADS
	depends on LINGMO_USE_MMU # fork()
	select LINGMO_PACKAGE_C_ARES
	select LINGMO_PACKAGE_LIBEV
	select LINGMO_PACKAGE_LIBSODIUM
	select LINGMO_PACKAGE_MBEDTLS
	select LINGMO_PACKAGE_PCRE
	help
	  Shadowsocks-libev is a lightweight secured SOCKS5 proxy for
	  embedded devices and low-end boxes.

	  https://github.com/shadowsocks/shadowsocks-libev

config LINGMO_PACKAGE_SHADOWSOCKS_LIBEV_CONNMARKTOS
	bool "connmarktos support in ss-server"
	depends on LINGMO_PACKAGE_SHADOWSOCKS_LIBEV
	select LINGMO_PACKAGE_LIBNETFILTER_CONNTRACK
	help
	  Build ss-server with the connmark to TOS feature.

	  This feature requires advanced tc, iptables and conntrack
	  rules to perform QoS on the server side.

	  If unsure, don't enable this option

comment "shadowsocks-libev needs a toolchain w/ threads"
	depends on LINGMO_TOOLCHAIN_HAS_SYNC_4
	depends on LINGMO_TOOLCHAIN_HAS_SYNC_8 || !LINGMO_ARCH_IS_64
	depends on LINGMO_USE_MMU
	depends on !LINGMO_TOOLCHAIN_HAS_THREADS
```

## package/shairport-sync/Config.in
```kconfig
config LINGMO_PACKAGE_SHAIRPORT_SYNC
	bool "shairport-sync"
	depends on LINGMO_TOOLCHAIN_HAS_THREADS_NPTL
	depends on LINGMO_INSTALL_LIBSTDCPP
	select LINGMO_PACKAGE_ALSA_LIB
	select LINGMO_PACKAGE_ALSA_LIB_MIXER
	select LINGMO_PACKAGE_LIBCONFIG
	select LINGMO_PACKAGE_OPENSSL if !LINGMO_PACKAGE_MBEDTLS
	select LINGMO_PACKAGE_POPT
	help
	  Shairport Sync emulates an AirPort Express for the purpose
	  of streaming audio from iTunes, iPods, iPhones, iPads and
	  AppleTVs.  Audio played by a Shairport Sync-powered device
	  stays in synchrony with the source and thus with other
	  devices that are playing the same source
	  synchronously. Thus, for example, synchronised multi-room
	  audio is possible without difficulty.

	  https://github.com/mikebrady/shairport-sync

if LINGMO_PACKAGE_SHAIRPORT_SYNC

config LINGMO_PACKAGE_SHAIRPORT_SYNC_CONVOLUTION
	bool "convolution support"
	select LINGMO_PACKAGE_LIBSNDFILE
	help
	  Enable audio DSP convolution support.

config LINGMO_PACKAGE_SHAIRPORT_SYNC_DBUS
	bool "dbus support"
	depends on LINGMO_USE_WCHAR # libglib2
	depends on LINGMO_TOOLCHAIN_HAS_THREADS # libglib2
	depends on LINGMO_USE_MMU # libglib2
	select LINGMO_PACKAGE_LIBGLIB2
	help
	  Enable support for support for the MPRIS and native
	  Shairport Sync D-Bus interface.

comment "shairport-sync dbus support needs a toolchain w/ wchar, threads"
	depends on LINGMO_USE_MMU
	depends on !LINGMO_USE_WCHAR || !LINGMO_TOOLCHAIN_HAS_THREADS

config LINGMO_PACKAGE_SHAIRPORT_SYNC_LIBSOXR
	bool "libsoxr support"
	select LINGMO_PACKAGE_LIBSOXR
	help
	  Enable support for libsoxr, the SoX Resampler library.

	  Briefly, Shairport Sync keeps in step with the audio source
	  by deleting or inserting frames of audio into the stream as
	  needed. This "interpolation" is normally inaudible, but it
	  can be heard in some circumstances. Libsoxr allows this
	  interpolation to be done much more smoothly and subtly.

config LINGMO_PACKAGE_SHAIRPORT_SYNC_MQTT
	bool "mqtt support"
	depends on LINGMO_USE_MMU # avahi
	depends on LINGMO_TOOLCHAIN_HAS_THREADS # avahi
	depends on !LINGMO_STATIC_LIBS # avahi
	select LINGMO_PACKAGE_AVAHI
	select LINGMO_PACKAGE_AVAHI_DAEMON
	select LINGMO_PACKAGE_DBUS
	select LINGMO_PACKAGE_MOSQUITTO
	help
	  Enable support for the MQTT, the Message Queuing Telemetry
	  Transport protocol.

comment "shairport-sync mqtt support needs a toolchain w/ dynamic library, threads"
	depends on LINGMO_USE_MMU
	depends on LINGMO_STATIC_LIBS || !LINGMO_TOOLCHAIN_HAS_THREADS

endif

comment "shairport-sync needs a toolchain w/ C++, NPTL"
	depends on LINGMO_USE_MMU
	depends on !LINGMO_INSTALL_LIBSTDCPP || !LINGMO_TOOLCHAIN_HAS_THREADS_NPTL
```

## package/shapelib/Config.in
```kconfig
config LINGMO_PACKAGE_SHAPELIB
	bool "shapelib"
	depends on LINGMO_INSTALL_LIBSTDCPP
	depends on LINGMO_TOOLCHAIN_HAS_THREADS
	help
	  The Shapefile C Library provides the ability to write simple
	  C programs for reading, writing and updating (to a limited
	  extent) ESRI Shapefiles, and the associated attribute file
	  (.dbf).

	  http://shapelib.maptools.org/

comment "shapelib needs a toolchain w/ C++, threads"
	depends on !LINGMO_INSTALL_LIBSTDCPP || !LINGMO_TOOLCHAIN_HAS_THREADS
```

## package/shared-mime-info/Config.in
```kconfig
config LINGMO_PACKAGE_SHARED_MIME_INFO
	bool "shared-mime-info"
	depends on LINGMO_USE_WCHAR # glib2
	depends on LINGMO_TOOLCHAIN_HAS_THREADS # glib2
	depends on LINGMO_USE_MMU # glib2
	select LINGMO_PACKAGE_LIBGLIB2
	select LINGMO_PACKAGE_LIBXML2
	help
	  The shared-mime-info package contains the core
	  database of common types and the update-mime-database
	  command used to extend it.

	  https://freedesktop.org/wiki/Software/shared-mime-info/

comment "shared-mime-info needs a toolchain w/ wchar, threads"
	depends on LINGMO_USE_MMU
	depends on !LINGMO_USE_WCHAR || !LINGMO_TOOLCHAIN_HAS_THREADS
```

## package/shellinabox/Config.in
```kconfig
config LINGMO_PACKAGE_SHELLINABOX
	bool "shellinabox"
	depends on LINGMO_USE_MMU # fork()
	depends on !LINGMO_STATIC_LIBS # dlfcn.h
	select LINGMO_PACKAGE_OPENSSL
	select LINGMO_PACKAGE_ZLIB
	help
	  Shell In A Box implements a web server that can export
	  arbitrary command line tools to a web based terminal
	  emulator. This emulator is accessible to any JavaScript and
	  CSS enabled web browser and does not require any additional
	  browser plugins.

	  https://github.com/shellinabox/shellinabox

comment "shellinabox needs a toolchain w/ dynamic library"
	depends on LINGMO_USE_MMU
	depends on LINGMO_STATIC_LIBS
```
