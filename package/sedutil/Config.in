## package/signal-estimator/Config.in
```kconfig
comment "signal-estimator needs a toochain w/ C++, threads, gcc >= 7"
	depends on !LINGMO_INSTALL_LIBSTDCPP \
		|| !LINGMO_TOOLCHAIN_GCC_AT_LEAST_7 \
		|| !LINGMO_TOOLCHAIN_HAS_THREADS

config LINGMO_PACKAGE_SIGNAL_ESTIMATOR
	bool "signal-estimator"
	depends on LINGMO_INSTALL_LIBSTDCPP
	depends on LINGMO_TOOLCHAIN_GCC_AT_LEAST_7 # C++17
	depends on LINGMO_TOOLCHAIN_HAS_THREADS # alsa-lib
	select LINGMO_PACKAGE_ALSA_LIB
	help
	  signal-estimator is a small command-line and GUI tool allowing
	  to measure different characteristics of the signal looped back
	  from audio output to audio input.

	  https://github.com/gavv/signal-estimator
```

## package/sigrok-cli/Config.in
```kconfig
config LINGMO_PACKAGE_SIGROK_CLI
	bool "sigrok-cli"
	# libsigrok->libglib2:
	depends on LINGMO_USE_WCHAR
	depends on LINGMO_TOOLCHAIN_HAS_THREADS
	depends on LINGMO_USE_MMU
	# libsigrok->libzip
	depends on !LINGMO_STATIC_LIBS
	# libsigrok
	depends on LINGMO_TOOLCHAIN_GCC_AT_LEAST_4_7
	depends on LINGMO_ENABLE_LOCALE
	select LINGMO_PACKAGE_LIBSIGROK
	help
	  Sigrok-cli is a command-line frontend for the sigrok
	  software suite.

	  http://sigrok.org/wiki/Sigrok-cli

comment "sigrok-cli needs a toolchain w/ locale, wchar, threads, dynamic library, gcc >= 4.7"
	depends on LINGMO_USE_MMU
	depends on !LINGMO_USE_WCHAR || !LINGMO_TOOLCHAIN_HAS_THREADS \
		|| !LINGMO_TOOLCHAIN_GCC_AT_LEAST_4_7 || LINGMO_STATIC_LIBS \
		|| !LINGMO_ENABLE_LOCALE
```

## package/simple-mail/Config.in
```kconfig
config LINGMO_PACKAGE_SIMPLE_MAIL
	bool "simple-mail"
	depends on LINGMO_PACKAGE_QT5
	select LINGMO_PACKAGE_QT5BASE_NETWORK
	select LINGMO_PACKAGE_OPENSSL
	help
	  An SMTP library written in C++ for Qt.

	  https://github.com/cutelyst/simple-mail
```

## package/sispmctl/Config.in
```kconfig
config LINGMO_PACKAGE_SISPMCTL
	bool "sispmctl"
	depends on LINGMO_TOOLCHAIN_HAS_THREADS # libusb
	depends on LINGMO_TOOLCHAIN_GCC_AT_LEAST_4_9 # libusb
	depends on LINGMO_USE_WCHAR
	depends on LINGMO_USE_MMU # fork()
	select LINGMO_PACKAGE_LIBUSB
	select LINGMO_PACKAGE_LIBUSB_COMPAT
	help
	  sispmctl is an application enabling the use of the GEMBIRD
	  SiS-PM and mSiS(sispm) USB-controlled power-outlet device
	  under Linux. Note that the device is also sold under
	  different Names, i.e. as "IntelliPlug" in Germany.

	  http://sispmctl.sourceforge.net/

comment "sispmctl needs a toolchain w/ threads, wchar, gcc >= 4.9"
	depends on !LINGMO_TOOLCHAIN_HAS_THREADS || !LINGMO_USE_WCHAR || \
		!LINGMO_TOOLCHAIN_GCC_AT_LEAST_4_9
	depends on LINGMO_USE_MMU
```

## package/skeleton-custom/Config.in
```kconfig
config LINGMO_PACKAGE_SKELETON_CUSTOM
	bool
	select LINGMO_PACKAGE_HAS_SKELETON

config LINGMO_PACKAGE_PROVIDES_SKELETON
	default "skeleton-custom" if LINGMO_PACKAGE_SKELETON_CUSTOM
```

## package/skeleton-init-none/Config.in
```kconfig
config LINGMO_PACKAGE_SKELETON_INIT_NONE
	bool
	select LINGMO_PACKAGE_HAS_SKELETON
	select LINGMO_PACKAGE_SKELETON_INIT_COMMON

config LINGMO_PACKAGE_PROVIDES_SKELETON
	default "skeleton-init-none" if LINGMO_PACKAGE_SKELETON_INIT_NONE
```

## package/skeleton-init-openrc/Config.in
```kconfig
config LINGMO_PACKAGE_SKELETON_INIT_OPENRC
	bool
	select LINGMO_PACKAGE_HAS_SKELETON
	select LINGMO_PACKAGE_SKELETON_INIT_COMMON

config LINGMO_PACKAGE_PROVIDES_SKELETON
	default "skeleton-init-openrc" if LINGMO_PACKAGE_SKELETON_INIT_OPENRC
```

## package/skeleton-init-systemd/Config.in
```kconfig
config LINGMO_PACKAGE_SKELETON_INIT_SYSTEMD
	bool
	select LINGMO_PACKAGE_HAS_SKELETON
	select LINGMO_PACKAGE_SKELETON_INIT_COMMON

config LINGMO_PACKAGE_PROVIDES_SKELETON
	default "skeleton-init-systemd" if LINGMO_PACKAGE_SKELETON_INIT_SYSTEMD
```
