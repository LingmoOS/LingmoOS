## package/qt5/qt5base/Config.in
```kconfig
config LINGMO_PACKAGE_QT5BASE
	bool "qt5base"
	select LINGMO_PACKAGE_ZLIB
	select LINGMO_PACKAGE_PCRE2
	select LINGMO_PACKAGE_PCRE2_16
	select LINGMO_PACKAGE_LIBOPENSSL_ENABLE_PSK if LINGMO_PACKAGE_LIBOPENSSL
	help
	  Qt is a cross-platform application and UI framework for
	  developers using C++.

	  This package corresponds to the qt5base module, which
	  contains the base Qt libraries: QtCore, QtNetwork, QtGui,
	  QtWidgets, etc.

	  https://qt.io

if LINGMO_PACKAGE_QT5BASE

config LINGMO_PACKAGE_QT5BASE_CUSTOM_CONF_OPTS
	string "Custom configuration options"
	help
	  Define custom qt5 configuration options which can be used to
	  enable or disable options not managed by buildroot. These
	  options are appended to the ones generated by buildroot and
	  passed to qt5base during configuration.

	  E.g. to remove the Windows Vista style option, add the option
	  -no-feature-style_windowsvista.

config LINGMO_PACKAGE_QT5BASE_CONFIG_FILE
	string "Config file"
	help
	  Configure options allow to set which modules are being
	  compiled or not in Qt, but Qt also provide a more
	  fine-grained mechanism to configure which features should be
	  enabled or disabled, through a header file. Examples of such
	  header files can be found in src/corelib/global/qconfig-*.h
	  in the Qt sources.

	  This option allows to set the path of such a configuration
	  file, which Buildroot will give to Qt at compile time.

config LINGMO_PACKAGE_QT5BASE_EXAMPLES
	bool "Compile and install examples (with code)"
	select LINGMO_PACKAGE_QT5BASE_NETWORK
	select LINGMO_PACKAGE_QT5BASE_XML
	help
	  If unsure, say N.

config LINGMO_PACKAGE_QT5BASE_NETWORK
	def_bool y

config LINGMO_PACKAGE_QT5BASE_CONCURRENT
	bool "concurrent module"
	help
	  This options enables the Qt5Concurrent library.

config LINGMO_PACKAGE_QT5BASE_SQL
	def_bool y

if LINGMO_PACKAGE_QT5BASE_SQL
config LINGMO_PACKAGE_QT5BASE_MYSQL
	bool "MySQL Plugin"
	depends on LINGMO_USE_MMU # mysql
	select LINGMO_PACKAGE_MARIADB
	select LINGMO_PACKAGE_NCURSES
	select LINGMO_PACKAGE_READLINE
	help
	  Build MySQL plugin
	  If unsure, say n.

config LINGMO_PACKAGE_QT5BASE_PSQL
	bool "PostgreSQL Plugin"
	depends on LINGMO_USE_MMU # postgresql
	depends on !LINGMO_STATIC_LIBS
	depends on LINGMO_USE_WCHAR # postgresql
	depends on !LINGMO_OPTIMIZE_FAST # postgresql
	select LINGMO_PACKAGE_POSTGRESQL
	help
	  Build PostgreSQL plugin
	  If unsure, say n.

comment "PostgreSQL plugin needs a toolchain w/ wchar, dynamic library"
	depends on LINGMO_USE_MMU
	depends on LINGMO_STATIC_LIBS || !LINGMO_USE_WCHAR

comment "PostgreSQL plugin can't be built with Optimize for fast"
	depends on LINGMO_OPTIMIZE_FAST

choice
	prompt "SQLite 3 support"
	default LINGMO_PACKAGE_QT5BASE_SQLITE_NONE
	help
	  Select SQLite support.

config LINGMO_PACKAGE_QT5BASE_SQLITE_NONE
	bool "No sqlite support"
	help
	  Do not compile any kind of SQLite support.

config LINGMO_PACKAGE_QT5BASE_SQLITE_QT
	bool "Qt SQLite"
	help
	  Use Qt bundled SQLite support.

config LINGMO_PACKAGE_QT5BASE_SQLITE_SYSTEM
	bool "System SQLite"
	select LINGMO_PACKAGE_SQLITE
	select LINGMO_PACKAGE_SQLITE_ENABLE_COLUMN_METADATA
	help
	  Use system SQLite.

endchoice

endif

config LINGMO_PACKAGE_QT5BASE_TEST
	def_bool y

config LINGMO_PACKAGE_QT5BASE_XML
	def_bool y

config LINGMO_PACKAGE_QT5BASE_GUI
	bool "gui module"
	select LINGMO_PACKAGE_FREETYPE
	# At least one graphic backend must be enabled, so enable
	# linuxfb if nothing is enabled.
	select LINGMO_PACKAGE_QT5BASE_LINUXFB if \
	       !LINGMO_PACKAGE_QT5BASE_DIRECTFB && \
	       !LINGMO_PACKAGE_QT5BASE_XCB && \
	       !LINGMO_PACKAGE_QT5BASE_EGLFS
	help
	  This option enables the Qt5Gui library.

if LINGMO_PACKAGE_QT5BASE_GUI

config LINGMO_PACKAGE_QT5BASE_WIDGETS
	bool "widgets module"
	select LINGMO_PACKAGE_XLIB_LIBXEXT if LINGMO_PACKAGE_QT5BASE_XCB
	help
	  This option enables the Qt5Widgets library.

comment "OpenGL support needs an OpenGL-capable backend"
	depends on !LINGMO_PACKAGE_QT5_GL_AVAILABLE

config LINGMO_PACKAGE_QT5BASE_OPENGL
	bool "OpenGL support"
	depends on LINGMO_PACKAGE_QT5_GL_AVAILABLE
	help
	  This option enables OpenGL support.

if LINGMO_PACKAGE_QT5BASE_OPENGL

choice
	prompt "OpenGL API"
	help
	  Select OpenGL API.

config LINGMO_PACKAGE_QT5BASE_OPENGL_DESKTOP
	bool "Desktop OpenGL"
	depends on LINGMO_PACKAGE_HAS_LIBGL
	help
	  Use desktop OpenGL.

config LINGMO_PACKAGE_QT5BASE_OPENGL_ES2
	bool "OpenGL ES 2.0+"
	depends on LINGMO_PACKAGE_HAS_LIBGLES
	help
	  Use OpenGL ES 2.0 and later versions.

endchoice

config LINGMO_PACKAGE_QT5BASE_OPENGL_LIB
	bool "opengl module"
	select LINGMO_PACKAGE_QT5BASE_WIDGETS
	help
	  This option enables the Qt5OpenGL library. This library
	  includes OpenGL support classes provided to ease porting
	  from Qt 4.x.

endif

config LINGMO_PACKAGE_QT5BASE_VULKAN
	bool "Vulkan support"
	depends on LINGMO_INSTALL_LIBSTDCPP # vulkan-loader
	depends on !LINGMO_STATIC_LIBS # vulkan-loader
	depends on LINGMO_TOOLCHAIN_HAS_THREADS # vulkan-loader
	select LINGMO_PACKAGE_VULKAN_HEADERS
	select LINGMO_PACKAGE_VULKAN_LOADER
	help
	  This option enables Vulkan support.

config LINGMO_PACKAGE_QT5BASE_LINUXFB
	bool "linuxfb support"

config LINGMO_PACKAGE_QT5BASE_DIRECTFB
	bool "directfb support"
	depends on LINGMO_PACKAGE_DIRECTFB

comment "directfb backend available if directfb is enabled"
	depends on !LINGMO_PACKAGE_DIRECTFB

config LINGMO_PACKAGE_QT5BASE_XCB
	bool "X.org XCB support"
	depends on LINGMO_PACKAGE_XORG7
	select LINGMO_PACKAGE_XLIB_LIBX11
	select LINGMO_PACKAGE_LIBXCB
	select LINGMO_PACKAGE_XCB_UTIL_IMAGE
	select LINGMO_PACKAGE_XCB_UTIL_KEYSYMS
	select LINGMO_PACKAGE_XCB_UTIL_RENDERUTIL
	select LINGMO_PACKAGE_XCB_UTIL_WM
	select LINGMO_PACKAGE_LIBXKBCOMMON

comment "X.org XCB backend available if X.org is enabled"
	depends on !LINGMO_PACKAGE_XORG7

config LINGMO_PACKAGE_QT5BASE_EGLFS
	bool "eglfs support"
	depends on LINGMO_PACKAGE_HAS_LIBEGL
	depends on LINGMO_PACKAGE_QT5_GL_AVAILABLE
	select LINGMO_PACKAGE_QT5BASE_OPENGL

comment "eglfs backend available if OpenGL and EGL are enabled"
	depends on !LINGMO_PACKAGE_HAS_LIBEGL || !LINGMO_PACKAGE_QT5_GL_AVAILABLE

config LINGMO_PACKAGE_QT5BASE_DEFAULT_QPA
	string "Default graphical platform"
	help
	  Choose the default platform abstraction to use for graphical
	  applications (e.g xcb, linuxfb, eglfs, ...). If this is
	  empty, the default for your architecture will be used
	  (usually this is eglfs).

	  You can get a list of supported platforms by running a Qt
	  application with the option "-platform help" on your
	  target. You can choose a different platform at runtime with
	  the -platform option.

config LINGMO_PACKAGE_QT5BASE_PRINTSUPPORT
	depends on LINGMO_PACKAGE_QT5BASE_WIDGETS
	def_bool y

config LINGMO_PACKAGE_QT5BASE_FONTCONFIG
	bool "fontconfig support"
	select LINGMO_PACKAGE_FONTCONFIG
	help
	  This option enables Fontconfig and Freetype support using
	  the system fontconfig and freetype2 libraries.

config LINGMO_PACKAGE_QT5BASE_HARFBUZZ
	bool "harfbuzz support"
	select LINGMO_PACKAGE_HARFBUZZ if \
		LINGMO_TOOLCHAIN_HAS_SYNC_4 && \
		LINGMO_TOOLCHAIN_GCC_AT_LEAST_4_9
	help
	  This option enables HarfBuzz support (either system harfbuzz
	  if the toolchain supports __sync for 4 bytes, or the qt
	  provided one which avoids this dependency by using QAtomic).

config LINGMO_PACKAGE_QT5BASE_GIF
	bool "GIF support"
	help
	  This compiles and installs the plugin for GIF reading support.

config LINGMO_PACKAGE_QT5BASE_JPEG
	bool "JPEG support"
	select LINGMO_PACKAGE_JPEG
	help
	  This option enables JPEG support using the system libjpeg
	  library.

config LINGMO_PACKAGE_QT5BASE_PNG
	bool "PNG support"
	select LINGMO_PACKAGE_LIBPNG
	help
	  This option enables PNG support using the system libpng
	  library.

endif

config LINGMO_PACKAGE_QT5BASE_SYSLOG
	bool "syslog support"
	help
	  Logs to the standard UNIX logging mechanism.

config LINGMO_PACKAGE_QT5BASE_DBUS
	bool "DBus module"
	depends on LINGMO_TOOLCHAIN_HAS_THREADS
	depends on LINGMO_USE_MMU
	select LINGMO_PACKAGE_DBUS
	help
	  This option enables the D-Bus module.

config LINGMO_PACKAGE_QT5BASE_ICU
	bool "Enable ICU support"
	depends on !LINGMO_BINFMT_FLAT # icu
	depends on LINGMO_HOST_GCC_AT_LEAST_4_9 # icu
	depends on LINGMO_TOOLCHAIN_GCC_AT_LEAST_4_9 # icu
	select LINGMO_PACKAGE_ICU
	help
	  This option enables ICU support in Qt5. This is for example
	  needed for Qt5Webkit.

comment "icu support needs a toolchain w/ gcc >= 4.9, host gcc >= 4.9"
	depends on !LINGMO_BINFMT_FLAT
	depends on !LINGMO_TOOLCHAIN_GCC_AT_LEAST_4_9 || \
		!LINGMO_HOST_GCC_AT_LEAST_4_9

config LINGMO_PACKAGE_QT5BASE_TSLIB
	bool "Enable Tslib support"
	select LINGMO_PACKAGE_TSLIB
	help
	  This options enables the Tslib plugin

endif
```

## package/qt5/qt5connectivity/Config.in
```kconfig
config LINGMO_PACKAGE_QT5CONNECTIVITY
	bool "qt5connectivity"
	depends on LINGMO_PACKAGE_NEARD || LINGMO_PACKAGE_BLUEZ5_UTILS
	select LINGMO_PACKAGE_QT5BASE_CONCURRENT
	select LINGMO_PACKAGE_QT5BASE_DBUS
	help
	  Qt is a cross-platform application and UI framework for
	  developers using C++.

	  Qt Connectivity module provides support for Bluetooth/NFC
	  peripherials.

	  https://doc.qt.io/qt-5/qtbluetooth-index.html
	  https://doc.qt.io/qt-5/qtnfc-index.html

comment "qt5connectivity needs neard and/or bluez5_utils"
	depends on !LINGMO_PACKAGE_NEARD && !LINGMO_PACKAGE_BLUEZ5_UTILS
```

## package/qt5/qt5declarative/Config.in
```kconfig
config LINGMO_PACKAGE_QT5DECLARATIVE
	bool "qt5declarative"
	depends on LINGMO_PACKAGE_QT5_JSCORE_AVAILABLE
	help
	  Qt is a cross-platform application and UI framework for
	  developers using C++.

	  Qt Declarative module provides the Qt QML and Qt Quick
	  modules for developing UIs with the QML language

	  https://doc.qt.io/qt-5/qtqml-index.html
	  https://doc.qt.io/qt-5/qtquick-index.html

if LINGMO_PACKAGE_QT5DECLARATIVE

config LINGMO_PACKAGE_QT5DECLARATIVE_QUICK
	bool "quick module"
	select LINGMO_PACKAGE_QT5BASE_GUI
	select LINGMO_PACKAGE_QT5BASE_OPENGL if LINGMO_PACKAGE_QT5_GL_AVAILABLE

endif
```

## package/qt5/qt5graphicaleffects/Config.in
```kconfig
config LINGMO_PACKAGE_QT5GRAPHICALEFFECTS
	bool "qt5graphicaleffects"
	depends on LINGMO_PACKAGE_QT5_GL_AVAILABLE
	depends on LINGMO_PACKAGE_QT5_JSCORE_AVAILABLE
	select LINGMO_PACKAGE_QT5DECLARATIVE
	select LINGMO_PACKAGE_QT5DECLARATIVE_QUICK
	help
	  Qt is a cross-platform application and UI framework for
	  developers using C++.

	  The Qt Graphical Effects module provides a set of QML types
	  for adding visually impressive and configurable effects to
	  user interfaces.

	  https://doc.qt.io/qt-5/qtgraphicaleffects-index.html

comment "qt5graphicaleffects needs an OpenGL-capable backend"
	depends on !LINGMO_PACKAGE_QT5_GL_AVAILABLE
	depends on LINGMO_PACKAGE_QT5_JSCORE_AVAILABLE
```

## package/qt5/qt5lottie/Config.in
```kconfig
config LINGMO_PACKAGE_QT5LOTTIE
	bool "qt5lottie"
	depends on LINGMO_PACKAGE_QT5_JSCORE_AVAILABLE
	select LINGMO_PACKAGE_QT5DECLARATIVE
	select LINGMO_PACKAGE_QT5DECLARATIVE_QUICK
	help
	  Qt is a cross-platform application and UI framework for
	  developers using C++.

	  This package corresponds to the qt5lottie module.

	  https://doc.qt.io/qt-5/qtlottieanimation-index.html
```

## package/qt5/qt5multimedia/Config.in
```kconfig
config LINGMO_PACKAGE_QT5MULTIMEDIA
	bool "qt5multimedia"
	select LINGMO_PACKAGE_QT5BASE_GUI
	select LINGMO_PACKAGE_QT5BASE_NETWORK
	select LINGMO_PACKAGE_QT5BASE_OPENGL_LIB if LINGMO_PACKAGE_QT5BASE_OPENGL
	help
	  Qt is a cross-platform application and UI framework for
	  developers using C++.

	  The Qt Multimedia module provides a rich feature set that
	  enables you to easily take advantage of a platform's
	  multimedia capabilities such as media playback and the use
	  of camera and radio devices.

	  https://doc.qt.io/qt-5/multimediaoverview.html
```

## package/qt5/qt5tools/Config.in
```kconfig
config LINGMO_PACKAGE_QT5TOOLS
	bool "qt5tools"
	help
	  Qt is a cross-platform application and UI framework for
	  developers using C++.

	  Qt Tools provides tools facilitate the development
	  and design of applications.

	  https://doc.qt.io/qt-5/qtmodules.html#qt-tools

if LINGMO_PACKAGE_QT5TOOLS

config LINGMO_PACKAGE_QT5TOOLS_LINGUIST_TOOLS
	bool "Linguist host tools (lconvert, lrelease, lupdate)"
	help
	  This option enables the linguist host tools
	  lconvert, lrelease and lupdate.

config LINGMO_PACKAGE_QT5TOOLS_QDOC_TOOL
	bool "qdoc host tool"
	# Needs llvm-config and libclang for the host, which is not
	# currently supported in Buildroot, unless the target is
	# already supported by llvm.
	depends on LINGMO_PACKAGE_LLVM_ARCH_SUPPORTS # llvm, clang
	depends on LINGMO_TOOLCHAIN_GCC_AT_LEAST_7 # llvm, clang
	depends on LINGMO_TOOLCHAIN_HAS_THREADS # llvm, clang
	depends on LINGMO_INSTALL_LIBSTDCPP # llvm, clang
	depends on !LINGMO_TOOLCHAIN_HAS_GCC_BUG_64735 # llvm, clang
	depends on !LINGMO_STATIC_LIBS # llvm, clang
	depends on LINGMO_USE_WCHAR # llvm, clang
	depends on LINGMO_HOST_GCC_AT_LEAST_7 # llvm, clang
	help
	  This option enables the qdoc host tool.

config LINGMO_PACKAGE_QT5TOOLS_PIXELTOOL
	bool "pixeltool"
	select LINGMO_PACKAGE_QT5BASE_GUI
	select LINGMO_PACKAGE_QT5BASE_WIDGETS
	select LINGMO_PACKAGE_QT5BASE_PNG # saving png images
	help
	  Compile and install the pixeltool program.

config LINGMO_PACKAGE_QT5TOOLS_QTDIAG
	bool "qtdiag"
	select LINGMO_PACKAGE_QT5BASE_GUI
	help
	  Compile and install the qtdiag program.

config LINGMO_PACKAGE_QT5TOOLS_QTPATHS
	bool "qtpaths"
	help
	  Compile and install the qtpaths program.

config LINGMO_PACKAGE_QT5TOOLS_QTPLUGININFO
	bool "qtplugininfo"
	help
	  Compile and install the qtplugininfo program.

endif
```

## package/qt5/qt5wayland/Config.in
```kconfig
comment "qt5wayland needs an OpenGL-capable backend"
	depends on !LINGMO_PACKAGE_QT5_GL_AVAILABLE

config LINGMO_PACKAGE_QT5WAYLAND
	bool "qt5wayland"
	depends on LINGMO_PACKAGE_QT5_GL_AVAILABLE
	select LINGMO_PACKAGE_WAYLAND
	help
	  Qt is a cross-platform application and UI framework for
	  developers using C++.

	  This package corresponds to the qt5wayland module.

	  https://qt.io

if LINGMO_PACKAGE_QT5WAYLAND

config LINGMO_PACKAGE_QT5WAYLAND_COMPOSITOR
	bool "Enable compositor (experimental)"
	help
	  The compositor API is still experimental, and not built by
	  default.

endif
```

## package/qt5/qt5webengine-chromium-catapult/Config.in
```kconfig
# Not user-selectable, it is only needed to be copied
# into the chromium source tree.
config LINGMO_PACKAGE_QT5WEBENGINE_CHROMIUM_CATAPULT
	bool
```

## package/qt5/qt5webengine-chromium/Config.in
```kconfig
# Not user-selectable, it is only needed to be copied
# into the qt5webengine source tree.
config LINGMO_PACKAGE_QT5WEBENGINE_CHROMIUM
	bool
	select LINGMO_PACKAGE_QT5WEBENGINE_CHROMIUM_CATAPULT
```
