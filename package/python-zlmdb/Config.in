## package/python-zlmdb/Config.in
```kconfig
config LINGMO_PACKAGE_PYTHON_ZLMDB
	bool "python-zlmdb"
	depends on LINGMO_PACKAGE_PYTHON_NUMPY_ARCH_SUPPORTS # python-numpy
	depends on LINGMO_INSTALL_LIBSTDCPP # python-numpy
	depends on LINGMO_TOOLCHAIN_USES_GLIBC || LINGMO_TOOLCHAIN_USES_MUSL # python-numpy
	depends on LINGMO_TOOLCHAIN_GCC_AT_LEAST_9 # python-numpy
	select LINGMO_PACKAGE_PYTHON_CBOR2 # runtime
	select LINGMO_PACKAGE_PYTHON_CFFI # runtime
	select LINGMO_PACKAGE_PYTHON_CLICK # runtime
	select LINGMO_PACKAGE_PYTHON_FLATBUFFERS # runtime
	select LINGMO_PACKAGE_PYTHON_LMDB # runtime
	select LINGMO_PACKAGE_PYTHON_NUMPY # runtime
	select LINGMO_PACKAGE_PYTHON_PYNACL # runtime
	select LINGMO_PACKAGE_PYTHON_PYYAML # runtime
	select LINGMO_PACKAGE_PYTHON_TXAIO # runtime
	help
	  Object-relational zero-copy in-memory database layer for
	  LMDB.

	  https://github.com/crossbario/zlmdb

comment "python-zlmdb needs a glibc or musl toolchain w/ C++, gcc >= 9"
	depends on LINGMO_PACKAGE_PYTHON_NUMPY_ARCH_SUPPORTS
	depends on !LINGMO_INSTALL_LIBSTDCPP || \
		!LINGMO_TOOLCHAIN_GCC_AT_LEAST_9 || \
		!(LINGMO_TOOLCHAIN_USES_GLIBC || LINGMO_TOOLCHAIN_USES_MUSL)
```

## package/python-zopfli/Config.in
```kconfig
config LINGMO_PACKAGE_PYTHON_ZOPFLI
	bool "python-zopfli"
	depends on LINGMO_INSTALL_LIBSTDCPP
	help
	  Zopfli module for python.

	  https://github.com/fonttools/py-zopfli

comment "python-zopfli needs a toolchain w/ C++"
	depends on !LINGMO_INSTALL_LIBSTDCPP
```

## package/python3/Config.in
```kconfig
comment "python3 needs a toolchain w/ wchar, threads, dynamic library"
	depends on LINGMO_USE_MMU
	depends on !LINGMO_USE_WCHAR || !LINGMO_TOOLCHAIN_HAS_THREADS || LINGMO_STATIC_LIBS

config LINGMO_PACKAGE_PYTHON3
	bool "python3"
	depends on LINGMO_USE_WCHAR
	# uses fork()
	depends on LINGMO_USE_MMU
	depends on LINGMO_TOOLCHAIN_HAS_THREADS # libffi
	depends on !LINGMO_STATIC_LIBS
	select LINGMO_PACKAGE_LIBFFI
	select LINGMO_PACKAGE_BLUEZ5_UTILS_HEADERS if LINGMO_PACKAGE_BLUEZ5_UTILS
	help
	  The python language interpreter.

	  http://www.python.org/

if LINGMO_PACKAGE_PYTHON3

choice
	prompt "python3 module format to install"
	default LINGMO_PACKAGE_PYTHON3_PYC_ONLY
	help
	  Select Python module format to install on target (py, pyc or
	  both)

config LINGMO_PACKAGE_PYTHON3_PY_ONLY
	bool ".py sources only"

config LINGMO_PACKAGE_PYTHON3_PYC_ONLY
	bool ".pyc compiled sources only"

config LINGMO_PACKAGE_PYTHON3_PY_PYC
	bool ".py sources and .pyc compiled"

endchoice

menu "core python3 modules"

comment "The following modules are unusual or require extra libraries"

config LINGMO_PACKAGE_PYTHON3_2TO3
	bool "2to3 module"
	help
	  code translation from python 2 to 3

config LINGMO_PACKAGE_PYTHON3_BERKELEYDB
	bool "berkeleydb"
	select LINGMO_PACKAGE_BERKELEYDB
	select LINGMO_PACKAGE_BERKELEYDB_DBM
	help
	  berkeleydb module for Python3

config LINGMO_PACKAGE_PYTHON3_BZIP2
	bool "bz2 module"
	select LINGMO_PACKAGE_BZIP2
	help
	  bzip2 module for Python3

config LINGMO_PACKAGE_PYTHON3_CODECSCJK
	bool "codecscjk module"
	help
	  Chinese/Japanese/Korean codecs module for Python (large).

config LINGMO_PACKAGE_PYTHON3_CURSES
	bool "curses module"
	select LINGMO_PACKAGE_NCURSES
	help
	  curses module for Python3.

config LINGMO_PACKAGE_PYTHON3_DECIMAL
	bool "decimal module"
	select LINGMO_PACKAGE_MPDECIMAL
	help
	  decimal module for Python3.

config LINGMO_PACKAGE_PYTHON3_OSSAUDIODEV
	bool "ossaudiodev module"
	help
	  ossaudiodev module for Python3.

config LINGMO_PACKAGE_PYTHON3_READLINE
	bool "readline"
	select LINGMO_PACKAGE_READLINE
	help
	  readline module for Python3 (required for command-line
	  editing in the Python shell).

config LINGMO_PACKAGE_PYTHON3_SSL
	bool "ssl"
	select LINGMO_PACKAGE_OPENSSL
	select LINGMO_PACKAGE_OPENSSL_FORCE_LIBOPENSSL
	select LINGMO_PACKAGE_LIBOPENSSL_ENABLE_BLAKE2
	help
	  _ssl module for Python3 (required for https in urllib etc).

config LINGMO_PACKAGE_PYTHON3_UNICODEDATA
	bool "unicodedata module"
	default y
	help
	  Unicode character database (used by stringprep module)
	  (large).

config LINGMO_PACKAGE_PYTHON3_SQLITE
	bool "sqlite module"
	select LINGMO_PACKAGE_SQLITE
	help
	  SQLite database support

config LINGMO_PACKAGE_PYTHON3_PYEXPAT
	bool "xml module"
	select LINGMO_PACKAGE_EXPAT
	help
	  pyexpat and xml libraries for Python3.

config LINGMO_PACKAGE_PYTHON3_XZ
	bool "xz module"
	select LINGMO_PACKAGE_XZ
	help
	  xz (a.k.a lzma) module for Python3

config LINGMO_PACKAGE_PYTHON3_ZLIB
	bool "zlib module"
	select LINGMO_PACKAGE_ZLIB
	help
	  zlib support in Python3

endmenu

endif
```

## package/python3/Config.in.host
```kconfig
config LINGMO_PACKAGE_HOST_PYTHON3
	bool "host python3"
	help
	  The python language interpreter. Host package.

	  http://www.python.org/

if LINGMO_PACKAGE_HOST_PYTHON3

config LINGMO_PACKAGE_HOST_PYTHON3_BZIP2
	bool "bzip2"
	help
	  bz2 module for host Python3.

config LINGMO_PACKAGE_HOST_PYTHON3_CURSES
	bool "curses"
	help
	  curses module for host Python3.

config LINGMO_PACKAGE_HOST_PYTHON3_SSL
	bool "ssl"
	select LINGMO_PACKAGE_HOST_OPENSSL
	help
	  _ssl module for host Python3.

endif
```

## package/qdecoder/Config.in
```kconfig
config LINGMO_PACKAGE_QDECODER
	bool "qdecoder"
	depends on !LINGMO_STATIC_LIBS
	help
	  qDecoder is a simple and powerful CGI library
	  for the C/C++ programming language.

	  http://wolkykim.github.io/qdecoder
```

## package/qemu/Config.in.host
```kconfig
config LINGMO_PACKAGE_HOST_QEMU_ARCH_SUPPORTS
	bool
	default y if LINGMO_arm
	default y if LINGMO_armeb
	default y if LINGMO_aarch64
	default y if LINGMO_i386
	default y if LINGMO_m68k
	default y if LINGMO_microblazeel
	default y if LINGMO_microblazebe
	default y if LINGMO_mips
	default y if LINGMO_mipsel
	default y if LINGMO_nios2
	default y if LINGMO_or1k
	default y if LINGMO_powerpc
	default y if LINGMO_powerpc64
	default y if LINGMO_powerpc64le
	default y if LINGMO_riscv
	default y if LINGMO_s390x
	default y if LINGMO_sh
	default y if LINGMO_sparc
	default y if LINGMO_sparc64
	default y if LINGMO_xtensa
	default y if LINGMO_x86_64
	depends on !LINGMO_x86_steamroller && !LINGMO_x86_core_avx2
	depends on !LINGMO_powerpc_620 && !LINGMO_powerpc_630

config LINGMO_PACKAGE_HOST_QEMU_SYSTEM_ARCH_SUPPORTS
	bool
	default y if LINGMO_PACKAGE_HOST_QEMU_ARCH_SUPPORTS
	default y if LINGMO_mips64
	default y if LINGMO_mips64el

config LINGMO_PACKAGE_HOST_QEMU_USER_ARCH_SUPPORTS
	bool
	default y if LINGMO_PACKAGE_HOST_QEMU_ARCH_SUPPORTS

comment "host-qemu needs a host gcc >= 8"
	depends on LINGMO_PACKAGE_HOST_QEMU_SYSTEM_ARCH_SUPPORTS || \
		LINGMO_PACKAGE_HOST_QEMU_USER_ARCH_SUPPORT
	depends on !LINGMO_HOST_GCC_AT_LEAST_8

config LINGMO_PACKAGE_HOST_QEMU
	bool "host qemu"
	depends on LINGMO_PACKAGE_HOST_QEMU_SYSTEM_ARCH_SUPPORTS || LINGMO_PACKAGE_HOST_QEMU_USER_ARCH_SUPPORTS
	depends on LINGMO_HOST_GCC_AT_LEAST_8
	select LINGMO_PACKAGE_HOST_QEMU_LINUX_USER_MODE \
		if !LINGMO_PACKAGE_HOST_QEMU_SYSTEM_MODE && LINGMO_PACKAGE_HOST_QEMU_USER_ARCH_SUPPORTS
	select LINGMO_PACKAGE_HOST_QEMU_SYSTEM_MODE \
		if !LINGMO_PACKAGE_HOST_QEMU_USER_ARCH_SUPPORTS
	help
	  QEMU is a generic and open source machine emulator and
	  virtualizer.

	  This option builds an emulator for your selected architecture.

	  http://www.qemu.org

if LINGMO_PACKAGE_HOST_QEMU

comment "Emulators selection"

config LINGMO_PACKAGE_HOST_QEMU_SYSTEM_MODE
	bool "Enable system emulation"
	depends on LINGMO_PACKAGE_HOST_QEMU_SYSTEM_ARCH_SUPPORTS
	help
	  Enables the build of the system emulator, which allows to
	  boot an entire system in Qemu.

config LINGMO_PACKAGE_HOST_QEMU_LINUX_USER_MODE
	bool "Enable Linux user-land emulation"
	depends on LINGMO_PACKAGE_HOST_QEMU_USER_ARCH_SUPPORTS
	help
	  Enables the build of the user-land emulator, which allows to
	  run user-space applications.

	  Note that system calls made by the emulated user-land are
	  serviced by the running host kernel. Therefore, if the
	  kernel headers used by your target are more recent than
	  the running host kernel, you may run into invalid system
	  calls, which may yield surprising effects.

config LINGMO_PACKAGE_HOST_QEMU_USER_MODE_ARGS
	string
	default "-cpu Nehalem,check=false" if LINGMO_x86_corei7

config LINGMO_PACKAGE_HOST_QEMU_VDE2
	bool "VDE2 support"
	help
	  Enables VDE2 support. VDE2 stands for Virtual Distributed
	  Ethernet and can be used to create virtual switches to
	  "plug" both physical and virtual machines in them.

config LINGMO_PACKAGE_HOST_QEMU_VIRTFS
	bool "Virtual filesystem support"
	depends on LINGMO_PACKAGE_HOST_QEMU_SYSTEM_MODE
	help
	  Enables support for virtual filesystem in Qemu allowing
	  shared filesystem between Qemu and its emulated target.

config LINGMO_PACKAGE_HOST_QEMU_USB
	bool "USB passthrough support"
	help
	  Enables USB passthrough support from guest to host.

endif
```

## package/qextserialport/Config.in
```kconfig
config LINGMO_PACKAGE_QEXTSERIALPORT
	bool "qextserialport"
	depends on LINGMO_PACKAGE_QT5
	help
	  A Qt library to manage serial ports

	  http://qextserialport.github.io/
```

## package/qjson/Config.in
```kconfig
config LINGMO_PACKAGE_QJSON
	bool "qjson"
	depends on LINGMO_PACKAGE_QT5
	help
	  QJson is a Qt-based library that maps JSON data to
	  QVariant objects and vice versa.

	  http://qjson.sourceforge.net
```

## package/qlibc/Config.in
```kconfig
config LINGMO_PACKAGE_QLIBC
	bool "qlibc"
	depends on LINGMO_TOOLCHAIN_HAS_THREADS
	depends on LINGMO_USE_WCHAR
	depends on !LINGMO_STATIC_LIBS
	select LINGMO_PACKAGE_LIBICONV if !LINGMO_ENABLE_LOCALE
	help
	  qLibc is currently one of the most functionally complete
	  public licensed C/C++ libraries. The C/C++ library which
	  includes all kinds of containers and general library
	  routines. It provides ready-made set of common container
	  APIs with consistant API look.

	  https://github.com/wolkykim/qlibc

comment "qlibc needs a toolchain w/ threads, wchar, dynamic library"
	depends on !LINGMO_TOOLCHAIN_HAS_THREADS || !LINGMO_USE_WCHAR || LINGMO_STATIC_LIBS
```

## package/qpdf/Config.in
```kconfig
config LINGMO_PACKAGE_QPDF
	bool "qpdf"
	depends on LINGMO_INSTALL_LIBSTDCPP
	depends on LINGMO_TOOLCHAIN_GCC_AT_LEAST_5 # C++14
	depends on LINGMO_TOOLCHAIN_HAS_ATOMIC
	select LINGMO_PACKAGE_ZLIB
	select LINGMO_PACKAGE_JPEG
	select LINGMO_PACKAGE_LIBOPENSSL_ENABLE_RC4 if LINGMO_PACKAGE_LIBOPENSSL
	help
	  QPDF is a command-line program that does structural,
	  content- preserving transformations on PDF files. It could
	  have been called something like pdf-to-pdf. It also provides
	  many useful capabilities to developers of PDF-producing
	  software or for people who just want to look at the innards
	  of a PDF file to learn more about how they work.

	  http://qpdf.sourceforge.net/

comment "qpdf needs a toolchain w/ C++, gcc >= 5"
	depends on LINGMO_TOOLCHAIN_HAS_ATOMIC
	depends on !LINGMO_INSTALL_LIBSTDCPP || \
		!LINGMO_TOOLCHAIN_GCC_AT_LEAST_5
```

## package/qpid-proton/Config.in
```kconfig
config LINGMO_PACKAGE_QPID_PROTON
	bool "qpid-proton"
	depends on LINGMO_INSTALL_LIBSTDCPP
	depends on !LINGMO_STATIC_LIBS # build a shared library
	depends on LINGMO_TOOLCHAIN_HAS_THREADS
	select LINGMO_PACKAGE_UTIL_LINUX
	select LINGMO_PACKAGE_UTIL_LINUX_LIBUUID
	help
	  The AMQP messaging toolkit

	  Qpid Proton is a high-performance, lightweight messaging
	  library. It can be used in the widest range of messaging
	  applications, including brokers, client libraries, routers,
	  bridges, proxies, and more.

	  https://qpid.apache.org/proton/

comment "qpid-proton needs a toolchain w/ C++, dynamic library, threads"
	depends on !LINGMO_INSTALL_LIBSTDCPP || LINGMO_STATIC_LIBS || \
		!LINGMO_TOOLCHAIN_HAS_THREADS
```

## package/qt-webkit-kiosk/Config.in
```kconfig
config LINGMO_PACKAGE_QT_WEBKIT_KIOSK
	bool "qt-webkit-kiosk"
	depends on LINGMO_PACKAGE_QT5
	depends on !LINGMO_STATIC_LIBS # qt5webkit
	depends on LINGMO_PACKAGE_QT5_JSCORE_AVAILABLE # qt5webkit
	depends on LINGMO_HOST_GCC_AT_LEAST_4_9 # qt5webkit -> icu
	depends on LINGMO_TOOLCHAIN_GCC_AT_LEAST_4_9 # qt5webkit -> icu
	depends on !LINGMO_BINFMT_FLAT # qt5webkit -> icu
	depends on !LINGMO_MIPS_SOFT_FLOAT # qt5webkit
	select LINGMO_PACKAGE_OPENSSL
	select LINGMO_PACKAGE_QT5BASE_GUI
	select LINGMO_PACKAGE_QT5BASE_WIDGETS
	select LINGMO_PACKAGE_QT5WEBKIT
	select LINGMO_PACKAGE_QT5MULTIMEDIA
	help
	  Simple kiosk-mode browser powered by Qt5Webkit

	  https://github.com/sergey-dryabzhinsky/qt-webkit-kiosk

if LINGMO_PACKAGE_QT_WEBKIT_KIOSK

config LINGMO_PACKAGE_QT_WEBKIT_KIOSK_SOUNDS
	bool "Install browser sound files"
	help
	  Deploy browser sound files on target

endif

comment "qt-webkit-kiosk needs a toolchain w/ dynamic library, gcc >= 4.9, host gcc >= 4.9"
	depends on LINGMO_STATIC_LIBS || !LINGMO_TOOLCHAIN_GCC_AT_LEAST_4_9 || \
		!LINGMO_HOST_GCC_AT_LEAST_4_9
	depends on LINGMO_PACKAGE_QT5_JSCORE_AVAILABLE
	depends on !LINGMO_BINFMT_FLAT
	depends on !LINGMO_MIPS_SOFT_FLOAT
```

## package/qt5/Config.in
```kconfig
config LINGMO_PACKAGE_QT5_GL_AVAILABLE
	bool
	default y
	depends on LINGMO_PACKAGE_HAS_LIBGL || LINGMO_PACKAGE_HAS_LIBGLES

config LINGMO_PACKAGE_QT5_JSCORE_AVAILABLE
	bool
	default y
	# Javascript engine is only available on certain architectures
	depends on LINGMO_arm || LINGMO_aarch64 || LINGMO_i386 || LINGMO_x86_64 || LINGMO_mipsel || LINGMO_arc
	# ARM needs BLX, so v5t+
	depends on !LINGMO_ARM_CPU_ARMV4

comment "Qt5 needs host g++ >= 5.0, and a toolchain w/ gcc >= 5.0, wchar, NPTL, C++, dynamic library"
	depends on !LINGMO_ARM_CPU_ARMV4
	depends on !LINGMO_INSTALL_LIBSTDCPP || !LINGMO_USE_WCHAR || \
		!LINGMO_TOOLCHAIN_HAS_THREADS_NPTL || LINGMO_STATIC_LIBS || \
		!LINGMO_HOST_GCC_AT_LEAST_5 || !LINGMO_TOOLCHAIN_GCC_AT_LEAST_5

menuconfig LINGMO_PACKAGE_QT5
	bool "Qt5"
	depends on LINGMO_INSTALL_LIBSTDCPP
	depends on LINGMO_USE_WCHAR
	depends on LINGMO_TOOLCHAIN_HAS_THREADS_NPTL
	depends on LINGMO_HOST_GCC_AT_LEAST_5 # Full C++11
	depends on LINGMO_TOOLCHAIN_GCC_AT_LEAST_5 # C++11, GCC_BUG_57694
	depends on !LINGMO_ARM_CPU_ARMV4 # needs ARMv5+
	depends on !LINGMO_STATIC_LIBS
	select LINGMO_PACKAGE_QT5BASE
	help
	  This option enables the Qt5 framework. Sub-options allow to
	  select which modules should be built.

	  http://qt.io

if LINGMO_PACKAGE_QT5
source "package/qt5/qt53d/Config.in"
source "package/qt5/qt5base/Config.in"
source "package/qt5/qt5charts/Config.in"
source "package/qt5/qt5coap/Config.in"
source "package/qt5/qt5connectivity/Config.in"
source "package/qt5/qt5declarative/Config.in"
source "package/qt5/qt5doc/Config.in"
source "package/qt5/qt5enginio/Config.in"
source "package/qt5/qt5graphicaleffects/Config.in"
source "package/qt5/qt5imageformats/Config.in"
source "package/qt5/qt5knx/Config.in"
source "package/qt5/qt5location/Config.in"
source "package/qt5/qt5lottie/Config.in"
source "package/qt5/qt5mqtt/Config.in"
source "package/qt5/qt5multimedia/Config.in"
source "package/qt5/qt5opcua/Config.in"
source "package/qt5/qt5quickcontrols/Config.in"
source "package/qt5/qt5quickcontrols2/Config.in"
source "package/qt5/qt5quicktimeline/Config.in"
source "package/qt5/qt5remoteobjects/Config.in"
source "package/qt5/qt5script/Config.in"
source "package/qt5/qt5scxml/Config.in"
source "package/qt5/qt5sensors/Config.in"
source "package/qt5/qt5serialbus/Config.in"
source "package/qt5/qt5serialport/Config.in"
source "package/qt5/qt5speech/Config.in"
source "package/qt5/qt5svg/Config.in"
source "package/qt5/qt5tools/Config.in"
source "package/qt5/qt5virtualkeyboard/Config.in"
source "package/qt5/qt5wayland/Config.in"
source "package/qt5/qt5webchannel/Config.in"
source "package/qt5/qt5webkit/Config.in"
source "package/qt5/qt5webengine/Config.in"
source "package/qt5/qt5webengine-chromium/Config.in"
source "package/qt5/qt5webengine-chromium-catapult/Config.in"
source "package/qt5/qt5websockets/Config.in"
source "package/qt5/qt5webview/Config.in"
source "package/qt5/qt5x11extras/Config.in"
source "package/qt5/qt5xmlpatterns/Config.in"
endif
```
