## package/python-typeguard/Config.in
```kconfig
config LINGMO_PACKAGE_PYTHON_TYPEGUARD
	bool "python-typeguard"
	help
	  Run-time type checker for Python.

	  https://github.com/agronholm/typeguard
```

## package/python-typepy/Config.in
```kconfig
config LINGMO_PACKAGE_PYTHON_TYPEPY
	bool "python-typepy"
	select LINGMO_PACKAGE_PYTHON_MBSTRDECODER # runtime
	help
	  A Python library for variable type
	  checker/validator/converter at a run time.

	  https://github.com/thombashi/typepy
```

## package/python-typing-inspect/Config.in
```kconfig
config LINGMO_PACKAGE_PYTHON_TYPING_INSPECT
	bool "python-typing-inspect"
	select LINGMO_PACKAGE_PYTHON_MYPY_EXTENSIONS # runtime
	help
	  Runtime inspection utilities for typing module.

	  https://github.com/ilevkivskyi/typing_inspect
```

## package/python-unittest-xml-reporting/Config.in
```kconfig
config LINGMO_PACKAGE_PYTHON_UNITTEST_XML_REPORTING
	bool "python-unittest-xml-reporting"
	select LINGMO_PACKAGE_PYTHON3_PYEXPAT
	help
	  unittest-based test runner with Ant/JUnit like XML
	  reporting.

	  http://github.com/xmlrunner/unittest-xml-reporting/
```

## package/python-urllib3/Config.in
```kconfig
config LINGMO_PACKAGE_PYTHON_URLLIB3
	bool "python-urllib3"
	select LINGMO_PACKAGE_PYTHON3_ZLIB # runtime
	help
	  Python HTTP library with thread-safe connection pooling, file
	  post support, sanity friendly, and more.

	  http://urllib3.readthedocs.org/
```

## package/python-uvicorn/Config.in
```kconfig
config LINGMO_PACKAGE_PYTHON_UVICORN
	bool "python-uvicorn"
	select LINGMO_PACKAGE_PYTHON_CLICK # runtime
	select LINGMO_PACKAGE_PYTHON_H11 # runtime
	select LINGMO_PACKAGE_PYTHON3_SSL # runtime
	help
	  The lightning-fast ASGI server.

	  https://www.uvicorn.org/
```

## package/python-uvloop/Config.in
```kconfig
config LINGMO_PACKAGE_PYTHON_UVLOOP
	bool "python-uvloop"
	depends on LINGMO_TOOLCHAIN_HAS_SYNC_4 # libuv
	depends on LINGMO_USE_MMU # libuv
	depends on !LINGMO_STATIC_LIBS # libuv
	depends on LINGMO_TOOLCHAIN_HAS_THREADS_NPTL # libuv
	depends on LINGMO_TOOLCHAIN_GCC_AT_LEAST_4_9 # libuv
	select LINGMO_PACKAGE_LIBUV
	select LINGMO_PACKAGE_PYTHON3_SSL
	help
	  Fast implementation of asyncio event loop on top of libuv.

	  http://github.com/MagicStack/uvloop

comment "python-uvloop needs a toolchain w/ NPTL, dynamic library, gcc >= 4.9"
	depends on !LINGMO_TOOLCHAIN_HAS_THREADS_NPTL || LINGMO_STATIC_LIBS \
		|| !LINGMO_TOOLCHAIN_GCC_AT_LEAST_4_9
	depends on LINGMO_TOOLCHAIN_HAS_SYNC_4
	depends on LINGMO_USE_MMU
```

## package/python-watchdog/Config.in
```kconfig
config LINGMO_PACKAGE_PYTHON_WATCHDOG
	bool "python-watchdog"
	select LINGMO_PACKAGE_PYTHON_ARGH # runtime
	select LINGMO_PACKAGE_PYTHON_PATHTOOLS # runtime
	select LINGMO_PACKAGE_PYTHON_PYYAML # runtime
	select LINGMO_PACKAGE_PYTHON_SETUPTOOLS # runtime
	help
	  Python API and shell utilities to monitor file system events.

	  http://github.com/gorakhargosh/watchdog
```

## package/python-weasyprint/Config.in
```kconfig
config LINGMO_PACKAGE_PYTHON_WEASYPRINT
	bool "python-weasyprint"
	depends on LINGMO_INSTALL_LIBSTDCPP # python-zopfli
	select LINGMO_PACKAGE_PYTHON_BROTLI # runtime
	select LINGMO_PACKAGE_PYTHON_CFFI # runtime
	select LINGMO_PACKAGE_PYTHON_CSSSELECT2 # runtime
	select LINGMO_PACKAGE_PYTHON_FONTTOOLS # runtime
	select LINGMO_PACKAGE_PYTHON_HTML5LIB # runtime
	select LINGMO_PACKAGE_PYTHON_PILLOW # runtime
	select LINGMO_PACKAGE_PYTHON_PYDYF # runtime
	select LINGMO_PACKAGE_PYTHON_PYPHEN # runtime
	select LINGMO_PACKAGE_PYTHON_TINYCSS2 # runtime
	select LINGMO_PACKAGE_PYTHON_ZOPFLI # runtime
	help
	  The Awesome Document Factory.

	  https://www.courtbouillon.org/weasyprint

comment "python-weasyprint needs a toolchain w/ C++"
	depends on !LINGMO_INSTALL_LIBSTDCPP
```

## package/python-web2py/Config.in
```kconfig
config LINGMO_PACKAGE_PYTHON_WEB2PY
	bool "python-web2py"
	select LINGMO_PACKAGE_PYTHON_PYDAL # runtime
	select LINGMO_PACKAGE_PYTHON3_ZLIB # runtime
	select LINGMO_PACKAGE_PYTHON3_PYEXPAT # runtime
	select LINGMO_PACKAGE_PYTHON3_SQLITE # runtime
	select LINGMO_PACKAGE_PYTHON_YATL # runtime
	help
	  web2py is a free open source full-stack framework for rapid
	  development of fast, scalable, secure and portable
	  database-driven web-based applications.

	  http://web2py.com

if LINGMO_PACKAGE_PYTHON_WEB2PY

config LINGMO_PACKAGE_PYTHON_WEB2PY_INSTALL_ADMIN
	bool "install admin panel application"
	default y
	help
	  This option install web2py admin panel application.
	  It can be removed to save space on embedded systems.

if LINGMO_PACKAGE_PYTHON_WEB2PY_INSTALL_ADMIN

config LINGMO_PACKAGE_PYTHON_WEB2PY_PASSWORD
	string "admin panel password"
	default web2py
	help
	  Set the admin panel password.

endif

endif
```

## package/python-webargs/Config.in
```kconfig
config LINGMO_PACKAGE_PYTHON_WEBARGS
	bool "python-webargs"
	select LINGMO_PACKAGE_PYTHON_MARSHMALLOW # runtime
	select LINGMO_PACKAGE_PYTHON_PACKAGING # runtime
	help
	  Declarative parsing and validation of HTTP request objects,
	  with built-in support for popular web frameworks, including
	  Flask, Django, Bottle, Tornado, Pyramid, Falcon, and
	  aiohttp.

	  https://github.com/marshmallow-code/webargs
```

## package/python-webob/Config.in
```kconfig
config LINGMO_PACKAGE_PYTHON_WEBOB
	bool "python-webob"
	select LINGMO_PACKAGE_PYTHON3_ZLIB # runtime
	help
	  WSGI request and response object.

	  http://webob.org/
```

## package/python-webpy/Config.in
```kconfig
config LINGMO_PACKAGE_PYTHON_WEBPY
	bool "python-webpy"
	select LINGMO_PACKAGE_PYTHON_CHEROOT # runtime
	select LINGMO_PACKAGE_PYTHON_MARKDOWN # runtime
	help
	  web.py is a web framework for Python that is as simple as it
	  is powerful.

	  http://webpy.org/
```

## package/python-websockets/Config.in
```kconfig
config LINGMO_PACKAGE_PYTHON_WEBSOCKETS
	bool "python-websockets"
	select LINGMO_PACKAGE_PYTHON3_ZLIB
	select LINGMO_PACKAGE_PYTHON3_SSL
	help
	  An implementation of the WebSocket Protocol (RFC 6455 &
	  7692).

	  https://github.com/aaugustin/websockets
```

## package/python-werkzeug/Config.in
```kconfig
config LINGMO_PACKAGE_PYTHON_WERKZEUG
	bool "python-werkzeug"
	select LINGMO_PACKAGE_PYTHON3_ZLIB # runtime
	help
	  Werkzeug is a WSGI utility library for Python. It's widely
	  used and BSD licensed.

	  http://werkzeug.pocoo.org/
```

## package/python-whoosh/Config.in
```kconfig
config LINGMO_PACKAGE_PYTHON_WHOOSH
	bool "python-whoosh"
	select LINGMO_PACKAGE_PYTHON3_ZLIB # runtime
	help
	  Whoosh is a fast, pure-Python full text indexing, search and
	  spell checking library.

	  https://pypi.python.org/pypi/Whoosh/
```

## package/python-wrapt/Config.in
```kconfig
config LINGMO_PACKAGE_PYTHON_WRAPT
	bool "python-wrapt"
	help
	  Module for decorators, wrappers and monkey patching.

	  https://github.com/GrahamDumpleton/wrapt
```

## package/python-wsproto/Config.in
```kconfig
config LINGMO_PACKAGE_PYTHON_WSPROTO
	bool "python-wsproto"
	select LINGMO_PACKAGE_PYTHON_H11 # runtime
	help
	  WebSockets state-machine based protocol implementation.

	  https://github.com/python-hyper/wsproto/
```

## package/python-wtforms/Config.in
```kconfig
config LINGMO_PACKAGE_PYTHON_WTFORMS
	bool "python-wtforms"
	select LINGMO_PACKAGE_PYTHON_MARKUPSAFE # runtime
	help
	  A flexible forms validation and rendering library for
	  Python web development.

	  https://wtforms.readthedocs.io/
```

## package/python-xlrd/Config.in
```kconfig
config LINGMO_PACKAGE_PYTHON_XLRD
	bool "python-xlrd"
	select LINGMO_PACKAGE_PYTHON3_PYEXPAT
	select LINGMO_PACKAGE_PYTHON3_ZLIB
	help
	  Library for developers to extract data from Microsoft
	  Excel(tm) spreadsheet files.

	  http://www.python-excel.org/
```

## package/python-xlsxwriter/Config.in
```kconfig
config LINGMO_PACKAGE_PYTHON_XLSXWRITER
	bool "python-xlsxwriter"
	select LINGMO_PACKAGE_PYTHON3_ZLIB
	help
	  A Python module for creating Excel XLSX files.

	  https://github.com/jmcnamara/XlsxWriter
```

## package/python-xlutils/Config.in
```kconfig
config LINGMO_PACKAGE_PYTHON_XLUTILS
	bool "python-xlutils"
	select LINGMO_PACKAGE_PYTHON_XLRD # runtime
	select LINGMO_PACKAGE_PYTHON_XLWT # runtime
	help
	  Utilities for working with Excel files that require both
	  xlrd and xlwt.

	  http://www.python-excel.org
```

## package/python-xmltodict/Config.in
```kconfig
config LINGMO_PACKAGE_PYTHON_XMLTODICT
	bool "python-xmltodict"
	select LINGMO_PACKAGE_PYTHON3_PYEXPAT # runtime
	help
	  Makes working with XML feel like you are working with JSON.

	  https://github.com/martinblech/xmltodict
```

## package/python-yarl/Config.in
```kconfig
config LINGMO_PACKAGE_PYTHON_YARL
	bool "python-yarl"
	select LINGMO_PACKAGE_PYTHON_MULTIDICT
	select LINGMO_PACKAGE_PYTHON_IDNA
	help
	  Yet another URL library.

	  http://yarl.readthedocs.io/
```

## package/python-yatl/Config.in
```kconfig
config LINGMO_PACKAGE_PYTHON_YATL
	bool "python-yatl"
	help
	  Yet Another Template Language.

	  https://github.com/web2py/yatl
```
