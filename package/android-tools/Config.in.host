## package/atest/Config.in
```kconfig
config LINGMO_PACKAGE_ATEST
	bool "atest"
	depends on LINGMO_TOOLCHAIN_HAS_THREADS # alsa-lib
	select LINGMO_PACKAGE_ALSA_LIB
	select LINGMO_PACKAGE_LIBEV
	help
	  atest is a test software for checking ALSA Asoc drivers
	  concerning the proper frame generation and capture.

	  https://github.com/amouiche/atest

comment "atest needs a toolchain w/ threads"
	depends on !LINGMO_TOOLCHAIN_HAS_THREADS
```

## package/atf/Config.in
```kconfig
config LINGMO_PACKAGE_ATF
	bool "atf"
	depends on LINGMO_INSTALL_LIBSTDCPP
	depends on LINGMO_USE_MMU # fork()
	help
	  ATF, or Automated Testing Framework, is a collection of
	  libraries to write test programs in C, C++ and POSIX shell.

	  https://github.com/jmmv/atf

comment "atf needs a toolchain w/ C++"
	depends on !LINGMO_INSTALL_LIBSTDCPP
	depends on LINGMO_USE_MMU
```

## package/atkmm/Config.in
```kconfig
config LINGMO_PACKAGE_ATKMM
	bool "atkmm (latest)"
	depends on LINGMO_INSTALL_LIBSTDCPP # glibmm
	depends on LINGMO_TOOLCHAIN_GCC_AT_LEAST_7 # libsigc
	depends on LINGMO_TOOLCHAIN_HAS_THREADS # at-spi2-core/glibmm -> libglib2
	depends on LINGMO_USE_MMU # at-spi2-core/glibmm -> libglib2
	depends on LINGMO_USE_WCHAR # at-spi2-core/glibmm -> libglib2
	select LINGMO_PACKAGE_AT_SPI2_CORE
	select LINGMO_PACKAGE_GLIBMM
	select LINGMO_PACKAGE_LIBSIGC

	help
	  The atkmm package is a set of C++ bindings for Atk.

	  http://www.gtkmm.org/

comment "atkmm needs a toolchain w/ C++, wchar, threads, gcc >= 7"
	depends on LINGMO_USE_MMU
	depends on !LINGMO_TOOLCHAIN_GCC_AT_LEAST_7 || !LINGMO_USE_WCHAR \
		|| !LINGMO_INSTALL_LIBSTDCPP || !LINGMO_TOOLCHAIN_HAS_THREADS
```

## package/atkmm2_28/Config.in
```kconfig
config LINGMO_PACKAGE_ATKMM2_28
	bool "atkmm (2.28.x)"
	depends on LINGMO_INSTALL_LIBSTDCPP # glibmm
	depends on LINGMO_TOOLCHAIN_GCC_AT_LEAST_4_9 # C++11
	depends on LINGMO_TOOLCHAIN_HAS_THREADS # at-spi2-core/glibmm -> libglib2
	depends on LINGMO_USE_MMU # at-spi2-core/glibmm -> libglib2
	depends on LINGMO_USE_WCHAR # at-spi2-core/glibmm -> libglib2
	select LINGMO_PACKAGE_AT_SPI2_CORE
	select LINGMO_PACKAGE_GLIBMM2_66
	select LINGMO_PACKAGE_LIBSIGC2

	help
	  The atkmm package is a set of C++ bindings for Atk.

	  This is the last version before the API and ABI change
	  introduced in 2.36.0 which requires C++17.

	  http://www.gtkmm.org/

comment "atkmm (2.28.x) needs a toolchain w/ C++, wchar, threads, gcc >= 4.9"
	depends on LINGMO_USE_MMU
	depends on !LINGMO_TOOLCHAIN_GCC_AT_LEAST_4_9 || !LINGMO_USE_WCHAR \
		|| !LINGMO_INSTALL_LIBSTDCPP || !LINGMO_TOOLCHAIN_HAS_THREADS
```

## package/atop/Config.in
```kconfig
config LINGMO_PACKAGE_ATOP
	bool "atop"
	depends on LINGMO_USE_MMU # fork()
	depends on LINGMO_USE_WCHAR # ncurses wchar
	depends on LINGMO_TOOLCHAIN_HEADERS_AT_LEAST_3_14 # PERF_FLAG_FD_CLOEXEC
	select LINGMO_PACKAGE_NCURSES
	select LINGMO_PACKAGE_NCURSES_WCHAR
	select LINGMO_PACKAGE_ZLIB
	help
	  Atop is an ASCII full-screen performance monitor for Linux
	  that is capable of reporting the activity of all processes
	  (even if processes have finished during the interval), daily
	  logging of system and process activity for long-term analysis,
	  highlighting overloaded system resources by using colors, etc.
	  At regular intervals, it shows system-level activity related
	  to the CPU, memory, swap, disks (including LVM) and network
	  layers, and for every process (and thread) it shows e.g. the
	  CPU utilization, memory growth, disk utilization, priority,
	  username, state, and exit code.

	  http://www.atoptool.nl

comment "atop needs a toolchain w/ wchar, headers >= 3.14"
	depends on LINGMO_USE_MMU
	depends on !LINGMO_USE_WCHAR || \
		!LINGMO_TOOLCHAIN_HEADERS_AT_LEAST_3_14
```

## package/audit/Config.in
```kconfig
# audit has some builtin per-architecture system call tables
config LINGMO_PACKAGE_AUDIT_ARCH_SUPPORTS
	bool
	default y if LINGMO_aarch64 || LINGMO_arm || LINGMO_armeb || \
		LINGMO_i386 || LINGMO_powerpc || LINGMO_powerpc64 || \
		LINGMO_x86_64

config LINGMO_PACKAGE_AUDIT
	bool "audit"
	depends on LINGMO_PACKAGE_AUDIT_ARCH_SUPPORTS
	depends on LINGMO_TOOLCHAIN_HAS_THREADS
	depends on !LINGMO_STATIC_LIBS
	help
	  The audit package contains the user space utilities for
	  storing and searching the audit records generated by
	  the audit subsystem in the Linux 2.6 kernel

	  Note: The z/OS remote plugin is disabled in this package

	  http://people.redhat.com/sgrubb/audit/

comment "audit needs a toolchain w/ threads, dynamic library"
	depends on !LINGMO_TOOLCHAIN_HAS_THREADS || LINGMO_STATIC_LIBS
	depends on LINGMO_PACKAGE_AUDIT_ARCH_SUPPORTS
```

## package/aufs-util/Config.in
```kconfig
comment "aufs-util needs a linux kernel and a toolchain w/ threads"
	depends on LINGMO_USE_MMU
	depends on !LINGMO_LINUX_KERNEL || !LINGMO_TOOLCHAIN_HAS_THREADS

config LINGMO_PACKAGE_AUFS_UTIL
	bool "aufs-util"
	depends on LINGMO_USE_MMU
	depends on LINGMO_LINUX_KERNEL
	depends on LINGMO_TOOLCHAIN_HAS_THREADS
	help
	  Aufs command line utilities.

	  Needs a kernel with aufs support. A kernel
	  extension package is available.

	  http://sourceforge.net/p/aufs/aufs-util/

if LINGMO_PACKAGE_AUFS_UTIL

config LINGMO_PACKAGE_AUFS_UTIL_VERSION
	string "aufs-util version"
	default ""
	help
	  The version you choose must match that of the aufs support
	  in your kernel. Usually, this is aufs3.x for 3.x kernels and
	  aufs4.x for 4.x kernels.

	  Usually, the sha1 of the cset you want to use; avoid using a
	  branch name as this yields non-reproducible builds.

	  See the following resources to see what versions are
	  available:

	  https://sourceforge.net/p/aufs/aufs-util/ci/master/tree/

endif
```
