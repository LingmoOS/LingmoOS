## package/android-tools/Config.in.host
```kconfig
config LINGMO_PACKAGE_HOST_ANDROID_TOOLS
	bool "host android-tools"
	select LINGMO_PACKAGE_HOST_ANDROID_TOOLS_ADB if \
		!LINGMO_PACKAGE_HOST_ANDROID_TOOLS_FASTBOOT
	help
	  This package contains the fastboot and adb utilities, that
	  can be used to interact with target devices using of these
	  protocols.

if LINGMO_PACKAGE_HOST_ANDROID_TOOLS

config LINGMO_PACKAGE_HOST_ANDROID_TOOLS_FASTBOOT
	bool "fastboot"
	depends on LINGMO_HOST_GCC_AT_LEAST_5 # host-libselinux -> host-libsepol
	help
	  This option will build and install the fastboot utility for
	  the host, which can be used to reflash target devices
	  implementing the fastboot protocol.

comment "fastboot needs a toolchain w/ host gcc >= 5"
	depends on !LINGMO_HOST_GCC_AT_LEAST_5

config LINGMO_PACKAGE_HOST_ANDROID_TOOLS_ADB
	bool "adb"
	help
	  This option will build and install the adb utility for the
	  host, which can be used to interact with target devices
	  implementing the ADB protocol.

config LINGMO_PACKAGE_HOST_ANDROID_TOOLS_EXT4_UTILS
	bool "ext4 utils"
	depends on LINGMO_HOST_GCC_AT_LEAST_5 # host-libselinux -> host-libsepol
	help
	  This option will build and install the ext4 utils for the
	  host, i.e. make_ext4fs, ext4fixup, ext2simg, img2simg,
	  simg2img and simg2simg.

comment "ext4 utils needs a toolchain w/ host gcc >= 5"
	depends on !LINGMO_HOST_GCC_AT_LEAST_5

endif
```

## package/angularjs/Config.in
```kconfig
config LINGMO_PACKAGE_ANGULARJS
	bool "angularjs"
	help
	  AngularJS web application framework.

	  http://angularjs.org
```

## package/aoetools/Config.in
```kconfig
config LINGMO_PACKAGE_AOETOOLS
	bool "aoetools"
	depends on LINGMO_TOOLCHAIN_HAS_THREADS
	help
	  The aoetools are programs for users of the ATA over Ethernet
	  (AoE) network storage protocol, a simple protocol for using
	  storage over an ethernet LAN.

	  http://aoetools.sourceforge.net/

comment "aoetools needs a toolchain w/ threads"
	depends on !LINGMO_TOOLCHAIN_HAS_THREADS
```

## package/apache/Config.in
```kconfig
config LINGMO_PACKAGE_APACHE
	bool "apache"
	depends on !LINGMO_STATIC_LIBS
	depends on LINGMO_TOOLCHAIN_HAS_THREADS
	depends on LINGMO_USE_MMU # apr
	select LINGMO_PACKAGE_APR_UTIL
	select LINGMO_PACKAGE_PCRE2
	help
	  The Apache HTTP Server Project is an effort to develop and
	  maintain an open-source HTTP server for modern operating
	  systems including UNIX and Windows NT. The goal of this
	  project is to provide a secure, efficient and extensible
	  server that provides HTTP services in sync with the current
	  HTTP standards.

	  https://httpd.apache.org

if LINGMO_PACKAGE_APACHE

choice
	prompt "Multi-Processing Module (MPM)"
	default LINGMO_PACKAGE_APACHE_MPM_WORKER
	help
	  Select the Multi-Processing Module (MPM).

config LINGMO_PACKAGE_APACHE_MPM_EVENT
	bool "event"
	help
	  A variant of the worker MPM with the goal of consuming threads
	  only for connections with active processing

config LINGMO_PACKAGE_APACHE_MPM_PREFORK
	bool "prefork"
	help
	  Implements a non-threaded, pre-forking web server

config LINGMO_PACKAGE_APACHE_MPM_WORKER
	bool "worker"
	help
	  Implements a hybrid multi-threaded multi-process web server

endchoice

endif

comment "apache needs a toolchain w/ dynamic library, threads"
	depends on LINGMO_USE_MMU
	depends on LINGMO_STATIC_LIBS || !LINGMO_TOOLCHAIN_HAS_THREADS
```

## package/apcupsd/Config.in
```kconfig
config LINGMO_PACKAGE_APCUPSD
	bool "apcupsd"
	depends on LINGMO_INSTALL_LIBSTDCPP
	depends on LINGMO_TOOLCHAIN_HAS_THREADS
	depends on LINGMO_USE_MMU # fork()
	help
	  A daemon for controlling APC UPSes.

	  http://www.apcupsd.org/

if LINGMO_PACKAGE_APCUPSD

config LINGMO_PACKAGE_APCUPSD_APCSMART
	bool "apcsmart"
	help
	  Compile APC SmartUPS serial driver

config LINGMO_PACKAGE_APCUPSD_DUMB
	bool "dumb"
	help
	  Compile dumb UPS driver

config LINGMO_PACKAGE_APCUPSD_MODBUS
	bool "modbus"
	help
	  Compile MODBUS driver code

config LINGMO_PACKAGE_APCUPSD_MODBUS_USB
	bool "modbus usb"
	depends on LINGMO_TOOLCHAIN_HAS_THREADS # libusb
	depends on LINGMO_TOOLCHAIN_GCC_AT_LEAST_4_9 # libusb
	select LINGMO_PACKAGE_LIBUSB
	select LINGMO_PACKAGE_LIBUSB_COMPAT
	select LINGMO_PACKAGE_APCUPSD_MODBUS
	help
	  Compile MODBUS/USB driver code

comment "modbus usb support needs a toolchain w/ threads, gcc >= 4.9"
	depends on !LINGMO_TOOLCHAIN_HAS_THREADS || \
		!LINGMO_TOOLCHAIN_GCC_AT_LEAST_4_9

config LINGMO_PACKAGE_APCUPSD_NET
	bool "net"
	help
	  Compile networking driver for slaves

config LINGMO_PACKAGE_APCUPSD_PCNET
	bool "pcnet"
	help
	  Compile PCNET driver code

config LINGMO_PACKAGE_APCUPSD_SNMP
	bool "snmp"
	help
	  Compile SNMP driver

config LINGMO_PACKAGE_APCUPSD_USB
	bool "usb"
	depends on LINGMO_TOOLCHAIN_HAS_THREADS # libusb
	depends on LINGMO_TOOLCHAIN_GCC_AT_LEAST_4_9 # libusb
	select LINGMO_PACKAGE_LIBUSB
	select LINGMO_PACKAGE_LIBUSB_COMPAT
	help
	  Compile USB UPS code

comment "usb support needs a toolchain w/ threads, gcc >= 4.9"
	depends on !LINGMO_TOOLCHAIN_HAS_THREADS || \
		!LINGMO_TOOLCHAIN_GCC_AT_LEAST_4_9

endif

comment "apcupsd needs a toolchain w/ C++, threads"
	depends on LINGMO_USE_MMU
	depends on !LINGMO_INSTALL_LIBSTDCPP || !LINGMO_TOOLCHAIN_HAS_THREADS
```

## package/apg/Config.in
```kconfig
config LINGMO_PACKAGE_APG
	bool "apg"
	help
	  Automated Password Generator (APG).

	  https://github.com/wilx/apg
```

## package/apitrace/Config.in
```kconfig
comment "apitrace needs a toolchain w/ C++, wchar, dynamic library, threads, gcc >= 7"
	depends on LINGMO_USE_MMU
	depends on !LINGMO_INSTALL_LIBSTDCPP || !LINGMO_USE_WCHAR || \
		LINGMO_STATIC_LIBS || !LINGMO_TOOLCHAIN_HAS_THREADS || \
		!LINGMO_TOOLCHAIN_GCC_AT_LEAST_7

config LINGMO_PACKAGE_APITRACE
	bool "apitrace"
	depends on LINGMO_USE_MMU # fork()
	depends on LINGMO_USE_WCHAR
	depends on LINGMO_INSTALL_LIBSTDCPP
	depends on !LINGMO_STATIC_LIBS # dlfcn.h
	depends on LINGMO_TOOLCHAIN_GCC_AT_LEAST_7 # C++17
	depends on LINGMO_TOOLCHAIN_HAS_THREADS
	select LINGMO_PACKAGE_XLIB_LIBX11 if LINGMO_PACKAGE_XORG7
	select LINGMO_PACKAGE_LIBPNG
	help
	  Trace and replay OpenGL and OpenGL ES APIs calls to/from a
	  file. You may install apitrace GUI from your distribution to
	  inspect generated traces.

	  http://apitrace.github.io/
```

## package/apparmor/Config.in
```kconfig
config LINGMO_PACKAGE_APPARMOR
	bool "apparmor"
	depends on LINGMO_USE_MMU # fork()
	depends on LINGMO_INSTALL_LIBSTDCPP
	depends on LINGMO_TOOLCHAIN_HAS_SYNC_4 # libapparmor
	depends on LINGMO_TOOLCHAIN_HAS_THREADS # libapparmor
	depends on LINGMO_TOOLCHAIN_HEADERS_AT_LEAST_3_16 # libapparmor
	select LINGMO_PACKAGE_LIBAPPARMOR
	help
	  AppArmor is an effective and easy-to-use Linux application
	  security system. AppArmor proactively protects the operating
	  system and applications from external or internal threats,
	  even zero-day attacks, by enforcing good behavior and
	  preventing even unknown application flaws from being
	  exploited.

	  This package builds the parser (which can load profiles).

	  http://wiki.apparmor.net

if LINGMO_PACKAGE_APPARMOR

config LINGMO_PACKAGE_APPARMOR_BINUTILS
	bool "binutils"
	help
	  A set of utilities (written in C):
	    aa-enabled    aa-exec

comment "utils need python3"
	depends on !LINGMO_PACKAGE_PYTHON3

config LINGMO_PACKAGE_APPARMOR_UTILS
	bool "utils"
	depends on LINGMO_PACKAGE_PYTHON3
	select LINGMO_PACKAGE_BUSYBOX_SHOW_OTHERS # net-tools
	select LINGMO_PACKAGE_NET_TOOLS # runtime (aa-unconfined)
	select LINGMO_PACKAGE_PYTHON3_READLINE
	help
	  A set of utilities (written in python):
	    aa-audit          aa-disable      aa-logprof
	    aa-autodep        aa-easyprof     aa-mergeprof
	    aa-cleanprof      aa-enforce      aa-status
	    aa-complain       aa-genprof      aa-unconfined

if LINGMO_PACKAGE_APPARMOR_UTILS

comment "utils (extras) need bash and perl, and busybox or gawk"
	depends on !LINGMO_PACKAGE_BASH || !LINGMO_PACKAGE_PERL \
		|| !(LINGMO_PACKAGE_BUSYBOX || LINGMO_PACKAGE_GAWK)

config LINGMO_PACKAGE_APPARMOR_UTILS_EXTRA
	bool "utils (extras)"
	depends on LINGMO_PACKAGE_BASH
	depends on LINGMO_PACKAGE_PERL
	depends on LINGMO_PACKAGE_BUSYBOX || LINGMO_PACKAGE_GAWK
	help
	  An extra set of utilities (written in a mixture of sh,
	  bash, perl, and awk):
	    aa-decode          (bash + perl)
	    aa-notify          (perl)
	    aa-remove-unknown  (sh + awk)

endif # LINGMO_PACKAGE_APPARMOR_UTILS

config LINGMO_PACKAGE_APPARMOR_PROFILES
	bool "profiles"
	help
	  Installs server-class profiles for a wide range of
	  usual programs and daemons.

endif # LINGMO_PACKAGE_APPARMOR

comment "apparmor needs a toolchain w/ headers >= 3.16, threads, C++"
	depends on LINGMO_USE_MMU
	depends on LINGMO_TOOLCHAIN_HAS_SYNC_4
	depends on !LINGMO_INSTALL_LIBSTDCPP || !LINGMO_TOOLCHAIN_HAS_THREADS \
		|| !LINGMO_TOOLCHAIN_HEADERS_AT_LEAST_3_16
```

## package/apr-util/Config.in
```kconfig
config LINGMO_PACKAGE_APR_UTIL
	bool "apr-util"
	# apr really needs shared library support
	depends on !LINGMO_STATIC_LIBS
	depends on LINGMO_USE_MMU # apr
	select LINGMO_PACKAGE_APR
	select LINGMO_PACKAGE_EXPAT
	help
	  The utility library for the apache runtime project

	  https://apr.apache.org

comment "apr-util needs a toolchain w/ dynamic library"
	depends on LINGMO_USE_MMU
	depends on LINGMO_STATIC_LIBS
```

## package/apr/Config.in
```kconfig
config LINGMO_PACKAGE_APR
	bool "apr"
	# apr really needs shared library support
	depends on !LINGMO_STATIC_LIBS
	depends on LINGMO_USE_MMU # fork() in apr_proc_fork()
	help
	  The mission of the Apache Portable Runtime (APR) project is to
	  create and maintain software libraries that provide a
	  predictable and consistent interface to underlying
	  platform-specific implementations

	  https://apr.apache.org

comment "apr needs a toolchain w/ dynamic library"
	depends on LINGMO_USE_MMU
	depends on LINGMO_STATIC_LIBS
```

## package/argp-standalone/Config.in
```kconfig
config LINGMO_PACKAGE_ARGP_STANDALONE
	bool "argp-standalone"
	# glibc provides its own argp implementation.
	depends on !LINGMO_TOOLCHAIN_USES_GLIBC
	help
	  Glibc hierarchical argument parsing standalone library.

	  https://github.com/ericonr/argp-standalone/
```

## package/argus/Config.in
```kconfig
config LINGMO_PACKAGE_ARGUS
	bool "argus"
	depends on LINGMO_TOOLCHAIN_HAS_THREADS
	depends on LINGMO_USE_MMU # fork()
	select LINGMO_PACKAGE_LIBPCAP
	select LINGMO_PACKAGE_LIBTIRPC if !LINGMO_TOOLCHAIN_HAS_NATIVE_RPC
	help
	  A Real Time Flow Monitor-based audit engine.

	  http://qosient.com/argus/

comment "argus needs a toolchain w/ threads"
	depends on !LINGMO_TOOLCHAIN_HAS_THREADS
	depends on LINGMO_USE_MMU
```

## package/armadillo/Config.in
```kconfig
comment "armadillo needs a toolchain w/ C++"
	depends on LINGMO_PACKAGE_OPENBLAS_ARCH_SUPPORTS
	depends on !LINGMO_INSTALL_LIBSTDCPP

comment "armadillo needs a toolchain w/ fortran, C++"
	depends on !LINGMO_PACKAGE_OPENBLAS_ARCH_SUPPORTS # otherwise, see comment above
	depends on LINGMO_PACKAGE_LAPACK_ARCH_SUPPORTS
	depends on !LINGMO_TOOLCHAIN_HAS_FORTRAN || !LINGMO_INSTALL_LIBSTDCPP

config LINGMO_PACKAGE_ARMADILLO
	bool "armadillo"
	depends on LINGMO_PACKAGE_OPENBLAS_ARCH_SUPPORTS || \
		(LINGMO_PACKAGE_LAPACK_ARCH_SUPPORTS && LINGMO_TOOLCHAIN_HAS_FORTRAN)
	depends on LINGMO_INSTALL_LIBSTDCPP
	help
	  Armadillo: An Open Source C++ Linear Algebra Library for
	  Fast Prototyping and Computationally Intensive Experiments.

	  http://arma.sourceforge.net/

if LINGMO_PACKAGE_ARMADILLO

choice
	prompt "BLAS implementation"

config LINGMO_PACKAGE_ARMADILLO_OPENBLAS
	bool "openblas"
	depends on LINGMO_PACKAGE_OPENBLAS_ARCH_SUPPORTS
	select LINGMO_PACKAGE_OPENBLAS

config LINGMO_PACKAGE_ARMADILLO_LAPACK
	bool "lapack"
	depends on LINGMO_PACKAGE_LAPACK_ARCH_SUPPORTS && LINGMO_TOOLCHAIN_HAS_FORTRAN
	select LINGMO_PACKAGE_LAPACK

endchoice

endif
```

## package/arp-scan/Config.in
```kconfig
config LINGMO_PACKAGE_ARP_SCAN
	bool "arp-scan"
	select LINGMO_PACKAGE_LIBPCAP
	help
	  The ARP scanner

	  arp-scan is a command-line tool that uses the ARP protocol to
	  discover and fingerprint IP hosts on the local network.

	  https://github.com/royhills/arp-scan

if LINGMO_PACKAGE_ARP_SCAN

config LINGMO_PACKAGE_ARP_SCAN_DATA
	bool "install data (OUI)"
	default y  # legacy
	help
	  Say 'y' here (the default) to install the data along the
	  binaries.

endif # LINGMO_PACKAGE_ARP_SCAN
```

## package/ascii-invaders/Config.in
```kconfig
config LINGMO_PACKAGE_ASCII_INVADERS
	bool "ascii_invaders"
	select LINGMO_PACKAGE_NCURSES
	help
	  An ASCII-art game like Space Invaders using ncurses.

	  https://github.com/macdice/ascii-invaders
```

## package/assimp/Config.in
```kconfig
config LINGMO_PACKAGE_ASSIMP
	bool "assimp"
	depends on LINGMO_INSTALL_LIBSTDCPP
	depends on LINGMO_USE_WCHAR
	depends on LINGMO_TOOLCHAIN_GCC_AT_LEAST_7
	select LINGMO_PACKAGE_ZLIB
	select LINGMO_PACKAGE_ZLIB_FORCE_LIBZLIB
	help
	  Open Asset Import Library (assimp) is a portable Open Source
	  library to import various well-known 3D model formats in a
	  uniform manner. The most recent version also knows how to
	  export 3d files and is therefore suitable as a general-purpose
	  3D model converter.

	  http://www.assimp.org

comment "assimp needs a toolchain w/ C++, wchar, gcc >= 7"
	depends on !LINGMO_INSTALL_LIBSTDCPP || !LINGMO_USE_WCHAR \
		|| !LINGMO_TOOLCHAIN_GCC_AT_LEAST_7
```

## package/asterisk/Config.in
```kconfig
config LINGMO_PACKAGE_ASTERISK
	bool "asterisk"
	depends on LINGMO_INSTALL_LIBSTDCPP
	depends on !LINGMO_STATIC_LIBS # dlfcn.h
	depends on !LINGMO_TOOLCHAIN_USES_MUSL
	depends on LINGMO_USE_MMU # libedit
	depends on LINGMO_TOOLCHAIN_HAS_THREADS
	depends on LINGMO_USE_WCHAR # libedit
	select LINGMO_PACKAGE_JANSSON
	select LINGMO_PACKAGE_LIBCURL
	select LINGMO_PACKAGE_LIBEDIT
	select LINGMO_PACKAGE_LIBILBC
	select LINGMO_PACKAGE_LIBXML2
	select LINGMO_PACKAGE_SQLITE
	select LINGMO_PACKAGE_UTIL_LINUX
	select LINGMO_PACKAGE_UTIL_LINUX_LIBUUID
	help
	  Asterisk is an open source framework for building
	  communications applications. Asterisk turns an ordinary
	  computer into a communications server. Asterisk powers IP PBX
	  systems, VoIP gateways, conference servers and other custom
	  solutions. It is used by small businesses, large businesses,
	  call centers, carriers and government agencies, worldwide.
	  Asterisk is free and open source.

	  http://www.asterisk.org/

comment "asterisk needs a glibc or uClibc toolchain w/ C++, dynamic library, threads, wchar"
	depends on LINGMO_USE_MMU
	depends on LINGMO_TOOLCHAIN_USES_MUSL || !LINGMO_INSTALL_LIBSTDCPP \
		|| LINGMO_STATIC_LIBS || !LINGMO_TOOLCHAIN_HAS_THREADS \
		|| !LINGMO_USE_WCHAR
```

## package/at-spi2-core/Config.in
```kconfig
config LINGMO_PACKAGE_AT_SPI2_CORE
	bool "at-spi2-core"
	depends on LINGMO_TOOLCHAIN_HAS_THREADS # dbus, glib2
	depends on LINGMO_USE_MMU # glib2
	depends on LINGMO_USE_WCHAR # glib2
	depends on !LINGMO_STATIC_LIBS # dlopen()
	select LINGMO_PACKAGE_DBUS
	select LINGMO_PACKAGE_LIBGLIB2
	select LINGMO_PACKAGE_LIBXML2
	select LINGMO_PACKAGE_XLIB_LIBXTST if LINGMO_PACKAGE_XORG7 # optionally for X11
	help
	  The At-Spi2 Core package is a part of the GNOME
	  Accessibility Project. It provides a Service Provider
	  Interface for the Assistive Technologies available on the
	  GNOME platform and a library against which applications
	  can be linked.

	  https://wiki.gnome.org/Accessibility

comment "at-spi2-core needs a toolchain w/ dynamic library, wchar, threads"
	depends on LINGMO_USE_MMU
	depends on LINGMO_STATIC_LIBS || !LINGMO_USE_WCHAR || !LINGMO_TOOLCHAIN_HAS_THREADS
```
