## package/python-lxml/Config.in
```kconfig
config LINGMO_PACKAGE_PYTHON_LXML
	bool "python-lxml"
	select LINGMO_PACKAGE_LIBXML2
	select LINGMO_PACKAGE_LIBXSLT
	select LINGMO_PACKAGE_PYTHON3_ZLIB
	help
	  The lxml XML toolkit is a Pythonic binding for the C libraries
	  libxml2 and libxslt.

	  http://lxml.de/
```

## package/python-m2crypto/Config.in
```kconfig
config LINGMO_PACKAGE_PYTHON_M2CRYPTO
	bool "python-m2crypto"
	select LINGMO_PACKAGE_OPENSSL
	select LINGMO_PACKAGE_PYTHON3_PYEXPAT # runtime
	select LINGMO_PACKAGE_PYTHON3_SSL # runtime
	help
	  M2Crypto: A Python crypto and SSL toolkit.

	  https://gitlab.com/m2crypto/m2crypto
```

## package/python-magic-wormhole/Config.in
```kconfig
config LINGMO_PACKAGE_PYTHON_MAGIC_WORMHOLE
	bool "python-magic-wormhole"
	depends on LINGMO_PACKAGE_HOST_RUSTC_TARGET_ARCH_SUPPORTS # python-cryptography
	select LINGMO_PACKAGE_PYTHON_ATTRS # runtime
	select LINGMO_PACKAGE_PYTHON_AUTOBAHN # runtime
	select LINGMO_PACKAGE_PYTHON_AUTOMAT # runtime
	select LINGMO_PACKAGE_PYTHON_CLICK # runtime
	select LINGMO_PACKAGE_PYTHON_CRYPTOGRAPHY # runtime
	select LINGMO_PACKAGE_PYTHON_HUMANIZE # runtime
	select LINGMO_PACKAGE_PYTHON_PYNACL # runtime
	select LINGMO_PACKAGE_PYTHON_SIX # runtime
	select LINGMO_PACKAGE_PYTHON_SPAKE2 # runtime
	select LINGMO_PACKAGE_PYTHON_TQDM # runtime
	select LINGMO_PACKAGE_PYTHON_TWISTED # runtime
	select LINGMO_PACKAGE_PYTHON_TXTORCON # runtime
	help
	  Securely transfer data between computers.

	  This package provides a library and a command-line tool
	  named "wormhole", which makes it possible to get
	  arbitrary-sized files and directories (or short pieces of
	  text) from one computer to another. The two endpoints are
	  identified by using identical "wormhole codes": in general,
	  the sending machine generates and displays the code, which
	  must then be typed into the receiving machine.

	  https://github.com/magic-wormhole/magic-wormhole
```

## package/python-mako/Config.in
```kconfig
config LINGMO_PACKAGE_PYTHON_MAKO
	bool "python-mako"
	select LINGMO_PACKAGE_PYTHON_MARKUPSAFE # runtime
	help
	  Mako is a template library written in Python. It provides a
	  familiar, non-XML syntax which compiles into Python modules
	  for maximum performance.

	  https://pypi.python.org/pypi/Mako

if LINGMO_PACKAGE_PYTHON_MAKO

config LINGMO_PACKAGE_PYTHON_MAKO_EXT_PYGMENTPLUGIN
	bool "mako extension pygmentplugin"
	select LINGMO_PACKAGE_PYTHON_PYGMENTS # runtime
	help
	  Provide python-pygments support for
	  mako.ext.pygmentplugin

config LINGMO_PACKAGE_PYTHON_MAKO_EXT_BABELPLUGIN
	bool "mako extension babelplugin"
	select LINGMO_PACKAGE_PYTHON_BABEL # runtime
	help
	  Provide python-babel support for
	  mako.ext.babelplugin

endif
```

## package/python-marshmallow-sqlalchemy/Config.in
```kconfig
config LINGMO_PACKAGE_PYTHON_MARSHMALLOW_SQLALCHEMY
	bool "python-marshmallow-sqlalchemy"
	select LINGMO_PACKAGE_PYTHON_MARSHMALLOW # runtime
	select LINGMO_PACKAGE_PYTHON_PACKAGING # runtime
	select LINGMO_PACKAGE_PYTHON_SQLALCHEMY # runtime
	help
	  SQLAlchemy integration with the marshmallow
	  (de)serialization library.

	  https://github.com/marshmallow-code/marshmallow-sqlalchemy
```

## package/python-matplotlib/Config.in
```kconfig
config LINGMO_PACKAGE_PYTHON_MATPLOTLIB
	bool "python-matplotlib"
	depends on LINGMO_INSTALL_LIBSTDCPP
	depends on LINGMO_PACKAGE_PYTHON_NUMPY_ARCH_SUPPORTS
	depends on LINGMO_TOOLCHAIN_USES_GLIBC || LINGMO_TOOLCHAIN_USES_MUSL # python-numpy
	depends on LINGMO_TOOLCHAIN_GCC_AT_LEAST_9 # python-numpy
	depends on LINGMO_HOST_GCC_AT_LEAST_9 # host-python-numpy
	select LINGMO_PACKAGE_FREETYPE # runtime
	select LINGMO_PACKAGE_LIBPNG # runtime
	select LINGMO_PACKAGE_PYTHON_CERTIFI # runtime
	select LINGMO_PACKAGE_PYTHON_CONTOURPY # runtime
	select LINGMO_PACKAGE_PYTHON_CYCLER
	select LINGMO_PACKAGE_PYTHON_PYBIND
	select LINGMO_PACKAGE_PYTHON_SETUPTOOLS # runtime
	select LINGMO_PACKAGE_PYTHON_DATEUTIL # runtime
	select LINGMO_PACKAGE_PYTHON_KIWISOLVER # runtime
	select LINGMO_PACKAGE_PYTHON_NUMPY # runtime
	select LINGMO_PACKAGE_PYTHON_PILLOW # runtime
	select LINGMO_PACKAGE_PYTHON_PYPARSING # runtime
	select LINGMO_PACKAGE_PYTHON3_ZLIB # runtime
	select LINGMO_PACKAGE_QHULL
	select LINGMO_PACKAGE_ZLIB # runtime
	help
	  Matplotlib strives to produce publication quality 2D
	  graphics for interactive graphing, scientific publishing,
	  user interface development and web application servers
	  targeting multiple user interfaces and hardcopy output
	  formats.

	  https://matplotlib.org/

if LINGMO_PACKAGE_PYTHON_MATPLOTLIB

config LINGMO_PACKAGE_PYTHON_MATPLOTLIB_QT
	bool "qt display"
	depends on LINGMO_PACKAGE_QT5 # python-pyqt5
	select LINGMO_PACKAGE_PYTHON_PYQT5
	select LINGMO_PACKAGE_QT5BASE_FONTCONFIG
	select LINGMO_PACKAGE_QT5BASE_WIDGETS

endif

comment "python-matplotlib needs a glibc or musl toolchain w/ C++, gcc >= 9, host gcc >= 9"
	depends on !(LINGMO_TOOLCHAIN_USES_GLIBC || LINGMO_TOOLCHAIN_USES_MUSL) || \
		!LINGMO_INSTALL_LIBSTDCPP || !LINGMO_HOST_GCC_AT_LEAST_9 || \
		!LINGMO_TOOLCHAIN_GCC_AT_LEAST_9
```

## package/python-mbstrdecoder/Config.in
```kconfig
config LINGMO_PACKAGE_PYTHON_MBSTRDECODER
	bool "python-mbstrdecoder"
	select LINGMO_PACKAGE_PYTHON_CHARDET # runtime
	help
	  multi-byte character string decoder.

	  https://github.com/thombashi/mbstrdecoder
```

## package/python-memory-profiler/Config.in
```kconfig
config LINGMO_PACKAGE_PYTHON_MEMORY_PROFILER
	bool "python-memory-profiler"
	select LINGMO_PACKAGE_PYTHON_PSUTIL # runtime
	help
	  A module for monitoring memory usage of a python program.

	  https://github.com/pythonprofilers/memory_profiler
```

## package/python-minimalmodbus/Config.in
```kconfig
config LINGMO_PACKAGE_PYTHON_MINIMALMODBUS
	bool "python-minimalmodbus"
	select LINGMO_PACKAGE_PYTHON_SERIAL # runtime
	help
	  Easy-to-use Modbus RTU and Modbus ASCII implementation.

	  https://minimalmodbus.readthedocs.io/
```

## package/python-ml-dtypes/Config.in
```kconfig
config LINGMO_PACKAGE_PYTHON_ML_DTYPES
	bool "python-ml-dtypes"
	depends on LINGMO_PACKAGE_PYTHON_NUMPY_ARCH_SUPPORTS
	depends on LINGMO_INSTALL_LIBSTDCPP # python-numpy
	depends on LINGMO_TOOLCHAIN_USES_GLIBC || LINGMO_TOOLCHAIN_USES_MUSL # python-numpy
	depends on LINGMO_TOOLCHAIN_GCC_AT_LEAST_9 # python-numpy
	depends on LINGMO_HOST_GCC_AT_LEAST_9 # host-python-numpy
	select LINGMO_PACKAGE_PYTHON_NUMPY
	help
	  ml_dtypes is a stand-alone implementation of several NumPy
	  dtype extensions used in machine learning libraries.

	  https://github.com/jax-ml/ml_dtypes

comment "python-ml-dtypes needs a glibc or musl toolchain w/ C++, gcc >= 9"
	depends on LINGMO_PACKAGE_PYTHON_NUMPY_ARCH_SUPPORTS
	depends on !LINGMO_INSTALL_LIBSTDCPP || \
		!LINGMO_TOOLCHAIN_GCC_AT_LEAST_9 || \
		!(LINGMO_TOOLCHAIN_USES_GLIBC || LINGMO_TOOLCHAIN_USES_MUSL)
```

## package/python-modbus-tk/Config.in
```kconfig
config LINGMO_PACKAGE_PYTHON_MODBUS_TK
	bool "python-modbus-tk"
	select LINGMO_PACKAGE_PYTHON_SERIAL # runtime
	help
	  Implementation of modbus protocol in python.

	  https://github.com/ljean/modbus-tk/
```

## package/python-munch/Config.in
```kconfig
config LINGMO_PACKAGE_PYTHON_MUNCH
	bool "python-munch"
	select LINGMO_PACKAGE_PYTHON_SETUPTOOLS # runtime
	select LINGMO_PACKAGE_PYTHON_SIX # runtime
	help
	  Munch is a dictionary that supports attribute-style access,
	  a la JavaScript.

	  https://github.com/Infinidat/munch
```

## package/python-mwclient/Config.in
```kconfig
config LINGMO_PACKAGE_PYTHON_MWCLIENT
	bool "python-mwclient"
	select LINGMO_PACKAGE_PYTHON_REQUESTS_OAUTHLIB # runtime
	select LINGMO_PACKAGE_PYTHON_SIX # runtime
	help
	  Python client library to interface with the MediaWiki API

	  https://github.com/mwclient/mwclient
```

## package/python-mwscrape/Config.in
```kconfig
config LINGMO_PACKAGE_PYTHON_MWSCRAPE
	bool "python-mwscrape"
	select LINGMO_PACKAGE_PYTHON_COUCHDB # runtime
	select LINGMO_PACKAGE_PYTHON_MWCLIENT # runtime
	select LINGMO_PACKAGE_PYTHON_PYLRU # runtime
	help
	  Download rendered articles from MediaWiki API to CouchDB

	  https://github.com/itkach/mwscrape
```

## package/python-mwscrape2slob/Config.in
```kconfig
config LINGMO_PACKAGE_PYTHON_MWSCRAPE2SLOB
	bool "python-mwscrape2slob"
	depends on !LINGMO_BINFMT_FLAT # python-slob -> python-pyicu -> icu
	depends on LINGMO_HOST_GCC_AT_LEAST_4_9 # python-slob -> python-pyicu -> icu
	depends on LINGMO_INSTALL_LIBSTDCPP # python-slob -> python-pyicu -> icu
	depends on LINGMO_TOOLCHAIN_GCC_AT_LEAST_4_9 # python-slob -> python-pyicu -> icu
	select LINGMO_PACKAGE_PYTHON_COUCHDB # runtime
	select LINGMO_PACKAGE_PYTHON_CSSSELECT # runtime
	select LINGMO_PACKAGE_PYTHON_CSSUTILS # runtime
	select LINGMO_PACKAGE_PYTHON_LXML # runtime
	select LINGMO_PACKAGE_PYTHON_SLOB # runtime
	help
	  A tool to create slob with content from a MediaWiki CouchDB
	  created by mwscrape.

	  https://github.com/itkach/mwscrape2slob

comment "python-mwscrape2slob needs a toolchain w/ C++, gcc >= 4.9, host gcc >= 4.9"
	depends on !LINGMO_INSTALL_LIBSTDCPP || \
		!LINGMO_TOOLCHAIN_GCC_AT_LEAST_4_9 || \
		!LINGMO_HOST_GCC_AT_LEAST_4_9
```

## package/python-networkmanager/Config.in
```kconfig
config LINGMO_PACKAGE_PYTHON_NETWORKMANAGER
	bool "python-networkmanager"
	depends on LINGMO_PACKAGE_NETWORK_MANAGER # runtime
	depends on LINGMO_USE_WCHAR # dbus-python
	depends on LINGMO_TOOLCHAIN_HAS_THREADS # dbus-python
	depends on LINGMO_PACKAGE_DBUS # dbus-python
	select LINGMO_PACKAGE_DBUS_PYTHON # runtime
	select LINGMO_PACKAGE_PYTHON_SIX # runtime
	help
	  python-networkmanager wraps NetworkManagers D-Bus interface
	  so you can be less verbose when talking to NetworkManager
	  from python. All interfaces have been wrapped in classes,
	  properties are exposed as python properties and function
	  calls are forwarded to the correct interface.

	  https://pypi.python.org/pypi/python-networkmanager/
```

## package/python-numpy/Config.in
```kconfig
config LINGMO_PACKAGE_PYTHON_NUMPY_ARCH_SUPPORTS
	bool
	# Numpy has some CPU specific code
	default y if LINGMO_arc
	default y if LINGMO_aarch64
	default y if LINGMO_arm
	default y if LINGMO_armeb
	default y if LINGMO_i386
	default y if LINGMO_mips
	default y if LINGMO_mipsel
	default y if LINGMO_powerpc
	default y if LINGMO_powerpc64
	default y if LINGMO_sh
	default y if LINGMO_x86_64

config LINGMO_PACKAGE_PYTHON_NUMPY
	bool "python-numpy"
	depends on LINGMO_PACKAGE_PYTHON_NUMPY_ARCH_SUPPORTS
	depends on LINGMO_INSTALL_LIBSTDCPP
	# python-numpy needs fenv.h which is not provided by uclibc
	depends on LINGMO_TOOLCHAIN_USES_GLIBC || LINGMO_TOOLCHAIN_USES_MUSL
	depends on LINGMO_TOOLCHAIN_GCC_AT_LEAST_9
	help
	  NumPy is the fundamental package for scientific computing
	  with Python.

	  Note that NumPy needs fenv.h fully supported by the
	  C library.

	  http://www.numpy.org/

comment "python-numpy needs a glibc or musl toolchain w/ C++, gcc >= 9"
	depends on LINGMO_PACKAGE_PYTHON_NUMPY_ARCH_SUPPORTS
	depends on !LINGMO_INSTALL_LIBSTDCPP || \
		!LINGMO_TOOLCHAIN_GCC_AT_LEAST_9 || \
		!(LINGMO_TOOLCHAIN_USES_GLIBC || LINGMO_TOOLCHAIN_USES_MUSL)
```

## package/python-opcua-asyncio/Config.in
```kconfig
config LINGMO_PACKAGE_PYTHON_OPCUA_ASYNCIO
	bool "python-opcua-asyncio"
	depends on LINGMO_PACKAGE_HOST_RUSTC_TARGET_ARCH_SUPPORTS # python-cryptography
	select LINGMO_PACKAGE_PYTHON_AIOFILES # runtime
	select LINGMO_PACKAGE_PYTHON_AIOSQLITE # runtime
	select LINGMO_PACKAGE_PYTHON_CRYPTOGRAPHY # runtime
	select LINGMO_PACKAGE_PYTHON_DATEUTIL # runtime
	select LINGMO_PACKAGE_PYTHON_PYTZ # runtime
	select LINGMO_PACKAGE_PYTHON_SORTEDCONTAINERS # runtime
	select LINGMO_PACKAGE_PYTHON_PYOPENSSL # runtime
	help
	  opcua-asyncio is an asyncio-based asynchronous
	  OPC UA client based on python-opcua, removing
	  hacks for support of python < 3.6.

	  https://github.com/FreeOpcUa/opcua-asyncio
```

## package/python-outcome/Config.in
```kconfig
config LINGMO_PACKAGE_PYTHON_OUTCOME
	bool "python-outcome"
	select LINGMO_PACKAGE_PYTHON_ATTRS # runtime
	help
	  Capture the outcome of Python function calls.

	  https://github.com/python-trio/outcome
```

## package/python-paramiko/Config.in
```kconfig
config LINGMO_PACKAGE_PYTHON_PARAMIKO
	bool "python-paramiko"
	depends on LINGMO_PACKAGE_HOST_RUSTC_TARGET_ARCH_SUPPORTS # python-cryptography, python-bcrypt
	select LINGMO_PACKAGE_PYTHON_BCRYPT # runtime
	select LINGMO_PACKAGE_PYTHON_CRYPTOGRAPHY # runtime
	select LINGMO_PACKAGE_PYTHON_PYNACL # runtime
	select LINGMO_PACKAGE_PYTHON3_ZLIB # runtime
	help
	  SSH2 protocol library.

	  https://github.com/paramiko/paramiko/
```

## package/python-pip/Config.in
```kconfig
config LINGMO_PACKAGE_PYTHON_PIP
	bool "python-pip"
	select LINGMO_PACKAGE_PYTHON_SETUPTOOLS # runtime
	select LINGMO_PACKAGE_PYTHON3_SSL
	help
	  The PyPA recommended tool for installing Python packages.

	  https://pip.pypa.io/
```

## package/python-prompt-toolkit/Config.in
```kconfig
config LINGMO_PACKAGE_PYTHON_PROMPT_TOOLKIT
	bool "python-prompt-toolkit"
	select LINGMO_PACKAGE_PYTHON_WCWIDTH # runtime
	select LINGMO_PACKAGE_PYTHON3_PYEXPAT # runtime
	help
	  Library for building powerful interactive command lines in
	  Python.

	  https://github.com/prompt-toolkit/python-prompt-toolkit
```

## package/python-protobuf/Config.in
```kconfig
config LINGMO_PACKAGE_PYTHON_PROTOBUF
	bool "python-protobuf"
	# host-protobuf only builds on certain architectures
	depends on LINGMO_PACKAGE_HOST_PROTOBUF_ARCH_SUPPORTS
	select LINGMO_PACKAGE_PYTHON_SIX # runtime
	help
	  Python implementation of the Google Protocol Buffers.

	  Protocol buffers are Google's language-neutral,
	  platform-neutral, extensible mechanism for serializing
	  structured data.

	  https://developers.google.com/protocol-buffers
```

## package/python-pudb/Config.in
```kconfig
config LINGMO_PACKAGE_PYTHON_PUDB
	bool "python-pudb"
	select LINGMO_PACKAGE_PYTHON_PACKAGING # runtime
	select LINGMO_PACKAGE_PYTHON_URWID # runtime
	select LINGMO_PACKAGE_PYTHON_URWID_READLINE # runtime
	select LINGMO_PACKAGE_PYTHON_JEDI # runtime
	select LINGMO_PACKAGE_PYTHON_PYGMENTS # runtime
	select LINGMO_PACKAGE_PYTHON3_CURSES # runtime
	help
	  A full-screen, console-based Python debugger.

	  https://github.com/inducer/pudb
```

## package/python-pyalsa/Config.in
```kconfig
config LINGMO_PACKAGE_PYTHON_PYALSA
	bool "python-pyalsa"
	depends on LINGMO_TOOLCHAIN_HAS_THREADS
	select LINGMO_PACKAGE_ALSA_LIB
	select LINGMO_PACKAGE_ALSA_LIB_HWDEP
	select LINGMO_PACKAGE_ALSA_LIB_MIXER
	select LINGMO_PACKAGE_ALSA_LIB_RAWMIDI
	select LINGMO_PACKAGE_ALSA_LIB_SEQ
	help
	  Official ALSA Python binding, including hardware
	  management, mixer and sequencer control.

	  http://www.alsa-project.org/

comment "python-pyalsa needs a toolchain w/ threads"
	depends on !LINGMO_TOOLCHAIN_HAS_THREADS
```
