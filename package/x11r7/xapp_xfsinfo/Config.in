## package/x11r7/xapp_xfsinfo/Config.in
```kconfig
config LINGMO_PACKAGE_XAPP_XFSINFO
	bool "xfsinfo"
	select LINGMO_PACKAGE_XLIB_LIBFS
	select LINGMO_PACKAGE_XLIB_LIBX11
	help
	  X font server information utility
```

## package/x11r7/xapp_xgamma/Config.in
```kconfig
config LINGMO_PACKAGE_XAPP_XGAMMA
	bool "xgamma"
	select LINGMO_PACKAGE_XLIB_LIBXXF86VM
	help
	  Alter a monitor's gamma correction through the X server
```

## package/x11r7/xapp_xgc/Config.in
```kconfig
config LINGMO_PACKAGE_XAPP_XGC
	bool "xgc"
	select LINGMO_PACKAGE_XLIB_LIBXAW
	help
	  X graphics demo
```

## package/x11r7/xapp_xhost/Config.in
```kconfig
config LINGMO_PACKAGE_XAPP_XHOST
	bool "xhost"
	select LINGMO_PACKAGE_XLIB_LIBX11
	select LINGMO_PACKAGE_XLIB_LIBXMU
	help
	  Controls host and/or user access to a running X server.
```

## package/x11r7/xapp_xinit/Config.in
```kconfig
config LINGMO_PACKAGE_XAPP_XINIT
	bool "xinit"
	depends on LINGMO_USE_MMU # fork()
	# Runtime dependency: can't start an X server unless there is one
	depends on LINGMO_PACKAGE_XSERVER_XORG_SERVER
	# Runtime dependency; mcookie is also in util-linux
	select LINGMO_PACKAGE_MCOOKIE if !LINGMO_PACKAGE_UTIL_LINUX
	select LINGMO_PACKAGE_XAPP_XAUTH
	select LINGMO_PACKAGE_XLIB_LIBX11
	help
	  X Window System initializer
```

## package/x11r7/xapp_xinput-calibrator/Config.in
```kconfig
config LINGMO_PACKAGE_XAPP_XINPUT_CALIBRATOR
	bool "xinput-calibrator"
	depends on LINGMO_INSTALL_LIBSTDCPP
	select LINGMO_PACKAGE_XLIB_LIBX11
	select LINGMO_PACKAGE_XLIB_LIBXI
	help
	  A generic touchscreen calibration program for X.Org.

	  http://www.freedesktop.org/wiki/Software/xinput_calibrator

comment "xinput-calibrator needs a toolchain w/ C++"
	depends on !LINGMO_INSTALL_LIBSTDCPP
```

## package/x11r7/xapp_xinput/Config.in
```kconfig
config LINGMO_PACKAGE_XAPP_XINPUT
	bool "xinput"
	select LINGMO_PACKAGE_XLIB_LIBX11
	select LINGMO_PACKAGE_XLIB_LIBXI
	select LINGMO_PACKAGE_XLIB_LIBXRANDR
	select LINGMO_PACKAGE_XLIB_LIBXINERAMA
	help
	  xinput
```

## package/x11r7/xapp_xkbcomp/Config.in
```kconfig
config LINGMO_PACKAGE_XAPP_XKBCOMP
	bool "xkbcomp"
	select LINGMO_PACKAGE_XLIB_LIBX11
	select LINGMO_PACKAGE_XLIB_LIBXKBFILE
	help
	  compile XKB keyboard description
```

## package/x11r7/xapp_xkbevd/Config.in
```kconfig
config LINGMO_PACKAGE_XAPP_XKBEVD
	bool "xkbevd"
	depends on LINGMO_USE_MMU # fork()
	select LINGMO_PACKAGE_XLIB_LIBXKBFILE
	help
	  XKB event daemon
```

## package/x11r7/xapp_xkbprint/Config.in
```kconfig
config LINGMO_PACKAGE_XAPP_XKBPRINT
	bool "xkbprint"
	select LINGMO_PACKAGE_XLIB_LIBXKBFILE
	help
	  print an XKB keyboard description
```

## package/x11r7/xapp_xkbutils/Config.in
```kconfig
config LINGMO_PACKAGE_XAPP_XKBUTILS
	bool "xkbutils"
	select LINGMO_PACKAGE_XLIB_LIBXAW
	select LINGMO_PACKAGE_XLIB_LIBXKBFILE
	help
	  X.Org xkbutils application
```

## package/x11r7/xapp_xkill/Config.in
```kconfig
config LINGMO_PACKAGE_XAPP_XKILL
	bool "xkill"
	select LINGMO_PACKAGE_XLIB_LIBX11
	select LINGMO_PACKAGE_XLIB_LIBXMU
	help
	  kill a client by its X resource
```

## package/x11r7/xapp_xload/Config.in
```kconfig
config LINGMO_PACKAGE_XAPP_XLOAD
	bool "xload"
	select LINGMO_PACKAGE_XLIB_LIBXAW
	help
	  system load average display for X
```

## package/x11r7/xapp_xlogo/Config.in
```kconfig
config LINGMO_PACKAGE_XAPP_XLOGO
	bool "xlogo"
	select LINGMO_PACKAGE_XLIB_LIBXAW
	select LINGMO_PACKAGE_XLIB_LIBXRENDER
	select LINGMO_PACKAGE_XLIB_LIBXFT
	help
	  X Window System logo
```

## package/x11r7/xapp_xlsatoms/Config.in
```kconfig
config LINGMO_PACKAGE_XAPP_XLSATOMS
	bool "xlsatoms"
	select LINGMO_PACKAGE_XLIB_LIBX11
	select LINGMO_PACKAGE_XLIB_LIBXMU
	help
	  list interned atoms defined on server
```

## package/x11r7/xapp_xlsclients/Config.in
```kconfig
config LINGMO_PACKAGE_XAPP_XLSCLIENTS
	bool "xlsclients"
	select LINGMO_PACKAGE_XLIB_LIBX11
	select LINGMO_PACKAGE_XLIB_LIBXMU
	select LINGMO_PACKAGE_LIBXCB
	select LINGMO_PACKAGE_XCB_UTIL
	help
	  X.Org xlsclients application
```

## package/x11r7/xapp_xlsfonts/Config.in
```kconfig
config LINGMO_PACKAGE_XAPP_XLSFONTS
	bool "xlsfonts"
	select LINGMO_PACKAGE_XLIB_LIBX11
	help
	  X.Org xlsfonts application
```

## package/x11r7/xapp_xmag/Config.in
```kconfig
config LINGMO_PACKAGE_XAPP_XMAG
	bool "xmag"
	select LINGMO_PACKAGE_XLIB_LIBXAW
	help
	  X.Org xmag application
```

## package/x11r7/xapp_xman/Config.in
```kconfig
config LINGMO_PACKAGE_XAPP_XMAN
	bool "xman"
	select LINGMO_PACKAGE_XLIB_LIBXAW
	help
	  Manual page display program for the X Window System
```

## package/x11r7/xapp_xmessage/Config.in
```kconfig
config LINGMO_PACKAGE_XAPP_XMESSAGE
	bool "xmessage"
	select LINGMO_PACKAGE_XLIB_LIBXAW
	help
	  display a message or query in a window (X-based /bin/echo)
```

## package/x11r7/xapp_xmh/Config.in
```kconfig
config LINGMO_PACKAGE_XAPP_XMH
	bool "xmh"
	depends on LINGMO_USE_MMU # fork()
	select LINGMO_PACKAGE_XLIB_LIBXAW
	select LINGMO_PACKAGE_XDATA_XBITMAPS
	help
	  send and read mail with an X interface to MH
```

## package/x11r7/xapp_xmodmap/Config.in
```kconfig
config LINGMO_PACKAGE_XAPP_XMODMAP
	bool "xmodmap"
	select LINGMO_PACKAGE_XLIB_LIBX11
	help
	  utility for modifying keymaps and pointer button mappings in X
```

## package/x11r7/xapp_xmore/Config.in
```kconfig
config LINGMO_PACKAGE_XAPP_XMORE
	bool "xmore"
	select LINGMO_PACKAGE_XLIB_LIBXAW
	help
	  plain text display program for the X Window System
```

## package/x11r7/xapp_xpr/Config.in
```kconfig
config LINGMO_PACKAGE_XAPP_XPR
	bool "xpr"
	select LINGMO_PACKAGE_XLIB_LIBX11
	select LINGMO_PACKAGE_XLIB_LIBXMU
	help
	  X.Org xpr application
```

## package/x11r7/xapp_xprop/Config.in
```kconfig
config LINGMO_PACKAGE_XAPP_XPROP
	bool "xprop"
	select LINGMO_PACKAGE_XLIB_LIBX11
	select LINGMO_PACKAGE_XLIB_LIBXMU
	help
	  property displayer for X
```
