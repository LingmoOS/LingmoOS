## package/x11r7/xapp_xrandr/Config.in
```kconfig
config LINGMO_PACKAGE_XAPP_XRANDR
	bool "xrandr"
	select LINGMO_PACKAGE_XLIB_LIBXRANDR
	select LINGMO_PACKAGE_XLIB_LIBX11
	help
	  primitive command line interface to RandR extension
```

## package/x11r7/xapp_xrdb/Config.in
```kconfig
config LINGMO_PACKAGE_XAPP_XRDB
	bool "xrdb"
	select LINGMO_PACKAGE_XLIB_LIBX11
	select LINGMO_PACKAGE_XLIB_LIBXMU
	help
	  X server resource database utility
```

## package/x11r7/xapp_xrefresh/Config.in
```kconfig
config LINGMO_PACKAGE_XAPP_XREFRESH
	bool "xrefresh"
	select LINGMO_PACKAGE_XLIB_LIBX11
	help
	  refresh all or part of an X screen
```

## package/x11r7/xapp_xset/Config.in
```kconfig
config LINGMO_PACKAGE_XAPP_XSET
	bool "xset"
	select LINGMO_PACKAGE_XLIB_LIBXMU
	help
	  X.Org xset application
```

## package/x11r7/xapp_xsetmode/Config.in
```kconfig
config LINGMO_PACKAGE_XAPP_XSETMODE
	bool "xsetmode"
	select LINGMO_PACKAGE_XLIB_LIBX11
	select LINGMO_PACKAGE_XLIB_LIBXI
	help
	  set the mode for an X Input device
```

## package/x11r7/xapp_xsetpointer/Config.in
```kconfig
config LINGMO_PACKAGE_XAPP_XSETPOINTER
	bool "xsetpointer"
	select LINGMO_PACKAGE_XLIB_LIBX11
	select LINGMO_PACKAGE_XLIB_LIBXI
	select LINGMO_PACKAGE_XORGPROTO
	help
	  set an X Input device as the main pointer
```

## package/x11r7/xapp_xsetroot/Config.in
```kconfig
config LINGMO_PACKAGE_XAPP_XSETROOT
	bool "xsetroot"
	select LINGMO_PACKAGE_XLIB_LIBX11
	select LINGMO_PACKAGE_XLIB_LIBXMU
	select LINGMO_PACKAGE_XLIB_LIBXCURSOR
	select LINGMO_PACKAGE_XDATA_XBITMAPS
	help
	  X.Org xsetroot application
```

## package/x11r7/xapp_xsm/Config.in
```kconfig
config LINGMO_PACKAGE_XAPP_XSM
	bool "xsm"
	depends on LINGMO_USE_MMU # fork()
	select LINGMO_PACKAGE_XLIB_LIBXAW
	help
	  X Session Manager
```

## package/x11r7/xapp_xstdcmap/Config.in
```kconfig
config LINGMO_PACKAGE_XAPP_XSTDCMAP
	bool "xstdcmap"
	select LINGMO_PACKAGE_XLIB_LIBX11
	select LINGMO_PACKAGE_XLIB_LIBXMU
	help
	  X standard colormap utility
```

## package/x11r7/xapp_xvidtune/Config.in
```kconfig
config LINGMO_PACKAGE_XAPP_XVIDTUNE
	bool "xvidtune"
	select LINGMO_PACKAGE_XLIB_LIBXAW
	select LINGMO_PACKAGE_XLIB_LIBXXF86VM
	help
	  video mode tuner for Xorg
```

## package/x11r7/xapp_xvinfo/Config.in
```kconfig
config LINGMO_PACKAGE_XAPP_XVINFO
	bool "xvinfo"
	select LINGMO_PACKAGE_XLIB_LIBX11
	select LINGMO_PACKAGE_XLIB_LIBXV
	help
	  Print out X-Video extension adaptor information
```

## package/x11r7/xapp_xwd/Config.in
```kconfig
config LINGMO_PACKAGE_XAPP_XWD
	bool "xwd"
	select LINGMO_PACKAGE_XLIB_LIBX11
	select LINGMO_PACKAGE_XLIB_LIBXKBFILE
	select LINGMO_PACKAGE_XLIB_LIBXMU
	help
	  dump an image of an X window
```

## package/x11r7/xapp_xwininfo/Config.in
```kconfig
config LINGMO_PACKAGE_XAPP_XWININFO
	bool "xwininfo"
	select LINGMO_PACKAGE_XLIB_LIBX11
	select LINGMO_PACKAGE_XLIB_LIBXMU
	help
	  window information utility for X
```

## package/x11r7/xcb-util-cursor/Config.in
```kconfig
config LINGMO_PACKAGE_XCB_UTIL_CURSOR
	bool "xcb-util-cursor"
	depends on LINGMO_PACKAGE_LIBXCB
	select LINGMO_PACKAGE_XCB_UTIL
	select LINGMO_PACKAGE_XCB_UTIL_IMAGE
	select LINGMO_PACKAGE_XCB_UTIL_RENDERUTIL
	help
	  The XCB util modules provides a number of libraries which
	  sit on top of libxcb, the core X protocol library, and some
	  of the extension libraries. These experimental libraries
	  provide convenience functions and interfaces which make the
	  raw X protocol more usable. Some of the libraries also
	  provide client-side code which is not strictly part of the X
	  protocol but which have traditionally been provided by Xlib.

	  XCB util-cursor module provides the following libraries:
	    - cursor: port of libxcursor

	  http://xcb.freedesktop.org/
```

## package/x11r7/xcb-util/Config.in
```kconfig
config LINGMO_PACKAGE_XCB_UTIL
	bool "xcb-util"
	depends on LINGMO_PACKAGE_LIBXCB
	help
	  Libraries which sit on top of libxcb, the core X protocol
	  library, and some of the extension libraries.

	  http://xcb.freedesktop.org/
```

## package/x11r7/xcursor-transparent-theme/Config.in
```kconfig
config LINGMO_PACKAGE_XCURSOR_TRANSPARENT_THEME
	bool "xcursor-transparent-theme"
	select LINGMO_PACKAGE_XLIB_LIBXCURSOR
	help
	  Completely transparent theme for hiding the X11 cursor.

	  No upstream site.
```

## package/x11r7/xdata_xbitmaps/Config.in
```kconfig
config LINGMO_PACKAGE_XDATA_XBITMAPS
	bool "xbitmaps"
	help
	  No description available
```

## package/x11r7/xdata_xcursor-themes/Config.in
```kconfig
config LINGMO_PACKAGE_XDATA_XCURSOR_THEMES
	bool "xdata_xcursor-themes"
	select LINGMO_PACKAGE_XLIB_LIBXCURSOR
	help
	  No description available
```

## package/x11r7/xdriver_xf86-input-evdev/Config.in
```kconfig
config LINGMO_PACKAGE_XDRIVER_XF86_INPUT_EVDEV
	bool "xf86-input-evdev"
	depends on LINGMO_PACKAGE_HAS_UDEV # libudev is configure dependency
	select LINGMO_PACKAGE_LIBEVDEV
	select LINGMO_PACKAGE_MTDEV
	select LINGMO_PACKAGE_XORGPROTO
	help
	  Generic Linux input driver

comment "xf86-input-evdev requires udev to be enabled"
	depends on !LINGMO_PACKAGE_HAS_UDEV
```

## package/x11r7/xdriver_xf86-input-joystick/Config.in
```kconfig
config LINGMO_PACKAGE_XDRIVER_XF86_INPUT_JOYSTICK
	bool "xf86-input-joystick"
	select LINGMO_PACKAGE_XORGPROTO
	help
	  X.Org driver for joystick input devices
```

## package/x11r7/xdriver_xf86-input-libinput/Config.in
```kconfig
config LINGMO_PACKAGE_XDRIVER_XF86_INPUT_LIBINPUT
	bool "xf86-input-libinput"
	depends on LINGMO_PACKAGE_HAS_UDEV # libinput
	select LINGMO_PACKAGE_LIBINPUT
	select LINGMO_PACKAGE_XORGPROTO
	help
	  This is an X driver based on libinput. It is a thin wrapper
	  around libinput, so while it does provide all features that
	  libinput supports it does little beyond.

comment "xf86-input-libinput needs udev /dev management"
	depends on !LINGMO_PACKAGE_HAS_UDEV
```

## package/x11r7/xdriver_xf86-input-synaptics/Config.in
```kconfig
config LINGMO_PACKAGE_XDRIVER_XF86_INPUT_SYNAPTICS
	bool "xf86-input-synaptics"
	select LINGMO_PACKAGE_LIBEVDEV
	select LINGMO_PACKAGE_MTDEV
	select LINGMO_PACKAGE_XORGPROTO
	help
	  X.Org driver for synaptics input devices
```

## package/x11r7/xdriver_xf86-input-vmmouse/Config.in
```kconfig
config LINGMO_PACKAGE_XDRIVER_XF86_INPUT_VMMOUSE
	bool "xf86-input-vmmouse"
	depends on LINGMO_i386 || LINGMO_x86_64
	select LINGMO_PACKAGE_XORGPROTO
	help
	  VMWare mouse input driver
```

## package/x11r7/xdriver_xf86-video-amdgpu/Config.in
```kconfig
config LINGMO_PACKAGE_XDRIVER_XF86_VIDEO_AMDGPU
	bool "xf86-video-amdgpu"
	depends on LINGMO_USE_MMU # libdrm
	depends on LINGMO_PACKAGE_HAS_LIBGBM
	select LINGMO_PACKAGE_LIBDRM
	select LINGMO_PACKAGE_LIBDRM_AMDGPU
	select LINGMO_PACKAGE_LIBEPOXY
	select LINGMO_PACKAGE_XLIB_LIBXCOMPOSITE
	select LINGMO_PACKAGE_XORGPROTO
	help
	  AMD GPU video driver

comment "xf86-video-amdgpu needs GBM"
	depends on LINGMO_USE_MMU
	depends on !LINGMO_PACKAGE_HAS_LIBGBM
```

## package/x11r7/xdriver_xf86-video-ark/Config.in
```kconfig
config LINGMO_PACKAGE_XDRIVER_XF86_VIDEO_ARK
	bool "xf86-video-ark"
	select LINGMO_PACKAGE_XORGPROTO
	help
	  X.Org driver for ark cards
```
