## package/x11r7/xapp_viewres/Config.in
```kconfig
config LINGMO_PACKAGE_XAPP_VIEWRES
	bool "viewres"
	select LINGMO_PACKAGE_XLIB_LIBXAW
	help
	  graphical class browser for Xt
```

## package/x11r7/xapp_x11perf/Config.in
```kconfig
config LINGMO_PACKAGE_XAPP_X11PERF
	bool "x11perf"
	select LINGMO_PACKAGE_XLIB_LIBX11
	select LINGMO_PACKAGE_XLIB_LIBXMU
	select LINGMO_PACKAGE_XLIB_LIBXFT
	help
	  summarize x11perf results
```

## package/x11r7/xapp_xauth/Config.in
```kconfig
config LINGMO_PACKAGE_XAPP_XAUTH
	bool "xauth"
	select LINGMO_PACKAGE_XLIB_LIBX11
	select LINGMO_PACKAGE_XLIB_LIBXAU
	select LINGMO_PACKAGE_XLIB_LIBXEXT
	select LINGMO_PACKAGE_XLIB_LIBXMU
	help
	  X authority file utility
```

## package/x11r7/xapp_xbacklight/Config.in
```kconfig
config LINGMO_PACKAGE_XAPP_XBACKLIGHT
	bool "xbacklight"
	select LINGMO_PACKAGE_XCB_UTIL
	select LINGMO_PACKAGE_XLIB_LIBX11
	select LINGMO_PACKAGE_XLIB_LIBXRANDR
	select LINGMO_PACKAGE_XLIB_LIBXRENDER
	help
	  xbacklight
```

## package/x11r7/xapp_xbiff/Config.in
```kconfig
config LINGMO_PACKAGE_XAPP_XBIFF
	bool "xbiff"
	select LINGMO_PACKAGE_XLIB_LIBXAW
	select LINGMO_PACKAGE_XDATA_XBITMAPS
	help
	  mailbox flag for X
```

## package/x11r7/xapp_xcalc/Config.in
```kconfig
config LINGMO_PACKAGE_XAPP_XCALC
	bool "xcalc"
	select LINGMO_PACKAGE_XLIB_LIBXAW
	help
	  scientific calculator for X
```

## package/x11r7/xapp_xclipboard/Config.in
```kconfig
config LINGMO_PACKAGE_XAPP_XCLIPBOARD
	bool "xclipboard"
	select LINGMO_PACKAGE_XLIB_LIBXAW
	help
	  interchange between cut buffer and selection
```

## package/x11r7/xapp_xclock/Config.in
```kconfig
config LINGMO_PACKAGE_XAPP_XCLOCK
	bool "xclock"
	select LINGMO_PACKAGE_XLIB_LIBX11
	select LINGMO_PACKAGE_XLIB_LIBXAW
	select LINGMO_PACKAGE_XLIB_LIBXFT
	select LINGMO_PACKAGE_XLIB_LIBXRENDER
	select LINGMO_PACKAGE_XLIB_LIBXKBFILE
	help
	  analog / digital clock for X
```

## package/x11r7/xapp_xcmsdb/Config.in
```kconfig
config LINGMO_PACKAGE_XAPP_XCMSDB
	bool "xcmsdb"
	select LINGMO_PACKAGE_XLIB_LIBX11
	help
	  Device Color Characterization utility for X Color Management
	  System
```

## package/x11r7/xapp_xcompmgr/Config.in
```kconfig
config LINGMO_PACKAGE_XAPP_XCOMPMGR
	bool "xcompmgr"
	select LINGMO_PACKAGE_XLIB_LIBXCOMPOSITE
	select LINGMO_PACKAGE_XLIB_LIBXDAMAGE
	select LINGMO_PACKAGE_XLIB_LIBXEXT
	select LINGMO_PACKAGE_XLIB_LIBXFIXES
	select LINGMO_PACKAGE_XLIB_LIBXRENDER
	help
	  xcompmgr is a sample compositing manager that enables basic
	  eye-candy effects.
```

## package/x11r7/xapp_xconsole/Config.in
```kconfig
config LINGMO_PACKAGE_XAPP_XCONSOLE
	bool "xconsole"
	depends on LINGMO_USE_MMU # fork()
	select LINGMO_PACKAGE_XLIB_LIBX11
	select LINGMO_PACKAGE_XLIB_LIBXAW
	select LINGMO_PACKAGE_XLIB_LIBXT
	select LINGMO_PACKAGE_XLIB_LIBXMU
	select LINGMO_PACKAGE_XORGPROTO
	help
	  xconsole - monitor system console messages with X
```

## package/x11r7/xapp_xcursorgen/Config.in
```kconfig
config LINGMO_PACKAGE_XAPP_XCURSORGEN
	bool "xcursorgen"
	select LINGMO_PACKAGE_LIBPNG
	select LINGMO_PACKAGE_XLIB_LIBX11
	select LINGMO_PACKAGE_XLIB_LIBXCURSOR
	help
	  create an X cursor file from a collection of PNG images
```

## package/x11r7/xapp_xdbedizzy/Config.in
```kconfig
config LINGMO_PACKAGE_XAPP_XDBEDIZZY
	bool "xdbedizzy"
	select LINGMO_PACKAGE_XLIB_LIBXEXT
	help
	  X.Org xdbedizzy application
```

## package/x11r7/xapp_xditview/Config.in
```kconfig
config LINGMO_PACKAGE_XAPP_XDITVIEW
	bool "xditview"
	select LINGMO_PACKAGE_XLIB_LIBXAW
	help
	  display ditroff output
```

## package/x11r7/xapp_xdm/Config.in
```kconfig
config LINGMO_PACKAGE_XAPP_XDM
	bool "xdm"
	depends on LINGMO_USE_MMU # fork()
	# Runtime dependency: can't start an X server unless there is one
	depends on LINGMO_PACKAGE_XSERVER_XORG_SERVER
	select LINGMO_PACKAGE_XAPP_SESSREG
	select LINGMO_PACKAGE_XAPP_XRDB
	select LINGMO_PACKAGE_XLIB_LIBX11
	select LINGMO_PACKAGE_XLIB_LIBXAW
	select LINGMO_PACKAGE_XLIB_LIBXDMCP
	select LINGMO_PACKAGE_XLIB_LIBXT
	select LINGMO_PACKAGE_XORGPROTO
	help
	  X.Org xdm application
```

## package/x11r7/xapp_xdpyinfo/Config.in
```kconfig
config LINGMO_PACKAGE_XAPP_XDPYINFO
	bool "xdpyinfo"
	depends on LINGMO_USE_MMU # fork()
	select LINGMO_PACKAGE_XLIB_LIBX11
	select LINGMO_PACKAGE_XLIB_LIBXEXT
	select LINGMO_PACKAGE_XLIB_LIBXTST
	help
	  display information utility for X
```

## package/x11r7/xapp_xdriinfo/Config.in
```kconfig
config LINGMO_PACKAGE_XAPP_XDRIINFO
	bool "xdriinfo"
	depends on LINGMO_PACKAGE_HAS_LIBGL
	select LINGMO_PACKAGE_XLIB_LIBX11
	select LINGMO_PACKAGE_XORGPROTO
	help
	  query configuration information of DRI drivers

comment "xdriinfo needs an OpenGL backend"
	depends on !LINGMO_PACKAGE_HAS_LIBGL
```

## package/x11r7/xapp_xedit/Config.in
```kconfig
config LINGMO_PACKAGE_XAPP_XEDIT
	bool "xedit"
	depends on LINGMO_USE_MMU # fork()
	select LINGMO_PACKAGE_XLIB_LIBXAW
	help
	  simple text editor for X
```

## package/x11r7/xapp_xev/Config.in
```kconfig
config LINGMO_PACKAGE_XAPP_XEV
	bool "xev"
	select LINGMO_PACKAGE_XLIB_LIBX11
	select LINGMO_PACKAGE_XLIB_LIBXRANDR
	help
	  print contents of X events
```

## package/x11r7/xapp_xeyes/Config.in
```kconfig
config LINGMO_PACKAGE_XAPP_XEYES
	bool "xeyes"
	select LINGMO_PACKAGE_XLIB_LIBX11
	select LINGMO_PACKAGE_XLIB_LIBXEXT
	select LINGMO_PACKAGE_XLIB_LIBXI
	select LINGMO_PACKAGE_XLIB_LIBXMU
	select LINGMO_PACKAGE_XLIB_LIBXT
	help
	  X.Org xeyes application
```

## package/x11r7/xapp_xf86dga/Config.in
```kconfig
config LINGMO_PACKAGE_XAPP_XF86DGA
	bool "xf86dga"
	depends on LINGMO_USE_MMU # fork()
	select LINGMO_PACKAGE_XLIB_LIBX11
	select LINGMO_PACKAGE_XLIB_LIBXXF86DGA
	help
	  test program for the XFree86-DGA extension
```

## package/x11r7/xapp_xfd/Config.in
```kconfig
config LINGMO_PACKAGE_XAPP_XFD
	bool "xfd"
	select LINGMO_PACKAGE_FREETYPE
	select LINGMO_PACKAGE_FONTCONFIG
	select LINGMO_PACKAGE_XLIB_LIBXAW
	select LINGMO_PACKAGE_XLIB_LIBXFT
	help
	  X.Org xfd application
```

## package/x11r7/xapp_xfindproxy/Config.in
```kconfig
config LINGMO_PACKAGE_XAPP_XFINDPROXY
	bool "xfindproxy"
	select LINGMO_PACKAGE_XLIB_LIBICE
	select LINGMO_PACKAGE_XLIB_LIBXT
	select LINGMO_PACKAGE_XORGPROTO
	help
	  xfindproxy utilizes the Proxy Management Protocol to
	  communicate with a proxy manager to locate available X11
	  proxy services.
```

## package/x11r7/xapp_xfontsel/Config.in
```kconfig
config LINGMO_PACKAGE_XAPP_XFONTSEL
	bool "xfontsel"
	select LINGMO_PACKAGE_XLIB_LIBXAW
	help
	  point and click selection of X11 font names
```

## package/x11r7/xapp_xfs/Config.in
```kconfig
config LINGMO_PACKAGE_XAPP_XFS
	bool "xfs"
	depends on LINGMO_USE_MMU # fork()
	select LINGMO_PACKAGE_XLIB_LIBFS
	select LINGMO_PACKAGE_XLIB_LIBXFONT2
	select LINGMO_PACKAGE_XORGPROTO
	help
	  X font server
```
