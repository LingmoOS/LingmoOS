## package/x11r7/xlib_libXtst/Config.in
```kconfig
config LINGMO_PACKAGE_XLIB_LIBXTST
	bool "libXtst"
	select LINGMO_PACKAGE_XLIB_LIBX11
	select LINGMO_PACKAGE_XLIB_LIBXI
	select LINGMO_PACKAGE_XLIB_LIBXEXT
	select LINGMO_PACKAGE_XORGPROTO
	help
	  X.Org Xtst library
```

## package/x11r7/xlib_libXv/Config.in
```kconfig
config LINGMO_PACKAGE_XLIB_LIBXV
	bool "libXv"
	select LINGMO_PACKAGE_XLIB_LIBX11
	select LINGMO_PACKAGE_XLIB_LIBXEXT
	select LINGMO_PACKAGE_XORGPROTO
	help
	  X.Org Xv library
```

## package/x11r7/xlib_libXvMC/Config.in
```kconfig
config LINGMO_PACKAGE_XLIB_LIBXVMC
	bool "libXvMC"
	select LINGMO_PACKAGE_XLIB_LIBX11
	select LINGMO_PACKAGE_XLIB_LIBXEXT
	select LINGMO_PACKAGE_XLIB_LIBXV
	select LINGMO_PACKAGE_XORGPROTO
	help
	  X.Org XvMC library
```

## package/x11r7/xlib_libXxf86dga/Config.in
```kconfig
config LINGMO_PACKAGE_XLIB_LIBXXF86DGA
	bool "libXxf86dga"
	depends on LINGMO_USE_MMU # fork()
	select LINGMO_PACKAGE_XLIB_LIBX11
	select LINGMO_PACKAGE_XLIB_LIBXEXT
	select LINGMO_PACKAGE_XORGPROTO
	help
	  X.Org Xxf86dga library
```

## package/x11r7/xlib_libXxf86vm/Config.in
```kconfig
config LINGMO_PACKAGE_XLIB_LIBXXF86VM
	bool "libXxf86vm"
	select LINGMO_PACKAGE_XLIB_LIBX11
	select LINGMO_PACKAGE_XLIB_LIBXEXT
	select LINGMO_PACKAGE_XORGPROTO
	help
	  X.Org Xxf86vm library
```

## package/x11r7/xlib_libdmx/Config.in
```kconfig
config LINGMO_PACKAGE_XLIB_LIBDMX
	bool "libdmx"
	select LINGMO_PACKAGE_XLIB_LIBX11
	select LINGMO_PACKAGE_XLIB_LIBXEXT
	select LINGMO_PACKAGE_XORGPROTO
	help
	  X.Org dmx library
```

## package/x11r7/xlib_libfontenc/Config.in
```kconfig
config LINGMO_PACKAGE_XLIB_LIBFONTENC
	bool "libfontenc"
	select LINGMO_PACKAGE_XORGPROTO
	select LINGMO_PACKAGE_ZLIB
	help
	  X.Org fontenc library
```

## package/x11r7/xlib_libxkbfile/Config.in
```kconfig
config LINGMO_PACKAGE_XLIB_LIBXKBFILE
	bool "libxkbfile"
	select LINGMO_PACKAGE_XLIB_LIBX11
	select LINGMO_PACKAGE_XORGPROTO
	help
	  X.Org xkbfile library
```

## package/x11r7/xlib_libxshmfence/Config.in
```kconfig
config LINGMO_PACKAGE_XLIB_LIBXSHMFENCE
	bool "libxshmfence"
	# Due to use of SYS_futex - can be enabled again when upstream
	# adds SYS_futex64 as an alternative
	depends on !LINGMO_RISCV_32
	depends on LINGMO_TOOLCHAIN_HAS_SYNC_4
	select LINGMO_PACKAGE_XORGPROTO
	help
	  X.Org shmfence library
```

## package/x11r7/xserver_xorg-server/Config.in
```kconfig
config LINGMO_PACKAGE_XSERVER_XORG_SERVER
	bool "xorg-server"
	depends on LINGMO_USE_MMU # fork()
	# We need a SHA1 implementation. If either openssl or
	# libgcrypt are already part of the build, we'll use one of
	# them, otherwise, use the small libsha1 library.
	select LINGMO_PACKAGE_LIBSHA1 if (!LINGMO_PACKAGE_OPENSSL && !LINGMO_PACKAGE_LIBGCRYPT)
	select LINGMO_PACKAGE_MCOOKIE
	select LINGMO_PACKAGE_PIXMAN
	select LINGMO_PACKAGE_XFONT_FONT_ALIAS
	select LINGMO_PACKAGE_XFONT_FONT_MISC_MISC
	select LINGMO_PACKAGE_XFONT_FONT_CURSOR_MISC
	select LINGMO_PACKAGE_XLIB_LIBX11
	select LINGMO_PACKAGE_XLIB_LIBXAU
	select LINGMO_PACKAGE_XLIB_LIBXCURSOR
	select LINGMO_PACKAGE_XLIB_LIBXCVT
	select LINGMO_PACKAGE_XLIB_LIBXDAMAGE
	select LINGMO_PACKAGE_XLIB_LIBXDMCP
	select LINGMO_PACKAGE_XLIB_LIBXEXT
	select LINGMO_PACKAGE_XLIB_LIBXFIXES
	select LINGMO_PACKAGE_XLIB_LIBXFONT2
	select LINGMO_PACKAGE_XLIB_LIBXFT
	select LINGMO_PACKAGE_XLIB_LIBXI
	select LINGMO_PACKAGE_XLIB_LIBXINERAMA
	select LINGMO_PACKAGE_XLIB_LIBXRANDR
	select LINGMO_PACKAGE_XLIB_LIBXRENDER
	select LINGMO_PACKAGE_XLIB_LIBXRES
	select LINGMO_PACKAGE_XLIB_LIBXXF86VM
	select LINGMO_PACKAGE_XLIB_LIBXKBFILE
	select LINGMO_PACKAGE_XLIB_XTRANS
	select LINGMO_PACKAGE_XDATA_XBITMAPS
	select LINGMO_PACKAGE_XORGPROTO
	select LINGMO_PACKAGE_XUTIL_UTIL_MACROS
	select LINGMO_PACKAGE_XKEYBOARD_CONFIG
	help
	  X.Org X server

	  http://xorg.freedesktop.org

if LINGMO_PACKAGE_XSERVER_XORG_SERVER

choice
	prompt "X Window System server type"
	help
	  Select the X Window System server to use

config LINGMO_PACKAGE_XSERVER_XORG_SERVER_MODULAR
	bool "Modular X.org"
	depends on LINGMO_INSTALL_LIBSTDCPP
	select LINGMO_PACKAGE_LIBDRM
	select LINGMO_PACKAGE_LIBPCIACCESS
	select LINGMO_PACKAGE_XLIB_LIBXSHMFENCE if \
		(LINGMO_TOOLCHAIN_HAS_SYNC_4 && !LINGMO_RISCV_32)
	help
	  This variant of the X.org server is the full-blown variant,
	  as used by desktop GNU/Linux distributions. The drivers (for
	  input and graphics) are built separately from the X.org
	  server (see the xdriver* packages).

comment "Modular X.org needs a toolchain w/ C++"
	depends on !LINGMO_INSTALL_LIBSTDCPP

config LINGMO_PACKAGE_XSERVER_XORG_SERVER_KDRIVE
	bool "KDrive / TinyX"
	help
	  This variant of the X.org server is a lightweight version
	  intended for embedded systems. The drivers (for input and
	  graphics) are built into the server. It is generally used
	  directly on top of the Linux framebuffer without DRM or
	  video card specific drivers.

endchoice

comment "Optional Servers"

config LINGMO_PACKAGE_XSERVER_XORG_SERVER_XVFB
	bool "Xvfb server"
	help
	  Virtual frame buffer X server.

config LINGMO_PACKAGE_XSERVER_XORG_SERVER_XEPHYR
	bool "Xephyr server"
	select LINGMO_PACKAGE_XCB_UTIL_IMAGE if LINGMO_PACKAGE_XSERVER_XORG_SERVER_KDRIVE
	select LINGMO_PACKAGE_XCB_UTIL_KEYSYMS if LINGMO_PACKAGE_XSERVER_XORG_SERVER_KDRIVE
	select LINGMO_PACKAGE_XCB_UTIL_RENDERUTIL if LINGMO_PACKAGE_XSERVER_XORG_SERVER_KDRIVE
	select LINGMO_PACKAGE_XCB_UTIL_WM if LINGMO_PACKAGE_XSERVER_XORG_SERVER_KDRIVE
	help
	  Xephyr nested X server; successor to Xnest.

endif
```

## package/x11r7/xutil_makedepend/Config.in
```kconfig
config LINGMO_PACKAGE_XUTIL_MAKEDEPEND
	bool "makedepend"
	select LINGMO_PACKAGE_XORGPROTO
	help
	  No description available
```

## package/x11r7/xwayland/Config.in
```kconfig
config LINGMO_PACKAGE_XWAYLAND
	bool "xwayland server"
	depends on LINGMO_USE_MMU # fork()
	depends on !LINGMO_STATIC_LIBS # wayland
	depends on LINGMO_TOOLCHAIN_HAS_THREADS # wayland
	# We need a SHA1 implementation. If either openssl or
	# libgcrypt are already part of the build, we'll use one of
	# them, otherwise, use the small libsha1 library.
	depends on !LINGMO_RISCV_32 # xlib_libxshmfence
	depends on LINGMO_TOOLCHAIN_HAS_SYNC_4 # xlib_libxshmfence
	select LINGMO_PACKAGE_LIBDRM
	select LINGMO_PACKAGE_LIBSHA1 if (!LINGMO_PACKAGE_OPENSSL && !LINGMO_PACKAGE_LIBGCRYPT)
	select LINGMO_PACKAGE_PIXMAN
	select LINGMO_PACKAGE_WAYLAND
	select LINGMO_PACKAGE_WAYLAND_PROTOCOLS
	select LINGMO_PACKAGE_XLIB_LIBXCVT
	select LINGMO_PACKAGE_XLIB_LIBXFONT2
	select LINGMO_PACKAGE_XLIB_LIBXKBFILE
	select LINGMO_PACKAGE_XLIB_LIBXRANDR
	select LINGMO_PACKAGE_XLIB_LIBXSHMFENCE
	select LINGMO_PACKAGE_XLIB_XTRANS
	select LINGMO_PACKAGE_XORGPROTO
	help
	  X.Org X server to run X clients under wayland

	  http://xorg.freedesktop.org

comment "xwayland needs a toolchain w/ threads, dynamic library"
	depends on LINGMO_USE_MMU
	depends on !LINGMO_RISCV_32
	depends on LINGMO_TOOLCHAIN_HAS_SYNC_4
	depends on !LINGMO_TOOLCHAIN_HAS_THREADS || LINGMO_STATIC_LIBS
```

## package/x11vnc/Config.in
```kconfig
config LINGMO_PACKAGE_X11VNC
	bool "x11vnc"
	depends on LINGMO_PACKAGE_XORG7
	depends on LINGMO_USE_MMU # fork()
	depends on !LINGMO_nios2 # libvncserver
	select LINGMO_PACKAGE_LIBVNCSERVER
	select LINGMO_PACKAGE_XLIB_LIBXT
	select LINGMO_PACKAGE_XLIB_LIBXEXT
	select LINGMO_PACKAGE_XLIB_LIBXTST
	select LINGMO_PACKAGE_LIBOPENSSL_ENABLE_BLOWFISH if LINGMO_PACKAGE_LIBOPENSSL
	select LINGMO_PACKAGE_LIBOPENSSL_ENABLE_RC4 if LINGMO_PACKAGE_LIBOPENSSL
	select LINGMO_PACKAGE_LIBOPENSSL_ENABLE_RMD160 if LINGMO_PACKAGE_LIBOPENSSL
	help
	  VNC server for X11 display

	  http://www.karlrunge.com/x11vnc/
```

## package/x264/Config.in
```kconfig
config LINGMO_PACKAGE_X264
	bool "x264"
	help
	  x264 is a free software library and application for
	  encoding video streams into the H.264/MPEG-4 AVC
	  compression format, and is released under the terms
	  of the GNU GPL.

	  https://www.videolan.org/developers/x264.html

if LINGMO_PACKAGE_X264

config LINGMO_PACKAGE_X264_CLI
	bool "CLI"
	help
	  Command-line tool to encode video streams into the
	  H.264/MPEG-4 AVC compression format.

endif
```

## package/x265/Config.in
```kconfig
config LINGMO_PACKAGE_X265
	bool "x265"
	depends on LINGMO_INSTALL_LIBSTDCPP
	depends on LINGMO_TOOLCHAIN_HAS_THREADS
	depends on !LINGMO_STATIC_LIBS # dlfcn
	depends on LINGMO_TOOLCHAIN_HAS_SYNC_4
	help
	  x265 is an open source free software and library for
	  encoding video using the High Efficiency Video Coding
	  (HEVC/H.265) standard. x265 is offered under either the GNU
	  General Public License (GPL) 2 license or a commercial
	  license, similar to the x264 project.

	  https://bitbucket.org/multicoreware/x265_git/wiki/Home

if LINGMO_PACKAGE_X265

config LINGMO_PACKAGE_X265_CLI
	bool "CLI"
	help
	  Command-line tool to encode video streams into the
	  H.265/HEVC compression format.

endif

comment "x265 needs a toolchain w/ C++, threads, dynamic library"
	depends on !LINGMO_INSTALL_LIBSTDCPP || LINGMO_STATIC_LIBS || \
		!LINGMO_TOOLCHAIN_HAS_THREADS
	depends on LINGMO_TOOLCHAIN_HAS_SYNC_4
```

## package/xapian/Config.in
```kconfig
config LINGMO_PACKAGE_XAPIAN
	bool "xapian"
	depends on LINGMO_USE_MMU # fork()
	depends on LINGMO_INSTALL_LIBSTDCPP
	select LINGMO_PACKAGE_ZLIB
	help
	  Xapian is an open Source search engine Library
	  It is a highly adaptable toolkit which allows developers
	  to easily add advanced indexing and search facilities to
	  their own applications.
	  It has built-in support for several families of weighting
	  models and supports a rich set of boolean query operators.

	  https://xapian.org/

comment "xapian needs a toolchain w/ C++"
	depends on LINGMO_USE_MMU
	depends on !LINGMO_INSTALL_LIBSTDCPP
```

## package/xavante/Config.in
```kconfig
config LINGMO_PACKAGE_XAVANTE
	bool "xavante"
	select LINGMO_PACKAGE_COPAS # runtime
	select LINGMO_PACKAGE_LUAFILESYSTEM # runtime
	select LINGMO_PACKAGE_LUASOCKET # runtime
	help
	  Xavante is a Lua HTTP 1.1 Web server that uses a modular
	  architecture based on URI mapped handlers. Xavante currently
	  offers a file handler, a redirect handler and a WSAPI handler.
	  Those are used for general files, URI remapping and WSAPI
	  applications respectively.

	  http://keplerproject.github.io/xavante
```

## package/xdg-dbus-proxy/Config.in
```kconfig
config LINGMO_PACKAGE_XDG_DBUS_PROXY
	bool "xdg-dbus-proxy"
	depends on LINGMO_USE_WCHAR # libglib2 -> gettext
	depends on LINGMO_TOOLCHAIN_HAS_THREADS # libglib2
	depends on LINGMO_USE_MMU # libglib2
	select LINGMO_PACKAGE_LIBGLIB2
	help
	  Filtering proxy for D-Bus connections.

	  https://github.com/flatpak/xdg-dbus-proxy

comment "xdg-dbus-proxy needs a toolchain w/ wchar, threads"
	depends on LINGMO_USE_MMU
	depends on !LINGMO_USE_WCHAR || !LINGMO_TOOLCHAIN_HAS_THREADS
```

## package/xdotool/Config.in
```kconfig
config LINGMO_PACKAGE_XDOTOOL
	bool "xdotool"
	depends on LINGMO_PACKAGE_XORG7
	depends on LINGMO_USE_MMU # fork()
	select LINGMO_PACKAGE_XLIB_LIBXTST
	select LINGMO_PACKAGE_XLIB_LIBXINERAMA
	select LINGMO_PACKAGE_LIBXKBCOMMON
	select LINGMO_PACKAGE_XLIB_LIBX11
	help
	  Command-line X11 automation tool

	  http://www.semicomplete.com/projects/xdotool
```

## package/xen/Config.in
```kconfig
config LINGMO_PACKAGE_XEN
	bool "xen"
	# needs "dmb" on ARM, so ARM >= v7
	depends on LINGMO_ARM_CPU_ARMV7A || LINGMO_aarch64
	select LINGMO_PACKAGE_XEN_HYPERVISOR if !LINGMO_PACKAGE_XEN_TOOLS
	help
	  This package builds the Xen hypervisor and toolstack.

	  http://www.xenproject.org/

if LINGMO_PACKAGE_XEN

config LINGMO_PACKAGE_XEN_HYPERVISOR
	bool "Xen hypervisor"
	help
	  The Xen binaries are avaliable in /usr/lib/xen/ See
	  http://wiki.xenproject.org/wiki/Getting_Started for using
	  the Xen hypervisor.

config LINGMO_PACKAGE_XEN_TOOLS
	bool "Xen tools"
	depends on !LINGMO_STATIC_LIBS # dtc (libfdt)
	depends on LINGMO_TOOLCHAIN_HAS_THREADS # libglib2
	depends on LINGMO_USE_WCHAR # libglib2
	select LINGMO_PACKAGE_DTC
	select LINGMO_PACKAGE_LIBAIO
	select LINGMO_PACKAGE_LIBGLIB2
	select LINGMO_PACKAGE_NCURSES
	select LINGMO_PACKAGE_OPENSSL
	select LINGMO_PACKAGE_PIXMAN
	select LINGMO_PACKAGE_SLIRP
	select LINGMO_PACKAGE_UTIL_LINUX
	select LINGMO_PACKAGE_UTIL_LINUX_LIBUUID
	select LINGMO_PACKAGE_YAJL
	select LINGMO_PACKAGE_ARGP_STANDALONE if !LINGMO_TOOLCHAIN_USES_GLIBC
	help
	  The Xen tools can be accessed by the xl command.

comment "xen tools need a toolchain w/ wchar, threads, dynamic library"
	depends on !LINGMO_USE_WCHAR || !LINGMO_TOOLCHAIN_HAS_THREADS || \
		LINGMO_STATIC_LIBS

endif
```

## package/xerces/Config.in
```kconfig
config LINGMO_PACKAGE_XERCES
	bool "xerces-c++"
	depends on LINGMO_INSTALL_LIBSTDCPP
	depends on !LINGMO_STATIC_LIBS
	depends on LINGMO_USE_WCHAR
	help
	  Xerces-C++ is a validating XML parser written in portable C++.

	  http://xerces.apache.org/xerces-c/

if LINGMO_PACKAGE_XERCES

config LINGMO_PACKAGE_XERCES_ENABLE_NETWORK
	bool "Enable network support"
	default y
	help
	  Enable network support in xerces

endif

comment "xerces-c++ needs a toolchain w/ C++, dynamic library, wchar"
	depends on !LINGMO_INSTALL_LIBSTDCPP || LINGMO_STATIC_LIBS || \
		!LINGMO_USE_WCHAR
```

## package/xfsprogs/Config.in
```kconfig
comment "xfsprogs needs a toolchain w/ threads, C++"
	depends on LINGMO_PACKAGE_LIBURCU_ARCH_SUPPORTS
	depends on LINGMO_USE_MMU
	depends on !LINGMO_TOOLCHAIN_HAS_THREADS || \
		!LINGMO_INSTALL_LIBSTDCPP

config LINGMO_PACKAGE_XFSPROGS
	bool "xfsprogs"
	depends on LINGMO_PACKAGE_LIBURCU_ARCH_SUPPORTS
	depends on LINGMO_USE_MMU # fork()
	depends on LINGMO_TOOLCHAIN_HAS_THREADS
	depends on LINGMO_INSTALL_LIBSTDCPP # liburcu
	select LINGMO_PACKAGE_INIH
	select LINGMO_PACKAGE_LIBURCU
	select LINGMO_PACKAGE_UTIL_LINUX
	select LINGMO_PACKAGE_UTIL_LINUX_LIBUUID
	select LINGMO_PACKAGE_UTIL_LINUX_LIBBLKID
	help
	  The XFS file system utilities and libraries

	  https://xfs.wiki.kernel.org
```

## package/xinetd/Config.in
```kconfig
config LINGMO_PACKAGE_XINETD
	bool "xinetd"
	depends on LINGMO_USE_MMU # fork()
	help
	  xinetd is a secure replacement for inetd. It was originally
	  written by panos@cs.colorado.edu.

	  http://www.xinetd.org
```

## package/xml-security-c/Config.in
```kconfig
config LINGMO_PACKAGE_XML_SECURITY_C
	bool "xml-security-c"
	depends on LINGMO_INSTALL_LIBSTDCPP # xerces
	depends on !LINGMO_STATIC_LIBS # xerces
	depends on LINGMO_USE_WCHAR # xerces
	depends on LINGMO_TOOLCHAIN_GCC_AT_LEAST_4_7 # C++11
	depends	on LINGMO_TOOLCHAIN_HAS_THREADS
	select LINGMO_PACKAGE_LIBOPENSSL_ENABLE_DES if LINGMO_PACKAGE_LIBOPENSSL
	select LINGMO_PACKAGE_OPENSSL
	select LINGMO_PACKAGE_XERCES
	help
	  The xml-security-c library is a C++ implementation of
	  the XML Digital Signature and Encryption specifications.

	  https://santuario.apache.org/cindex.html

comment "xml-security-c needs a toolchain w/ C++, wchar, dynamic library, threads, gcc >= 4.7"
	depends on !LINGMO_INSTALL_LIBSTDCPP || !LINGMO_USE_WCHAR || \
		LINGMO_STATIC_LIBS || !LINGMO_TOOLCHAIN_GCC_AT_LEAST_4_7 || \
		!LINGMO_TOOLCHAIN_HAS_THREADS
```
