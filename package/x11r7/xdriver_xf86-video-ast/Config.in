## package/x11r7/xdriver_xf86-video-ast/Config.in
```kconfig
config LINGMO_PACKAGE_XDRIVER_XF86_VIDEO_AST
	bool "xf86-video-ast"
	select LINGMO_PACKAGE_XORGPROTO
	help
	  No description available
```

## package/x11r7/xdriver_xf86-video-ati/Config.in
```kconfig
config LINGMO_PACKAGE_XDRIVER_XF86_VIDEO_ATI
	bool "xf86-video-ati"
	depends on LINGMO_i386 || LINGMO_x86_64 # DRI radeon r100 driver
	depends on LINGMO_PACKAGE_HAS_LIBGBM
	select LINGMO_PACKAGE_LIBDRM
	select LINGMO_PACKAGE_LIBDRM_RADEON
	select LINGMO_PACKAGE_XLIB_LIBXCOMPOSITE
	select LINGMO_PACKAGE_XORGPROTO
	help
	  ATI video driver

comment "xf86-video-ati needs GBM"
	depends on LINGMO_i386 || LINGMO_x86_64
	depends on !LINGMO_PACKAGE_HAS_LIBGBM
```

## package/x11r7/xdriver_xf86-video-cirrus/Config.in
```kconfig
config LINGMO_PACKAGE_XDRIVER_XF86_VIDEO_CIRRUS
	bool "xf86-video-cirrus"
	select LINGMO_PACKAGE_XORGPROTO
	help
	  Cirrus Logic video driver
```

## package/x11r7/xdriver_xf86-video-dummy/Config.in
```kconfig
config LINGMO_PACKAGE_XDRIVER_XF86_VIDEO_DUMMY
	bool "xf86-video-dummy"
	select LINGMO_PACKAGE_XORGPROTO
	help
	  X.Org driver for dummy cards
```

## package/x11r7/xdriver_xf86-video-fbdev/Config.in
```kconfig
config LINGMO_PACKAGE_XDRIVER_XF86_VIDEO_FBDEV
	bool "xf86-video-fbdev"
	select LINGMO_PACKAGE_XORGPROTO
	help
	  video driver for framebuffer device
```

## package/x11r7/xdriver_xf86-video-geode/Config.in
```kconfig
config LINGMO_PACKAGE_XDRIVER_XF86_VIDEO_GEODE
	bool "xf86-video-geode"
	depends on LINGMO_i386
	select LINGMO_PACKAGE_XORGPROTO
	help
	  video driver for geode device
```

## package/x11r7/xdriver_xf86-video-i128/Config.in
```kconfig
config LINGMO_PACKAGE_XDRIVER_XF86_VIDEO_I128
	bool "xf86-video-i128"
	select LINGMO_PACKAGE_XORGPROTO
	help
	  Number 9 I128 video driver
```

## package/x11r7/xdriver_xf86-video-imx/Config.in
```kconfig
config LINGMO_PACKAGE_XDRIVER_XF86_VIDEO_IMX
	bool "xf86-video-imx"
	depends on LINGMO_ARM_EABI # libz160
	depends on LINGMO_TOOLCHAIN_USES_GLIBC # libz160
	depends on LINGMO_LINUX_KERNEL # linux/mxcfb.h
	depends on LINGMO_PACKAGE_GPU_AMD_BIN_MX51_OUTPUT_X11
	select LINGMO_PACKAGE_LIBZ160
	select LINGMO_PACKAGE_XORGPROTO
	help
	  X.Org driver for iMX5 GPU

	  To use this driver, add the correct configuration to your
	  /etc/X11/xorg.conf, as follows:

	  Section "Device"
	    [...]
	    Driver "imx"
	    Option "fbdev" "/dev/fb0"
	  EndSection

comment "xf86-video-imx needs an EABI toolchain w/ glibc"
	depends on LINGMO_arm
	depends on !LINGMO_ARM_EABI || !LINGMO_TOOLCHAIN_USES_GLIBC

comment "xf86-video-imx needs gpu-amd-bin-mx51 with X11 output and a Linux kernel to be built"
	depends on LINGMO_arm
	depends on !LINGMO_LINUX_KERNEL || !LINGMO_PACKAGE_GPU_AMD_BIN_MX51_OUTPUT_X11
```

## package/x11r7/xdriver_xf86-video-intel/Config.in
```kconfig
config LINGMO_PACKAGE_XDRIVER_XF86_VIDEO_INTEL
	bool "xf86-video-intel"
	depends on (LINGMO_i386 || LINGMO_x86_64)
	select LINGMO_PACKAGE_LIBPCIACCESS
	select LINGMO_PACKAGE_LIBDRM
	select LINGMO_PACKAGE_LIBDRM_INTEL
	select LINGMO_PACKAGE_XLIB_LIBXRANDR
	select LINGMO_PACKAGE_XORGPROTO
	help
	  Intel video driver
```

## package/x11r7/xdriver_xf86-video-mga/Config.in
```kconfig
config LINGMO_PACKAGE_XDRIVER_XF86_VIDEO_MGA
	bool "xf86-video-mga"
	select LINGMO_PACKAGE_LIBDRM
	select LINGMO_PACKAGE_XORGPROTO
	help
	  Matrox video driver
```

## package/x11r7/xdriver_xf86-video-neomagic/Config.in
```kconfig
config LINGMO_PACKAGE_XDRIVER_XF86_VIDEO_NEOMAGIC
	bool "xf86-video-neomagic"
	select LINGMO_PACKAGE_XORGPROTO
	help
	  Neomagic video driver
```

## package/x11r7/xdriver_xf86-video-nouveau/Config.in
```kconfig
config LINGMO_PACKAGE_XDRIVER_XF86_VIDEO_NOUVEAU
	bool "xf86-video-nouveau"
	depends on LINGMO_PACKAGE_HAS_LIBGL
	select LINGMO_PACKAGE_LIBDRM
	select LINGMO_PACKAGE_LIBDRM_NOUVEAU
	select LINGMO_PACKAGE_XORGPROTO
	help
	  Nouveau video driver

	  http://nouveau.freedesktop.org

comment "xf86-video-nouveau needs an OpenGL backend"
	depends on !LINGMO_PACKAGE_HAS_LIBGL
```

## package/x11r7/xdriver_xf86-video-nv/Config.in
```kconfig
config LINGMO_PACKAGE_XDRIVER_XF86_VIDEO_NV
	bool "xf86-video-nv"
	select LINGMO_PACKAGE_XORGPROTO
	help
	  NVIDIA video driver
```

## package/x11r7/xdriver_xf86-video-openchrome/Config.in
```kconfig
config LINGMO_PACKAGE_XDRIVER_XF86_VIDEO_OPENCHROME
	bool "xf86-video-openchrome"
	depends on LINGMO_PACKAGE_HAS_LIBGL
	select LINGMO_PACKAGE_LIBDRM
	select LINGMO_PACKAGE_XLIB_LIBX11
	select LINGMO_PACKAGE_XLIB_LIBXCOMPOSITE
	select LINGMO_PACKAGE_XLIB_LIBXVMC
	select LINGMO_PACKAGE_XORGPROTO
	help
	  Openchrome, A free and Open Source video driver for the
	  VIA/S3G UniChrome and UniChrome Pro graphics chipsets.

	  https://www.freedesktop.org/wiki/Openchrome/

comment "xf86-video-openchrome needs an OpenGL backend"
	depends on !LINGMO_PACKAGE_HAS_LIBGL
```

## package/x11r7/xdriver_xf86-video-qxl/Config.in
```kconfig
config LINGMO_PACKAGE_XDRIVER_XF86_VIDEO_QXL
	bool "xf86-video-qxl"
	depends on (LINGMO_i386 || LINGMO_x86_64)
	select LINGMO_PACKAGE_LIBDRM if LINGMO_PACKAGE_HAS_UDEV # for KMS
	select LINGMO_PACKAGE_LIBPCIACCESS
	select LINGMO_PACKAGE_SPICE_PROTOCOL
	select LINGMO_PACKAGE_XLIB_LIBXFONT2 if !LINGMO_PACKAGE_XLIB_LIBXFONT
	select LINGMO_PACKAGE_XORGPROTO
	help
	  QEMU QXL paravirt video driver

	  https://gitlab.freedesktop.org/xorg/driver/xf86-video-qxl
```

## package/x11r7/xdriver_xf86-video-r128/Config.in
```kconfig
config LINGMO_PACKAGE_XDRIVER_XF86_VIDEO_R128
	bool "xf86-video-r128"
	select LINGMO_PACKAGE_XORGPROTO
	help
	  R128 video driver
```

## package/x11r7/xdriver_xf86-video-savage/Config.in
```kconfig
config LINGMO_PACKAGE_XDRIVER_XF86_VIDEO_SAVAGE
	bool "xf86-video-savage"
	select LINGMO_PACKAGE_LIBDRM
	select LINGMO_PACKAGE_XORGPROTO
	help
	  S3 Savage video driver
```

## package/x11r7/xdriver_xf86-video-siliconmotion/Config.in
```kconfig
config LINGMO_PACKAGE_XDRIVER_XF86_VIDEO_SILICONMOTION
	bool "xf86-video-siliconmotion"
	select LINGMO_PACKAGE_XORGPROTO
	help
	  Silicon Motion video driver
```

## package/x11r7/xdriver_xf86-video-sis/Config.in
```kconfig
config LINGMO_PACKAGE_XDRIVER_XF86_VIDEO_SIS
	bool "xf86-video-sis"
	select LINGMO_PACKAGE_LIBDRM
	select LINGMO_PACKAGE_XORGPROTO
	help
	  SiS and XGI video driver
```

## package/x11r7/xdriver_xf86-video-tdfx/Config.in
```kconfig
config LINGMO_PACKAGE_XDRIVER_XF86_VIDEO_TDFX
	bool "xf86-video-tdfx"
	select LINGMO_PACKAGE_LIBDRM
	select LINGMO_PACKAGE_XORGPROTO
	help
	  3Dfx video driver
```

## package/x11r7/xdriver_xf86-video-trident/Config.in
```kconfig
config LINGMO_PACKAGE_XDRIVER_XF86_VIDEO_TRIDENT
	bool "xf86-video-trident"
	select LINGMO_PACKAGE_XORGPROTO
	help
	  Trident video driver
```

## package/x11r7/xdriver_xf86-video-vesa/Config.in
```kconfig
config LINGMO_PACKAGE_XDRIVER_XF86_VIDEO_VESA
	bool "xf86-video-vesa"
	select LINGMO_PACKAGE_XORGPROTO
	help
	  Generic VESA video driver
```

## package/x11r7/xdriver_xf86-video-vmware/Config.in
```kconfig
config LINGMO_PACKAGE_XDRIVER_XF86_VIDEO_VMWARE
	bool "xf86-video-vmware"
	depends on LINGMO_PACKAGE_MESA3D
	depends on LINGMO_i386 || LINGMO_x86_64
	select LINGMO_PACKAGE_MESA3D_GALLIUM_DRIVER_SVGA
	select LINGMO_PACKAGE_XORGPROTO
	help
	  VMware SVGA video driver

comment "xf86-video-vmware needs mesa3d"
	depends on !LINGMO_PACKAGE_MESA3D
```

## package/x11r7/xdriver_xf86-video-voodoo/Config.in
```kconfig
config LINGMO_PACKAGE_XDRIVER_XF86_VIDEO_VOODOO
	bool "xf86-video-voodoo"
	select LINGMO_PACKAGE_XORGPROTO
	help
	  Voodoo video driver
```

## package/x11r7/xfont_encodings/Config.in
```kconfig
config LINGMO_PACKAGE_XFONT_ENCODINGS
	bool "encodings"
	select LINGMO_PACKAGE_XUTIL_UTIL_MACROS
	help
	  No description available
```
