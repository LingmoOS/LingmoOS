## package/x11r7/xfont_font-util/Config.in
```kconfig
config LINGMO_PACKAGE_XFONT_FONT_UTIL
	bool "font-util"
	help
	  No description available
```

## package/x11r7/xfont_font-winitzki-cyrillic/Config.in
```kconfig
config LINGMO_PACKAGE_XFONT_FONT_WINITZKI_CYRILLIC
	bool "font-winitzki-cyrillic"
	select LINGMO_PACKAGE_XFONT_FONT_UTIL
	help
	  No description available
```

## package/x11r7/xkeyboard-config/Config.in
```kconfig
config LINGMO_PACKAGE_XKEYBOARD_CONFIG
	bool "xkeyboard-config"
	# Runtime dependencies
	select LINGMO_PACKAGE_XAPP_XKBCOMP if LINGMO_PACKAGE_XORG7
	select LINGMO_PACKAGE_XLIB_LIBX11 if LINGMO_PACKAGE_XORG7
	select LINGMO_PACKAGE_XORGPROTO if LINGMO_PACKAGE_XORG7
	help
	  keyboard configuration database for X

	  https://gitlab.freedesktop.org/xkeyboard-config/xkeyboard-config
```

## package/x11r7/xlib_libFS/Config.in
```kconfig
config LINGMO_PACKAGE_XLIB_LIBFS
	bool "libFS"
	select LINGMO_PACKAGE_XLIB_XTRANS
	select LINGMO_PACKAGE_XORGPROTO
	help
	  X.Org FS library
```

## package/x11r7/xlib_libICE/Config.in
```kconfig
config LINGMO_PACKAGE_XLIB_LIBICE
	bool "libICE"
	select LINGMO_PACKAGE_XLIB_XTRANS
	select LINGMO_PACKAGE_XORGPROTO
	help
	  X.Org ICE library
```

## package/x11r7/xlib_libSM/Config.in
```kconfig
config LINGMO_PACKAGE_XLIB_LIBSM
	bool "libSM"
	select LINGMO_PACKAGE_XLIB_LIBICE
	select LINGMO_PACKAGE_XLIB_XTRANS
	select LINGMO_PACKAGE_XORGPROTO
	help
	  X.Org SM library
```

## package/x11r7/xlib_libX11/Config.in
```kconfig
config LINGMO_PACKAGE_XLIB_LIBX11
	bool "libX11"
	select LINGMO_PACKAGE_LIBXCB
	select LINGMO_PACKAGE_XUTIL_UTIL_MACROS
	select LINGMO_PACKAGE_XLIB_XTRANS
	select LINGMO_PACKAGE_XLIB_LIBXAU
	select LINGMO_PACKAGE_XLIB_LIBXDMCP
	select LINGMO_PACKAGE_XORGPROTO
	help
	  X.Org X11 library
```

## package/x11r7/xlib_libXau/Config.in
```kconfig
config LINGMO_PACKAGE_XLIB_LIBXAU
	bool "libXau"
	select LINGMO_PACKAGE_XORGPROTO
	select LINGMO_PACKAGE_XUTIL_UTIL_MACROS
	help
	  X.Org Xau library
```

## package/x11r7/xlib_libXaw/Config.in
```kconfig
config LINGMO_PACKAGE_XLIB_LIBXAW
	bool "libXaw"
	select LINGMO_PACKAGE_XLIB_LIBX11
	select LINGMO_PACKAGE_XLIB_LIBXT
	select LINGMO_PACKAGE_XLIB_LIBXMU
	select LINGMO_PACKAGE_XLIB_LIBXPM
	select LINGMO_PACKAGE_XORGPROTO
	help
	  X.Org Xaw library
```

## package/x11r7/xlib_libXcomposite/Config.in
```kconfig
config LINGMO_PACKAGE_XLIB_LIBXCOMPOSITE
	bool "libXcomposite"
	select LINGMO_PACKAGE_XLIB_LIBX11
	select LINGMO_PACKAGE_XLIB_LIBXEXT
	select LINGMO_PACKAGE_XLIB_LIBXFIXES
	select LINGMO_PACKAGE_XORGPROTO
	help
	  X.Org Xcomposite library
```

## package/x11r7/xlib_libXcursor/Config.in
```kconfig
config LINGMO_PACKAGE_XLIB_LIBXCURSOR
	bool "libXcursor"
	select LINGMO_PACKAGE_XLIB_LIBX11
	select LINGMO_PACKAGE_XLIB_LIBXFIXES
	select LINGMO_PACKAGE_XLIB_LIBXRENDER
	select LINGMO_PACKAGE_XORGPROTO
	help
	  X.Org Xcursor library
```

## package/x11r7/xlib_libXdamage/Config.in
```kconfig
config LINGMO_PACKAGE_XLIB_LIBXDAMAGE
	bool "libXdamage"
	select LINGMO_PACKAGE_XLIB_LIBX11
	select LINGMO_PACKAGE_XLIB_LIBXFIXES
	select LINGMO_PACKAGE_XORGPROTO
	help
	  X.Org Xdamage library
```

## package/x11r7/xlib_libXdmcp/Config.in
```kconfig
config LINGMO_PACKAGE_XLIB_LIBXDMCP
	bool "libXdmcp"
	select LINGMO_PACKAGE_XUTIL_UTIL_MACROS
	select LINGMO_PACKAGE_XORGPROTO
	help
	  X.Org Xdmcp library
```

## package/x11r7/xlib_libXext/Config.in
```kconfig
config LINGMO_PACKAGE_XLIB_LIBXEXT
	bool "libXext"
	select LINGMO_PACKAGE_XLIB_LIBX11
	select LINGMO_PACKAGE_XORGPROTO
	help
	  X.Org Xext library
```

## package/x11r7/xlib_libXfixes/Config.in
```kconfig
config LINGMO_PACKAGE_XLIB_LIBXFIXES
	bool "libXfixes"
	select LINGMO_PACKAGE_XLIB_LIBX11
	select LINGMO_PACKAGE_XORGPROTO
	help
	  X.Org Xfixes library
```

## package/x11r7/xlib_libXfont/Config.in
```kconfig
config LINGMO_PACKAGE_XLIB_LIBXFONT
	bool "libXfont"
	select LINGMO_PACKAGE_FREETYPE
	select LINGMO_PACKAGE_XLIB_LIBFONTENC
	select LINGMO_PACKAGE_XLIB_XTRANS
	select LINGMO_PACKAGE_XFONT_ENCODINGS
	select LINGMO_PACKAGE_XORGPROTO
	help
	  X.Org Xfont library
```

## package/x11r7/xlib_libXfont2/Config.in
```kconfig
config LINGMO_PACKAGE_XLIB_LIBXFONT2
	bool "libXfont2"
	select LINGMO_PACKAGE_FREETYPE
	select LINGMO_PACKAGE_XLIB_LIBFONTENC
	select LINGMO_PACKAGE_XLIB_XTRANS
	select LINGMO_PACKAGE_XFONT_ENCODINGS
	select LINGMO_PACKAGE_XORGPROTO
	help
	  X.Org Xfont library
```

## package/x11r7/xlib_libXft/Config.in
```kconfig
config LINGMO_PACKAGE_XLIB_LIBXFT
	bool "libXft"
	select LINGMO_PACKAGE_FONTCONFIG
	select LINGMO_PACKAGE_FREETYPE
	select LINGMO_PACKAGE_XLIB_LIBX11
	select LINGMO_PACKAGE_XLIB_LIBXEXT
	select LINGMO_PACKAGE_XLIB_LIBXRENDER
	select LINGMO_PACKAGE_XORGPROTO
	help
	  X.Org Xft library
```

## package/x11r7/xlib_libXinerama/Config.in
```kconfig
config LINGMO_PACKAGE_XLIB_LIBXINERAMA
	bool "libXinerama"
	select LINGMO_PACKAGE_XLIB_LIBX11
	select LINGMO_PACKAGE_XLIB_LIBXEXT
	select LINGMO_PACKAGE_XORGPROTO
	help
	  X.Org Xinerama library
```

## package/x11r7/xlib_libXpm/Config.in
```kconfig
config LINGMO_PACKAGE_XLIB_LIBXPM
	bool "libXpm"
	select LINGMO_PACKAGE_XLIB_LIBX11
	select LINGMO_PACKAGE_XLIB_LIBXEXT
	select LINGMO_PACKAGE_XLIB_LIBXT
	select LINGMO_PACKAGE_XORGPROTO
	help
	  X.Org Xpm library
```

## package/x11r7/xlib_libXpresent/Config.in
```kconfig
config LINGMO_PACKAGE_XLIB_LIBXPRESENT
	bool "libXpresent"
	select LINGMO_PACKAGE_XLIB_LIBX11
	select LINGMO_PACKAGE_XLIB_LIBXEXT
	select LINGMO_PACKAGE_XLIB_LIBXFIXES
	select LINGMO_PACKAGE_XLIB_LIBXRANDR
	select LINGMO_PACKAGE_XORGPROTO
	help
	  X.Org Xpresent library
```

## package/x11r7/xlib_libXrandr/Config.in
```kconfig
config LINGMO_PACKAGE_XLIB_LIBXRANDR
	bool "libXrandr"
	select LINGMO_PACKAGE_XLIB_LIBX11
	select LINGMO_PACKAGE_XLIB_LIBXEXT
	select LINGMO_PACKAGE_XLIB_LIBXRENDER
	select LINGMO_PACKAGE_XORGPROTO
	help
	  X.Org Xrandr library
```

## package/x11r7/xlib_libXrender/Config.in
```kconfig
config LINGMO_PACKAGE_XLIB_LIBXRENDER
	bool "libXrender"
	select LINGMO_PACKAGE_XLIB_LIBX11
	select LINGMO_PACKAGE_XORGPROTO
	help
	  X.Org Xrender library
```

## package/x11r7/xlib_libXres/Config.in
```kconfig
config LINGMO_PACKAGE_XLIB_LIBXRES
	bool "libXres"
	select LINGMO_PACKAGE_XLIB_LIBX11
	select LINGMO_PACKAGE_XLIB_LIBXEXT
	select LINGMO_PACKAGE_XORGPROTO
	help
	  X.Org XRes library
```

## package/x11r7/xlib_libXt/Config.in
```kconfig
config LINGMO_PACKAGE_XLIB_LIBXT
	bool "libXt"
	select LINGMO_PACKAGE_XLIB_LIBSM
	select LINGMO_PACKAGE_XLIB_LIBX11
	select LINGMO_PACKAGE_XORGPROTO
	select LINGMO_PACKAGE_XCB_PROTO
	select LINGMO_PACKAGE_LIBXCB
	help
	  X.Org Xt library
```
