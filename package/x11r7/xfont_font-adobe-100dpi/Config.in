## package/x11r7/xfont_font-adobe-100dpi/Config.in
```kconfig
config LINGMO_PACKAGE_XFONT_FONT_ADOBE_100DPI
	bool "font-adobe-100dpi"
	select LINGMO_PACKAGE_XFONT_FONT_UTIL
	help
	  No description available
```

## package/x11r7/xfont_font-adobe-75dpi/Config.in
```kconfig
config LINGMO_PACKAGE_XFONT_FONT_ADOBE_75DPI
	bool "font-adobe-75dpi"
	select LINGMO_PACKAGE_XFONT_FONT_UTIL
	help
	  No description available
```

## package/x11r7/xfont_font-alias/Config.in
```kconfig
config LINGMO_PACKAGE_XFONT_FONT_ALIAS
	bool "font-alias"
	select LINGMO_PACKAGE_XFONT_FONT_UTIL
	help
	  No description available
```

## package/x11r7/xfont_font-arabic-misc/Config.in
```kconfig
config LINGMO_PACKAGE_XFONT_FONT_ARABIC_MISC
	bool "font-arabic-misc"
	select LINGMO_PACKAGE_XFONT_FONT_UTIL
	help
	  No description available
```

## package/x11r7/xfont_font-bh-100dpi/Config.in
```kconfig
config LINGMO_PACKAGE_XFONT_FONT_BH_100DPI
	bool "font-bh-100dpi"
	select LINGMO_PACKAGE_XFONT_FONT_UTIL
	help
	  No description available
```

## package/x11r7/xfont_font-bh-75dpi/Config.in
```kconfig
config LINGMO_PACKAGE_XFONT_FONT_BH_75DPI
	bool "font-bh-75dpi"
	select LINGMO_PACKAGE_XFONT_FONT_UTIL
	help
	  No description available
```

## package/x11r7/xfont_font-bh-lucidatypewriter-100dpi/Config.in
```kconfig
config LINGMO_PACKAGE_XFONT_FONT_BH_LUCIDATYPEWRITER_100DPI
	bool "font-bh-lucidatypewriter-100dpi"
	select LINGMO_PACKAGE_XFONT_FONT_UTIL
	help
	  No description available
```

## package/x11r7/xfont_font-bh-lucidatypewriter-75dpi/Config.in
```kconfig
config LINGMO_PACKAGE_XFONT_FONT_BH_LUCIDATYPEWRITER_75DPI
	bool "font-bh-lucidatypewriter-75dpi"
	select LINGMO_PACKAGE_XFONT_FONT_UTIL
	help
	  No description available
```

## package/x11r7/xfont_font-bh-ttf/Config.in
```kconfig
config LINGMO_PACKAGE_XFONT_FONT_BH_TTF
	bool "font-bh-ttf"
	select LINGMO_PACKAGE_XFONT_FONT_UTIL
	help
	  No description available
```

## package/x11r7/xfont_font-bitstream-100dpi/Config.in
```kconfig
config LINGMO_PACKAGE_XFONT_FONT_BITSTREAM_100DPI
	bool "font-bitstream-100dpi"
	select LINGMO_PACKAGE_XFONT_FONT_UTIL
	help
	  No description available
```

## package/x11r7/xfont_font-bitstream-75dpi/Config.in
```kconfig
config LINGMO_PACKAGE_XFONT_FONT_BITSTREAM_75DPI
	bool "font-bitstream-75dpi"
	select LINGMO_PACKAGE_XFONT_FONT_UTIL
	help
	  No description available
```

## package/x11r7/xfont_font-cursor-misc/Config.in
```kconfig
config LINGMO_PACKAGE_XFONT_FONT_CURSOR_MISC
	bool "font-cursor-misc"
	select LINGMO_PACKAGE_XFONT_FONT_UTIL
	help
	  No description available
```

## package/x11r7/xfont_font-daewoo-misc/Config.in
```kconfig
config LINGMO_PACKAGE_XFONT_FONT_DAEWOO_MISC
	bool "font-daewoo-misc"
	select LINGMO_PACKAGE_XFONT_FONT_UTIL
	help
	  No description available
```

## package/x11r7/xfont_font-ibm-type1/Config.in
```kconfig
config LINGMO_PACKAGE_XFONT_FONT_IBM_TYPE1
	bool "font-ibm-type1"
	select LINGMO_PACKAGE_XFONT_FONT_UTIL
	help
	  No description available
```

## package/x11r7/xfont_font-isas-misc/Config.in
```kconfig
config LINGMO_PACKAGE_XFONT_FONT_ISAS_MISC
	bool "font-isas-misc"
	select LINGMO_PACKAGE_XFONT_FONT_UTIL
	help
	  No description available
```

## package/x11r7/xfont_font-jis-misc/Config.in
```kconfig
config LINGMO_PACKAGE_XFONT_FONT_JIS_MISC
	bool "font-jis-misc"
	select LINGMO_PACKAGE_XFONT_FONT_UTIL
	help
	  No description available
```

## package/x11r7/xfont_font-micro-misc/Config.in
```kconfig
config LINGMO_PACKAGE_XFONT_FONT_MICRO_MISC
	bool "font-micro-misc"
	select LINGMO_PACKAGE_XFONT_FONT_UTIL
	help
	  No description available
```

## package/x11r7/xfont_font-misc-cyrillic/Config.in
```kconfig
config LINGMO_PACKAGE_XFONT_FONT_MISC_CYRILLIC
	bool "font-misc-cyrillic"
	select LINGMO_PACKAGE_XFONT_FONT_UTIL
	help
	  No description available
```

## package/x11r7/xfont_font-misc-ethiopic/Config.in
```kconfig
config LINGMO_PACKAGE_XFONT_FONT_MISC_ETHIOPIC
	bool "font-misc-ethiopic"
	select LINGMO_PACKAGE_XFONT_FONT_UTIL
	help
	  No description available
```

## package/x11r7/xfont_font-misc-meltho/Config.in
```kconfig
config LINGMO_PACKAGE_XFONT_FONT_MISC_MELTHO
	bool "font-misc-meltho"
	select LINGMO_PACKAGE_XFONT_FONT_UTIL
	help
	  No description available
```

## package/x11r7/xfont_font-mutt-misc/Config.in
```kconfig
config LINGMO_PACKAGE_XFONT_FONT_MUTT_MISC
	bool "font-mutt-misc"
	select LINGMO_PACKAGE_XFONT_FONT_UTIL
	help
	  No description available
```

## package/x11r7/xfont_font-schumacher-misc/Config.in
```kconfig
config LINGMO_PACKAGE_XFONT_FONT_SCHUMACHER_MISC
	bool "font-schumacher-misc"
	select LINGMO_PACKAGE_XFONT_FONT_UTIL
	help
	  No description available
```

## package/x11r7/xfont_font-screen-cyrillic/Config.in
```kconfig
config LINGMO_PACKAGE_XFONT_FONT_SCREEN_CYRILLIC
	bool "font-screen-cyrillic"
	select LINGMO_PACKAGE_XFONT_FONT_UTIL
	help
	  No description available
```

## package/x11r7/xfont_font-sony-misc/Config.in
```kconfig
config LINGMO_PACKAGE_XFONT_FONT_SONY_MISC
	bool "font-sony-misc"
	select LINGMO_PACKAGE_XFONT_FONT_UTIL
	help
	  No description available
```

## package/x11r7/xfont_font-sun-misc/Config.in
```kconfig
config LINGMO_PACKAGE_XFONT_FONT_SUN_MISC
	bool "font-sun-misc"
	select LINGMO_PACKAGE_XFONT_FONT_UTIL
	help
	  No description available
```
