## package/libsquish/Config.in
```kconfig
config LINGMO_PACKAGE_LIBSQUISH
	bool "libsquish"
	depends on LINGMO_INSTALL_LIBSTDCPP
	help
	  The libSquish library compresses images with the DXT standard
	  (also known as S3TC). This standard is mainly used by OpenGL
	  and DirectX for the lossy compression of RGBA textures.

	  http://sourceforge.net/projects/libsquish

comment "libsquish needs a toolchain w/ C++"
	depends on !LINGMO_INSTALL_LIBSTDCPP
```

## package/libss7/Config.in
```kconfig
config LINGMO_PACKAGE_LIBSS7
	bool "libss7"
	depends on LINGMO_USE_MMU # dahdi-tools <- perl
	depends on LINGMO_LINUX_KERNEL
	depends on LINGMO_TOOLCHAIN_HAS_THREADS
	select LINGMO_PACKAGE_DAHDI_LINUX
	select LINGMO_PACKAGE_DAHDI_TOOLS
	help
	  libss7 is an open source library that encapsulates the
	  protocols used to communicate using Signaling System 7
	  over ISDN (T1, E1).

	  http://www.asterisk.org/downloads/libss7

comment "libss7 needs a Linux kernel to be built"
	depends on !LINGMO_LINUX_KERNEL

comment "libss7 needs a toolchain w/ threads"
	depends on !LINGMO_TOOLCHAIN_HAS_THREADS
```

## package/libssh/Config.in
```kconfig
config LINGMO_PACKAGE_LIBSSH
	bool "libssh"
	depends on LINGMO_USE_MMU # fork()
	depends on !LINGMO_STATIC_LIBS
	depends on LINGMO_TOOLCHAIN_HAS_THREADS
	select LINGMO_PACKAGE_OPENSSL if !(LINGMO_PACKAGE_MBEDTLS || LINGMO_PACKAGE_LIBGCRYPT)
	select LINGMO_PACKAGE_LIBOPENSSL_ENABLE_DES if LINGMO_PACKAGE_LIBOPENSSL
	help
	  libssh is a multiplatform C library implementing the SSHv2
	  and SSHv1 protocol on client and server side. With libssh,
	  you can remotely execute programs, transfer files, use a
	  secure and transparent tunnel for your remote applications.

	  http://www.libssh.org/

if LINGMO_PACKAGE_LIBSSH

config LINGMO_PACKAGE_LIBSSH_SERVER
	bool "server"
	help
	  Enable libssh server support

choice
	prompt "Crypto Backend"
	help
	  Select crypto library to be used in libssh.

config LINGMO_PACKAGE_LIBSSH_MBEDTLS
	bool "mbedtls"
	depends on LINGMO_PACKAGE_MBEDTLS

config LINGMO_PACKAGE_LIBSSH_LIBGCRYPT
	bool "gcrypt"
	depends on LINGMO_PACKAGE_LIBGCRYPT

config LINGMO_PACKAGE_LIBSSH_OPENSSL
	bool "openssl"
	depends on LINGMO_PACKAGE_OPENSSL

endchoice

endif

comment "libssh needs a toolchain w/ dynamic library, threads"
	depends on LINGMO_USE_MMU
	depends on LINGMO_STATIC_LIBS || !LINGMO_TOOLCHAIN_HAS_THREADS
```

## package/libssh2/Config.in
```kconfig
config LINGMO_PACKAGE_LIBSSH2
	bool "libssh2"
	select LINGMO_PACKAGE_OPENSSL if !(LINGMO_PACKAGE_MBEDTLS || LINGMO_PACKAGE_LIBGCRYPT)
	help
	  libssh2 is a client-side C library implementing the SSH2
	  protocol as defined by Internet Drafts: SECSH-TRANS(22),
	  SECSH-USERAUTH(25), SECSH-CONNECTION(23), SECSH-ARCH(20),
	  SECSH-FILEXFER(06)*, SECSH-DHGEX(04), and SECSH-NUMBERS(10)

	  http://www.libssh2.org/

if LINGMO_PACKAGE_LIBSSH2

choice
	prompt "Crypto Backend"
	help
	  Select crypto library to be used in libssh2.

config LINGMO_PACKAGE_LIBSSH2_MBEDTLS
	bool "mbedtls"
	depends on LINGMO_PACKAGE_MBEDTLS

config LINGMO_PACKAGE_LIBSSH2_LIBGCRYPT
	bool "gcrypt"
	depends on LINGMO_PACKAGE_LIBGCRYPT

config LINGMO_PACKAGE_LIBSSH2_OPENSSL
	bool "openssl"
	depends on LINGMO_PACKAGE_OPENSSL
	select LINGMO_PACKAGE_LIBOPENSSL_ENABLE_RMD160 if LINGMO_PACKAGE_LIBOPENSSL

endchoice
endif
```

## package/libstrophe/Config.in
```kconfig
config LINGMO_PACKAGE_LIBSTROPHE
	bool "libstrophe"
	depends on LINGMO_TOOLCHAIN_HAS_THREADS
	select LINGMO_PACKAGE_OPENSSL if !LINGMO_PACKAGE_GNUTLS
	select LINGMO_PACKAGE_LIBXML2 if !LINGMO_PACKAGE_EXPAT
	help
	  libstrophe is a lightweight XMPP client library written in C.
	  It has minimal dependencies and is configurable for various
	  environments. It runs well on both Linux, Unix, and Windows
	  based platforms.

	  https://github.com/strophe/libstrophe

comment "libstrophe needs a toolchain w/ threads"
	depends on !LINGMO_TOOLCHAIN_HAS_THREADS
```

## package/libsvg-cairo/Config.in
```kconfig
config LINGMO_PACKAGE_LIBSVG_CAIRO
	bool "libsvg-cairo"
	select LINGMO_PACKAGE_CAIRO
	select LINGMO_PACKAGE_CAIRO_SVG
	select LINGMO_PACKAGE_LIBSVG
	help
	  Libsvg-cairo provides the ability to render SVG content from
	  files or buffers. All rendering is performed using the cairo
	  rendering library.

	  http://cairographics.org
```
