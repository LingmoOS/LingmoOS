## package/librsvg/Config.in
```kconfig
config LINGMO_PACKAGE_LIBRSVG
	bool "librsvg"
	depends on LINGMO_PACKAGE_HOST_RUSTC_TARGET_ARCH_SUPPORTS
	depends on LINGMO_USE_WCHAR # glib2
	depends on LINGMO_TOOLCHAIN_HAS_THREADS # glib2
	depends on LINGMO_USE_MMU # glib2
	depends on LINGMO_INSTALL_LIBSTDCPP # pango
	depends on LINGMO_TOOLCHAIN_HAS_SYNC_4 # pango -> harfbuzz
	depends on LINGMO_TOOLCHAIN_GCC_AT_LEAST_4_9 # pango -> harfbuzz
	select LINGMO_PACKAGE_CAIRO
	select LINGMO_PACKAGE_CAIRO_PNG
	select LINGMO_PACKAGE_CAIRO_SCRIPT
	select LINGMO_PACKAGE_GDK_PIXBUF
	select LINGMO_PACKAGE_HOST_RUSTC
	select LINGMO_PACKAGE_LIBGLIB2
	select LINGMO_PACKAGE_LIBXML2
	select LINGMO_PACKAGE_PANGO
	help
	  The rsvg library is an efficient renderer for Scalable
	  Vector Graphics (SVG) pictures.

	  https://wiki.gnome.org/Projects/LibRsvg

comment "librsvg needs a toolchain w/ wchar, threads, C++, gcc >= 4.9"
	depends on LINGMO_PACKAGE_HOST_RUSTC_TARGET_ARCH_SUPPORTS
	depends on LINGMO_USE_MMU
	depends on LINGMO_TOOLCHAIN_HAS_SYNC_4
	depends on !LINGMO_USE_WCHAR || !LINGMO_TOOLCHAIN_HAS_THREADS || \
		!LINGMO_TOOLCHAIN_GCC_AT_LEAST_4_9 || \
		!LINGMO_INSTALL_LIBSTDCPP
```

## package/librtas/Config.in
```kconfig
config LINGMO_PACKAGE_LIBRTAS
	bool "librtas"
	depends on LINGMO_powerpc || LINGMO_powerpc64 || LINGMO_powerpc64le
	help
	  The librtas package provides an interface for Run-Time
	  Abstraction Services (RTAS) calls on PAPR platforms.
	  The libraries allow users to examine and manipulate hardware,
	  and parse RTAS events.

	  http://librtas.sourceforge.net/
```

## package/librtlsdr/Config.in
```kconfig
config LINGMO_PACKAGE_LIBRTLSDR
	bool "librtlsdr"
	depends on LINGMO_TOOLCHAIN_HAS_THREADS
	depends on LINGMO_TOOLCHAIN_GCC_AT_LEAST_4_9 # libusb
	select LINGMO_PACKAGE_LIBUSB
	help
	  Library and command line programs for accessing
	  RTL2832U SDR dongles.

	  http://sdr.osmocom.org/trac/wiki/rtl-sdr/

if LINGMO_PACKAGE_LIBRTLSDR

config LINGMO_PACKAGE_LIBRTLSDR_DETACH_DRIVER
	bool "Detach kernel driver"
	default y
	help
	  Enable this option if you would like librtlsdr to
	  automatically detach any kernel driver associated to the
	  RTL2832U USB device on startup if one is loaded.

config LINGMO_PACKAGE_LIBRTLSDR_ZEROCOPY
	bool "Enable usbfs zero-copy support"
	default y
	help
	  This option allows to use kernel usbfs mmap instead
	  of buffers in userspace. If you experiment crash with
	  kernel < 5.6, disable this option.

endif

comment "librtlsdr needs a toolchain w/ threads, gcc >= 4.9"
	depends on !LINGMO_TOOLCHAIN_HAS_THREADS || \
		!LINGMO_TOOLCHAIN_GCC_AT_LEAST_4_9
```

## package/libscrypt/Config.in
```kconfig
config LINGMO_PACKAGE_LIBSCRYPT
	bool "libscrypt"
	# Unconditionally builds a shared library
	depends on !LINGMO_STATIC_LIBS
	help
	  This is a library that implements the secure password
	  hashing function "scrypt".

	  http://www.lolware.net/libscrypt.html

comment "libscrypt needs a toolchain w/ dynamic library"
	depends on LINGMO_STATIC_LIBS
```

## package/libseccomp/Config.in
```kconfig
config LINGMO_PACKAGE_LIBSECCOMP_ARCH_SUPPORTS
	bool
	default y if LINGMO_aarch64
	default y if LINGMO_arm || LINGMO_armeb
	default y if LINGMO_mips || LINGMO_mipsel || LINGMO_mips64 || LINGMO_mips64el
	default y if LINGMO_i386 || LINGMO_x86_64
	default y if LINGMO_powerpc64 || LINGMO_powerpc
	default y if LINGMO_RISCV_64
	default y if LINGMO_s390x

config LINGMO_PACKAGE_LIBSECCOMP
	bool "libseccomp"
	depends on LINGMO_PACKAGE_LIBSECCOMP_ARCH_SUPPORTS
	depends on LINGMO_TOOLCHAIN_HEADERS_AT_LEAST_3_17
	help
	  High level interface to the Linux Kernel's seccomp filter

	  The libseccomp library provides an easy to use, platform
	  independent, interface to the Linux Kernel's syscall filtering
	  mechanism: seccomp. The libseccomp API is designed to abstract
	  away the underlying BPF based syscall filter language and
	  present a more conventional function-call based filtering
	  interface that should be familiar to, and easily adopted by
	  application developers.

	  https://github.com/seccomp/libseccomp

comment "libseccomp needs a toolchain w/ headers >= 3.17"
	depends on LINGMO_PACKAGE_LIBSECCOMP_ARCH_SUPPORTS
	depends on !LINGMO_TOOLCHAIN_HEADERS_AT_LEAST_3_17
```

## package/libsecret/Config.in
```kconfig
config LINGMO_PACKAGE_LIBSECRET
	bool "libsecret"
	depends on LINGMO_USE_WCHAR # gettext dep in libglib2
	depends on LINGMO_TOOLCHAIN_HAS_THREADS # libglib2
	depends on LINGMO_USE_MMU # libglib2
	select LINGMO_PACKAGE_LIBGLIB2
	help
	  libsecret is a library for storing and retrieving passwords
	  and other secrets. It communicates with the "Secret Service"
	  using DBus. gnome-keyring and ksecretservice are both
	  implementations of a Secret Service.

	  https://wiki.gnome.org/Projects/Libsecret

comment "libsecret needs a toolchain w/ wchar, threads"
	depends on LINGMO_USE_MMU
	depends on !LINGMO_USE_WCHAR || !LINGMO_TOOLCHAIN_HAS_THREADS
```

## package/libselinux/Config.in
```kconfig
config LINGMO_PACKAGE_LIBSELINUX
	bool "libselinux"
	depends on LINGMO_TOOLCHAIN_HAS_THREADS
	depends on !LINGMO_STATIC_LIBS
	depends on LINGMO_TOOLCHAIN_GCC_AT_LEAST_5 # libsepol
	select LINGMO_PACKAGE_LIBSEPOL
	select LINGMO_PACKAGE_PCRE2
	select LINGMO_PACKAGE_MUSL_FTS if !LINGMO_TOOLCHAIN_USES_GLIBC
	select LINGMO_PACKAGE_PYTHON_SETUPTOOLS if LINGMO_PACKAGE_PYTHON3
	help
	  libselinux is the runtime SELinux library that provides
	  interfaces (e.g. library functions for the SELinux kernel
	  APIs like getcon(), other support functions like
	  getseuserbyname()) to SELinux-aware applications. libselinux
	  may use the shared libsepol to manipulate the binary policy
	  if necessary (e.g. to downgrade the policy format to an
	  older version supported by the kernel) when loading policy.

	  http://selinuxproject.org/page/Main_Page

comment "libselinux needs a toolchain w/ threads, dynamic library, gcc >= 5"
	depends on !LINGMO_TOOLCHAIN_HAS_THREADS || LINGMO_STATIC_LIBS || \
		!LINGMO_TOOLCHAIN_GCC_AT_LEAST_5
```

## package/libsemanage/Config.in
```kconfig
config LINGMO_PACKAGE_LIBSEMANAGE
	bool "libsemanage"
	depends on LINGMO_PACKAGE_AUDIT_ARCH_SUPPORTS
	depends on LINGMO_TOOLCHAIN_HAS_THREADS
	depends on !LINGMO_STATIC_LIBS
	depends on LINGMO_TOOLCHAIN_GCC_AT_LEAST_5 # libselinux -> libsepol
	select LINGMO_PACKAGE_AUDIT
	select LINGMO_PACKAGE_LIBSELINUX
	select LINGMO_PACKAGE_BZIP2
	help
	  libsemanage is the policy management library. It uses
	  libsepol for binary policy manipulation and libselinux for
	  interacting with the SELinux system. It also exec's helper
	  programs for loading policy and for checking whether the
	  file_contexts configuration is valid (load_policy and
	  setfiles from policycoreutils) presently, although this may
	  change at least for the bootstrapping case (for rpm).

	  http://selinuxproject.org/page/Main_Page

comment "libsemanage needs a toolchain w/ threads, dynamic library, gcc >= 5"
	depends on LINGMO_PACKAGE_AUDIT_ARCH_SUPPORTS
	depends on !LINGMO_TOOLCHAIN_HAS_THREADS || LINGMO_STATIC_LIBS || \
		!LINGMO_TOOLCHAIN_GCC_AT_LEAST_5
```

## package/libserial/Config.in
```kconfig
config LINGMO_PACKAGE_LIBSERIAL
	bool "libserial"
	depends on LINGMO_INSTALL_LIBSTDCPP
	depends on LINGMO_TOOLCHAIN_GCC_AT_LEAST_5 # C++14
	depends on LINGMO_TOOLCHAIN_HAS_THREADS # boost
	depends on LINGMO_USE_WCHAR # boost
	select LINGMO_PACKAGE_BOOST
	help
	  Simplified serial port programming in C++ under POSIX
	  operating systems.

	  http://libserial.sourceforge.net/

comment "libserial needs a toolchain w/ C++, gcc >= 5, threads, wchar"
	depends on !LINGMO_INSTALL_LIBSTDCPP || \
		!LINGMO_TOOLCHAIN_GCC_AT_LEAST_5 || \
		!LINGMO_TOOLCHAIN_HAS_THREADS || !LINGMO_USE_WCHAR
```

## package/libsexy/Config.in
```kconfig
config LINGMO_PACKAGE_LIBSEXY
	bool "libsexy"
	depends on LINGMO_PACKAGE_LIBGTK2
	select LINGMO_PACKAGE_LIBXML2
	help
	  libsexy is a collection of GTK+ widgets that extend the
	  functionality of such standard widgets as GtkEntry and
	  GtkLabel by subclassing them and working around the
	  limitations of the widgets.

	  https://blog.chipx86.com/tag/libsexy/
```

## package/libshairplay/Config.in
```kconfig
config LINGMO_PACKAGE_LIBSHAIRPLAY
	bool "libshairplay"
	depends on LINGMO_TOOLCHAIN_HAS_THREADS
	depends on LINGMO_USE_MMU # avahi
	depends on !LINGMO_STATIC_LIBS # avahi
	select LINGMO_PACKAGE_AVAHI
	select LINGMO_PACKAGE_AVAHI_DAEMON
	select LINGMO_PACKAGE_AVAHI_LIBDNSSD_COMPATIBILITY # runtime
	help
	  libshairplay is a client library that emulates an airplay
	  server.

	  https://github.com/juhovh/shairplay

comment "libshairplay needs a toolchain w/ threads, dynamic library"
	depends on LINGMO_USE_MMU
	depends on !LINGMO_TOOLCHAIN_HAS_THREADS || LINGMO_STATIC_LIBS
```

## package/libshdata/Config.in
```kconfig
config LINGMO_PACKAGE_LIBSHDATA
	bool "libshdata"
	depends on LINGMO_TOOLCHAIN_HAS_SYNC_4
	depends on LINGMO_TOOLCHAIN_HAS_ATOMIC # libfutils
	depends on LINGMO_INSTALL_LIBSTDCPP # libfutils
	depends on LINGMO_TOOLCHAIN_HAS_THREADS # libfutils
	select LINGMO_PACKAGE_LIBFUTILS
	select LINGMO_PACKAGE_ULOG
	help
	  This library provides lock free shared-memory tools

	  https://github.com/Parrot-Developers/libshdata

if LINGMO_PACKAGE_LIBSHDATA

config LINGMO_PACKAGE_LIBSHDATA_STRESS
	bool "libshdata-stress binary"
	depends on !LINGMO_STATIC_LIBS
	help
	  Install libshdata-stress binary as well

comment "libshdata-stress needs a toolchain w/ dynamic library"
	depends on LINGMO_STATIC_LIBS

endif

comment "libshdata needs a toolchain w/ C++, threads"
	depends on LINGMO_TOOLCHAIN_HAS_SYNC_4
	depends on LINGMO_TOOLCHAIN_HAS_ATOMIC
	depends on !LINGMO_INSTALL_LIBSTDCPP || !LINGMO_TOOLCHAIN_HAS_THREADS
```

## package/libsigrok/Config.in
```kconfig
config LINGMO_PACKAGE_LIBSIGROK
	bool "libsigrok"
	# libglib2
	depends on LINGMO_USE_WCHAR
	depends on LINGMO_TOOLCHAIN_HAS_THREADS
	depends on LINGMO_USE_MMU
	depends on LINGMO_ENABLE_LOCALE
	depends on !LINGMO_STATIC_LIBS # libzip
	# std=c11
	depends on LINGMO_TOOLCHAIN_GCC_AT_LEAST_4_7
	select LINGMO_PACKAGE_LIBZIP
	select LINGMO_PACKAGE_LIBGLIB2
	help
	  Libsigrok is a shared library written in C, which provides
	  the basic hardware access drivers for logic analyzers and
	  other supported devices, as well as input/output file format
	  support.

	  This library is a part of the sigrok software suite.

	  http://sigrok.org/wiki/Libsigrok

if LINGMO_PACKAGE_LIBSIGROK

config LINGMO_PACKAGE_LIBSIGROKCXX
	bool "build C++ bindings"
	depends on LINGMO_INSTALL_LIBSTDCPP
	depends on LINGMO_TOOLCHAIN_GCC_AT_LEAST_7 # glibmm -> libsigc
	depends on LINGMO_HOST_GCC_AT_LEAST_4_9 # host-doxygen
	select LINGMO_PACKAGE_GLIBMM
	select LINGMO_PACKAGE_HOST_DOXYGEN
	help
	  Build libsigrok C++ bindings as well.

comment "C++ bindings need a toolchain w/ C++, gcc >= 7, host gcc >= 4.9"
	depends on !LINGMO_INSTALL_LIBSTDCPP || \
		!LINGMO_TOOLCHAIN_GCC_AT_LEAST_7 || \
		!LINGMO_HOST_GCC_AT_LEAST_4_9

endif

comment "libsigrok needs a toolchain w/ wchar, locale, threads, dynamic library, gcc >= 4.7"
	depends on LINGMO_USE_MMU
	depends on !LINGMO_USE_WCHAR || !LINGMO_TOOLCHAIN_HAS_THREADS \
		|| !LINGMO_TOOLCHAIN_GCC_AT_LEAST_4_7 || LINGMO_STATIC_LIBS \
		|| !LINGMO_ENABLE_LOCALE
```

## package/libsigrokdecode/Config.in
```kconfig
config LINGMO_PACKAGE_LIBSIGROKDECODE
	bool "libsigrokdecode"
	depends on LINGMO_USE_WCHAR # libglib2/python3
	depends on LINGMO_TOOLCHAIN_HAS_THREADS # libglib2/python3
	depends on LINGMO_USE_MMU # libglib2/python3
	depends on !LINGMO_STATIC_LIBS # python3
	select LINGMO_PACKAGE_LIBGLIB2
	select LINGMO_PACKAGE_PYTHON3
	help
	  Libsigrokdecode is a shared library written in C, which
	  provides (streaming) protocol decoding functionality. Say
	  yes here if you want to add this functionality to your
	  buildroot-generated sigrok suite.

	  This library is a part of the sigrok software suite.

	  http://sigrok.org/wiki/Libsigrokdecode

comment "libsigrokdecode needs a toolchain w/ wchar, threads, dynamic library"
	depends on LINGMO_USE_MMU
	depends on !LINGMO_USE_WCHAR || !LINGMO_TOOLCHAIN_HAS_THREADS || LINGMO_STATIC_LIBS
```

## package/libsigsegv/Config.in
```kconfig
config LINGMO_PACKAGE_LIBSIGSEGV_ARCH_SUPPORTS
	bool
	default y if LINGMO_TOOLCHAIN_HAS_UCONTEXT

config LINGMO_PACKAGE_LIBSIGSEGV
	bool "libsigsegv"
	depends on LINGMO_PACKAGE_LIBSIGSEGV_ARCH_SUPPORTS
	help
	  Library for handling page faults in user mode.

	  http://www.gnu.org/software/libsigsegv/
```

## package/libsolv/Config.in
```kconfig
config LINGMO_PACKAGE_LIBSOLV
	bool "libsolv"
	depends on LINGMO_USE_MMU # fork()
	select LINGMO_PACKAGE_ZLIB
	help
	  A free package dependency solver using a satisfiability
	  algorithm.

	  https://github.com/openSUSE/libsolv
```

## package/libsoup/Config.in
```kconfig
config LINGMO_PACKAGE_LIBSOUP
	bool "libsoup"
	depends on LINGMO_USE_WCHAR # glib2, gnutls and libpsl
	depends on LINGMO_TOOLCHAIN_HAS_THREADS # glib2
	depends on LINGMO_USE_MMU # glib2
	select LINGMO_PACKAGE_LIBXML2
	select LINGMO_PACKAGE_LIBGLIB2
	select LINGMO_PACKAGE_LIBPSL
	select LINGMO_PACKAGE_SQLITE
	help
	  libsoup is an HTTP client/server library. It uses GObject
	  and the GLib main loop, to integrate well with GNOME
	  applications.

	  https://wiki.gnome.org/Projects/libsoup

if LINGMO_PACKAGE_LIBSOUP

config LINGMO_PACKAGE_LIBSOUP_GNOME
	bool "libsoup-gnome"
	help
	  Build libsoup-gnome library.

config LINGMO_PACKAGE_LIBSOUP_SSL
	bool "https support"
	depends on !LINGMO_STATIC_LIBS # glib-networking, gnutls
	select LINGMO_PACKAGE_GLIB_NETWORKING # runtime
	select LINGMO_PACKAGE_GNUTLS # runtime
	help
	  Enable HTTPS (SSL) support.

comment "libsoup https support needs a toolchain w/ dynamic library"
	depends on LINGMO_STATIC_LIBS

endif

comment "libsoup needs a toolchain w/ wchar, threads"
	depends on LINGMO_USE_MMU
	depends on !LINGMO_USE_WCHAR || !LINGMO_TOOLCHAIN_HAS_THREADS
```

## package/libsoup3/Config.in
```kconfig
config LINGMO_PACKAGE_LIBSOUP3
	bool "libsoup3"
	depends on LINGMO_USE_WCHAR # glib2, libpsl
	depends on LINGMO_TOOLCHAIN_HAS_THREADS # glib2
	depends on LINGMO_USE_MMU # glib2
	select LINGMO_PACKAGE_LIBGLIB2
	select LINGMO_PACKAGE_LIBPSL
	select LINGMO_PACKAGE_NGHTTP2
	select LINGMO_PACKAGE_SQLITE
	help
	  libsoup3 is an HTTP client/server library. It uses GObject
	  and the GLib main loop, to integrate well with GNOME
	  applications.

	  https://wiki.gnome.org/Projects/libsoup

if LINGMO_PACKAGE_LIBSOUP3

config LINGMO_PACKAGE_LIBSOUP3_SSL
	bool "https support"
	depends on !LINGMO_STATIC_LIBS # glib-networking, gnutls
	select LINGMO_PACKAGE_GLIB_NETWORKING # runtime
	select LINGMO_PACKAGE_GNUTLS # runtime
	help
	  Enable HTTPS (SSL) support.

comment "libsoup3 https support needs a toolchain w/ dynamic library"
	depends on LINGMO_STATIC_LIBS

endif

comment "libsoup3 needs a toolchain w/ wchar, threads"
	depends on LINGMO_USE_MMU
	depends on !LINGMO_USE_WCHAR || !LINGMO_TOOLCHAIN_HAS_THREADS
```

## package/libspdm/Config.in
```kconfig
config LINGMO_PACKAGE_LIBSPDM_CPU_FAMILY
	string
	# OpenSSL doesn't support "arc" (LINGMO_arcle || LINGMO_arceb), "arm"
	# (if LINGMO_arm || LINGMO_armeb) or "riscv32"/"riscv6"
	# (LINGMO_riscv && LINGMO_RISCV_32/LINGMO_RISCV_64). So we don't
	# support those here
	default "aarch64"	if LINGMO_aarch64 || LINGMO_aarch64_be
	default "ia32"		if LINGMO_i386
	default "x64"		if LINGMO_x86_64

config LINGMO_PACKAGE_LIBSPDM_ARCH_SUPPORTS
	bool
	default y if LINGMO_PACKAGE_LIBSPDM_CPU_FAMILY != ""

config LINGMO_PACKAGE_LIBSPDM
	bool "libspdm"
	depends on LINGMO_PACKAGE_LIBSPDM_ARCH_SUPPORTS
	select LINGMO_PACKAGE_OPENSSL
	select LINGMO_PACKAGE_OPENSSL_FORCE_LIBOPENSSL
	help
	  libspdm is a sample implementation that follows
	  the DMTF SPDM specifications

	  https://github.com/DMTF/libspdm
```
