## package/sysrepo/Config.in
```kconfig
config LINGMO_PACKAGE_SYSREPO
	bool "sysrepo"
	depends on LINGMO_USE_MMU
	depends on LINGMO_TOOLCHAIN_HAS_SYNC_4 # libyang
	depends on !LINGMO_STATIC_LIBS
	depends on LINGMO_INSTALL_LIBSTDCPP
	depends on LINGMO_TOOLCHAIN_HAS_THREADS_NPTL
	depends on LINGMO_TOOLCHAIN_GCC_AT_LEAST_4_8 # C++11
	select LINGMO_PACKAGE_LIBYANG
	select LINGMO_PACKAGE_PCRE2
	help
	  Sysrepo is an YANG-based configuration and operational state
	  data store for Unix/Linux applications.

	  https://github.com/sysrepo

if LINGMO_PACKAGE_SYSREPO

config LINGMO_PACKAGE_SYSREPO_EXAMPLES
	bool "enable examples"
	help
	  Enable sysrepo examples.

endif

comment "sysrepo needs a toolchain w/ C++, NPTL, dynamic library, gcc >= 4.8"
	depends on LINGMO_USE_MMU
	depends on LINGMO_TOOLCHAIN_HAS_SYNC_4
	depends on LINGMO_STATIC_LIBS || !LINGMO_INSTALL_LIBSTDCPP \
		|| !LINGMO_TOOLCHAIN_HAS_THREADS_NPTL
```

## package/system-config-printer/Config.in
```kconfig
config LINGMO_PACKAGE_SYSTEM_CONFIG_PRINTER
	bool "system-config-printer"
	depends on LINGMO_PACKAGE_CUPS
	help
	  Graphical user interface for CUPS administration

	  https://github.com/OpenPrinting/system-config-printer
```

## package/systemd-bootchart/Config.in
```kconfig
config LINGMO_PACKAGE_SYSTEMD_BOOTCHART_ARCH_SUPPORTS
	bool
	# see src/architecture.h
	default y if LINGMO_aarch64 || LINGMO_aarch64_be
	default y if LINGMO_arm || LINGMO_armeb
	default y if LINGMO_i386 || LINGMO_x86_64
	default y if LINGMO_m68k
	default y if LINGMO_mips || LINGMO_mipsel || LINGMO_mips64 || LINGMO_mips64el
	default y if LINGMO_powerpc || LINGMO_powerpc64 || LINGMO_powerpc64le
	default y if LINGMO_sh
	default y if LINGMO_sparc || LINGMO_sparc64

config LINGMO_PACKAGE_SYSTEMD_BOOTCHART
	bool "systemd-bootchart"
	depends on LINGMO_PACKAGE_SYSTEMD_BOOTCHART_ARCH_SUPPORTS
	depends on LINGMO_INIT_SYSTEMD
	depends on LINGMO_TOOLCHAIN_HEADERS_AT_LEAST_3_17
	help
	  systemd-bootchart is a tool, usually run at system startup,
	  that collects the CPU load, disk load, memory usage, as well
	  as per-process information from a running system. Collected
	  results are output as an SVG graph.

	  systemd-bootchart requires a Linux kernel >= 3.0 with the
	  following options enabled:

	  - CONFIG_SCHEDSTATS
	  - CONFIG_SCHED_DEBUG

	  These options will be automatically enabled by Buildroot if
	  it is responsible for building the kernel. Otherwise, if you
	  are building your kernel outside of Buildroot, make sure
	  these options are enabled.

	  http://www.freedesktop.org/software/systemd/man/systemd-bootchart.html

comment "systemd-bootchart needs a toolchain w/ headers >= 3.17"
	depends on LINGMO_PACKAGE_SYSTEMD_BOOTCHART_ARCH_SUPPORTS
	depends on LINGMO_INIT_SYSTEMD
	depends on !LINGMO_TOOLCHAIN_HEADERS_AT_LEAST_3_17
```

## package/systemd/Config.in.host
```kconfig
# Select this if you need host systemd tools (e.g. systemctl)
config LINGMO_PACKAGE_HOST_SYSTEMD
	bool
	depends on LINGMO_HOST_GCC_AT_LEAST_5
```

## package/sysvinit/Config.in
```kconfig
config LINGMO_PACKAGE_SYSVINIT
	bool "sysvinit"
	depends on LINGMO_USE_MMU # fork()
	depends on LINGMO_INIT_SYSV
	depends on LINGMO_PACKAGE_BUSYBOX_SHOW_OTHERS
	help
	  System V style implementation of /sbin/init, parent of all
	  processes

	  http://savannah.nongnu.org/projects/sysvinit
```

## package/taglib/Config.in
```kconfig
config LINGMO_PACKAGE_TAGLIB
	bool "taglib"
	depends on LINGMO_INSTALL_LIBSTDCPP
	depends on LINGMO_USE_WCHAR
	help
	  TagLib is a library for reading and editing the meta-data of
	  several popular audio formats. Currently it supports both
	  ID3v1 and ID3v2 for MP3 files, Ogg Vorbis comments and ID3
	  tags and Vorbis comments in FLAC, MPC, Speex, WavPack and
	  TrueAudio files.

	  http://taglib.org/

comment "taglib needs a toolchain w/ C++, wchar"
	depends on !LINGMO_INSTALL_LIBSTDCPP || !LINGMO_USE_WCHAR
```

## package/tar/Config.in
```kconfig
config LINGMO_PACKAGE_TAR
	bool "tar"
	depends on LINGMO_USE_WCHAR
	depends on LINGMO_USE_MMU # fork()
	depends on LINGMO_PACKAGE_BUSYBOX_SHOW_OTHERS
	help
	  A program that saves many files together into a single tape
	  or disk archive, and can restore individual files from the
	  archive.

	  http://www.gnu.org/software/tar/

comment "tar needs a toolchain w/ wchar"
	depends on !LINGMO_USE_WCHAR
	depends on LINGMO_USE_MMU
	depends on LINGMO_PACKAGE_BUSYBOX_SHOW_OTHERS
```

## package/targetcli-fb/Config.in
```kconfig
comment "targetcli-fb needs Python, a glibc toolchain, gcc >= 4.9, host gcc >= 8"
	depends on !LINGMO_PACKAGE_PYTHON3
	depends on LINGMO_USE_MMU
	depends on LINGMO_PACKAGE_GOBJECT_INTROSPECTION_ARCH_SUPPORTS
	depends on !LINGMO_HOST_GCC_AT_LEAST_8 || \
		!LINGMO_TOOLCHAIN_GCC_AT_LEAST_4_9 || \
		!LINGMO_TOOLCHAIN_USES_GLIBC

config LINGMO_PACKAGE_TARGETCLI_FB
	bool "targetcli-fb"
	depends on LINGMO_PACKAGE_PYTHON3 # python-configshell-fb
	depends on LINGMO_USE_MMU # python-gobject -> gobject-introspection
	depends on LINGMO_PACKAGE_GOBJECT_INTROSPECTION_ARCH_SUPPORTS # python-gobject -> gobject-introspection
	depends on LINGMO_HOST_GCC_AT_LEAST_8 # python-gobject -> gobject-introspection
	depends on LINGMO_TOOLCHAIN_GCC_AT_LEAST_4_9 # python-gobject -> gobject-introspection
	depends on LINGMO_TOOLCHAIN_USES_GLIBC # python-gobject -> gobject-introspection
	select LINGMO_PACKAGE_PYTHON_CONFIGSHELL_FB
	select LINGMO_PACKAGE_PYTHON_RTSLIB_FB
	select LINGMO_PACKAGE_PYTHON_SIX
	select LINGMO_PACKAGE_PYTHON_GOBJECT
	help
	  targetcli-fb is a command-line interface for configuring the
	  LIO generic SCSI target, present in 3.x Linux kernel
	  versions.

	  https://github.com/open-iscsi/targetcli-fb
```

## package/taskd/Config.in
```kconfig
config LINGMO_PACKAGE_TASKD
	bool "taskd"
	depends on !LINGMO_STATIC_LIBS # gnutls
	depends on LINGMO_USE_WCHAR # gnutls
	depends on LINGMO_USE_MMU # fork()
	depends on LINGMO_INSTALL_LIBSTDCPP
	select LINGMO_PACKAGE_GNUTLS
	select LINGMO_PACKAGE_UTIL_LINUX
	select LINGMO_PACKAGE_UTIL_LINUX_LIBUUID
	help
	  Task management synchronization daemon.

	  http://taskwarrior.org/

comment "taskd needs a toolchain w/ C++, wchar, dynamic library"
	depends on LINGMO_USE_MMU
	depends on !LINGMO_USE_WCHAR || !LINGMO_INSTALL_LIBSTDCPP || \
		LINGMO_STATIC_LIBS
```

## package/tbb/Config.in
```kconfig
config LINGMO_PACKAGE_TBB
	bool "tbb"
	# tbb needs fenv.h which is not provided by uclibc
	depends on !LINGMO_TOOLCHAIN_USES_UCLIBC
	depends on !LINGMO_STATIC_LIBS
	depends on LINGMO_TOOLCHAIN_HAS_THREADS
	depends on LINGMO_INSTALL_LIBSTDCPP
	depends on !LINGMO_TOOLCHAIN_HAS_GCC_BUG_64735 # exception_ptr
	help
	  Intel(R) Threading Building Blocks (Intel(R) TBB) lets you
	  easily write parallel C++ programs that take full advantage
	  of multicore performance, that are portable, composable and
	  have future-proof scalability.

	  https://www.threadingbuildingblocks.org/

comment "tbb needs a glibc or musl toolchain w/ dynamic library, threads, C++"
	depends on LINGMO_TOOLCHAIN_USES_UCLIBC || LINGMO_STATIC_LIBS || \
		!LINGMO_TOOLCHAIN_HAS_THREADS || !LINGMO_INSTALL_LIBSTDCPP

comment "tbb needs exception_ptr"
	depends on LINGMO_TOOLCHAIN_HAS_GCC_BUG_64735
```

## package/tcf-agent/Config.in
```kconfig
config LINGMO_PACKAGE_TCF_AGENT
	bool "tcf-agent"
	depends on LINGMO_TOOLCHAIN_HAS_THREADS
	depends on LINGMO_PACKAGE_TCF_AGENT_ARCH_SUPPORTS
	depends on LINGMO_USE_MMU # util-linux
	select LINGMO_PACKAGE_UTIL_LINUX
	select LINGMO_PACKAGE_UTIL_LINUX_LIBUUID
	help
	  Target Communication Framework Agent is an example
	  application using the Target Communication Framework
	  Library.

	  Target Communication Framework is universal, extensible,
	  simple, lightweight, vendor agnostic framework for tools and
	  targets to communicate for purpose of debugging, profiling,
	  code patching and other device software development needs.

	  tcf-agent is a daemon, which provides TCF services that can
	  be used by local and remote clients.

	  https://wiki.eclipse.org/TCF

config LINGMO_PACKAGE_TCF_AGENT_ARCH
	string
	default "arm"        if LINGMO_arm || LINGMO_armeb
	default "a64"        if LINGMO_aarch64 || LINGMO_aarch64_be
	default "i686"       if LINGMO_i386 && LINGMO_ARCH="i686"
	default "i386"       if LINGMO_i386 && !LINGMO_ARCH="i686"
	default "x86_64"     if LINGMO_x86_64
	default "powerpc"    if LINGMO_powerpc || LINGMO_powerpc64 || \
		LINGMO_powerpc64le
	default "microblaze" if LINGMO_microblaze || LINGMO_microblazeel

config LINGMO_PACKAGE_TCF_AGENT_ARCH_SUPPORTS
	bool
	default y if LINGMO_PACKAGE_TCF_AGENT_ARCH != ""

comment "tcf-agent needs a toolchain w/ threads"
	depends on LINGMO_PACKAGE_TCF_AGENT_ARCH_SUPPORTS
	depends on LINGMO_USE_MMU
	depends on !LINGMO_TOOLCHAIN_HAS_THREADS
```

## package/tcpdump/Config.in
```kconfig
config LINGMO_PACKAGE_TCPDUMP
	bool "tcpdump"
	select LINGMO_PACKAGE_LIBPCAP
	help
	  A tool for network monitoring and data acquisition.

	  https://www.tcpdump.org/

if LINGMO_PACKAGE_TCPDUMP

config LINGMO_PACKAGE_TCPDUMP_SMB
	bool "smb dump support"
	help
	  enable possibly-buggy SMB printer

endif
```

## package/tcpreplay/Config.in
```kconfig
config LINGMO_PACKAGE_TCPREPLAY
	bool "tcpreplay"
	depends on LINGMO_USE_MMU # fork()
	select LINGMO_PACKAGE_LIBPCAP
	select LINGMO_PACKAGE_MUSL_FTS if !LINGMO_TOOLCHAIN_USES_GLIBC
	help
	  Tcpreplay is a tool for replaying network traffic from files
	  saved with tcpdump or other tools which write pcap(3) files.

	  http://tcpreplay.appneta.com/
```
