## package/supertux/Config.in
```kconfig
config LINGMO_PACKAGE_SUPERTUX
	bool "supertux"
	depends on LINGMO_INSTALL_LIBSTDCPP
	depends on LINGMO_PACKAGE_HAS_LIBGL # libglew
	depends on LINGMO_PACKAGE_OPENAL_ARCH_SUPPORTS
	depends on LINGMO_PACKAGE_XORG7 # libglew, SDL2 OpenGL (GLX)
	depends on LINGMO_TOOLCHAIN_GCC_AT_LEAST_6 # C++14
	depends on LINGMO_TOOLCHAIN_HAS_THREADS_NPTL # openal
	depends on LINGMO_TOOLCHAIN_SUPPORTS_ALWAYS_LOCKFREE_ATOMIC_INTS # boost-filesystem
	depends on LINGMO_USE_MMU # SDL2 OpenGL (GLX)
	depends on !LINGMO_STATIC_LIBS # SDL2
	depends on LINGMO_USE_WCHAR # Boost
	select LINGMO_PACKAGE_BOOST
	select LINGMO_PACKAGE_BOOST_DATE_TIME
	select LINGMO_PACKAGE_BOOST_FILESYSTEM
	select LINGMO_PACKAGE_BOOST_LOCALE
	select LINGMO_PACKAGE_BOOST_SYSTEM
	select LINGMO_PACKAGE_FREETYPE
	select LINGMO_PACKAGE_GLM
	select LINGMO_PACKAGE_LIBCURL
	select LINGMO_PACKAGE_LIBGLEW
	select LINGMO_PACKAGE_LIBOGG
	select LINGMO_PACKAGE_LIBPNG
	select LINGMO_PACKAGE_LIBVORBIS
	select LINGMO_PACKAGE_OPENAL
	select LINGMO_PACKAGE_PHYSFS
	select LINGMO_PACKAGE_SDL2
	select LINGMO_PACKAGE_SDL2_IMAGE
	select LINGMO_PACKAGE_SDL2_OPENGL
	select LINGMO_PACKAGE_ZLIB
	help
	  SuperTux is a free classic 2D jump'n run sidescroller game in
	  a style similar to the original Super Mario games covered
	  under the GNU GPL.

	  http://supertux.github.io/

comment "supertux needs OpenGL and a toolchain w/ C++, gcc >= 6, NPTL, dynamic library, wchar"
	depends on LINGMO_PACKAGE_OPENAL_ARCH_SUPPORTS
	depends on LINGMO_PACKAGE_XORG7
	depends on LINGMO_USE_MMU
	depends on LINGMO_TOOLCHAIN_SUPPORTS_ALWAYS_LOCKFREE_ATOMIC_INTS
	depends on !LINGMO_INSTALL_LIBSTDCPP || !LINGMO_PACKAGE_HAS_LIBGL || \
		!LINGMO_TOOLCHAIN_GCC_AT_LEAST_6 || !LINGMO_TOOLCHAIN_HAS_THREADS_NPTL || \
		LINGMO_STATIC_LIBS || !LINGMO_USE_WCHAR
```

## package/supertuxkart/Config.in
```kconfig
config LINGMO_PACKAGE_SUPERTUXKART
	bool "supertuxkart"
	depends on LINGMO_HOSTARCH = "x86_64" || LINGMO_HOSTARCH = "x86"
	depends on LINGMO_i386 || LINGMO_x86_64
	depends on LINGMO_USE_MMU # fork()
	depends on LINGMO_INSTALL_LIBSTDCPP # openal
	depends on LINGMO_TOOLCHAIN_GCC_AT_LEAST_4_9 # harfbuzz, openal
	depends on LINGMO_TOOLCHAIN_HAS_THREADS_NPTL # openal
	depends on LINGMO_PACKAGE_OPENAL_ARCH_SUPPORTS # openal
	depends on LINGMO_PACKAGE_HAS_LIBGL
	depends on LINGMO_PACKAGE_XORG7
	depends on !LINGMO_TOOLCHAIN_USES_MUSL
	select LINGMO_PACKAGE_FREETYPE
	select LINGMO_PACKAGE_ENET
	select LINGMO_PACKAGE_HARFBUZZ
	select LINGMO_PACKAGE_JPEG
	select LINGMO_PACKAGE_LIBCURL
	select LINGMO_PACKAGE_LIBOGG
	select LINGMO_PACKAGE_LIBPNG
	select LINGMO_PACKAGE_LIBSQUISH
	select LINGMO_PACKAGE_LIBVORBIS
	select LINGMO_PACKAGE_OPENSSL if !LINGMO_PACKAGE_MBEDTLS
	select LINGMO_PACKAGE_OPENAL
	select LINGMO_PACKAGE_SDL2
	select LINGMO_PACKAGE_XLIB_LIBXRANDR
	select LINGMO_PACKAGE_ZLIB
	select LINGMO_PACKAGE_BLUEZ5_UTILS_PLUGINS_HID if LINGMO_PACKAGE_BLUEZ5_UTILS && LINGMO_TOOLCHAIN_HEADERS_AT_LEAST_3_18 # runtime
	help
	  Karts. Nitro. Action! SuperTuxKart is a free 3D arcade kart
	  racer with multiple karts, tracks and modes you can play.
	  Beat the evil Nolok by any means necessary, and make the
	  mascot kingdom safe once again!

	  http://supertuxkart.sourceforge.net/Main_Page

comment "supertuxkart needs an OpenGL backend, a uClibc or glibc toolchain w/ NPTL, C++, gcc >= 4.9"
	depends on LINGMO_HOSTARCH = "x86_64" || LINGMO_HOSTARCH = "x86"
	depends on LINGMO_i386 || LINGMO_x86_64
	depends on LINGMO_USE_MMU
	depends on LINGMO_PACKAGE_OPENAL_ARCH_SUPPORTS
	depends on LINGMO_PACKAGE_XORG7
	depends on !LINGMO_TOOLCHAIN_HAS_THREADS_NPTL \
		|| !LINGMO_INSTALL_LIBSTDCPP \
		|| !LINGMO_TOOLCHAIN_GCC_AT_LEAST_4_9 \
		|| !LINGMO_PACKAGE_HAS_LIBGL \
		|| LINGMO_TOOLCHAIN_USES_MUSL
```

## package/supervisor/Config.in
```kconfig
config LINGMO_PACKAGE_SUPERVISOR
	bool "supervisor"
	depends on LINGMO_PACKAGE_PYTHON3
	select LINGMO_PACKAGE_PYTHON_SETUPTOOLS # runtime dependency
	help
	  A client/server system that allows its users to control a
	  number of processes on UNIX-like operating systems.

	  http://supervisord.org/

comment "supervisor needs a python interpreter"
	depends on !LINGMO_PACKAGE_PYTHON3
```

## package/suricata/Config.in
```kconfig
config LINGMO_PACKAGE_SURICATA
	bool "suricata"
	depends on LINGMO_PACKAGE_HOST_RUSTC_TARGET_ARCH_SUPPORTS
	depends on LINGMO_USE_MMU # fork()
	depends on LINGMO_USE_WCHAR
	depends on LINGMO_TOOLCHAIN_HAS_THREADS
	select LINGMO_PACKAGE_HOST_RUSTC
	select LINGMO_PACKAGE_JANSSON
	select LINGMO_PACKAGE_LIBHTP
	select LINGMO_PACKAGE_LIBPCAP
	select LINGMO_PACKAGE_LIBYAML
	select LINGMO_PACKAGE_PCRE
	help
	  Suricata is a free and open source, mature, fast and robust
	  network threat detection engine.

	  The Suricata engine is capable of real time intrusion
	  detection (IDS), inline intrusion prevention (IPS), network
	  security monitoring (NSM) and offline pcap processing.

	  https://suricata-ids.org

comment "suricata needs a toolchain w/ wchar, threads"
	depends on LINGMO_PACKAGE_HOST_RUSTC_TARGET_ARCH_SUPPORTS
	depends on LINGMO_USE_MMU
	depends on !LINGMO_USE_WCHAR || !LINGMO_TOOLCHAIN_HAS_THREADS
```

## package/sway/Config.in
```kconfig
config LINGMO_PACKAGE_SWAY
	bool "sway"
	depends on LINGMO_PACKAGE_SYSTEMD # is required by the sd-bus provider
	depends on !LINGMO_STATIC_LIBS # wlroots
	depends on LINGMO_TOOLCHAIN_HAS_THREADS # pango, wlroots
	depends on LINGMO_PACKAGE_HAS_LIBEGL # wlroots
	depends on LINGMO_PACKAGE_HAS_LIBEGL_WAYLAND # wlroots
	depends on LINGMO_PACKAGE_HAS_LIBGLES # wlroots
	depends on LINGMO_PACKAGE_HAS_UDEV # wlroots
	depends on LINGMO_TOOLCHAIN_HAS_SYNC_4 # json-c, pango
	depends on LINGMO_USE_WCHAR # pango
	depends on LINGMO_USE_MMU # pango
	depends on LINGMO_INSTALL_LIBSTDCPP # pango
	depends on LINGMO_TOOLCHAIN_GCC_AT_LEAST_4_9 # pango
	select LINGMO_PACKAGE_WLROOTS
	select LINGMO_PACKAGE_JSON_C
	select LINGMO_PACKAGE_PCRE
	select LINGMO_PACKAGE_CAIRO
	select LINGMO_PACKAGE_CAIRO_PNG
	select LINGMO_PACKAGE_PANGO
	select LINGMO_PACKAGE_XKEYBOARD_CONFIG # runtime
	help
	  i3-compatible Wayland compositor
	  Note:
	    The default sway config uses the foot package as the
	    default terminal. If you plan on using the default
	    config, it is recommended to select the foot package!

	  https://github.com/swaywm/sway

if LINGMO_PACKAGE_SWAY

config LINGMO_PACKAGE_SWAY_SWAYBAR
	bool "swaybar"
	select LINGMO_PACKAGE_DEJAVU
	select LINGMO_PACKAGE_JQ if LINGMO_PACKAGE_BASH_COMPLETION # Runtime
	select LINGMO_PACKAGE_DMENU_WAYLAND # Runtime
	help
	  Enable support for swaybar

if LINGMO_PACKAGE_SWAY_SWAYBAR

config LINGMO_PACKAGE_SWAY_SWAYBAR_TRAY
	bool "swaybar tray"
	help
	  Enable support for swaybar tray

endif # LINGMO_PACKAGE_SWAY_SWAYBAR

config LINGMO_PACKAGE_SWAY_SWAYNAG
	bool "swaynag"
	help
	  Enable support for swaynag

endif # LINGMO_PACKAGE_SWAY

comment "sway needs systemd, udev, EGL w/ Wayland backend and OpenGL ES support"
	depends on !LINGMO_PACKAGE_SYSTEMD || \
		!LINGMO_PACKAGE_HAS_UDEV || \
		!LINGMO_PACKAGE_HAS_LIBEGL || \
		!LINGMO_PACKAGE_HAS_LIBEGL_WAYLAND || \
		!LINGMO_PACKAGE_HAS_LIBGLES

comment "sway needs a toolchain w/ wchar, threads, C++, dynamic library, gcc >= 4.9"
	depends on LINGMO_USE_MMU
	depends on LINGMO_TOOLCHAIN_HAS_SYNC_4
	depends on !LINGMO_USE_WCHAR || \
		!LINGMO_TOOLCHAIN_HAS_THREADS || \
		!LINGMO_TOOLCHAIN_GCC_AT_LEAST_4_9 || \
		!LINGMO_INSTALL_LIBSTDCPP || \
		LINGMO_STATIC_LIBS
```

## package/swaybg/Config.in
```kconfig
config LINGMO_PACKAGE_SWAYBG
	bool "swaybg"
	default y if LINGMO_PACKAGE_SWAY
	depends on !LINGMO_STATIC_LIBS # wayland -> dlfcn.h
	depends on LINGMO_TOOLCHAIN_HAS_THREADS # wayland
	select LINGMO_PACKAGE_CAIRO
	select LINGMO_PACKAGE_CAIRO_PNG
	select LINGMO_PACKAGE_WAYLAND
	select LINGMO_PACKAGE_WAYLAND_PROTOCOLS
	help
	  Wallpaper tool for Wayland compositors.

	  https://github.com/swaywm/swaybg
```

## package/swupdate/Config.in
```kconfig
config LINGMO_PACKAGE_SWUPDATE
	bool "swupdate"
	depends on !LINGMO_STATIC_LIBS
	depends on LINGMO_TOOLCHAIN_HAS_THREADS
	depends on LINGMO_USE_MMU # fork()
	depends on LINGMO_TOOLCHAIN_HAS_SYNC_4 # json-c
	select LINGMO_PACKAGE_JSON_C
	select LINGMO_PACKAGE_LIBUBOOTENV
	help
	  swupdate provides a reliable way to update the software on
	  an embedded system.

	  swupdate is highly configurable to fit the targets
	  requirements and to minimize the footprint. The provided
	  default configuration file LINGMO_PACKAGE_SWUPDATE_CONFIG will
	  enable swupdate with an embedded webserver, a parser and a
	  handler for raw NAND or NOR flash.

	  The default configuration file builds a reasonable firmware
	  update system with minimal external dependencies in mind.
	  If you like to use your own modified configuration,
	  you have to select the necessary packages manually:

	  * Select LINGMO_PACKAGE_LUA or LINGMO_PACKAGE_LUAJIT if you want
	    want to have Lua support.
	  * Select LINGMO_PACKAGE_LIBCURL if you want to use the download
	    feature.
	  * Select LINGMO_PACKAGE_OPENSSL or LINGMO_PACKAGE_MBEDTLS if you
	    want to add encryption support.
	  * Select LINGMO_PACKAGE_MTD if you want to use swupdate with
	    UBI partitions.
	  * Select LINGMO_PACKAGE_ZLIB if you want to deal with gzip
	    compressed archives.
	  * Select LINGMO_PACKAGE_ZSTD if you want to deal with zstd
	    compressed archives.
	  * Select LINGMO_PACKAGE_ZEROMQ to add support for using a
	    remote handler.
	  * Select LINGMO_PACKAGE_LIBRSYNC to add support for using
	    rdiff handler.
	  * Select LINGMO_PACKAGE_LIBGPIOD to add support for
	    microcontroller firmware update.
	  * Select LINGMO_PACKAGE_EFIBOOTMGR to add support for EFI Boot
	    Guard.
	  * Select LINGMO_PACKAGE_LIBCURL, LINGMO_PACKAGE_LIBWEBSOCKETS,
	    and LINGMO_PACKAGE_LIBURIPARSER
	    to add support for the SWU forwarder.

	  https://sbabic.github.io/swupdate

if LINGMO_PACKAGE_SWUPDATE

config LINGMO_PACKAGE_SWUPDATE_CONFIG
	string "swupdate configuration file"
	default "package/swupdate/swupdate.config"
	help
	  Path to the swupdate configuration file.

	  I you wish to use your own modified swupdate configuration
	  file specify the config file location with this option.

config LINGMO_PACKAGE_SWUPDATE_USB
	bool "swupdate usb"
	depends on LINGMO_PACKAGE_SYSTEMD
	help
	  Enable update from USB disk.

comment "swupdate usb needs systemd"
	depends on !LINGMO_PACKAGE_SYSTEMD

config LINGMO_PACKAGE_SWUPDATE_WEBSERVER
	bool "swupdate webserver"
	default y
	help
	  Enable update from remote using a web server on the target.

config LINGMO_PACKAGE_SWUPDATE_INSTALL_WEBSITE
	bool "install default website"
	default y
	depends on LINGMO_PACKAGE_SWUPDATE_WEBSERVER
	help
	  Install the provided website to /var/www/swupdate.

	  This is necessary if you want to run swupdate with the
	  embedded webserver and do not provide an own website to be
	  installed to /var/www/swupdate.
endif

comment "swupdate needs a toolchain w/ dynamic library, threads"
	depends on LINGMO_USE_MMU
	depends on LINGMO_TOOLCHAIN_HAS_SYNC_4
	depends on LINGMO_STATIC_LIBS || !LINGMO_TOOLCHAIN_HAS_THREADS
```

## package/sylpheed/Config.in
```kconfig
config LINGMO_PACKAGE_SYLPHEED
	bool "sylpheed"
	depends on LINGMO_PACKAGE_LIBGTK2
	help
	  lightweight and user-friendly e-mail client.

	  http://sylpheed.sraoss.jp/en/
```

## package/synergy/Config.in
```kconfig
config LINGMO_PACKAGE_SYNERGY
	bool "synergy"
	depends on LINGMO_PACKAGE_XORG7
	depends on LINGMO_INSTALL_LIBSTDCPP
	depends on LINGMO_USE_WCHAR
	depends on LINGMO_USE_MMU # fork()
	depends on LINGMO_TOOLCHAIN_GCC_AT_LEAST_4_9 # C++14
	select LINGMO_PACKAGE_XLIB_LIBX11
	select LINGMO_PACKAGE_XLIB_LIBXTST
	help
	  Synergy lets you easily share a single mouse and
	  keyboard between multiple computers with different
	  operating systems, each with its own display,
	  without special hardware.

	  https://github.com/symless/synergy-core/

comment "synergy needs a toolchain w/ C++, wchar, gcc >= 4.9"
	depends on LINGMO_PACKAGE_XORG7
	depends on LINGMO_USE_MMU
	depends on !(LINGMO_INSTALL_LIBSTDCPP && LINGMO_USE_WCHAR && \
		LINGMO_TOOLCHAIN_GCC_AT_LEAST_4_9)
```

## package/sysdig/Config.in
```kconfig
config LINGMO_PACKAGE_SYSDIG
	bool "sysdig"
	depends on LINGMO_PACKAGE_LIBABSEIL_CPP_ARCH_SUPPORTS # falcosecurity-libs
	depends on LINGMO_PACKAGE_PROTOBUF_ARCH_SUPPORTS # falcosecurity-libs
	depends on LINGMO_LINUX_KERNEL # falcosecurity-libs
	depends on LINGMO_INSTALL_LIBSTDCPP
	depends on LINGMO_TOOLCHAIN_GCC_AT_LEAST_8 # falcosecurity-libs -> grpc -> libabseil-cpp
	depends on LINGMO_TOOLCHAIN_HAS_THREADS # falcosecurity-libs
	depends on !LINGMO_STATIC_LIBS # falcosecurity-libs
	depends on LINGMO_TOOLCHAIN_USES_GLIBC # falcosecurity-libs
	depends on LINGMO_PACKAGE_LUAINTERPRETER_ABI_VERSION_5_1 # falcosecurity-libs
	depends on LINGMO_TOOLCHAIN_HAS_SYNC_4 || LINGMO_TOOLCHAIN_HAS_ATOMIC # falcosecurity-libs
	select LINGMO_PACKAGE_FALCOSECURITY_LIBS
	select LINGMO_PACKAGE_NCURSES
	select LINGMO_PACKAGE_JSON_FOR_MODERN_CPP
	select LINGMO_PACKAGE_YAML_CPP
	help
	  Sysdig is open source, system-level exploration:
	  capture system state and activity from a running Linux
	  instance, then save, filter and analyze.
	  Think of it as strace + tcpdump + lsof + awesome sauce.
	  With a little Lua cherry on top.

	  https://github.com/draios/sysdig/wiki

comment "sysdig needs a glibc toolchain w/ C++, threads, gcc >= 8, dynamic library, a Linux kernel, and luajit or lua 5.1 to be built"
	depends on LINGMO_PACKAGE_LIBABSEIL_CPP_ARCH_SUPPORTS
	depends on LINGMO_PACKAGE_PROTOBUF_ARCH_SUPPORTS
	depends on LINGMO_TOOLCHAIN_HAS_SYNC_4 || LINGMO_TOOLCHAIN_HAS_ATOMIC
	depends on !LINGMO_LINUX_KERNEL || !LINGMO_INSTALL_LIBSTDCPP \
		|| !LINGMO_TOOLCHAIN_HAS_THREADS \
		|| !LINGMO_TOOLCHAIN_GCC_AT_LEAST_8 || LINGMO_STATIC_LIBS \
		|| !LINGMO_TOOLCHAIN_USES_GLIBC \
		|| !LINGMO_PACKAGE_LUAINTERPRETER_ABI_VERSION_5_1
```

## package/syslog-ng/Config.in
```kconfig
config LINGMO_PACKAGE_SYSLOG_NG
	bool "syslog-ng"
	depends on LINGMO_USE_WCHAR # glib2
	depends on LINGMO_TOOLCHAIN_HAS_THREADS
	depends on LINGMO_USE_MMU # fork()
	depends on LINGMO_PACKAGE_BUSYBOX_SHOW_OTHERS
	select LINGMO_PACKAGE_LIBGLIB2
	select LINGMO_PACKAGE_PCRE2
	select LINGMO_PACKAGE_OPENSSL
	help
	  syslog-ng is an enhanced log daemon, supporting a wide range
	  of input and output methods: syslog, unstructured text,
	  queueing, SQL & NoSQL

	  https://www.syslog-ng.com/products/open-source-log-management/

comment "syslog-ng needs a toolchain w/ wchar, threads"
	depends on LINGMO_USE_MMU
	depends on !LINGMO_USE_WCHAR || !LINGMO_TOOLCHAIN_HAS_THREADS
	depends on LINGMO_PACKAGE_BUSYBOX_SHOW_OTHERS
```

## package/sysprof/Config.in
```kconfig
config LINGMO_PACKAGE_SYSPROF
	bool "sysprof"
	depends on LINGMO_USE_WCHAR # glib2
	depends on LINGMO_TOOLCHAIN_HAS_THREADS # glib2
	depends on LINGMO_USE_MMU # glib2
	# In its util.h file, sysprof contains architecture-specific
	# code
	depends on LINGMO_i386 || LINGMO_x86_64 || LINGMO_powerpc || LINGMO_sh4a || LINGMO_sh4aeb
	select LINGMO_PACKAGE_LIBGLIB2
	help
	  Sysprof is a statistical, system-wide profiler that can
	  profile user and kernel code using the perf API.

	  http://sysprof.com

if LINGMO_PACKAGE_SYSPROF

config LINGMO_PACKAGE_SYSPROF_GUI
	bool "sysprof GUI"
	depends on LINGMO_PACKAGE_LIBGTK2
	select LINGMO_PACKAGE_LIBGLADE
	select LINGMO_PACKAGE_GDK_PIXBUF
	help
	  GUI for the sysprof system-wide statistical profiler.

endif

comment "sysprof needs a toolchain w/ wchar, threads"
	depends on LINGMO_USE_MMU
	depends on LINGMO_i386 || LINGMO_x86_64 || LINGMO_powerpc || LINGMO_sh4a || LINGMO_sh4aeb
	depends on !LINGMO_USE_WCHAR || !LINGMO_TOOLCHAIN_HAS_THREADS
```
