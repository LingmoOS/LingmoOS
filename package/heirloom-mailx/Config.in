## package/icu/Config.in
```kconfig
config LINGMO_PACKAGE_ICU
	bool "icu"
	depends on LINGMO_INSTALL_LIBSTDCPP
	depends on LINGMO_USE_WCHAR
	depends on LINGMO_HOST_GCC_AT_LEAST_4_9 # C++11 PR56019
	depends on LINGMO_TOOLCHAIN_GCC_AT_LEAST_4_9 # C++11 PR56019
	depends on LINGMO_TOOLCHAIN_HAS_THREADS
	# icu does some funky things by generating by itself an ELF
	# file, and it cannot easily be changed to generate FLAT
	# format.
	depends on !LINGMO_BINFMT_FLAT
	help
	  International Components for Unicode.

	  https://icu.unicode.org/

if LINGMO_PACKAGE_ICU

config LINGMO_PACKAGE_ICU_CUSTOM_DATA_PATH
	string "Path to custom data library file"
	help
	  This option allows to define the path to a custom data
	  library generated with http://apps.icu-project.org/datacustom/
	  Make sure you select the appropiate version to match the one
	  provided by buildroot.
	  Leave empty to not use this functionality.

endif

comment "icu needs a toolchain w/ C++, wchar, threads, gcc >= 4.9, host gcc >= 4.9"
	depends on !LINGMO_BINFMT_FLAT
	depends on !LINGMO_INSTALL_LIBSTDCPP || !LINGMO_USE_WCHAR || \
		!LINGMO_TOOLCHAIN_HAS_THREADS || \
		!LINGMO_TOOLCHAIN_GCC_AT_LEAST_4_9 || \
		!LINGMO_HOST_GCC_AT_LEAST_4_9
```

## package/ifenslave/Config.in
```kconfig
config LINGMO_PACKAGE_IFENSLAVE
	bool "ifenslave"
	depends on LINGMO_PACKAGE_BUSYBOX_SHOW_OTHERS
	help
	  Configure network interfaces for parallel routing (bonding)

	  https://salsa.debian.org/debian/ifenslave
```

## package/ifplugd/Config.in
```kconfig
config LINGMO_PACKAGE_IFPLUGD
	bool "ifplugd"
	# libdaemon uses fork()
	depends on LINGMO_USE_MMU
	depends on LINGMO_PACKAGE_BUSYBOX_SHOW_OTHERS
	select LINGMO_PACKAGE_LIBDAEMON
	help
	  Ifplugd is a daemon which will automatically configure your
	  ethernet device when a cable is plugged in and automatically
	  de-configure it if the cable is pulled out. This is useful
	  on laptops with onboard network adapters, since it will only
	  configure the interface when a cable is really connected.

	  http://0pointer.de/lennart/projects/ifplugd/
```

## package/iftop/Config.in
```kconfig
config LINGMO_PACKAGE_IFTOP
	bool "iftop"
	depends on LINGMO_TOOLCHAIN_HAS_THREADS
	select LINGMO_PACKAGE_NCURSES
	select LINGMO_PACKAGE_LIBPCAP
	help
	  iftop does for network usage what top(1) does for CPU usage.
	  It listens to network traffic on a named interface and
	  displays a table of current bandwidth usage by pairs of hosts.
	  Handy for answering the question "why is our ADSL link so
	  slow?".

	  http://www.ex-parrot.com/pdw/iftop/

comment "iftop needs a toolchain w/ threads"
	depends on !LINGMO_TOOLCHAIN_HAS_THREADS
```

## package/ifupdown-scripts/Config.in
```kconfig
config LINGMO_PACKAGE_IFUPDOWN_SCRIPTS
	bool "ifupdown scripts"
	default y if LINGMO_ROOTFS_SKELETON_DEFAULT
	depends on !LINGMO_PACKAGE_SYSTEMD_NETWORKD && !LINGMO_PACKAGE_NETIFRC
	help
	  Set of scripts used by ifupdown (either the standalone one,
	  or the busybox one) to bring network up, or tear it down.
```

## package/ifupdown/Config.in
```kconfig
config LINGMO_PACKAGE_IFUPDOWN
	bool "ifupdown"
	depends on LINGMO_USE_MMU # fork()
	depends on LINGMO_TOOLCHAIN_HEADERS_AT_LEAST_3_4 # iproute2
	depends on LINGMO_PACKAGE_BUSYBOX_SHOW_OTHERS
	# runtime for ip binary
	select LINGMO_PACKAGE_IPROUTE2 if !LINGMO_PACKAGE_BUSYBOX
	# runtime for run-parts
	select LINGMO_PACKAGE_DEBIANUTILS if !LINGMO_PACKAGE_BUSYBOX
	help
	  High level tools to configure network interfaces.

	  https://tracker.debian.org/pkg/ifupdown

comment "ifupdown needs a toolchain w/ headers >= 3.4"
	depends on LINGMO_USE_MMU
	depends on !LINGMO_TOOLCHAIN_HEADERS_AT_LEAST_3_4
	depends on LINGMO_PACKAGE_BUSYBOX_SHOW_OTHERS
```

## package/igh-ethercat/Config.in
```kconfig
comment "igh-ethercat needs a Linux kernel to be built"
	depends on !LINGMO_LINUX_KERNEL

config LINGMO_PACKAGE_IGH_ETHERCAT
	bool "igh-ethercat"
	depends on LINGMO_LINUX_KERNEL
	help
	  IgH EtherCAT Master for Linux.

	  http://www.etherlab.org/en/ethercat/index.php

if LINGMO_PACKAGE_IGH_ETHERCAT

config LINGMO_PACKAGE_IGH_ETHERCAT_8139TOO
	bool "8139too driver"

config LINGMO_PACKAGE_IGH_ETHERCAT_E100
	bool "e100 driver"

config LINGMO_PACKAGE_IGH_ETHERCAT_E1000
	bool "e1000 driver"

config LINGMO_PACKAGE_IGH_ETHERCAT_E1000E
	bool "e1000e driver"

config LINGMO_PACKAGE_IGH_ETHERCAT_R8169
	bool "r8169 driver"

endif
```

## package/igmpproxy/Config.in
```kconfig
config LINGMO_PACKAGE_IGMPPROXY
	bool "igmpproxy"
	depends on LINGMO_USE_MMU # fork()
	depends on LINGMO_USE_WCHAR
	help
	  A simple dynamic Multicast Routing Daemon
	  using only IGMP signalling. It's intended
	  for simple forwarding of Multicast traffic
	  between networks.

	  http://sourceforge.net/projects/igmpproxy/

comment "igmpproxy needs a toolchain w/ wchar"
	depends on LINGMO_USE_MMU
	depends on !LINGMO_USE_WCHAR
```
