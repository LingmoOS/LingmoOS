## package/heirloom-mailx/Config.in
```kconfig
config LINGMO_PACKAGE_HEIRLOOM_MAILX
	bool "heirloom-mailx"
	# uses fork()
	depends on LINGMO_USE_MMU
	depends on !LINGMO_STATIC_LIBS
	select LINGMO_PACKAGE_LIBOPENSSL_ENABLE_DES if LINGMO_PACKAGE_LIBOPENSSL
	select LINGMO_PACKAGE_LIBOPENSSL_ENABLE_RC2 if LINGMO_PACKAGE_LIBOPENSSL
	help
	  Heirloom mailx (previously known as nail) is a mail user
	  agent for Unix systems.

	  It can be used as a command-line mail reader, but also more
	  importantly on embedded systems, as a mail composition
	  program and SMTP client, in order to send e-mail from shell
	  scripts. It supports SMTP authentication (login, plain,
	  cram-md5), SMTPS, MIME encoding of attachements, and more.

	  http://heirloom.sourceforge.net/mailx.html

comment "heirloom-mailx needs a toolchain w/ dynamic library"
	depends on LINGMO_STATIC_LIBS
	depends on LINGMO_USE_MMU
```

## package/hiawatha/Config.in
```kconfig
comment "hiawatha needs a toolchain w/ threads, dynamic library"
	depends on LINGMO_USE_MMU
	depends on LINGMO_TOOLCHAIN_HAS_SYNC_4
	depends on !LINGMO_TOOLCHAIN_HAS_THREADS || LINGMO_STATIC_LIBS

config LINGMO_PACKAGE_HIAWATHA
	bool "hiawatha"
	# needs fork()
	depends on LINGMO_USE_MMU
	depends on LINGMO_TOOLCHAIN_HAS_SYNC_4 # __sync_*_4 intrisics
	depends on LINGMO_TOOLCHAIN_HAS_THREADS
	depends on !LINGMO_STATIC_LIBS
	select LINGMO_PACKAGE_ZLIB
	help
	  Hiawatha is a webserver for Unix and has been built with
	  security in mind. This resulted in a highly secure
	  webserver, in both code and features.

	  This webserver runs on Linux, BSD, MacOS X and
	  Windows. Although it can run any kind of CGI / FastCGI
	  application, it has been optimized for usage with PHP. Most
	  well known PHP frameworks and CMS applications have been
	  tested with Hiawatha and ran without a problem. Hiawatha
	  supports many web and HTTP features such as CGI/FastCGI,
	  HTTP authentication, virtual host support, request
	  pipelining, keep alive connections, URL rewriting and many
	  more.

	  http://www.hiawatha-webserver.org/

if LINGMO_PACKAGE_HIAWATHA

config LINGMO_PACKAGE_HIAWATHA_SSL
	bool "hiawatha TLS support"

endif
```

## package/hidapi/Config.in
```kconfig
config LINGMO_PACKAGE_HIDAPI
	bool "hidapi"
	depends on LINGMO_PACKAGE_HAS_UDEV
	depends on LINGMO_TOOLCHAIN_HAS_THREADS_NPTL
	depends on LINGMO_TOOLCHAIN_GCC_AT_LEAST_4_9 # libusb
	select LINGMO_PACKAGE_LIBUSB
	select LINGMO_PACKAGE_LIBGUDEV
	select LINGMO_PACKAGE_LIBICONV if !LINGMO_ENABLE_LOCALE
	# runtime UTF conversion support
	select LINGMO_TOOLCHAIN_GLIBC_GCONV_LIBS_COPY if LINGMO_TOOLCHAIN_USES_GLIBC
	help
	  HIDAPI is a multi-platform library which allows an application
	  to interface with USB and Bluetooth HID-Class devices on
	  Windows, Linux, and Mac OS X.

	  http://github.com/libusb/hidapi/

comment "hidapi needs udev /dev management and a toolchain w/ NPTL, gcc >= 4.9"
	depends on !LINGMO_TOOLCHAIN_HAS_THREADS_NPTL || \
		!LINGMO_PACKAGE_HAS_UDEV || \
		!LINGMO_TOOLCHAIN_GCC_AT_LEAST_4_9
```

## package/highway/Config.in
```kconfig
config LINGMO_PACKAGE_HIGHWAY
	bool "highway"
	depends on LINGMO_TOOLCHAIN_HAS_ATOMIC
	depends on LINGMO_INSTALL_LIBSTDCPP
	# For gcc bug 58969, see:
	# https://gcc.gnu.org/bugzilla/show_bug.cgi?id=58969
	depends on LINGMO_TOOLCHAIN_GCC_AT_LEAST_7 # C++11, GCC_BUG_58969
	help
	  Highway is a C++ library that provides portable SIMD/vector
	  intrinsics.

	  https://github.com/google/highway

if LINGMO_PACKAGE_HIGHWAY

config LINGMO_PACKAGE_HIGHWAY_CONTRIB
	bool "Enable Contrib"
	help
	  Build Highway contrib library which contains extra
	  SIMD-related utilities: an image class with aligned rows, a
	  math library (16 functions already implemented, mostly
	  trigonometry), and functions for computing dot products and
	  sorting.

config LINGMO_PACKAGE_HIGHWAY_EXAMPLES
	bool "Enable Examples"
	help
	  Build Highway examples

endif

comment "highway needs a toolchain w/ C++, gcc >= 7"
	depends on LINGMO_TOOLCHAIN_HAS_ATOMIC
	depends on !LINGMO_INSTALL_LIBSTDCPP || !LINGMO_TOOLCHAIN_GCC_AT_LEAST_7
```

## package/hostapd/Config.in
```kconfig
config LINGMO_PACKAGE_HOSTAPD
	bool "hostapd"
	depends on LINGMO_USE_MMU # fork()
	select LINGMO_PACKAGE_LIBOPENSSL_ENABLE_DES if LINGMO_PACKAGE_LIBOPENSSL
	select LINGMO_PACKAGE_LIBOPENSSL_ENABLE_MD4 if LINGMO_PACKAGE_LIBOPENSSL
	help
	  User space daemon for wireless access points.

	  It implements IEEE 802.11 access point management,
	  IEEE 802.1X/WPA/WPA2/EAP authenticators, RADIUS client,
	  EAP server and RADIUS authentication server.

	  http://w1.fi/hostapd/

if LINGMO_PACKAGE_HOSTAPD

config LINGMO_PACKAGE_HOSTAPD_DRIVER_HOSTAP
	bool "Enable hostap driver"
	default y
	select LINGMO_PACKAGE_HOSTAPD_HAS_WIFI_DRIVERS
	help
	  Enable support for Host AP driver.

config LINGMO_PACKAGE_HOSTAPD_DRIVER_NL80211
	bool "Enable nl80211 driver"
	default y
	depends on LINGMO_TOOLCHAIN_HAS_THREADS # libnl
	select LINGMO_PACKAGE_LIBNL
	select LINGMO_PACKAGE_HOSTAPD_HAS_WIFI_DRIVERS
	help
	  Enable support for drivers using the nl80211 kernel interface.

comment "nl80211 driver needs a toolchain w/ threads"
	depends on !LINGMO_TOOLCHAIN_HAS_THREADS

config LINGMO_PACKAGE_HOSTAPD_DRIVER_WIRED
	bool "Enable wired driver"
	help
	  Enable support for wired authenticator.

config LINGMO_PACKAGE_HOSTAPD_DRIVER_NONE
	bool
	default y
	depends on !LINGMO_PACKAGE_HOSTAPD_DRIVER_HOSTAP
	depends on !LINGMO_PACKAGE_HOSTAPD_DRIVER_NL80211
	depends on !LINGMO_PACKAGE_HOSTAPD_DRIVER_WIRED

config LINGMO_PACKAGE_HOSTAPD_HAS_WIFI_DRIVERS
	bool

config LINGMO_PACKAGE_HOSTAPD_ACS
	bool "Enable ACS"
	default y
	depends on LINGMO_PACKAGE_HOSTAPD_DRIVER_NL80211
	help
	  Enable support for standard ACS (Automatic Channel Selection).
	  Some propietary drivers use a custom algorithm which requires
	  channel to be set to '0' (which enables ACS in the config),
	  causing hostapd to use the standard one which doesn't work
	  for those cases.

comment "ACS is currently only supported through the nl80211 driver"
	depends on !LINGMO_PACKAGE_HOSTAPD_DRIVER_NL80211

config LINGMO_PACKAGE_HOSTAPD_EAP
	bool "Enable EAP"
	depends on !LINGMO_STATIC_LIBS
	help
	  Enable support for EAP and RADIUS.

comment "hostapd EAP needs a toolchain w/ dynamic library"
	depends on LINGMO_STATIC_LIBS

config LINGMO_PACKAGE_HOSTAPD_WPS
	bool "Enable WPS"
	help
	  Enable support for Wi-Fi Protected Setup.

config LINGMO_PACKAGE_HOSTAPD_WPA3
	bool "Enable WPA3 support"
	select LINGMO_PACKAGE_OPENSSL
	select LINGMO_PACKAGE_OPENSSL_FORCE_LIBOPENSSL
	help
	  Enable WPA3 support including OWE, SAE, DPP

config LINGMO_PACKAGE_HOSTAPD_VLAN
	bool "Enable VLAN support"
	default y
	help
	  Enable support for VLANs.

if LINGMO_PACKAGE_HOSTAPD_VLAN

config LINGMO_PACKAGE_HOSTAPD_VLAN_DYNAMIC
	bool "Enable dynamic VLAN support"
	default y
	help
	  Enable support for fully dynamic VLANs.
	  This enables hostapd to automatically create
	  bridge and VLAN interfaces if necessary.

config LINGMO_PACKAGE_HOSTAPD_VLAN_NETLINK
	bool "Use netlink-based API for VLAN operations"
	default y
	depends on LINGMO_TOOLCHAIN_HAS_THREADS # libnl
	select LINGMO_PACKAGE_LIBNL
	help
	  Use netlink-based kernel API for VLAN operations
	  instead of ioctl().

comment "netlink-based VLAN support needs a toolchain w/ threads"
	depends on !LINGMO_TOOLCHAIN_HAS_THREADS

endif # LINGMO_PACKAGE_HOSTAPD_VLAN

endif
```

## package/hplip/Config.in
```kconfig
config LINGMO_PACKAGE_HPLIP
	bool "hplip"
	depends on LINGMO_INSTALL_LIBSTDCPP
	depends on LINGMO_PACKAGE_CUPS
	depends on LINGMO_TOOLCHAIN_HAS_THREADS # libusb
	depends on LINGMO_TOOLCHAIN_GCC_AT_LEAST_4_9 # libusb
	depends on !LINGMO_STATIC_LIBS # libdl
	select LINGMO_PACKAGE_LIBUSB
	select LINGMO_PACKAGE_JPEG
	help
	  HP Linux Imaging and Printing (HPLIP)
	  HPLIP is an HP-developed solution for printing, scanning, and
	  faxing with HP inkjet and laser based printers in Linux. The
	  HPLIP project provides printing support for 2,211 printer
	  models, including Deskjet, Officejet, Photosmart, PSC
	  (Print Scan Copy), Business Inkjet, LaserJet, Edgeline MFP,
	  and LaserJet MFP.

	  http://hplipopensource.com/

comment "hplip needs a toolchain w/ C++, threads, dynamic library, gcc >= 4.9"
	depends on LINGMO_PACKAGE_CUPS
	depends on !LINGMO_INSTALL_LIBSTDCPP || !LINGMO_TOOLCHAIN_HAS_THREADS || \
		LINGMO_STATIC_LIBS || !LINGMO_TOOLCHAIN_GCC_AT_LEAST_4_9
```

## package/htop/Config.in
```kconfig
config LINGMO_PACKAGE_HTOP
	bool "htop"
	depends on LINGMO_USE_MMU # fork()
	depends on !LINGMO_STATIC_LIBS # dlopen()
	select LINGMO_PACKAGE_NCURSES
	help
	  htop is an interactive text-mode process viewer for Linux.
	  It aims to be a better top.

	  https://htop.dev/

comment "htop needs a toolchain w/ dynamic library"
	depends on LINGMO_USE_MMU
	depends on LINGMO_STATIC_LIBS
```

## package/htpdate/Config.in
```kconfig
config LINGMO_PACKAGE_HTPDATE
	bool "htpdate"
	depends on LINGMO_USE_MMU # fork()
	help
	  The HTTP Time Protocol (HTP) is used to synchronize a
	  computer's time with web servers as reference time source.

	  https://github.com/twekkel/htpdate
```

## package/httping/Config.in
```kconfig
comment "httping needs a toolchain w/ wchar"
	depends on !LINGMO_USE_WCHAR

config LINGMO_PACKAGE_HTTPING
	bool "httping"
	depends on LINGMO_USE_WCHAR
	help
	  Httping is like 'ping' but for http-requests.
	  Give it an url, and it'll show you how long it takes to
	  connect, send a request and retrieve the reply (only the
	  headers).
	  Be aware that the transmission across the network also takes
	  time! So it measures the latency of the webserver + network.

	  http://www.vanheusden.com/httping/

if LINGMO_PACKAGE_HTTPING

config LINGMO_PACKAGE_HTTPING_TFO
	bool "TCP Fast Open (TFO) support"

endif
```

## package/hwloc/Config.in
```kconfig
config LINGMO_PACKAGE_HWLOC
	bool "hwloc"
	depends on LINGMO_TOOLCHAIN_HAS_THREADS
	help
	  Portable Hardware Locality

	  Provides a portable abstraction (across OS, versions,
	  architectures, ...)  of the hierarchical topology of modern
	  architectures, including NUMA memory nodes, sockets, shared
	  caches, cores and simultaneous multithreading.

	  http://www.open-mpi.org/projects/hwloc/

comment "hwloc needs a toolchain w/ threads"
	depends on !LINGMO_TOOLCHAIN_HAS_THREADS
```

## package/i2pd/Config.in
```kconfig
config LINGMO_PACKAGE_I2PD
	bool "i2pd"
	depends on LINGMO_USE_MMU # fork()
	depends on LINGMO_TOOLCHAIN_HAS_ATOMIC
	# pthread_condattr_setclock
	depends on LINGMO_TOOLCHAIN_HAS_THREADS_NPTL
	depends on LINGMO_TOOLCHAIN_SUPPORTS_ALWAYS_LOCKFREE_ATOMIC_INTS # boost-filesystem
	depends on LINGMO_INSTALL_LIBSTDCPP
	depends on LINGMO_USE_WCHAR # boost
	depends on !LINGMO_TOOLCHAIN_HAS_GCC_BUG_64735 # exception_ptr
	select LINGMO_PACKAGE_BOOST
	select LINGMO_PACKAGE_BOOST_DATE_TIME
	select LINGMO_PACKAGE_BOOST_FILESYSTEM
	select LINGMO_PACKAGE_BOOST_PROGRAM_OPTIONS
	select LINGMO_PACKAGE_BOOST_SYSTEM
	select LINGMO_PACKAGE_OPENSSL
	select LINGMO_PACKAGE_ZLIB
	help
	  i2pd (I2P Daemon) is a full-featured C++ implementation of I2P
	  client.

	  I2P (Invisible Internet Protocol) is a universal anonymous
	  network layer.
	  All communications over I2P are anonymous and end-to-end
	  encrypted, participants don't reveal their real IP addresses.

	  http://i2pd.website

comment "i2pd needs a toolchain w/ C++, NPTL, wchar"
	depends on LINGMO_USE_MMU
	depends on LINGMO_TOOLCHAIN_HAS_ATOMIC
	depends on LINGMO_TOOLCHAIN_SUPPORTS_ALWAYS_LOCKFREE_ATOMIC_INTS
	depends on !LINGMO_INSTALL_LIBSTDCPP || \
		!LINGMO_TOOLCHAIN_HAS_THREADS_NPTL || !LINGMO_USE_WCHAR

comment "i2pd needs exception_ptr"
	depends on LINGMO_USE_MMU
	depends on LINGMO_TOOLCHAIN_HAS_ATOMIC
	depends on LINGMO_TOOLCHAIN_SUPPORTS_ALWAYS_LOCKFREE_ATOMIC_INTS
	depends on LINGMO_TOOLCHAIN_HAS_GCC_BUG_64735
```

## package/i7z/Config.in
```kconfig
config LINGMO_PACKAGE_I7Z
	bool "i7z"
	depends on LINGMO_i386 || LINGMO_x86_64
	depends on LINGMO_TOOLCHAIN_HAS_THREADS
	select LINGMO_PACKAGE_NCURSES
	help
	  "A better i7 (and now i3, i5) reporting tool for Linux."

	  i7z can print out the C-states and temperature for i3, i5
	  and i7 based Core processors from Intel (including Nehalems,
	  Sandy Bridge and Ivy Bridge).

	  https://github.com/ajaiantilal/i7z

comment "i7z needs a toolchain w/ threads"
	depends on LINGMO_i386 || LINGMO_x86_64
	depends on !LINGMO_TOOLCHAIN_HAS_THREADS
```

## package/ibm-sw-tpm2/Config.in
```kconfig
config LINGMO_PACKAGE_IBM_SW_TPM2
	bool "ibm-sw-tpm2"
	depends on LINGMO_TOOLCHAIN_HAS_THREADS
	depends on !LINGMO_STATIC_LIBS # ibm-sw-tpm2
	select LINGMO_PACKAGE_OPENSSL
	select LINGMO_PACKAGE_OPENSSL_FORCE_LIBOPENSSL
	help
	  This project is an implementation of the TCG TPM 2.0
	  specification. It is based on the TPM specification Parts 3
	  and 4 source code donated by Microsoft, with additional
	  files to complete the implementation.

	  https://sourceforge.net/projects/ibmswtpm2/

comment "ibm-sw-tpm2 needs a toolchain w/ threads, dynamic library"
	depends on !LINGMO_TOOLCHAIN_HAS_THREADS || LINGMO_STATIC_LIBS
```

## package/ibrcommon/Config.in
```kconfig
config LINGMO_PACKAGE_IBRCOMMON
	bool "ibrcommon"
	depends on LINGMO_INSTALL_LIBSTDCPP
	depends on LINGMO_TOOLCHAIN_HAS_THREADS
	help
	  IBR-DTN is a small dtn application that supports:
	  Bundle Protocol RFC 5050
	  Bundle Security Protocol RFC 6257

	  http://trac.ibr.cs.tu-bs.de/project-cm-2012-ibrdtn

comment "ibrcommon needs a toolchain w/ C++, threads"
	depends on !LINGMO_INSTALL_LIBSTDCPP || !LINGMO_TOOLCHAIN_HAS_THREADS
```

## package/ibrdtn-tools/Config.in
```kconfig
config LINGMO_PACKAGE_IBRDTN_TOOLS
	bool "ibrdtn-tools"
	depends on LINGMO_INSTALL_LIBSTDCPP
	depends on LINGMO_TOOLCHAIN_HAS_THREADS
	select LINGMO_PACKAGE_IBRCOMMON
	select LINGMO_PACKAGE_IBRDTN
	help
	  IBR-DTN is a small dtn application that supports:
	  Bundle Protocol RFC 5050
	  Bundle Security Protocol RFC 6257

	  http://trac.ibr.cs.tu-bs.de/project-cm-2012-ibrdtn

comment "ibrdtn-tools needs a toolchain w/ C++, threads"
	depends on !LINGMO_INSTALL_LIBSTDCPP || !LINGMO_TOOLCHAIN_HAS_THREADS
```

## package/ibrdtn/Config.in
```kconfig
config LINGMO_PACKAGE_IBRDTN
	bool "ibrdtn"
	depends on LINGMO_INSTALL_LIBSTDCPP
	depends on LINGMO_TOOLCHAIN_HAS_THREADS
	select LINGMO_PACKAGE_IBRCOMMON
	help
	  IBR-DTN is a small dtn application that supports:
	  Bundle Protocol RFC 5050
	  Bundle Security Protocol RFC 6257

	  This package contains the ibrdtn library.

	  http://trac.ibr.cs.tu-bs.de/project-cm-2012-ibrdtn

comment "ibrdtn needs a toolchain w/ C++, threads"
	depends on !LINGMO_INSTALL_LIBSTDCPP || !LINGMO_TOOLCHAIN_HAS_THREADS
```

## package/ibrdtnd/Config.in
```kconfig
config LINGMO_PACKAGE_IBRDTND
	bool "ibrdtnd"
	depends on LINGMO_INSTALL_LIBSTDCPP
	depends on LINGMO_TOOLCHAIN_HAS_THREADS
	select LINGMO_PACKAGE_IBRDTN
	select LINGMO_PACKAGE_IBRCOMMON
	help
	  IBR-DTN is a small dtn application that supports:
	  Bundle Protocol RFC 5050
	  Bundle Security Protocol RFC 6257

	  http://trac.ibr.cs.tu-bs.de/project-cm-2012-ibrdtn

comment "ibrdtnd needs a toolchain w/ C++, threads"
	depends on !LINGMO_INSTALL_LIBSTDCPP || !LINGMO_TOOLCHAIN_HAS_THREADS
```
