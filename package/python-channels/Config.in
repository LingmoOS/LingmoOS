## package/python-channels/Config.in
```kconfig
config LINGMO_PACKAGE_PYTHON_CHANNELS
	bool "python-channels"
	# python-daphne -> python-autobahn -> python-cryptography
	depends on LINGMO_PACKAGE_HOST_RUSTC_TARGET_ARCH_SUPPORTS
	select LINGMO_PACKAGE_PYTHON_ASGIREF # runtime
	select LINGMO_PACKAGE_PYTHON_DAPHNE # runtime
	select LINGMO_PACKAGE_PYTHON_DJANGO # runtime
	help
	  Channels augments Django to bring WebSocket, long-poll
	  HTTP, task offloading and other async support to your
	  code, using familiar Django design patterns and a
	  flexible underlying framework that lets you not only
	  customize behaviours but also write support for your
	  own protocols and needs.

	  http://github.com/django/channels
```

## package/python-cherrypy/Config.in
```kconfig
config LINGMO_PACKAGE_PYTHON_CHERRYPY
	bool "python-cherrypy"
	select LINGMO_PACKAGE_PYTHON_CHEROOT # runtime
	select LINGMO_PACKAGE_PYTHON_JARACO_CLASSES # runtime
	select LINGMO_PACKAGE_PYTHON_PORTEND # runtime
	select LINGMO_PACKAGE_PYTHON3_PYEXPAT # runtime
	select LINGMO_PACKAGE_PYTHON_SIX # runtime
	select LINGMO_PACKAGE_PYTHON3_ZLIB # runtime
	help
	  A minimalist web framework

	  http://www.cherrypy.org
```

## package/python-configshell-fb/Config.in
```kconfig
config LINGMO_PACKAGE_PYTHON_CONFIGSHELL_FB
	bool "python-configshell-fb"
	select LINGMO_PACKAGE_PYTHON_PYPARSING
	select LINGMO_PACKAGE_PYTHON3_READLINE
	select LINGMO_PACKAGE_PYTHON_SIX
	select LINGMO_PACKAGE_PYTHON_URWID
	help
	  configshell-fb is a Python library that provides a framework
	  for building simple but nice CLI-based applications.

	  https://github.com/open-iscsi/configshell-fb
```

## package/python-contourpy/Config.in
```kconfig
config LINGMO_PACKAGE_PYTHON_CONTOURPY
	bool "python-contourpy"
	depends on LINGMO_INSTALL_LIBSTDCPP
	select LINGMO_PACKAGE_PYTHON_PYBIND
	help
	  Python library for calculating contours of 2D quadrilateral
	  grids.

	  https://github.com/contourpy/contourpy

comment "python-contourpy needs a toolchain w/ C++"
	depends on !LINGMO_INSTALL_LIBSTDCPP
```

## package/python-couchdb/Config.in
```kconfig
config LINGMO_PACKAGE_PYTHON_COUCHDB
	bool "python-couchdb"
	select LINGMO_PACKAGE_PYTHON3_SSL # runtime
	help
	  Python client library for working with CouchDB.

	  https://github.com/djc/couchdb-python/
```

## package/python-cryptography/Config.in
```kconfig
config LINGMO_PACKAGE_PYTHON_CRYPTOGRAPHY
	bool "python-cryptography"
	depends on LINGMO_PACKAGE_HOST_RUSTC_TARGET_ARCH_SUPPORTS
	select LINGMO_PACKAGE_OPENSSL
	select LINGMO_PACKAGE_PYTHON_CFFI # runtime
	help
	  cryptography is a package designed to expose cryptographic
	  primitives and recipes to Python developers.

	  https://cryptography.io
```

## package/python-cssutils/Config.in
```kconfig
config LINGMO_PACKAGE_PYTHON_CSSUTILS
	bool "python-cssutils"
	select LINGMO_PACKAGE_PYTHON3_PYEXPAT # runtime
	help
	  A CSS Cascading Style Sheets library for Python.

	  http://cthedot.de/cssutils/
```

## package/python-daemon/Config.in
```kconfig
config LINGMO_PACKAGE_PYTHON_DAEMON
	bool "python-daemon"
	select LINGMO_PACKAGE_PYTHON_DOCUTILS # runtime
	select LINGMO_PACKAGE_PYTHON_LOCKFILE # runtime
	help
	  Library to implement a well-behaved Unix daemon process.

	  https://pypi.python.org/pypi/python-daemon/
```

## package/python-daemonize/Config.in
```kconfig
config LINGMO_PACKAGE_PYTHON_DAEMONIZE
	bool "python-daemonize"
	select LINGMO_PACKAGE_PYTHON_SETUPTOOLS # runtime
	help
	  Library to enable your code run as a daemon process on
	  Unix-like systems.

	  https://pypi.python.org/pypi/daemonize
```

## package/python-daphne/Config.in
```kconfig
config LINGMO_PACKAGE_PYTHON_DAPHNE
	bool "python-daphne"
	# python-autobahn -> python-cryptography
	depends on LINGMO_PACKAGE_HOST_RUSTC_TARGET_ARCH_SUPPORTS
	select LINGMO_PACKAGE_PYTHON_ASGIREF # runtime
	select LINGMO_PACKAGE_PYTHON_AUTOBAHN # runtime
	select LINGMO_PACKAGE_PYTHON_TWISTED # runtime
	select LINGMO_PACKAGE_PYTHON_TWISTED_TLS # runtime
	help
	  Daphne is a HTTP, HTTP2 and WebSocket protocol server for
	  ASGI and ASGI-HTTP, developed to power Django Channels.
	  It supports automatic negotiation of protocols; there's no
	  need for URL prefixing to determine WebSocket endpoints
	  versus HTTP endpoints.

	  https://github.com/django/daphne
```

## package/python-dateutil/Config.in
```kconfig
config LINGMO_PACKAGE_PYTHON_DATEUTIL
	bool "python-dateutil"
	select LINGMO_PACKAGE_PYTHON_SIX
	help
	  Extensions to the standard Python datetime module.

	  https://dateutil.readthedocs.io
```

## package/python-dbus-fast/Config.in
```kconfig
config LINGMO_PACKAGE_PYTHON_DBUS_FAST
	bool "python-dbus-fast"
	select LINGMO_PACKAGE_HOST_PYTHON_CYTHON
	select LINGMO_PACKAGE_PYTHON3_PYEXPAT # runtime
	help
	  A faster version of dbus-next, a DBus library for Python with
	  asyncio support.

	  https://github.com/bluetooth-devices/dbus-fast
```

## package/python-decorator/Config.in
```kconfig
config LINGMO_PACKAGE_PYTHON_DECORATOR
	bool "python-decorator"
	help
	  Better living through Python with decorators

	  https://github.com/micheles/decorator
```

## package/python-dialog3/Config.in
```kconfig
config LINGMO_PACKAGE_PYTHON_DIALOG3
	bool "python-dialog3"
	depends on LINGMO_USE_MMU # dialog
	select LINGMO_PACKAGE_DIALOG
	help
	  A Python 3 only interface to the UNIX dialog utility and
	  mostly-compatible programs.

	  http://pythondialog.sourceforge.net/
```

## package/python-dicttoxml/Config.in
```kconfig
config LINGMO_PACKAGE_PYTHON_DICTTOXML
	bool "python-dicttoxml"
	select LINGMO_PACKAGE_PYTHON3_PYEXPAT
	help
	  Converts a Python dictionary or other native data type into
	  a valid XML string.

	  https://github.com/quandyfactory/dicttoxml
```

## package/python-dicttoxml2/Config.in
```kconfig
config LINGMO_PACKAGE_PYTHON_DICTTOXML2
	bool "python-dicttoxml2"
	select LINGMO_PACKAGE_PYTHON3_PYEXPAT
	help
	  Converts a Python dictionary or other native data type into
	  a valid XML string.

	  https://github.com/Ousret/dicttoxml
```

## package/python-docker-pycreds/Config.in
```kconfig
config LINGMO_PACKAGE_PYTHON_DOCKER_PYCREDS
	bool "python-docker-pycreds"
	select LINGMO_PACKAGE_PYTHON_SIX # runtime
	help
	  Python bindings for the docker credentials store API.

	  https://github.com/shin-/dockerpy-creds
```

## package/python-docker/Config.in
```kconfig
config LINGMO_PACKAGE_PYTHON_DOCKER
	bool "python-docker"
	# docker-engine may be running on another host, so no other dependency
	select LINGMO_PACKAGE_PYTHON3_SSL # runtime
	select LINGMO_PACKAGE_PYTHON_PACKAGING # runtime
	select LINGMO_PACKAGE_PYTHON_REQUESTS # runtime
	select LINGMO_PACKAGE_PYTHON_URLLIB3 # runtime
	select LINGMO_PACKAGE_PYTHON_WEBSOCKET_CLIENT # runtime
	help
	  A Python library for the Docker Engine API.

	  https://github.com/docker/docker-py
```

## package/python-dockerpty/Config.in
```kconfig
config LINGMO_PACKAGE_PYTHON_DOCKERPTY
	bool "python-dockerpty"
	select LINGMO_PACKAGE_PYTHON_SIX # runtime
	help
	  Python library to use the pseudo-tty of a docker container.

	  https://github.com/d11wtq/dockerpty
```

## package/python-dpkt/Config.in
```kconfig
config LINGMO_PACKAGE_PYTHON_DPKT
	bool "python-dpkt"
	select LINGMO_PACKAGE_PYTHON3_ZLIB # runtime
	help
	  Fast, simple packet creation / parsing, with definitions
	  for the basic TCP/IP protocols.

	  https://github.com/kbandla/dpkt
```

## package/python-dtschema/Config.in
```kconfig
config LINGMO_PACKAGE_PYTHON_DTSCHEMA
	bool "python-dtschema"
	depends on LINGMO_PACKAGE_HOST_RUSTC_TARGET_ARCH_SUPPORTS # python-jsonschema -> python-rpds-py
	select LINGMO_PACKAGE_PYTHON_JSONSCHEMA # runtime
	select LINGMO_PACKAGE_PYTHON_PYLIBFDT # runtime
	select LINGMO_PACKAGE_PYTHON_RFC3987 # runtime
	select LINGMO_PACKAGE_PYTHON_RUAMEL_YAML # runtime
	help
	  DeviceTree validation schema and tools.

	  https://github.com/devicetree-org/dt-schema
```

## package/python-ecdsa/Config.in
```kconfig
config LINGMO_PACKAGE_PYTHON_ECDSA
	bool "python-ecdsa"
	select LINGMO_PACKAGE_PYTHON_SIX # runtime
	help
	  ECDSA cryptographic signature library (pure python).

	  http://github.com/tlsfuzzer/python-ecdsa
```

## package/python-engineio/Config.in
```kconfig
config LINGMO_PACKAGE_PYTHON_ENGINEIO
	bool "python-engineio"
	select LINGMO_PACKAGE_PYTHON3_ZLIB
	help
	  Engine.IO server.

	  http://github.com/miguelgrinberg/python-engineio/
```

## package/python-entrypoints/Config.in
```kconfig
config LINGMO_PACKAGE_PYTHON_ENTRYPOINTS
	bool "python-entrypoints"
	help
	  Discover and load entry points from installed packages.

	  https://github.com/takluyver/entrypoints
```

## package/python-esptool/Config.in
```kconfig
config LINGMO_PACKAGE_PYTHON_ESPTOOL
	bool "python-esptool"
	depends on LINGMO_PACKAGE_HOST_RUSTC_TARGET_ARCH_SUPPORTS # python-cryptography
	select LINGMO_PACKAGE_PYTHON_BITSTRING # runtime
	select LINGMO_PACKAGE_PYTHON_CRYPTOGRAPHY # runtime
	select LINGMO_PACKAGE_PYTHON_ECDSA # runtime
	select LINGMO_PACKAGE_PYTHON_INTELHEX # runtime
	select LINGMO_PACKAGE_PYTHON_PYYAML # runtime
	select LINGMO_PACKAGE_PYTHON_REEDSOLO # runtime
	select LINGMO_PACKAGE_PYTHON_SERIAL # runtime
	select LINGMO_PACKAGE_PYTHON3_ZLIB
	help
	  A serial utility to communicate & flash code to Espressif
	  ESP8266 & ESP32 chips.

	  https://github.com/espressif/esptool
```
