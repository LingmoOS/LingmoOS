## package/libgtk3/Config.in
```kconfig
comment "libgtk3 needs a toolchain w/ wchar, threads, C++, gcc >= 4.9"
	depends on LINGMO_PACKAGE_HOST_RUSTC_ARCH_SUPPORTS
	depends on LINGMO_USE_MMU
	depends on LINGMO_TOOLCHAIN_HAS_SYNC_4
	depends on !LINGMO_USE_WCHAR || !LINGMO_INSTALL_LIBSTDCPP || \
		!LINGMO_TOOLCHAIN_GCC_AT_LEAST_4_9 || \
		!LINGMO_TOOLCHAIN_HAS_THREADS

comment "libgtk3 needs an OpenGL or an OpenGL-EGL/wayland backend"
	depends on LINGMO_USE_MMU
	depends on LINGMO_TOOLCHAIN_HAS_SYNC_4
	depends on !LINGMO_PACKAGE_HAS_LIBEGL_WAYLAND && \
		!LINGMO_PACKAGE_HAS_LIBGL

config LINGMO_PACKAGE_LIBGTK3
	bool "libgtk3"
	depends on LINGMO_PACKAGE_HOST_RUSTC_ARCH_SUPPORTS # host-libgtk3 -> host-librsvg
	depends on LINGMO_USE_WCHAR # glib2
	depends on LINGMO_TOOLCHAIN_HAS_THREADS # glib2
	depends on LINGMO_USE_MMU # glib2
	depends on LINGMO_INSTALL_LIBSTDCPP # pango
	depends on LINGMO_TOOLCHAIN_HAS_SYNC_4 # pango -> harfbuzz
	depends on LINGMO_TOOLCHAIN_GCC_AT_LEAST_4_9 # pango -> harfbuzz
	depends on LINGMO_PACKAGE_HAS_LIBEGL_WAYLAND || \
		LINGMO_PACKAGE_HAS_LIBGL
	select LINGMO_PACKAGE_AT_SPI2_CORE
	select LINGMO_PACKAGE_CAIRO
	select LINGMO_PACKAGE_CAIRO_PS
	select LINGMO_PACKAGE_CAIRO_PDF
	select LINGMO_PACKAGE_CAIRO_SVG
	select LINGMO_PACKAGE_LIBEPOXY
	select LINGMO_PACKAGE_LIBGLIB2
	select LINGMO_PACKAGE_PANGO
	select LINGMO_PACKAGE_GDK_PIXBUF
	# At least one backend is required
	select LINGMO_PACKAGE_LIBGTK3_BROADWAY if \
		!(LINGMO_PACKAGE_LIBGTK3_X11 || LINGMO_PACKAGE_LIBGTK3_WAYLAND)
	help
	  The GTK+ version 3 graphical user interface library

	  https://www.gtk.org/

if LINGMO_PACKAGE_LIBGTK3

config LINGMO_PACKAGE_LIBGTK3_BROADWAY
	bool "Broadway GDK backend"
	default y
	  help
	  This enables the Broadway backend for GDK, which provides
	  support for displaying GTK+ applications in a web browser,
	  using HTML5 and web sockets.

	  For example, to run gtk3-demo on a target which IP address is
	  192.168.0.1 and use it from a web browser, execute the
	  following commands:

	  $ broadwayd -a 192.168.0.1 -p 8080 :2 &
	  $ export GDK_BACKEND=broadway
	  $ export BROADWAY_DISPLAY=:2
	  $ gtk3-demo

	  Then open a web browser at address http://192.168.0.1:8080.
	  Javascript and web sockets should be enabled.

comment "Wayland GDK backend needs an OpenGL EGL backend provided by mesa3d w/ headers >= 3.17"
	depends on !LINGMO_PACKAGE_MESA3D_OPENGL_EGL || \
		!LINGMO_TOOLCHAIN_HEADERS_AT_LEAST_3_17

config LINGMO_PACKAGE_LIBGTK3_WAYLAND
	bool "Wayland GDK backend"
	default y
	depends on LINGMO_PACKAGE_HAS_LIBEGL_WAYLAND
	depends on LINGMO_TOOLCHAIN_HEADERS_AT_LEAST_3_17
	select LINGMO_PACKAGE_WAYLAND
	select LINGMO_PACKAGE_WAYLAND_PROTOCOLS
	select LINGMO_PACKAGE_LIBXKBCOMMON
	help
	  This enables the Wayland backend for GDK.

comment "X11 GDK backend needs an OpenGL provider"
	depends on !LINGMO_PACKAGE_HAS_LIBGL

config LINGMO_PACKAGE_LIBGTK3_X11
	bool "X11 GDK backend"
	default y
	depends on LINGMO_PACKAGE_XORG7
	depends on LINGMO_PACKAGE_HAS_LIBGL
	select LINGMO_PACKAGE_FONTCONFIG
	select LINGMO_PACKAGE_XLIB_LIBX11
	select LINGMO_PACKAGE_XLIB_LIBXEXT
	select LINGMO_PACKAGE_XLIB_LIBXRANDR
	select LINGMO_PACKAGE_XLIB_LIBXRENDER
	select LINGMO_PACKAGE_XLIB_LIBXI
	help
	  This enables the X11 backend for GDK.

config LINGMO_PACKAGE_LIBGTK3_DEMO
	bool "Install libgtk3 demo program"
	select LINGMO_PACKAGE_SHARED_MIME_INFO
	select LINGMO_PACKAGE_HICOLOR_ICON_THEME
	help
	  The GTK+ source base contains a demo program. This
	  option allows to install this program to the target.

config LINGMO_PACKAGE_LIBGTK3_TESTS
	bool "Install libgtk3 tests"
	help
	  The GTK+ source base contains tests. This option
	  allows to install them to the target.

endif
```

## package/libgudev/Config.in
```kconfig
config LINGMO_PACKAGE_LIBGUDEV
	bool "libgudev"
	depends on LINGMO_PACKAGE_HAS_UDEV
	depends on LINGMO_USE_WCHAR # gettext
	depends on LINGMO_TOOLCHAIN_HAS_THREADS
	depends on LINGMO_USE_MMU # fork()
	select LINGMO_PACKAGE_LIBGLIB2
	help
	  This library provides GObject bindings for libudev.  It was
	  originally part of udev-extras, then udev, then systemd.
	  It's now a project on its own. Required for building some
	  programs that use udev, when using systemd.

	  https://wiki.gnome.org/Projects/libgudev

comment "libgudev needs udev /dev handling and a toolchain w/ wchar, threads"
	depends on LINGMO_USE_MMU
	depends on !LINGMO_USE_WCHAR || !LINGMO_TOOLCHAIN_HAS_THREADS || \
		!LINGMO_PACKAGE_HAS_UDEV
```

## package/libhdhomerun/Config.in
```kconfig
config LINGMO_PACKAGE_LIBHDHOMERUN
	bool "libhdhomerun"
	depends on LINGMO_TOOLCHAIN_HAS_THREADS
	depends on !LINGMO_STATIC_LIBS
	help
	  HDHomeRun is a network-attached digital television tuner
	  box, produced by the company SiliconDust USA, Inc.

	  http://www.silicondust.com

comment "libhdhomerun needs a toolchain w/ threads, dynamic library"
	depends on !LINGMO_TOOLCHAIN_HAS_THREADS || LINGMO_STATIC_LIBS
```

## package/libheif/Config.in
```kconfig
config LINGMO_PACKAGE_LIBHEIF
	bool "libheif"
	depends on !LINGMO_TOOLCHAIN_HAS_BINUTILS_BUG_30730
	depends on LINGMO_INSTALL_LIBSTDCPP
	depends on LINGMO_TOOLCHAIN_GCC_AT_LEAST_4_8 # C++11
	help
	  libheif is an HEIF and AVIF file format decoder and encoder.

	  https://github.com/strukturag/libheif

comment "libheif needs a toolchain w/ C++, gcc >= 4.8"
	depends on !LINGMO_TOOLCHAIN_HAS_BINUTILS_BUG_30730
	depends on !LINGMO_INSTALL_LIBSTDCPP || !LINGMO_TOOLCHAIN_GCC_AT_LEAST_4_8
```

## package/libhid/Config.in
```kconfig
config LINGMO_PACKAGE_LIBHID
	bool "libhid"
	depends on LINGMO_TOOLCHAIN_HAS_THREADS # libusb
	depends on LINGMO_TOOLCHAIN_GCC_AT_LEAST_4_9 # libusb
	select LINGMO_PACKAGE_LIBUSB
	select LINGMO_PACKAGE_LIBUSB_COMPAT
	help
	  Userspace library for accessing USB HID devices

	  https://directory.fsf.org/wiki/Libhid

comment "libhid needs a toolchain w/ threads, gcc >= 4.9"
	depends on !LINGMO_TOOLCHAIN_HAS_THREADS || \
		!LINGMO_TOOLCHAIN_GCC_AT_LEAST_4_9
```
