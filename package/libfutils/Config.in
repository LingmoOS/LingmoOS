## package/libfutils/Config.in
```kconfig
config LINGMO_PACKAGE_LIBFUTILS
	bool "libfutils"
	depends on LINGMO_TOOLCHAIN_HAS_ATOMIC
	depends on LINGMO_INSTALL_LIBSTDCPP # ulog
	depends on LINGMO_TOOLCHAIN_HAS_THREADS # ulog
	select LINGMO_PACKAGE_ULOG
	help
	  This library contains some common useful functions (list,
	  hash, time)

	  https://github.com/Parrot-Developers/libfutils

comment "libfutils needs a toolchain w/ C++, threads"
	depends on !LINGMO_INSTALL_LIBSTDCPP || !LINGMO_TOOLCHAIN_HAS_THREADS
	depends on LINGMO_TOOLCHAIN_HAS_ATOMIC
```

## package/libgcrypt/Config.in
```kconfig
config LINGMO_PACKAGE_LIBGCRYPT
	bool "libgcrypt"
	depends on LINGMO_PACKAGE_LIBGPG_ERROR_ARCH_SUPPORTS # libgpg-error
	select LINGMO_PACKAGE_LIBGPG_ERROR
	help
	  LibGCrypt is GNU's basic cryptographic library.

	  http://www.gnu.org/software/libgcrypt/
```

## package/libgdiplus/Config.in
```kconfig
config LINGMO_PACKAGE_LIBGDIPLUS
	bool "libgdiplus"
	depends on LINGMO_PACKAGE_XORG7
	depends on LINGMO_USE_WCHAR # libglib2 -> gettext
	depends on LINGMO_TOOLCHAIN_HAS_THREADS # libglib2
	depends on LINGMO_USE_MMU # libglib2
	depends on LINGMO_INSTALL_LIBSTDCPP
	select LINGMO_PACKAGE_XLIB_LIBXFT
	select LINGMO_PACKAGE_LIBGLIB2
	select LINGMO_PACKAGE_CAIRO
	select LINGMO_PACKAGE_LIBPNG
	help
	  An Open Source implementation of the GDI+ API.

	  https://github.com/mono/libgdiplus

comment "libgdiplus needs a toolchain w/ wchar, threads, C++"
	depends on LINGMO_USE_MMU
	depends on LINGMO_PACKAGE_XORG7
	depends on !LINGMO_USE_WCHAR || !LINGMO_TOOLCHAIN_HAS_THREADS || \
		!LINGMO_INSTALL_LIBSTDCPP
```

## package/libgee/Config.in
```kconfig
config LINGMO_PACKAGE_LIBGEE
	bool "libgee"
	depends on LINGMO_USE_WCHAR
	depends on LINGMO_TOOLCHAIN_HAS_THREADS
	depends on LINGMO_USE_MMU # fork()
	depends on LINGMO_TOOLCHAIN_GCC_AT_LEAST_4_9
	select LINGMO_PACKAGE_LIBGLIB2
	help
	  Libgee is an utility library providing GObject-based
	  interfaces and classes for commonly used data structures.

	  https://wiki.gnome.org/Projects/Libgee

comment "libgee needs a toolchain w/ wchar, threads, gcc >= 4.9"
	depends on LINGMO_USE_MMU
	depends on !LINGMO_USE_WCHAR || !LINGMO_TOOLCHAIN_HAS_THREADS || \
		!LINGMO_TOOLCHAIN_GCC_AT_LEAST_4_9
```

## package/libgeos/Config.in
```kconfig
config LINGMO_PACKAGE_LIBGEOS
	bool "libgeos"
	depends on LINGMO_INSTALL_LIBSTDCPP
	depends on LINGMO_USE_WCHAR
	depends on LINGMO_TOOLCHAIN_HAS_THREADS
	depends on LINGMO_TOOLCHAIN_GCC_AT_LEAST_4_9 # C++14
	depends on !LINGMO_TOOLCHAIN_HAS_BINUTILS_BUG_27597
	help
	  GEOS (Geometry Engine - Open Source) is a C++ port of the
	  JTS Topology Suite (JTS). It aims to contain the complete
	  functionality of JTS in C++. This includes all the OpenGIS
	  Simple Features for SQL spatial predicate functions and
	  spatial operators, as well as specific JTS enhanced functions.

	  https://trac.osgeo.org/geos

comment "libgeos needs a toolchain w/ C++, wchar, gcc >= 4.9, threads not binutils bug 27597"
	depends on !LINGMO_INSTALL_LIBSTDCPP || !LINGMO_USE_WCHAR || \
		   !LINGMO_TOOLCHAIN_HAS_THREADS || \
		   !LINGMO_TOOLCHAIN_GCC_AT_LEAST_4_9 || \
		   LINGMO_TOOLCHAIN_HAS_BINUTILS_BUG_27597
```

## package/libgeotiff/Config.in
```kconfig
config LINGMO_PACKAGE_LIBGEOTIFF
	bool "libgeotiff"
	depends on LINGMO_INSTALL_LIBSTDCPP # proj
	depends on LINGMO_TOOLCHAIN_GCC_AT_LEAST_4_7 # proj
	depends on LINGMO_TOOLCHAIN_HAS_THREADS_NPTL # proj
	depends on LINGMO_USE_WCHAR # proj
	select LINGMO_PACKAGE_PROJ
	select LINGMO_PACKAGE_TIFF
	help
	  Libgeotiff is an open source library normally hosted on top of
	  libtiff for reading, and writing GeoTIFF information tags.

	  https://github.com/OSGeo/libgeotiff

comment "libgeotiff needs a toolchain w/ C++, gcc >= 4.7, NPTL, wchar"
	depends on !LINGMO_INSTALL_LIBSTDCPP || \
		!LINGMO_TOOLCHAIN_GCC_AT_LEAST_4_7 || \
		!LINGMO_TOOLCHAIN_HAS_THREADS_NPTL || !LINGMO_USE_WCHAR
```

## package/libgit2/Config.in
```kconfig
config LINGMO_PACKAGE_LIBGIT2
	bool "libgit2"
	depends on !LINGMO_STATIC_LIBS # libhttpparser
	select LINGMO_PACKAGE_LIBHTTPPARSER
	select LINGMO_PACKAGE_ZLIB
	help
	  libgit2 is a portable, pure C implementation of the Git core
	  methods provided as a linkable library with a solid API,
	  allowing to build Git functionality into your application.

	  https://github.com/libgit2/libgit2

comment "libgit2 needs a toolchain w/ dynamic library"
	depends on LINGMO_STATIC_LIBS

if LINGMO_PACKAGE_LIBGIT2

config LINGMO_PACKAGE_LIBGIT2_CLI
	bool "enable command line interface (git2_cli)"
	help
	  Enable a command-line interface for libgit2.
	  It aims to be git-compatible.

endif
```

## package/libglade/Config.in
```kconfig
config LINGMO_PACKAGE_LIBGLADE
	bool "libglade"
	depends on LINGMO_PACKAGE_LIBGTK2
	depends on LINGMO_USE_WCHAR # glib2
	depends on LINGMO_TOOLCHAIN_HAS_THREADS # glib2
	depends on LINGMO_USE_MMU # glib2
	select LINGMO_PACKAGE_LIBGLIB2
	select LINGMO_PACKAGE_AT_SPI2_CORE
	select LINGMO_PACKAGE_LIBXML2
	help
	  Libglade allows you to load glade interface files in a program
	  at runtime. It doesn't require GLADE to be used, but GLADE is
	  by far the easiest way to create the interface files.

	  https://download.gnome.org/sources/libglade/

comment "libglade needs a toolchain w/ wchar, threads"
	depends on LINGMO_USE_MMU
	depends on LINGMO_PACKAGE_LIBGTK2
	depends on !LINGMO_USE_WCHAR || !LINGMO_TOOLCHAIN_HAS_THREADS
```

## package/libglew/Config.in
```kconfig
config LINGMO_PACKAGE_LIBGLEW
	bool "libglew"
	depends on LINGMO_PACKAGE_XORG7
	depends on LINGMO_PACKAGE_HAS_LIBGL
	select LINGMO_PACKAGE_XLIB_LIBX11
	select LINGMO_PACKAGE_XLIB_LIBXEXT
	select LINGMO_PACKAGE_XLIB_LIBXI
	select LINGMO_PACKAGE_XLIB_LIBXMU
	help
	  The OpenGL Extension Wrangler Library (GLEW) is a
	  cross-platform C/C++ extension loading library. GLEW provides
	  efficient run-time mechanisms for determining which OpenGL
	  extensions are supported on the target platform. OpenGL core
	  and extension functionality is exposed in a single header
	  file.

	  https://github.com/nigels-com/glew

comment "libglew depends on X.org and needs an OpenGL backend"
	depends on !LINGMO_PACKAGE_XORG7 || !LINGMO_PACKAGE_HAS_LIBGL
```

## package/libglfw/Config.in
```kconfig
config LINGMO_PACKAGE_LIBGLFW
	bool "libglfw"
	depends on LINGMO_PACKAGE_XORG7 || LINGMO_PACKAGE_WAYLAND
	depends on LINGMO_PACKAGE_HAS_LIBGL || LINGMO_PACKAGE_HAS_LIBGLES
	select LINGMO_PACKAGE_LIBXKBCOMMON if LINGMO_PACKAGE_WAYLAND
	select LINGMO_PACKAGE_WAYLAND_PROTOCOLS if LINGMO_PACKAGE_WAYLAND
	select LINGMO_PACKAGE_XLIB_LIBXCURSOR if LINGMO_PACKAGE_XORG7
	select LINGMO_PACKAGE_XLIB_LIBXEXT if LINGMO_PACKAGE_XORG7
	select LINGMO_PACKAGE_XLIB_LIBXI if LINGMO_PACKAGE_XORG7
	select LINGMO_PACKAGE_XLIB_LIBXINERAMA if LINGMO_PACKAGE_XORG7
	select LINGMO_PACKAGE_XLIB_LIBXRANDR if LINGMO_PACKAGE_XORG7
	help
	  GLFW is an Open Source, multi-platform library for creating
	  windows with OpenGL contexts and receiving input and events.

	  http://www.glfw.org

comment "libglfw depends on X.org or Wayland and an OpenGL or GLES backend"
	depends on !(LINGMO_PACKAGE_XORG7 || LINGMO_PACKAGE_WAYLAND)
	depends on !(LINGMO_PACKAGE_HAS_LIBGL || LINGMO_PACKAGE_HAS_LIBGLES)
```

## package/libglib2/Config.in
```kconfig
config LINGMO_PACKAGE_LIBGLIB2
	bool "libglib2"
	depends on LINGMO_USE_WCHAR # gettext
	depends on LINGMO_TOOLCHAIN_HAS_THREADS
	depends on LINGMO_USE_MMU # fork()
	select LINGMO_PACKAGE_LIBICONV if !LINGMO_ENABLE_LOCALE
	select LINGMO_PACKAGE_LIBFFI
	select LINGMO_PACKAGE_PCRE2
	select LINGMO_PACKAGE_ZLIB
	help
	  Low-level core library that forms the basis of GTK+ and GNOME.

	  http://www.gtk.org/

comment "libglib2 needs a toolchain w/ wchar, threads"
	depends on LINGMO_USE_MMU
	depends on !LINGMO_USE_WCHAR || !LINGMO_TOOLCHAIN_HAS_THREADS
```

## package/libglu/Config.in
```kconfig
config LINGMO_PACKAGE_LIBGLU
	bool "libglu"
	depends on LINGMO_PACKAGE_HAS_LIBGL
	help
	  Mesa OpenGL Utility library

	  http://cgit.freedesktop.org/mesa/glu/

comment "libglu needs an OpenGL backend"
	depends on !LINGMO_PACKAGE_HAS_LIBGL
```

## package/libglvnd/Config.in
```kconfig
config LINGMO_PACKAGE_LIBGLVND
	bool "libglvnd"
	depends on LINGMO_TOOLCHAIN_HAS_SYNC_4 # __sync_*_4 intrisics
	depends on !LINGMO_STATIC_LIBS # dlfcn.h
	depends on LINGMO_TOOLCHAIN_HAS_THREADS
	help
	  The GL Vendor-Neutral Dispatch library

	  libglvnd is a vendor-neutral dispatch layer for arbitrating
	  OpenGL API calls between multiple vendors. It allows multiple
	  drivers from different vendors to coexist on the same
	  filesystem, and determines which vendor to dispatch each API
	  call to at runtime.

	  Both GLX and EGL are supported, in any combination with OpenGL
	  and OpenGL ES.

if LINGMO_PACKAGE_LIBGLVND

# The following symbols should be selected by the libglvnd-aware
# GL/EGL/GLES providers.
config LINGMO_PACKAGE_LIBGLVND_DISPATCH_GL
	bool
	depends on LINGMO_PACKAGE_XORG7 # libx11, libXext, xorgproto
	select LINGMO_PACKAGE_XLIB_LIBX11
	select LINGMO_PACKAGE_XLIB_LIBXEXT
	select LINGMO_PACKAGE_XORGPROTO
	select LINGMO_PACKAGE_HAS_LIBGL

config LINGMO_PACKAGE_LIBGLVND_DISPATCH_EGL
	bool
	select LINGMO_PACKAGE_HAS_LIBEGL

config LINGMO_PACKAGE_LIBGLVND_DISPATCH_GLES
	bool
	select LINGMO_PACKAGE_HAS_LIBGLES

config LINGMO_PACKAGE_PROVIDES_LIBGL
	default "libglvnd" if LINGMO_PACKAGE_LIBGLVND_DISPATCH_GL

config LINGMO_PACKAGE_PROVIDES_LIBEGL
	default "libglvnd" if LINGMO_PACKAGE_LIBGLVND_DISPATCH_EGL

config LINGMO_PACKAGE_PROVIDES_LIBGLES
	default "libglvnd" if LINGMO_PACKAGE_LIBGLVND_DISPATCH_GLES

endif

comment "libglvnd needs a toolchain w/ dynamic library, threads"
	depends on LINGMO_TOOLCHAIN_HAS_SYNC_4
	depends on LINGMO_STATIC_LIBS || !LINGMO_TOOLCHAIN_HAS_THREADS
```

## package/libgpg-error/Config.in
```kconfig
config LINGMO_PACKAGE_LIBGPG_ERROR_ARCH_SUPPORTS
	bool
	# see src/syscfg/
	default y if \
		LINGMO_aarch64	|| LINGMO_aarch64_be	|| \
		LINGMO_arm		|| LINGMO_armeb		|| \
		LINGMO_i386	|| LINGMO_mips		|| \
		LINGMO_mipsel	|| LINGMO_mips64		|| \
		LINGMO_mips64el	|| LINGMO_m68k		|| \
		LINGMO_nios2	|| LINGMO_or1k		|| \
		LINGMO_powerpc	|| LINGMO_powerpc64 	|| \
		LINGMO_powerpc64le	|| LINGMO_RISCV_64		|| \
		LINGMO_RISCV_32	|| LINGMO_s390x		|| \
		LINGMO_sh4		|| LINGMO_sh4eb		|| \
		LINGMO_sh4a	|| LINGMO_sh4aeb		|| \
		LINGMO_sparc	|| LINGMO_sparc64		|| \
		LINGMO_x86_64

config LINGMO_PACKAGE_LIBGPG_ERROR
	bool "libgpg-error"
	depends on LINGMO_PACKAGE_LIBGPG_ERROR_ARCH_SUPPORTS
	help
	  Libgpg-error is a small library with error codes and
	  descriptions shared by most GnuPG related software.

	  https://www.gnupg.org/related_software/libgpg-error

config LINGMO_PACKAGE_LIBGPG_ERROR_SYSCFG
	string
	default "aarch64-unknown-linux-gnu" \
		if LINGMO_aarch64 || LINGMO_aarch64_be
	default "arm-unknown-linux-gnueabi" \
		if LINGMO_arm || LINGMO_armeb
	default "i686-pc-linux-gnu" \
		if LINGMO_i386
	default "mips-unknown-linux-gnu" \
		if LINGMO_mips || LINGMO_mipsel
	default "mips64el-unknown-linux-gnuabi64" \
		if LINGMO_mips64 || LINGMO_mips64el
	default "m68k-unknown-linux-gnu" \
		if LINGMO_m68k
	default "nios2-unknown-linux-gnu" \
		if LINGMO_nios2
	default "or1k-unknown-linux-gnu" \
		if LINGMO_or1k
	default "powerpc-unknown-linux-gnu" \
		if LINGMO_powerpc
	default "powerpc64-unknown-linux-gnu" \
		if LINGMO_powerpc64 || LINGMO_powerpc64le
	default "riscv32-unknown-linux-gnu" \
		if LINGMO_RISCV_32
	default "riscv64-unknown-linux-gnu" \
		if LINGMO_RISCV_64
	default "s390x-unknown-linux-gnu" \
		if LINGMO_s390x
	default "sh4-unknown-linux-gnu" \
		if LINGMO_sh4 || LINGMO_sh4eb || LINGMO_sh4a || LINGMO_sh4aeb
	default "sparc-unknown-linux-gnu" \
		if LINGMO_sparc
	default "sparc64-unknown-linux-gnu" \
		if LINGMO_sparc64
	default "x86_64-unknown-linux-gnu" \
		if LINGMO_x86_64
```

## package/libgpgme/Config.in
```kconfig
config LINGMO_PACKAGE_LIBGPGME
	bool "libgpgme"
	depends on LINGMO_PACKAGE_LIBGPG_ERROR_ARCH_SUPPORTS # libgpg-error
	depends on LINGMO_USE_MMU # libassuan
	select LINGMO_PACKAGE_GNUPG2 if LINGMO_PACKAGE_GNUPG2_DEPENDS && !LINGMO_PACKAGE_GNUPG # runtime
	select LINGMO_PACKAGE_GNUPG if !LINGMO_PACKAGE_GNUPG2_DEPENDS # runtime
	select LINGMO_PACKAGE_LIBGPG_ERROR
	select LINGMO_PACKAGE_LIBASSUAN
	help
	  GnuPG Made Easy (GPGME) is a library designed to make access
	  to GnuPG easier for applications.

	  http://www.gnupg.org/related_software/gpgme/
```

## package/libgphoto2/Config.in
```kconfig
config LINGMO_PACKAGE_LIBGPHOTO2
	bool "libgphoto2"
	depends on LINGMO_TOOLCHAIN_HAS_THREADS # libusb
	depends on LINGMO_TOOLCHAIN_GCC_AT_LEAST_4_9 # libusb
	select LINGMO_PACKAGE_LIBTOOL
	select LINGMO_PACKAGE_LIBUSB
	select LINGMO_PACKAGE_LIBXML2
	help
	  libgphoto2 is the core library designed to allow access to
	  digital camera by external programs.

	  http://gphoto.org/proj/libgphoto2/

comment "libgphoto needs a toolchain w/ threads, gcc >= 4.9"
	depends on !LINGMO_TOOLCHAIN_HAS_THREADS || \
		!LINGMO_TOOLCHAIN_GCC_AT_LEAST_4_9
```

## package/libgpiod/Config.in
```kconfig
config LINGMO_PACKAGE_LIBGPIOD
	bool "libgpiod"
	depends on LINGMO_TOOLCHAIN_HEADERS_AT_LEAST_4_8
	help
	  This is a C library that abstracts the GPIO character
	  device operations on linux.

	  https://git.kernel.org/pub/scm/libs/libgpiod/libgpiod.git/

if LINGMO_PACKAGE_LIBGPIOD

config LINGMO_PACKAGE_LIBGPIOD_TOOLS
	bool "install tools"
	help
	  Include a set of command-line tools for managing GPIOs.

endif

comment "libgpiod needs kernel headers >= 4.8"
	depends on !LINGMO_TOOLCHAIN_HEADERS_AT_LEAST_4_8
```

## package/libgsm/Config.in
```kconfig
config LINGMO_PACKAGE_LIBGSM
	bool "libgsm"
	depends on !LINGMO_STATIC_LIBS
	help
	  Shared libraries for GSM 06.10 lossy speech compression.

	  http://www.quut.com/gsm

comment "libgsm needs a toolchain w/ dynamic library"
	depends on LINGMO_STATIC_LIBS
```

## package/libgta/Config.in
```kconfig
config LINGMO_PACKAGE_LIBGTA
	bool "libgta"
	select LINGMO_PACKAGE_BZIP2
	select LINGMO_PACKAGE_ZLIB
	select LINGMO_PACKAGE_XZ
	help
	  Libgta is a portable library that implements the Generic
	  Tagged Array (GTA) file format.

	  https://marlam.de/gta
```

## package/libgtk2/Config.in
```kconfig
config LINGMO_PACKAGE_LIBGTK2
	bool "libgtk2"
	depends on LINGMO_PACKAGE_XORG7
	depends on LINGMO_USE_WCHAR # glib2
	depends on LINGMO_TOOLCHAIN_HAS_THREADS # glib2
	depends on LINGMO_USE_MMU # glib2
	depends on LINGMO_INSTALL_LIBSTDCPP # pango
	depends on LINGMO_TOOLCHAIN_HAS_SYNC_4 # pango -> harfbuzz
	depends on LINGMO_TOOLCHAIN_GCC_AT_LEAST_4_9 # pango -> harfbuzz
	select LINGMO_PACKAGE_AT_SPI2_CORE
	select LINGMO_PACKAGE_CAIRO
	select LINGMO_PACKAGE_CAIRO_PS
	select LINGMO_PACKAGE_CAIRO_PDF
	select LINGMO_PACKAGE_CAIRO_SVG
	select LINGMO_PACKAGE_LIBGLIB2
	select LINGMO_PACKAGE_PANGO
	select LINGMO_PACKAGE_GDK_PIXBUF
	select LINGMO_PACKAGE_FONTCONFIG
	select LINGMO_PACKAGE_XLIB_LIBX11
	select LINGMO_PACKAGE_XLIB_LIBXEXT
	select LINGMO_PACKAGE_XLIB_LIBXRENDER
	help
	  The GTK+ version 2 graphical user interface library

	  http://www.gtk.org/

if LINGMO_PACKAGE_LIBGTK2

config LINGMO_PACKAGE_LIBGTK2_DEMO
	bool "Install libgtk2 demo program"
	help
	  The GTK+ source base contains a gtk-demo program. This
	  option allows to install this program to the target.

endif

comment "libgtk2 needs a toolchain w/ wchar, threads, C++, gcc >= 4.9"
	depends on LINGMO_USE_MMU
	depends on LINGMO_TOOLCHAIN_HAS_SYNC_4
	depends on LINGMO_PACKAGE_XORG7
	depends on !LINGMO_USE_WCHAR || !LINGMO_INSTALL_LIBSTDCPP || \
		!LINGMO_TOOLCHAIN_GCC_AT_LEAST_4_9 || \
		!LINGMO_TOOLCHAIN_HAS_THREADS
```
