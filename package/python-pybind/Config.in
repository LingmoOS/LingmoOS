## package/python-pybind/Config.in
```kconfig
config LINGMO_PACKAGE_PYTHON_PYBIND
	bool "python-pybind"
	depends on LINGMO_INSTALL_LIBSTDCPP
	help
	  PyBind is a lightweight header-only library that exposes C++
	  types in Python and vice versa, mainly to create Python
	  bindings of existing C++ code.

	  http://pybind11.readthedocs.org/en/master

comment "python-pybind needs a toolchain w/ C++"
	depends on !LINGMO_INSTALL_LIBSTDCPP
```

## package/python-pycairo/Config.in
```kconfig
config LINGMO_PACKAGE_PYTHON_PYCAIRO
	bool "python-pycairo"
	select LINGMO_PACKAGE_CAIRO
	help
	  Python interface for cairo.

	  https://pycairo.readthedocs.io
```

## package/python-pycares/Config.in
```kconfig
config LINGMO_PACKAGE_PYTHON_PYCARES
	bool "python-pycares"
	select LINGMO_PACKAGE_PYTHON_CFFI # runtime
	help
	  Python interface for c-ares.

	  http://github.com/saghul/pycares
```

## package/python-pycups/Config.in
```kconfig
config LINGMO_PACKAGE_PYTHON_PYCUPS
	bool "python-pycups"
	depends on LINGMO_PACKAGE_CUPS
	help
	  Python bindings for libcups.

	  https://github.com/zdohnal/pycups
```

## package/python-pydantic/Config.in
```kconfig
config LINGMO_PACKAGE_PYTHON_PYDANTIC
	bool "python-pydantic"
	depends on LINGMO_PACKAGE_HOST_RUSTC_TARGET_ARCH_SUPPORTS # python-pydantic-core
	select LINGMO_PACKAGE_PYTHON_ANNOTATED_TYPES # runtime
	select LINGMO_PACKAGE_PYTHON_PYDANTIC_CORE # runtime
	select LINGMO_PACKAGE_PYTHON_TYPING_EXTENSIONS # runtime
	help
	  Data validation and settings management using python 3.6
	  type hinting.

	  https://github.com/pydantic/pydantic
```

## package/python-pyicu/Config.in
```kconfig
config LINGMO_PACKAGE_PYTHON_PYICU
	bool "python-pyicu"
	depends on !LINGMO_BINFMT_FLAT # icu
	depends on LINGMO_HOST_GCC_AT_LEAST_4_9 # icu
	depends on LINGMO_INSTALL_LIBSTDCPP # icu
	depends on LINGMO_TOOLCHAIN_GCC_AT_LEAST_4_9 # icu
	select LINGMO_PACKAGE_ICU
	help
	  Python extension wrapping the ICU C++ API.

	  https://gitlab.pyicu.org/main/pyicu

comment "python-pyicu needs a toolchain w/ C++, gcc >= 4.9, host gcc >= 4.9"
	depends on !LINGMO_BINFMT_FLAT
	depends on !LINGMO_INSTALL_LIBSTDCPP || \
		!LINGMO_TOOLCHAIN_GCC_AT_LEAST_4_9 || \
		!LINGMO_HOST_GCC_AT_LEAST_4_9
```

## package/python-pyjwt/Config.in
```kconfig
config LINGMO_PACKAGE_PYTHON_PYJWT
	bool "python-pyjwt"
	help
	  JSON Web Token implementation in Python.

	  http://github.com/jpadilla/pyjwt
```

## package/python-pylibftdi/Config.in
```kconfig
config LINGMO_PACKAGE_PYTHON_PYLIBFTDI
	bool "python-pylibftdi"
	depends on LINGMO_TOOLCHAIN_HAS_THREADS # libusb
	depends on LINGMO_TOOLCHAIN_GCC_AT_LEAST_4_9 # libftdi -> libusb
	select LINGMO_PACKAGE_LIBFTDI
	help
	  This package contains the python language binding libftdi.

	  https://pypi.python.org/pypi/pylibftdi

comment "python-pylibftdi needs a toolchain w/ threads, gcc >= 4.9"
	depends on !LINGMO_TOOLCHAIN_HAS_THREADS || \
		!LINGMO_TOOLCHAIN_GCC_AT_LEAST_4_9
```

## package/python-pymodbus/Config.in
```kconfig
config LINGMO_PACKAGE_PYTHON_PYMODBUS
	bool "python-pymodbus"
	select LINGMO_PACKAGE_PYTHON_SIX # runtime
	select LINGMO_PACKAGE_PYTHON_SERIAL # runtime
	help
	  Pymodbus is a full Modbus protocol implementation.

	  https://github.com/riptideio/pymodbus
```

## package/python-pymupdf/Config.in
```kconfig
config LINGMO_PACKAGE_PYTHON_PYMUPDF
	bool "python-pymupdf"
	depends on LINGMO_INSTALL_LIBSTDCPP # mupdf -> harfbuzz
	depends on LINGMO_TOOLCHAIN_HAS_SYNC_4 # mupdf -> harfbuzz
	depends on LINGMO_TOOLCHAIN_GCC_AT_LEAST_4_9 # mupdf -> harfbuzz
	depends on LINGMO_PACKAGE_XORG7
	select LINGMO_PACKAGE_HOST_SWIG
	select LINGMO_PACKAGE_FREETYPE
	select LINGMO_PACKAGE_MUPDF
	select LINGMO_PACKAGE_ZLIB
	help
	  Python bindings for the PDF rendering library MuPDF.

	  https://github.com/pymupdf/PyMuPDF

comment "python-pymupdf needs Xorg"
	depends on LINGMO_TOOLCHAIN_HAS_SYNC_4
	depends on !LINGMO_PACKAGE_XORG7

comment "python-pymupdf needs a toolchain w/ C++, gcc >= 4.9"
	depends on LINGMO_TOOLCHAIN_HAS_SYNC_4
	depends on !LINGMO_INSTALL_LIBSTDCPP || \
		!LINGMO_TOOLCHAIN_GCC_AT_LEAST_4_9
```

## package/python-pynacl/Config.in
```kconfig
config LINGMO_PACKAGE_PYTHON_PYNACL
	bool "python-pynacl"
	select LINGMO_PACKAGE_LIBSODIUM
	select LINGMO_PACKAGE_PYTHON_CFFI # runtime
	help
	  Python binding to the Networking and Cryptography (NaCl)
	  library.

	  https://pypi.python.org/pypi/PyNaCl
```

## package/python-pyndiff/Config.in
```kconfig
config LINGMO_PACKAGE_PYTHON_PYNDIFF
	bool "python-pyndiff"
	select LINGMO_PACKAGE_PYTHON_XMLJSON # runtime
	select LINGMO_PACKAGE_PYTHON_SETUPTOOLS # runtime
	help
	  Generate human-readable ndiff output when comparing 2 Nmap
	  XML scan files.

	  https://github.com/rackerlabs/pyndiff
```

## package/python-pyopenssl/Config.in
```kconfig
config LINGMO_PACKAGE_PYTHON_PYOPENSSL
	bool "python-pyopenssl"
	depends on LINGMO_PACKAGE_HOST_RUSTC_TARGET_ARCH_SUPPORTS # python-cryptography
	select LINGMO_PACKAGE_PYTHON_CRYPTOGRAPHY # runtime
	help
	  Python wrapper module around the OpenSSL library.

	  https://github.com/pyca/pyopenssl
```

## package/python-pyparted/Config.in
```kconfig
config LINGMO_PACKAGE_PYTHON_PYPARTED
	bool "python-pyparted"
	depends on LINGMO_ENABLE_LOCALE # parted
	depends on LINGMO_TOOLCHAIN_GCC_AT_LEAST_5 # parted
	depends on LINGMO_USE_WCHAR
	select LINGMO_PACKAGE_PARTED
	help
	  Python bindings for GNU parted (libparted).

	  https://github.com/rhinstaller/pyparted

comment "pyparted needs a toolchain w/ locale, wchar, gcc >= 5"
	depends on !LINGMO_ENABLE_LOCALE || !LINGMO_USE_WCHAR || \
		!LINGMO_TOOLCHAIN_GCC_AT_LEAST_5
```

## package/python-pyqrcode/Config.in
```kconfig
config LINGMO_PACKAGE_PYTHON_PYQRCODE
	bool "python-pyqrcode"
	select LINGMO_PACKAGE_PYTHON3_PYEXPAT # runtime
	select LINGMO_PACKAGE_PYTHON3_CODECSCJK # runtime
	help
	  A QR code generator written purely in Python with SVG, EPS,
	  PNG and terminal output.

	  https://github.com/mnooner256/pyqrcode
```

## package/python-pyqt5/Config.in
```kconfig
comment "python-pyqt5 needs Qt5"
	depends on !LINGMO_PACKAGE_QT5

config LINGMO_PACKAGE_PYTHON_PYQT5
	bool "python-pyqt5"
	depends on LINGMO_PACKAGE_QT5
	select LINGMO_PACKAGE_PYTHON_SIP
	select LINGMO_PACKAGE_QT5BASE_GUI
	help
	  Python bindings for Qt 5

	  http://www.riverbankcomputing.com/software/pyqt/
```

## package/python-pyrsistent/Config.in
```kconfig
config LINGMO_PACKAGE_PYTHON_PYRSISTENT
	bool "python-pyrsistent"
	help
	  Persistent/Functional/Immutable data structures.

	  http://github.com/tobgu/pyrsistent/
```

## package/python-pysensors/Config.in
```kconfig
config LINGMO_PACKAGE_PYTHON_PYSENSORS
	bool "python-pysensors"
	select LINGMO_PACKAGE_LM_SENSORS # runtime
	help
	  Python bindings for libsensors.so from the lm-sensors project
	  via ctypes. Supports API version 4, i.e. libsensors version
	  3.x.

	  https://pypi.org/project/PySensors
```

## package/python-pysftp/Config.in
```kconfig
config LINGMO_PACKAGE_PYTHON_PYSFTP
	bool "python-pysftp"
	depends on LINGMO_PACKAGE_HOST_RUSTC_TARGET_ARCH_SUPPORTS # python-paramiko -> python-cryptography
	select LINGMO_PACKAGE_PYTHON_PARAMIKO # runtime
	help
	  A friendly face on SFTP.

	  https://bitbucket.org/dundeemt/pysftp
```

## package/python-pysmi/Config.in
```kconfig
config LINGMO_PACKAGE_PYTHON_PYSMI
	bool "python-pysmi"
	select LINGMO_PACKAGE_PYTHON_PLY # runtime
	help
	  SNMP SMI/MIB Parser.

	  https://github.com/etingof/pysmi
```

## package/python-pysnmp-mibs/Config.in
```kconfig
config LINGMO_PACKAGE_PYTHON_PYSNMP_MIBS
	bool "python-pysnmp-mibs"
	depends on LINGMO_INSTALL_LIBSTDCPP # pysnmp -> pyasn
	select LINGMO_PACKAGE_PYTHON_PYSNMP
	help
	  PySNMP MIBs is a set of IETF & IANA MIBs pre-compiled and
	  packaged to simplify their use with the PySNMP library.

	  http://pysnmp.sf.net

comment "python-pysnmp-libs needs a toolchain w/ C++"
	depends on !LINGMO_INSTALL_LIBSTDCPP
```

## package/python-pysnmp/Config.in
```kconfig
config LINGMO_PACKAGE_PYTHON_PYSNMP
	bool "python-pysnmp"
	select LINGMO_PACKAGE_PYTHON_PYSMI # runtime
	select LINGMO_PACKAGE_PYTHON_PYCRYPTODOMEX # runtime
	select LINGMO_PACKAGE_PYTHON_PYASN1 # runtime
	help
	  PySNMP is a cross-platform, pure-Python SNMP engine
	  implementation.

	  http://pysnmp.sf.net
```

## package/python-pyspnego/Config.in
```kconfig
config LINGMO_PACKAGE_PYTHON_PYSPNEGO
	bool "python-pyspnego"
	depends on LINGMO_PACKAGE_HOST_RUSTC_TARGET_ARCH_SUPPORTS # python-cryptography
	select LINGMO_PACKAGE_PYTHON_CRYPTOGRAPHY # runtime
	help
	  Windows Negotiate Authentication Client and Server.

	  https://github.com/jborean93/pyspnego
```

## package/python-pytablereader/Config.in
```kconfig
config LINGMO_PACKAGE_PYTHON_PYTABLEREADER
	bool "python-pytablereader"
	depends on LINGMO_PACKAGE_HOST_RUSTC_TARGET_ARCH_SUPPORTS # python-jsonschema -> python-rpds-py
	select LINGMO_PACKAGE_PYTHON_BEAUTIFULSOUP4 # runtime
	select LINGMO_PACKAGE_PYTHON_DATAPROPERTY # runtime
	select LINGMO_PACKAGE_PYTHON_JSONSCHEMA # runtime
	select LINGMO_PACKAGE_PYTHON_MBSTRDECODER # runtime
	select LINGMO_PACKAGE_PYTHON_PATHPY # runtime
	select LINGMO_PACKAGE_PYTHON_PATHVALIDATE # runtime
	select LINGMO_PACKAGE_PYTHON_SIX # runtime
	select LINGMO_PACKAGE_PYTHON_TABLEDATA # runtime
	select LINGMO_PACKAGE_PYTHON_TYPEPY # runtime
	help
	  A python library to load structured table data from
	  files/URL with various data formats:
	  CSV/Excel/HTML/JSON/LTSV/Markdown/TSV.

	  https://github.com/thombashi/pytablereader
```

## package/python-pytest-asyncio/Config.in
```kconfig
config LINGMO_PACKAGE_PYTHON_PYTEST_ASYNCIO
	bool "python-pytest-asyncio"
	select LINGMO_PACKAGE_PYTHON_PYTEST # runtime
	help
	  Pytest support for asyncio.

	  https://github.com/pytest-dev/pytest-asyncio
```
