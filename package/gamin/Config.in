## package/gamin/Config.in
```kconfig
config LINGMO_PACKAGE_GAMIN
	bool "gamin"
	depends on LINGMO_USE_WCHAR # glib2
	depends on LINGMO_TOOLCHAIN_HAS_THREADS
	depends on LINGMO_USE_MMU # glib2
	select LINGMO_PACKAGE_LIBGLIB2
	help
	  the File Alteration Monitor

	  http://www.gnome.org/~veillard/gamin/sources

comment "gamin needs a toolchain w/ wchar, threads"
	depends on LINGMO_USE_MMU
	depends on !LINGMO_USE_WCHAR || !LINGMO_TOOLCHAIN_HAS_THREADS
```

## package/gauche/Config.in
```kconfig
# Architecture dependency from the bundled bdwgc.
config LINGMO_PACKAGE_GAUCHE_ARCH_SUPPORTS
	bool
	default y if LINGMO_arm || LINGMO_armeb || LINGMO_i386 || LINGMO_m68k || \
		LINGMO_mips || LINGMO_mipsel || LINGMO_mips64 || \
		LINGMO_mips64el || LINGMO_powerpc || LINGMO_powerpc64 || \
		LINGMO_powerpc64le || LINGMO_sh || LINGMO_x86_64

config LINGMO_PACKAGE_GAUCHE
	bool "gauche"
	depends on LINGMO_TOOLCHAIN_HAS_THREADS_NPTL
	depends on LINGMO_USE_MMU # fork()
	depends on LINGMO_PACKAGE_GAUCHE_ARCH_SUPPORTS
	depends on !LINGMO_STATIC_LIBS
	help
	  Gauche is an R7RS Scheme implementation developed to be a
	  handy script interpreter, which allows programmers and
	  system administrators to write small to large scripts for
	  their daily chores. Quick startup, built-in system
	  interface, native multilingual support are some of its
	  goals.

	  http://practical-scheme.net/gauche/

comment "gauche needs a toolchain w/ NPTL, dynamic library"
	depends on LINGMO_USE_MMU
	depends on LINGMO_PACKAGE_GAUCHE_ARCH_SUPPORTS
	depends on !LINGMO_TOOLCHAIN_HAS_THREADS_NPTL || LINGMO_STATIC_LIBS
```

## package/gawk/Config.in
```kconfig
config LINGMO_PACKAGE_GAWK
	bool "gawk"
	depends on LINGMO_USE_WCHAR
	depends on LINGMO_USE_MMU # fork()
	depends on LINGMO_PACKAGE_BUSYBOX_SHOW_OTHERS
	help
	  A special-purpose programming language which is data driven
	  rather than procedural. Allows for simple data-reformatting
	  jobs with just a few lines of code.

	  http://www.gnu.org/software/gawk/

comment "gawk needs a toolchain w/ wchar"
	depends on LINGMO_USE_MMU
	depends on !LINGMO_USE_WCHAR
	depends on LINGMO_PACKAGE_BUSYBOX_SHOW_OTHERS
```

## package/gcc/Config.in.host
```kconfig
comment "GCC Options"

choice
	prompt "GCC compiler Version"
	default LINGMO_GCC_VERSION_ARC if LINGMO_GCC_VERSION_4_8_ARC # legacy
	default LINGMO_GCC_VERSION_ARC if LINGMO_arc
	default LINGMO_GCC_VERSION_POWERPC_SPE if LINGMO_POWERPC_CPU_HAS_SPE
	default LINGMO_GCC_VERSION_12_X
	help
	  Select the version of gcc you wish to use.

config LINGMO_GCC_VERSION_ARC
	bool "gcc arc (13.1)"
	# Only supported architecture
	depends on LINGMO_arc
	select LINGMO_TOOLCHAIN_GCC_AT_LEAST_13

config LINGMO_GCC_VERSION_POWERPC_SPE
	bool "gcc powerpc spe"
	# powerpc spe support has been deprecated since gcc 8.x.
	# https://gcc.gnu.org/ml/gcc/2018-04/msg00102.html
	depends on LINGMO_POWERPC_CPU_HAS_SPE
	select LINGMO_TOOLCHAIN_GCC_AT_LEAST_8

config LINGMO_GCC_VERSION_11_X
	bool "gcc 11.x"
	depends on !LINGMO_ARCH_NEEDS_GCC_AT_LEAST_12
	# powerpc spe support has been deprecated since gcc 8.x.
	# https://gcc.gnu.org/ml/gcc/2018-04/msg00102.html
	depends on !LINGMO_POWERPC_CPU_HAS_SPE
	# ARC HS48 rel 31 only supported by gcc arc fork.
	depends on !LINGMO_archs4x_rel31
	select LINGMO_TOOLCHAIN_GCC_AT_LEAST_11

config LINGMO_GCC_VERSION_12_X
	bool "gcc 12.x"
	depends on !LINGMO_ARCH_NEEDS_GCC_AT_LEAST_13
	# powerpc spe support has been deprecated since gcc 8.x.
	# https://gcc.gnu.org/ml/gcc/2018-04/msg00102.html
	depends on !LINGMO_POWERPC_CPU_HAS_SPE
	# ARC HS48 rel 31 only supported by gcc arc fork.
	depends on !LINGMO_archs4x_rel31
	select LINGMO_TOOLCHAIN_GCC_AT_LEAST_12

config LINGMO_GCC_VERSION_13_X
	bool "gcc 13.x"
	# powerpc spe support has been deprecated since gcc 8.x.
	# https://gcc.gnu.org/ml/gcc/2018-04/msg00102.html
	depends on !LINGMO_POWERPC_CPU_HAS_SPE
	select LINGMO_TOOLCHAIN_GCC_AT_LEAST_13

endchoice

# libcilkrts was introduced in gcc 4.9 and removed in gcc 8.x
config LINGMO_GCC_SUPPORTS_LIBCILKRTS
	bool
	default y if !LINGMO_TOOLCHAIN_GCC_AT_LEAST_8

config LINGMO_GCC_SUPPORTS_DLANG
	bool
	default y if LINGMO_aarch64
	default y if LINGMO_arm
	default y if LINGMO_i386
	default y if LINGMO_mips || LINGMO_mipsel
	default y if LINGMO_mips64 || LINGMO_mips64el
	default y if LINGMO_powerpc || LINGMO_powerpc64 || LINGMO_powerpc64le
	default y if LINGMO_x86_64
	default y if LINGMO_riscv && !LINGMO_RISCV_64
	depends on LINGMO_TOOLCHAIN_GCC_AT_LEAST_9
	depends on LINGMO_TOOLCHAIN_USES_GLIBC
	# "The D front-end is now itself written in D, in order to build GDC, you
	# will need a working GDC compiler (GCC version 9.1 or later)."
	# https://gcc.gnu.org/git/?p=gcc.git;a=commitdiff;h=5fee5ec362f7a243f459e6378fd49dfc89dc9fb5
	depends on !LINGMO_TOOLCHAIN_GCC_AT_LEAST_12

config LINGMO_GCC_VERSION
	string
	default "8.4.0"     if LINGMO_GCC_VERSION_POWERPC_SPE
	default "11.4.0"    if LINGMO_GCC_VERSION_11_X
	default "12.3.0"    if LINGMO_GCC_VERSION_12_X
	default "13.3.0"    if LINGMO_GCC_VERSION_13_X
	default "arc-2023.09-release" if LINGMO_GCC_VERSION_ARC

config LINGMO_EXTRA_GCC_CONFIG_OPTIONS
	string "Additional gcc options"
	default ""
	help
	  Any additional gcc configure options you may want to
	  include. Those options are applied for all of the gcc
	  initial, gcc intermediate and gcc final passes.

config LINGMO_TOOLCHAIN_BUILDROOT_CXX
	bool "Enable C++ support"
	select LINGMO_INSTALL_LIBSTDCPP
	help
	  Enable this option if you want your toolchain to support the
	  C++ language and you want C++ libraries to be installed on
	  your target system.

comment "Fortran support needs a toolchain w/ wchar"
	depends on LINGMO_TOOLCHAIN_HAS_LIBQUADMATH
	depends on !LINGMO_USE_WCHAR # libquadmath

config LINGMO_TOOLCHAIN_BUILDROOT_FORTRAN
	bool "Enable Fortran support"
	# on architecture building libquadmath, wchar is required
	depends on !LINGMO_TOOLCHAIN_HAS_LIBQUADMATH || \
		(LINGMO_TOOLCHAIN_HAS_LIBQUADMATH && LINGMO_USE_WCHAR)
	select LINGMO_TOOLCHAIN_HAS_FORTRAN
	help
	  Enable this option if you want your toolchain to support the
	  Fortran language and you want Fortran libraries to be
	  installed on your target system.

config LINGMO_TOOLCHAIN_BUILDROOT_DLANG
	bool "Enable D language support"
	depends on LINGMO_GCC_SUPPORTS_DLANG
	select LINGMO_TOOLCHAIN_HAS_DLANG
	help
	  Enable this option if you want your toolchain to support the
	  D language and you want D libraries to be installed on your
	  target system.

config LINGMO_GCC_ENABLE_OPENMP
	bool "Enable compiler OpenMP support"
	depends on !LINGMO_PTHREADS_NONE && !LINGMO_arc && !LINGMO_microblaze
	select LINGMO_TOOLCHAIN_HAS_OPENMP
	help
	  Enable OpenMP support for the compiler

config LINGMO_GCC_ENABLE_GRAPHITE
	bool "Enable graphite support"
	depends on LINGMO_TOOLCHAIN_GCC_AT_LEAST_5
	help
	  This option enables the graphite optimizations in the
	  compiler.

comment "graphite support needs gcc >= 5.x"
	depends on !LINGMO_TOOLCHAIN_GCC_AT_LEAST_5
```

## package/gcnano-binaries/Config.in
```kconfig
comment "gcnano-binaries needs a Linux kernel to be built"
	depends on LINGMO_arm
	depends on !LINGMO_LINUX_KERNEL

comment "gcnano-binaries needs a glibc toolchain w/ threads, dynamic library"
	depends on LINGMO_arm
	depends on !LINGMO_TOOLCHAIN_USES_GLIBC || !LINGMO_TOOLCHAIN_HAS_THREADS \
		|| LINGMO_STATIC_LIBS

config LINGMO_PACKAGE_GCNANO_BINARIES
	bool "gcnano-binaries"
	depends on LINGMO_arm
	depends on LINGMO_LINUX_KERNEL
	depends on LINGMO_TOOLCHAIN_USES_GLIBC
	depends on LINGMO_TOOLCHAIN_HAS_THREADS # libdrm, wayland
	depends on !LINGMO_STATIC_LIBS
	select LINGMO_PACKAGE_HAS_LIBEGL
	select LINGMO_PACKAGE_HAS_LIBGBM
	select LINGMO_PACKAGE_LIBGBM_HAS_FEATURE_FORMAT_MODIFIER_PLANE_COUNT
	select LINGMO_PACKAGE_LIBGBM_HAS_FEATURE_DMA_BUF
	select LINGMO_PACKAGE_HAS_LIBGLES
	select LINGMO_PACKAGE_LIBDRM
	select LINGMO_PACKAGE_WAYLAND
	help
	  Driver and libraries for stm vivante gcnano gpu.
	  https://github.com/STMicroelectronics/gcnano-binaries/

if LINGMO_PACKAGE_GCNANO_BINARIES

config LINGMO_PACKAGE_PROVIDES_LIBEGL
	default "gcnano-binaries"

config LINGMO_PACKAGE_PROVIDES_LIBGBM
	default "gcnano-binaries"

config LINGMO_PACKAGE_PROVIDES_LIBGLES
	default "gcnano-binaries"

endif
```

## package/gconf/Config.in
```kconfig
config LINGMO_PACKAGE_GCONF
	bool "gconf"
	depends on LINGMO_TOOLCHAIN_HAS_THREADS # dbus, libglib2
	depends on LINGMO_USE_MMU # dbus, libglib2
	depends on LINGMO_USE_WCHAR # libglib2
	depends on !LINGMO_STATIC_LIBS
	select LINGMO_PACKAGE_DBUS
	select LINGMO_PACKAGE_DBUS_GLIB
	select LINGMO_PACKAGE_LIBGLIB2
	select LINGMO_PACKAGE_LIBXML2
	help
	  GConf was a system used by the GNOME desktop environment for
	  storing configuration settings for the desktop and
	  applications. It is similar to the Windows Registry.

	  https://projects.gnome.org/gconf/

comment "gconf needs a toolchain w/ threads, wchar, dynamic library"
	depends on LINGMO_USE_MMU
	depends on !LINGMO_TOOLCHAIN_HAS_THREADS || !LINGMO_USE_WCHAR \
		|| LINGMO_STATIC_LIBS
```

## package/gcr/Config.in
```kconfig
config LINGMO_PACKAGE_GCR
	bool "gcr"
	depends on LINGMO_PACKAGE_LIBGPG_ERROR_ARCH_SUPPORTS # libgcrypt -> libgpg-error
	depends on LINGMO_USE_WCHAR # libglib2
	depends on LINGMO_TOOLCHAIN_HAS_THREADS # libglib2
	depends on LINGMO_USE_MMU # libglib2
	depends on !LINGMO_STATIC_LIBS # p11-kit
	select LINGMO_PACKAGE_GNUPG2 if LINGMO_PACKAGE_GNUPG2_DEPENDS && !LINGMO_PACKAGE_GNUPG # runtime
	select LINGMO_PACKAGE_GNUPG if !LINGMO_PACKAGE_GNUPG2_DEPENDS # runtime
	select LINGMO_PACKAGE_LIBGCRYPT
	select LINGMO_PACKAGE_LIBGLIB2
	select LINGMO_PACKAGE_P11_KIT
	help
	  Library for cryptographic UIs and accessing PKCS#11 modules.

	  https://developer.gnome.org/gcr/

comment "gcr needs a toolchain w/ wchar, threads, dynamic library"
	depends on LINGMO_PACKAGE_LIBGPG_ERROR_ARCH_SUPPORTS
	depends on LINGMO_USE_MMU
	depends on !LINGMO_USE_WCHAR || !LINGMO_TOOLCHAIN_HAS_THREADS || \
		LINGMO_STATIC_LIBS
```

## package/gd/Config.in
```kconfig
menuconfig LINGMO_PACKAGE_GD
	bool "gd"
	help
	  GD is a graphics library. It allows your code to quickly
	  draw images complete with lines, arcs, text, multiple
	  colours, cut and paste from other images, flood fills, and
	  write out the result as a PNG file. This is particularly
	  useful in World Wide Web applications, where PNG is one of
	  the formats accepted for inline images by most browsers.

	  https://libgd.github.io/

if LINGMO_PACKAGE_GD

config LINGMO_PACKAGE_GD_ANNOTATE
	bool "annotate"

config LINGMO_PACKAGE_GD_BDFTOGD
	bool "bdftogd"
	depends on LINGMO_PACKAGE_PERL

config LINGMO_PACKAGE_GD_GD2COPYPAL
	bool "gd2copypal"

config LINGMO_PACKAGE_GD_GD2TOGIF
	bool "gd2togif"

config LINGMO_PACKAGE_GD_GD2TOPNG
	bool "gd2topng"
	select LINGMO_PACKAGE_LIBPNG

config LINGMO_PACKAGE_GD_GDCMPGIF
	bool "gdcmpgif"

config LINGMO_PACKAGE_GD_GDPARTTOPNG
	bool "gdparttopng"
	select LINGMO_PACKAGE_LIBPNG

config LINGMO_PACKAGE_GD_GDTOPNG
	bool "gdtopng"
	select LINGMO_PACKAGE_LIBPNG

config LINGMO_PACKAGE_GD_GIFTOGD2
	bool "giftogd2"

config LINGMO_PACKAGE_GD_PNGTOGD
	bool "pngtogd"
	select LINGMO_PACKAGE_LIBPNG

config LINGMO_PACKAGE_GD_PNGTOGD2
	bool "pngtogd2"
	select LINGMO_PACKAGE_LIBPNG

config LINGMO_PACKAGE_GD_WEBPNG
	bool "webpng"
	select LINGMO_PACKAGE_LIBPNG

endif
```

## package/gdal/Config.in
```kconfig
config LINGMO_PACKAGE_GDAL
	bool "gdal"
	depends on LINGMO_TOOLCHAIN_HAS_SYNC_4 # json-c
	depends on LINGMO_INSTALL_LIBSTDCPP # proj, qhull
	# configure can't find proj, when linking statically
	depends on !LINGMO_STATIC_LIBS
	depends on LINGMO_TOOLCHAIN_GCC_AT_LEAST_4_7 # C++11, proj
	depends on !LINGMO_TOOLCHAIN_HAS_BINUTILS_BUG_27597
	depends on LINGMO_TOOLCHAIN_HAS_THREADS_NPTL # proj
	depends on LINGMO_USE_WCHAR # proj
	select LINGMO_PACKAGE_GIFLIB
	select LINGMO_PACKAGE_JPEG
	select LINGMO_PACKAGE_JSON_C
	select LINGMO_PACKAGE_LIBGEOTIFF
	select LINGMO_PACKAGE_LIBPNG
	select LINGMO_PACKAGE_PROJ
	select LINGMO_PACKAGE_QHULL
	select LINGMO_PACKAGE_ZLIB
	help
	  GDAL is a translator library for raster and vector geospatial
	  data formats. As a library, it presents a single raster
	  abstract data model and single vector abstract data model to
	  the calling application for all supported formats. It also
	  comes with a variety of useful command line utilities for data
	  translation and processing.

	  https://gdal.org/

comment "gdal needs a toolchain w/ C++, dynamic library, gcc >= 4.7, not binutils bug 27597, NPTL, wchar"
	depends on LINGMO_TOOLCHAIN_HAS_SYNC_4
	depends on !LINGMO_INSTALL_LIBSTDCPP || LINGMO_STATIC_LIBS || \
		!LINGMO_TOOLCHAIN_GCC_AT_LEAST_4_7 || \
		LINGMO_TOOLCHAIN_HAS_BINUTILS_BUG_27597 || \
		!LINGMO_TOOLCHAIN_HAS_THREADS_NPTL || !LINGMO_USE_WCHAR
```

## package/gdb/Config.in
```kconfig
config LINGMO_PACKAGE_GDB_ARCH_SUPPORTS
	bool
	default y
	depends on !((LINGMO_arm || LINGMO_armeb) && LINGMO_BINFMT_FLAT)
	depends on !LINGMO_microblaze

comment "gdb needs a glibc or uclibc toolchain"
	depends on LINGMO_or1k
	depends on LINGMO_TOOLCHAIN_USES_MUSL

comment "gdb/gdbserver needs a toolchain w/ threads, threads debug"
	depends on LINGMO_PACKAGE_GDB_ARCH_SUPPORTS
	depends on !LINGMO_TOOLCHAIN_HAS_THREADS || !LINGMO_TOOLCHAIN_HAS_THREADS_DEBUG

comment "gdb/gdbserver >= 8.x needs a toolchain w/ C++, gcc >= 4.8"
	depends on !LINGMO_INSTALL_LIBSTDCPP || !LINGMO_TOOLCHAIN_GCC_AT_LEAST_4_8

config LINGMO_PACKAGE_GDB
	bool "gdb"
	depends on LINGMO_TOOLCHAIN_HAS_THREADS && LINGMO_TOOLCHAIN_HAS_THREADS_DEBUG
	depends on LINGMO_PACKAGE_GDB_ARCH_SUPPORTS
	depends on LINGMO_TOOLCHAIN_GCC_AT_LEAST_4_8
	depends on LINGMO_INSTALL_LIBSTDCPP
	# The or1k musl port is incomplete, elf_gregset_t definition is missing:
	# https://git.musl-libc.org/cgit/musl/tree/arch/or1k/bits/user.h?h=v1.2.3
	depends on !LINGMO_or1k || !LINGMO_TOOLCHAIN_USES_MUSL
	# When the external toolchain gdbserver is copied to the
	# target, we don't allow building a separate gdbserver. The
	# one from the external toolchain should be used.
	select LINGMO_PACKAGE_GDB_SERVER if \
		(!LINGMO_PACKAGE_GDB_DEBUGGER && !LINGMO_TOOLCHAIN_EXTERNAL_GDB_SERVER_COPY)
	help
	  GDB, the GNU Project debugger, allows you to see what is
	  going on `inside' another program while it executes -- or
	  what another program was doing at the moment it crashed.

	  This option allows to build gdbserver and/or the gdb
	  debugger for the target.

	  For embedded development, the most common solution is to
	  build only 'gdbserver' for the target, and use a cross-gdb
	  on the host. See LINGMO_PACKAGE_HOST_GDB in the Toolchain menu
	  to enable one. Notice that external toolchains often provide
	  their own pre-built cross-gdb and gdbserver binaries.

	  http://www.gnu.org/software/gdb/

if LINGMO_PACKAGE_GDB

config LINGMO_PACKAGE_GDB_SERVER
	bool "gdbserver"
	depends on !LINGMO_TOOLCHAIN_EXTERNAL_GDB_SERVER_COPY
	help
	  Build the gdbserver stub to run on the target.
	  A full gdb is needed to debug the progam.

config LINGMO_PACKAGE_GDB_DEBUGGER
	bool "full debugger"
	depends on LINGMO_USE_WCHAR
	depends on !LINGMO_sh
	select LINGMO_PACKAGE_GMP
	select LINGMO_PACKAGE_MPFR if (LINGMO_GDB_VERSION_14 || LINGMO_arc)
	select LINGMO_PACKAGE_NCURSES
	select LINGMO_PACKAGE_ZLIB

comment "full gdb on target needs a toolchain w/ wchar"
	depends on !LINGMO_sh
	depends on !LINGMO_USE_WCHAR

if LINGMO_PACKAGE_GDB_DEBUGGER

config LINGMO_PACKAGE_GDB_TUI
	bool "TUI support"
	help
	  This option enables terminal user interface (TUI) for gdb

	  "The GDB Text User Interface (TUI) is a terminal interface
	  which uses the curses library to show the source file, the
	  assembly output, the program registers and GDB commands in
	  separate text windows."

	  https://sourceware.org/gdb/current/onlinedocs/gdb/TUI.html

config LINGMO_PACKAGE_GDB_PYTHON
	bool "Python support"
	depends on LINGMO_PACKAGE_PYTHON3
	help
	  This option enables Python support in the target gdb.

endif

endif
```
