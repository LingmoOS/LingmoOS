## package/gdb/Config.in.host
```kconfig
config LINGMO_PACKAGE_HOST_GDB_ARCH_SUPPORTS
	bool
	default y
	depends on !((LINGMO_arm || LINGMO_armeb) && LINGMO_BINFMT_FLAT)
	depends on !LINGMO_microblaze

comment "Host GDB Options"
	depends on !LINGMO_TOOLCHAIN_EXTERNAL_GDB_SERVER_COPY
	depends on LINGMO_PACKAGE_HOST_GDB_ARCH_SUPPORTS

config LINGMO_PACKAGE_HOST_GDB
	bool "Build cross gdb for the host"
	# When the external toolchain gdbserver is used, we shouldn't
	# allow to build a cross-gdb, as the one of the external
	# toolchain should be used.
	depends on !LINGMO_TOOLCHAIN_EXTERNAL_GDB_SERVER_COPY
	depends on LINGMO_PACKAGE_HOST_GDB_ARCH_SUPPORTS
	help
	  Build a cross gdb that runs on the host machine and debugs
	  programs running on the target. It requires 'gdbserver'
	  installed on the target, see LINGMO_PACKAGE_GDB_SERVER to
	  enable it.

if LINGMO_PACKAGE_HOST_GDB

config LINGMO_PACKAGE_HOST_GDB_TUI
	bool "TUI support"
	help
	  This option enables terminal user interface (TUI) for gdb

config LINGMO_PACKAGE_HOST_GDB_PYTHON3
	bool "Python support"
	help
	  This option enables the Python 3 support in the cross gdb.

config LINGMO_PACKAGE_HOST_GDB_SIM
	bool "Simulator support"
	depends on !LINGMO_arc
	help
	  This option enables the simulator support in the cross gdb.

choice
	prompt "GDB debugger Version"
	default LINGMO_GDB_VERSION_13
	depends on !LINGMO_arc
	help
	  Select the version of gdb you wish to use.

config LINGMO_GDB_VERSION_12
	bool "gdb 12.x"

config LINGMO_GDB_VERSION_13
	bool "gdb 13.x"

config LINGMO_GDB_VERSION_14
	bool "gdb 14.x"

endchoice

endif

# If cross-gdb is not enabled, the latest stable version is chosen.
config LINGMO_GDB_VERSION
	string
	default "arc-2023.09-release" if LINGMO_arc
	default "12.1"     if LINGMO_GDB_VERSION_12
	default "13.2"     if LINGMO_GDB_VERSION_13 || !LINGMO_PACKAGE_HOST_GDB
	# When making 14.x the default, or 14.x becomes the oldest version,
	# be sure to update the target variant to properly select mpfr.
	default "14.2"     if LINGMO_GDB_VERSION_14
	depends on LINGMO_PACKAGE_GDB || LINGMO_PACKAGE_HOST_GDB
```

## package/gdbm/Config.in
```kconfig
config LINGMO_PACKAGE_GDBM
	bool "gdbm"
	depends on LINGMO_USE_MMU # fork()
	depends on LINGMO_USE_WCHAR
	help
	  GNU dbm is a set of database routines that use extensible
	  hashing. It works similar to the standard UNIX dbm routines.

	  https://www.gnu.org/software/gdbm/gdbm.html

comment "gdbm needs a toolchain w/ wchar"
	depends on LINGMO_USE_MMU
	depends on !LINGMO_USE_WCHAR
```

## package/gdk-pixbuf-xlib/Config.in
```kconfig
config LINGMO_PACKAGE_GDK_PIXBUF_XLIB
	bool "gdk-pixbuf-xlib"
	depends on LINGMO_PACKAGE_XORG7
	depends on LINGMO_USE_MMU # gdk-pixbuf -> glib2
	depends on LINGMO_USE_WCHAR # gdk-pixbuf -> glib2
	depends on LINGMO_TOOLCHAIN_HAS_THREADS # gdk-pixbuf -> glib2
	select LINGMO_PACKAGE_GDK_PIXBUF
	select LINGMO_PACKAGE_XLIB_LIBX11
	help
	  Deprecated Xlib integration for GdkPixbuf.

	  https://gitlab.gnome.org/Archive/gdk-pixbuf-xlib

comment "gdk-pixbuf-xlib needs a toolchain w/ wchar, threads"
	depends on LINGMO_PACKAGE_XORG7
	depends on LINGMO_USE_MMU
	depends on !LINGMO_USE_WCHAR || !LINGMO_TOOLCHAIN_HAS_THREADS
```

## package/gdk-pixbuf/Config.in
```kconfig
config LINGMO_PACKAGE_GDK_PIXBUF
	bool "gdk-pixbuf"
	depends on LINGMO_USE_WCHAR # glib2
	depends on LINGMO_TOOLCHAIN_HAS_THREADS # glib2
	depends on LINGMO_USE_MMU # glib2
	select LINGMO_PACKAGE_LIBGLIB2
	select LINGMO_PACKAGE_LIBICONV if !LINGMO_ENABLE_LOCALE
	help
	  Gdk-Pixbuf is an image loader and scaler. It uses GObject
	  and the GLib, to integrate well with GNOME applications.

	  https://www.gtk.org/

comment "gdk-pixbuf needs a toolchain w/ wchar, threads"
	depends on LINGMO_USE_MMU
	depends on !LINGMO_USE_WCHAR || !LINGMO_TOOLCHAIN_HAS_THREADS
```

## package/gensio/Config.in
```kconfig
config LINGMO_PACKAGE_GENSIO
	bool "gensio"
	depends on LINGMO_USE_MMU # fork()
	depends on LINGMO_TOOLCHAIN_HAS_ATOMIC
	help
	  A library to abstract stream I/O like serial port, TCP,
	  telnet, UDP, SSL, IPMI SOL, etc.

	  https://github.com/cminyard/gensio
```

## package/gerbera/Config.in
```kconfig
config LINGMO_PACKAGE_GERBERA
	bool "gerbera"
	depends on LINGMO_USE_MMU # fork()
	depends on LINGMO_TOOLCHAIN_HAS_ATOMIC
	depends on LINGMO_TOOLCHAIN_HAS_THREADS
	depends on LINGMO_TOOLCHAIN_GCC_AT_LEAST_8 # C++17 filesystem
	depends on LINGMO_INSTALL_LIBSTDCPP
	depends on !LINGMO_STATIC_LIBS
	depends on LINGMO_USE_WCHAR # fmt
	select LINGMO_PACKAGE_FMT
	select LINGMO_PACKAGE_LIBICONV if !LINGMO_ENABLE_LOCALE
	select LINGMO_PACKAGE_LIBUPNP if !LINGMO_PACKAGE_LIBNPUPNP
	select LINGMO_PACKAGE_PUGIXML
	select LINGMO_PACKAGE_PUGIXML_XPATH_SUPPORT
	select LINGMO_PACKAGE_SPDLOG
	select LINGMO_PACKAGE_SQLITE
	select LINGMO_PACKAGE_UTIL_LINUX
	select LINGMO_PACKAGE_UTIL_LINUX_LIBUUID
	select LINGMO_PACKAGE_ZLIB
	help
	  A free media server.
	  Stream your media to devices on your home network.

	  Select LINGMO_PACKAGE_DUKTAPE if you want to enable JavaScript
	  for scripting.

	  https://gerbera.io

comment "gerbera needs a toolchain w/ C++, dynamic library, threads, wchar, gcc >= 8"
	depends on LINGMO_USE_MMU
	depends on LINGMO_TOOLCHAIN_HAS_ATOMIC
	depends on !LINGMO_INSTALL_LIBSTDCPP || LINGMO_STATIC_LIBS || \
		!LINGMO_TOOLCHAIN_HAS_THREADS || !LINGMO_USE_WCHAR || \
		!LINGMO_TOOLCHAIN_GCC_AT_LEAST_8
```

## package/gesftpserver/Config.in
```kconfig
config LINGMO_PACKAGE_GESFTPSERVER
	bool "gesftpserver"
	depends on LINGMO_USE_WCHAR
	depends on LINGMO_TOOLCHAIN_HAS_THREADS
	depends on LINGMO_USE_MMU # fork()
	select LINGMO_PACKAGE_LIBICONV if !LINGMO_ENABLE_LOCALE
	help
	  Green End SFTP Server

	  This is an SFTP server supporting up to protocol version 6.
	  It is possible to use it as a drop-in replacement for the
	  OpenSSH server, or to provide sftp support for Dropbear.

	  http://www.greenend.org.uk/rjk/sftpserver/

comment "gesftpserver needs a toolchain w/ wchar, threads"
	depends on LINGMO_USE_MMU
	depends on !LINGMO_USE_WCHAR || !LINGMO_TOOLCHAIN_HAS_THREADS
```

## package/gettext-gnu/Config.in
```kconfig
config LINGMO_PACKAGE_GETTEXT_GNU
	bool
	depends on LINGMO_USE_WCHAR
	select LINGMO_PACKAGE_HAS_GETTEXT
	help
	  The GNU `gettext' utilities are a set of tools that provide a
	  framework to help other GNU packages produce multi-lingual
	  messages.

	  Only the libintl library will be installed in the
	  target. The full gettext suite, including tools, will be
	  installed in the staging directory.

	  http://www.gnu.org/software/gettext/

if LINGMO_PACKAGE_GETTEXT_GNU

config LINGMO_PACKAGE_PROVIDES_GETTEXT
	default "gettext-gnu"

endif

config LINGMO_PACKAGE_PROVIDES_HOST_GETTEXT
	default "host-gettext-gnu" if LINGMO_SYSTEM_ENABLE_NLS
```

## package/gettext-tiny/Config.in
```kconfig
config LINGMO_PACKAGE_GETTEXT_TINY
	bool
	select LINGMO_PACKAGE_HAS_GETTEXT
	help
	  Stub and/or lightweight replacements of the gnu gettext
	  suite; because the GNU one takes ages to compile.

	  https://github.com/sabotage-linux/gettext-tiny

if LINGMO_PACKAGE_GETTEXT_TINY

config LINGMO_PACKAGE_PROVIDES_GETTEXT
	default "gettext-tiny"

endif

config LINGMO_PACKAGE_PROVIDES_HOST_GETTEXT
	default "host-gettext-tiny" if !LINGMO_SYSTEM_ENABLE_NLS
```

## package/gettext/Config.in
```kconfig
config LINGMO_PACKAGE_GETTEXT
	bool "gettext"
	select LINGMO_PACKAGE_GETTEXT_GNU if LINGMO_SYSTEM_ENABLE_NLS
	select LINGMO_PACKAGE_GETTEXT_TINY if !LINGMO_SYSTEM_ENABLE_NLS

config LINGMO_PACKAGE_GETTEXT_PROVIDES_LIBINTL
	bool
	default y if LINGMO_SYSTEM_ENABLE_NLS
	depends on !LINGMO_TOOLCHAIN_HAS_FULL_GETTEXT

config LINGMO_PACKAGE_HAS_GETTEXT
	bool

config LINGMO_PACKAGE_PROVIDES_GETTEXT
	string

config LINGMO_PACKAGE_PROVIDES_HOST_GETTEXT
	string
```

## package/ghostscript/Config.in
```kconfig
config LINGMO_PACKAGE_GHOSTSCRIPT
	bool "ghostscript"
	depends on LINGMO_USE_MMU # fork()
	select LINGMO_PACKAGE_FONTCONFIG
	select LINGMO_PACKAGE_GHOSTSCRIPT_FONTS
	select LINGMO_PACKAGE_JPEG
	select LINGMO_PACKAGE_LCMS2
	select LINGMO_PACKAGE_LIBPNG
	select LINGMO_PACKAGE_TIFF
	help
	  Ghostscript is an interpreter for PostScript and Portable
	  Document Format (PDF) files.

	  http://ghostscript.com
```

## package/giblib/Config.in
```kconfig
config LINGMO_PACKAGE_GIBLIB
	bool "giblib"
	depends on LINGMO_PACKAGE_XORG7
	depends on !LINGMO_STATIC_LIBS
	select LINGMO_PACKAGE_IMLIB2
	select LINGMO_PACKAGE_IMLIB2_X
	help
	  Giblib is a simple library which wraps imlib2.

	  http://linuxbrit.co.uk/giblib/

comment "giblib support needs a toolchain w/ dynamic library"
	depends on LINGMO_STATIC_LIBS
```

## package/git-crypt/Config.in
```kconfig
config LINGMO_PACKAGE_GIT_CRYPT
	bool "git-crypt"
	depends on LINGMO_INSTALL_LIBSTDCPP
	depends on LINGMO_TOOLCHAIN_GCC_AT_LEAST_4_9 # C++11
	depends on !LINGMO_TOOLCHAIN_HAS_GCC_BUG_64735 # exception_ptr
	depends on LINGMO_USE_MMU # git
	select LINGMO_PACKAGE_GIT # runtime
	select LINGMO_PACKAGE_OPENSSL
	help
	  git-crypt enables transparent encryption and decryption of
	  files in a git repository.

	  https://www.agwa.name/projects/git-crypt/

comment "git-crypt needs a toolchain w/ C++, gcc >= 4.9"
	depends on !LINGMO_INSTALL_LIBSTDCPP \
		|| !LINGMO_TOOLCHAIN_GCC_AT_LEAST_4_9
	depends on LINGMO_USE_MMU

comment "git-crypt needs a toolchain not affected by GCC bug 64735"
	depends on LINGMO_USE_MMU
	depends on LINGMO_TOOLCHAIN_HAS_GCC_BUG_64735
```

## package/git/Config.in
```kconfig
config LINGMO_PACKAGE_GIT
	bool "git"
	depends on LINGMO_USE_MMU # uses fork()
	select LINGMO_PACKAGE_ZLIB
	select LINGMO_PACKAGE_LIBICONV if !LINGMO_ENABLE_LOCALE
	help
	  Git is a free and open source distributed version control
	  system designed to handle everything from small to very large
	  projects.

	  http://git-scm.com
```
