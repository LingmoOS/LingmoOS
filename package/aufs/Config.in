## package/aufs/Config.in
```kconfig
# Automatically selected by the corresponding linux extension
config LINGMO_PACKAGE_AUFS
	bool

if LINGMO_PACKAGE_AUFS

# Both come from the selection of the linux extension.
config LINGMO_PACKAGE_AUFS_SERIES
	int
	default LINGMO_LINUX_KERNEL_EXT_AUFS_SERIES

config LINGMO_PACKAGE_AUFS_VERSION
	string
	default LINGMO_LINUX_KERNEL_EXT_AUFS_VERSION

endif
```

## package/autofs/Config.in
```kconfig
config LINGMO_PACKAGE_AUTOFS
	bool "autofs"
	depends on LINGMO_TOOLCHAIN_HAS_THREADS_NPTL
	depends on LINGMO_USE_MMU
	depends on !LINGMO_STATIC_LIBS # dlfcn
	depends on !LINGMO_TOOLCHAIN_USES_MUSL # nsswitch
	select LINGMO_PACKAGE_LIBTIRPC if !LINGMO_TOOLCHAIN_HAS_NATIVE_RPC
	help
	  Autofs controls the operation of the automount daemons. The
	  automount daemons automatically mount filesystems when they
	  are used and unmount them after a period of inactivity based
	  on a set of pre-configured maps defined by default in
	  /etc/auto.master. The kernel automounter implements SunOS
	  style automounter under Linux and requires a kernel version
	  of at least 2.6.17 and the autofs4 kernel module.

	  http://www.linuxfromscratch.org/blfs/view/svn/general/autofs.html

comment "autofs needs a glibc or uClibc toolchain w/ NPTL and dynamic library"
	depends on LINGMO_USE_MMU
	depends on !LINGMO_TOOLCHAIN_HAS_THREADS_NPTL || LINGMO_STATIC_LIBS \
		|| LINGMO_TOOLCHAIN_USES_MUSL
```

## package/autossh/Config.in
```kconfig
config LINGMO_PACKAGE_AUTOSSH
	bool "autossh"
	depends on LINGMO_USE_MMU # fork()
	depends on LINGMO_PACKAGE_DROPBEAR || LINGMO_PACKAGE_OPENSSH
	help
	  autossh is a program to start a copy of ssh and monitor it,
	  restarting it as necessary should it die or stop passing
	  traffic.

	  http://www.harding.motd.ca/autossh/
```

## package/avahi/Config.in
```kconfig
config LINGMO_PACKAGE_AVAHI
	bool "avahi"
	# libdaemon uses fork()
	depends on LINGMO_USE_MMU
	depends on LINGMO_TOOLCHAIN_HAS_THREADS
	depends on !LINGMO_STATIC_LIBS
	help
	  Avahi is a system which facilitates service
	  discovery on a local network.

	  http://www.avahi.org/

if LINGMO_PACKAGE_AVAHI

config LINGMO_PACKAGE_AVAHI_AUTOIPD
	bool "IPv4LL network address configuration daemon"
	default y
	select LINGMO_PACKAGE_LIBDAEMON
	help
	  Avahi-autoipd implements IPv4LL, "Dynamic Configuration of
	  IPv4 Link-Local Addresses" (IETF RFC3927), a protocol for
	  automatic IP address configuration from the link-local
	  169.254.0.0/16 range without the need for a central server.
	  It is primarily intended to be used in ad-hoc networks which
	  lack a DHCP server.

config LINGMO_PACKAGE_AVAHI_DAEMON
	bool "mDNS/DNS-SD daemon"
	select LINGMO_PACKAGE_LIBDAEMON
	select LINGMO_PACKAGE_EXPAT
	help
	  The Avahi mDNS/DNS-SD daemon implementing Apple's ZeroConf
	  architecture (also known as "Rendezvous" or "Bonjour").
	  The daemon registers local IP addresses and services using
	  mDNS/DNS-SD.

# This hidden option allows packages that need the libavahi-client to
# more easily determine if it's available or not.
config LINGMO_PACKAGE_AVAHI_LIBAVAHI_CLIENT
	bool
	default y if LINGMO_PACKAGE_DBUS

config LINGMO_PACKAGE_AVAHI_LIBDNSSD_COMPATIBILITY
	bool "libdns_sd compatibility (Bonjour)"
	depends on LINGMO_PACKAGE_AVAHI_DAEMON
	select LINGMO_PACKAGE_DBUS
	help
	  Enable the libdns_sd (Bonjour) compatibility library support
	  for legacy applications.

config LINGMO_PACKAGE_AVAHI_DEFAULT_SERVICES
	bool "install default service definitions"
	depends on LINGMO_PACKAGE_AVAHI_DAEMON
	help
	  Install the SSH/SFTP service definitions included with the
	  Avahi daemon by default.

endif

comment "avahi needs a toolchain w/ threads"
	depends on LINGMO_USE_MMU
	depends on !LINGMO_TOOLCHAIN_HAS_THREADS
```

## package/avocado/Config.in
```kconfig
config LINGMO_PACKAGE_AVOCADO
	bool "avocado"
	depends on LINGMO_USE_WCHAR # python3
	depends on LINGMO_USE_MMU # python3
	depends on LINGMO_TOOLCHAIN_HAS_THREADS # python3
	depends on !LINGMO_STATIC_LIBS # python3
	select LINGMO_PACKAGE_PYTHON3
	select LINGMO_PACKAGE_PYTHON3_BZIP2
	select LINGMO_PACKAGE_PYTHON3_PYEXPAT
	select LINGMO_PACKAGE_PYTHON3_SQLITE
	select LINGMO_PACKAGE_PYTHON3_XZ
	select LINGMO_PACKAGE_PYTHON_SETUPTOOLS # runtime, pkg_resources
	help
	  Avocado is an automated testing suite containing
	  tests for various subsystems.

	  https://avocado-framework.readthedocs.io/

comment "avocado needs a toolchain w/ wchar, threads, dynamic library"
	depends on LINGMO_USE_MMU
	depends on !LINGMO_USE_WCHAR || !LINGMO_TOOLCHAIN_HAS_THREADS || LINGMO_STATIC_LIBS
```

## package/avrdude/Config.in
```kconfig
config LINGMO_PACKAGE_AVRDUDE
	bool "avrdude"
	depends on LINGMO_TOOLCHAIN_HAS_THREADS
	depends on LINGMO_USE_WCHAR # elfutils
	depends on !LINGMO_STATIC_LIBS # elfutils
	depends on LINGMO_TOOLCHAIN_GCC_AT_LEAST_4_9 # libusb
	select LINGMO_PACKAGE_ELFUTILS
	select LINGMO_PACKAGE_LIBUSB
	select LINGMO_PACKAGE_LIBUSB_COMPAT
	select LINGMO_PACKAGE_NCURSES
	help
	  avrdude is a programmer for Atmel AVR microcontrollers
	  this package provides a version with new linuxspi driver

	  https://github.com/kcuzner/avrdude

if LINGMO_PACKAGE_AVRDUDE

config LINGMO_PACKAGE_AVRDUDE_SPI
	bool "SPI support"
	default y # Backward compatibility
	depends on LINGMO_TOOLCHAIN_HEADERS_AT_LEAST_4_8

comment "SPI support needs a toolchain w/ linux headers >= 4.8"
	depends on !LINGMO_TOOLCHAIN_HEADERS_AT_LEAST_4_8

endif

comment "avrdude needs a toolchain w/ threads, wchar, dynamic library, gcc >= 4.9"
	depends on !LINGMO_TOOLCHAIN_HAS_THREADS || !LINGMO_USE_WCHAR \
		|| LINGMO_STATIC_LIBS || !LINGMO_TOOLCHAIN_GCC_AT_LEAST_4_9
```

## package/axel/Config.in
```kconfig
config LINGMO_PACKAGE_AXEL
	bool "axel"
	depends on LINGMO_TOOLCHAIN_HAS_THREADS
	depends on LINGMO_TOOLCHAIN_GCC_AT_LEAST_4_9 # C11/stdatomic.h
	help
	  HTTP/FTP download accelerator.

	  https://github.com/axel-download-accelerator/axel/

comment "axel needs a toolchain w/ threads, gcc >= 4.9"
	depends on !LINGMO_TOOLCHAIN_HAS_THREADS || \
		!LINGMO_TOOLCHAIN_GCC_AT_LEAST_4_9
```

## package/azmq/Config.in
```kconfig
config LINGMO_PACKAGE_AZMQ
	bool "azmq"
	depends on LINGMO_INSTALL_LIBSTDCPP
	depends on LINGMO_TOOLCHAIN_HAS_ATOMIC
	depends on LINGMO_TOOLCHAIN_HAS_THREADS # boost, zeromq
	depends on LINGMO_TOOLCHAIN_GCC_AT_LEAST_4_8 # C++11
	depends on LINGMO_USE_WCHAR # boost
	depends on LINGMO_TOOLCHAIN_SUPPORTS_ALWAYS_LOCKFREE_ATOMIC_INTS # boost-thread
	depends on !LINGMO_TOOLCHAIN_HAS_GCC_BUG_64735 # exception_ptr
	select LINGMO_PACKAGE_ZEROMQ
	select LINGMO_PACKAGE_BOOST
	select LINGMO_PACKAGE_BOOST_CHRONO
	select LINGMO_PACKAGE_BOOST_DATE_TIME
	select LINGMO_PACKAGE_BOOST_RANDOM
	select LINGMO_PACKAGE_BOOST_SYSTEM
	select LINGMO_PACKAGE_BOOST_THREAD
	help
	  This library provides Boost Asio style bindings for ZeroMQ.

	  https://github.com/zeromq/azmq

comment "azmq needs a toolchain w/ C++11, wchar and threads"
	depends on LINGMO_TOOLCHAIN_SUPPORTS_ALWAYS_LOCKFREE_ATOMIC_INTS
	depends on !(LINGMO_INSTALL_LIBSTDCPP && LINGMO_TOOLCHAIN_GCC_AT_LEAST_4_8 \
		&& LINGMO_USE_WCHAR && LINGMO_TOOLCHAIN_HAS_THREADS)

comment "azmq needs exception_ptr"
	depends on LINGMO_TOOLCHAIN_HAS_GCC_BUG_64735
```

## package/azure-iot-sdk-c/Config.in
```kconfig
config LINGMO_PACKAGE_AZURE_IOT_SDK_C
	bool "azure-iot-sdk-c"
	depends on LINGMO_INSTALL_LIBSTDCPP
	depends on LINGMO_TOOLCHAIN_HAS_THREADS_NPTL
	depends on LINGMO_USE_WCHAR
	select LINGMO_PACKAGE_LIBCURL
	select LINGMO_PACKAGE_LIBXML2
	select LINGMO_PACKAGE_OPENSSL
	select LINGMO_PACKAGE_UTIL_LINUX
	select LINGMO_PACKAGE_UTIL_LINUX_LIBUUID
	help
	  Microsoft Azure IoT Hub device SDK for C is used
	  to connect devices running C code to Azure IoT Hub.

	  https://github.com/Azure/azure-iot-sdk-c

comment "azure-iot-sdk-c needs a toolchain w/ C++, NPTL and wchar"
	depends on !LINGMO_INSTALL_LIBSTDCPP || \
		!LINGMO_TOOLCHAIN_HAS_THREADS_NPTL || !LINGMO_USE_WCHAR
```

## package/babeltrace2/Config.in
```kconfig
config LINGMO_PACKAGE_BABELTRACE2
	bool "babeltrace2"
	depends on LINGMO_USE_WCHAR # libglib2
	depends on LINGMO_TOOLCHAIN_HAS_THREADS # libglib2
	depends on LINGMO_USE_MMU # libglib2
	select LINGMO_PACKAGE_LIBGLIB2
	help
	  Babeltrace 2 is an open-source trace manipulation toolkit.

	  The Babeltrace 2 project offers a library with a C API,
	  Python 3 bindings, and a command-line tool which makes it
	  very easy for mere mortals to view, convert, transform, and
	  analyze traces.

	  Babeltrace 2 is also the reference parser implementation of
	  the Common Trace Format (CTF), a very versatile trace format
	  followed by various tracers and tools such as LTTng and
	  barectf. The Babeltrace 2 library and its Python bindings
	  can read and write CTF traces.

	  To get support for the debugging information filter
	  component class, enable the elfutils package
	  (LINGMO_PACKAGE_ELFUTILS).

	  https://babeltrace.org/

comment "babeltrace2 needs a toolchain w/ wchar, threads"
	depends on LINGMO_USE_MMU
	depends on !LINGMO_USE_WCHAR || !LINGMO_TOOLCHAIN_HAS_THREADS
```

## package/balena-engine/Config.in
```kconfig
config LINGMO_PACKAGE_BALENA_ENGINE
	bool "balena-engine"
	depends on LINGMO_PACKAGE_HOST_GO_TARGET_ARCH_SUPPORTS
	depends on LINGMO_PACKAGE_HOST_GO_TARGET_CGO_LINKING_SUPPORTS
	depends on !LINGMO_TOOLCHAIN_USES_UCLIBC # no fexecve
	depends on LINGMO_USE_MMU # util-linux
	select LINGMO_PACKAGE_CGROUPFS_MOUNT if !LINGMO_PACKAGE_SYSTEMD # runtime
	select LINGMO_PACKAGE_IPTABLES # runtime
	select LINGMO_PACKAGE_UTIL_LINUX # runtime
	select LINGMO_PACKAGE_UTIL_LINUX_BINARIES # runtime
	select LINGMO_PACKAGE_UTIL_LINUX_MOUNT # runtime
	select LINGMO_PACKAGE_UTIL_LINUX_MOUNTPOINT # runtime
	select LINGMO_PACKAGE_UTIL_LINUX_PIVOT_ROOT # runtime
	help
	  balenaEngine is a new container engine purpose-built for
	  embedded and IoT use cases and compatible with Docker
	  containers.

	  https://github.com/balena-os/balena-engine

comment "balena-engine needs a glibc or musl toolchain w/ threads"
	depends on LINGMO_PACKAGE_HOST_GO_TARGET_ARCH_SUPPORTS
	depends on LINGMO_PACKAGE_HOST_GO_TARGET_CGO_LINKING_SUPPORTS
	depends on !LINGMO_TOOLCHAIN_HAS_THREADS || LINGMO_TOOLCHAIN_USES_UCLIBC
	depends on LINGMO_USE_MMU
```

## package/bash/Config.in
```kconfig
config LINGMO_PACKAGE_BASH
	bool "bash"
	# uses fork()
	depends on LINGMO_USE_MMU
	depends on LINGMO_PACKAGE_BUSYBOX_SHOW_OTHERS
	select LINGMO_PACKAGE_NCURSES
	select LINGMO_PACKAGE_READLINE
	help
	  The standard GNU Bourne again shell.

	  http://tiswww.case.edu/php/chet/bash/bashtop.html

if LINGMO_PACKAGE_BASH

config LINGMO_PACKAGE_BASH_LOADABLE_EXAMPLES
	bool "loadable examples"
	depends on !LINGMO_STATIC_LIBS
	help
	  This option will enable the installation of the "loadable"
	  examples, which are dynamically loadable extension providing
	  additional built-ins commands to bash. There are typically
	  not needed as they are provided as regular, external
	  commands.

endif
```

## package/bat/Config.in
```kconfig
config LINGMO_PACKAGE_BAT
	bool "bat"
	depends on LINGMO_PACKAGE_HOST_RUSTC_TARGET_ARCH_SUPPORTS
	select LINGMO_PACKAGE_HOST_RUSTC
	# we need a full version of less
	select LINGMO_PACKAGE_BUSYBOX_SHOW_OTHERS
	select LINGMO_PACKAGE_LESS
	help
	  A cat(1) clone with syntax highlighting and Git integration.

	  https://github.com/sharkdp/bat
```

## package/batctl/Config.in
```kconfig
config LINGMO_PACKAGE_BATCTL
	bool "batctl"
	depends on LINGMO_TOOLCHAIN_HAS_THREADS # libnl
	select LINGMO_PACKAGE_LIBNL
	help
	  Batctl is the configuration and debugging tool for batman-adv.

	  http://www.open-mesh.org/projects/batman-adv/wiki/Using-batctl

comment "batctl needs a toolchain w/ threads"
	depends on !LINGMO_TOOLCHAIN_HAS_THREADS
```

## package/bayer2rgb-neon/Config.in
```kconfig
config LINGMO_PACKAGE_BAYER2RGB_NEON_ARCH_SUPPORTS
	bool
	default y if LINGMO_arm && LINGMO_ARM_CPU_HAS_NEON
	default y if LINGMO_aarch64

config LINGMO_PACKAGE_BAYER2RGB_NEON
	bool "bayer2rgb-neon"
	depends on LINGMO_PACKAGE_BAYER2RGB_NEON_ARCH_SUPPORTS
	depends on !LINGMO_STATIC_LIBS
	depends on LINGMO_INSTALL_LIBSTDCPP
	depends on LINGMO_TOOLCHAIN_GCC_AT_LEAST_4_9 # C++11
	help
	  bayer2rgb-neon is a library which allows
	  to decode raw camera bayer to RGB using
	  NEON hardware acceleration.

	  https://gitlab-ext.sigma-chemnitz.de/ensc/bayer2rgb

comment "bayer2rgb-neon needs a toolchain w/ C++, dynamic library, gcc >= 4.9"
	depends on LINGMO_PACKAGE_BAYER2RGB_NEON_ARCH_SUPPORTS
	depends on LINGMO_STATIC_LIBS || !LINGMO_INSTALL_LIBSTDCPP || \
		!LINGMO_TOOLCHAIN_GCC_AT_LEAST_4_9
```

## package/bcache-tools/Config.in
```kconfig
config LINGMO_PACKAGE_BCACHE_TOOLS
	bool "bcache tools"
	depends on LINGMO_PACKAGE_HAS_UDEV
	depends on LINGMO_USE_MMU # util-linux (libblkid)
	select LINGMO_PACKAGE_UTIL_LINUX
	select LINGMO_PACKAGE_UTIL_LINUX_LIBUUID
	select LINGMO_PACKAGE_UTIL_LINUX_LIBBLKID
	help
	  Bcache is a Linux kernel block layer cache. It allows one or
	  more fast disk drives such as flash-based solid state drives
	  (SSDs) to act as a cache for one or more slower hard disk
	  drives.

	  http://bcache.evilpiepirate.org/

	  This is the user space bcache tools, required to setup the
	  linux bcache feature of the Linux kernel.

comment "bcache-tools needs udev /dev management"
	depends on LINGMO_USE_MMU
	depends on !LINGMO_PACKAGE_HAS_UDEV
```

## package/bctoolbox/Config.in
```kconfig
config LINGMO_PACKAGE_BCTOOLBOX
	bool "bctoolbox"
	depends on LINGMO_INSTALL_LIBSTDCPP
	depends on LINGMO_TOOLCHAIN_HAS_THREADS
	depends on !LINGMO_TOOLCHAIN_HAS_GCC_BUG_64735 # exception_ptr
	select LINGMO_PACKAGE_LIBICONV if !LINGMO_ENABLE_LOCALE
	help
	  Utilities library used by Belledonne Communications
	  softwares like belle-sip, mediastreamer2 and linphone.

	  Select LINGMO_PACKAGE_MBEDTLS for crypto support.

	  https://github.com/BelledonneCommunications/bctoolbox

comment "bctoolbox needs a toolchain w/ C++, threads"
	depends on !LINGMO_INSTALL_LIBSTDCPP || !LINGMO_TOOLCHAIN_HAS_THREADS

comment "bctoolbox needs a toolchain not affected by GCC bug 64735"
	depends on LINGMO_TOOLCHAIN_HAS_GCC_BUG_64735
```

## package/bcusdk/Config.in
```kconfig
config LINGMO_PACKAGE_BCUSDK
	bool "bcusdk"
	depends on LINGMO_USE_MMU # libpthsem
	depends on LINGMO_INSTALL_LIBSTDCPP
	select LINGMO_PACKAGE_LIBPTHSEM
	select LINGMO_PACKAGE_ARGP_STANDALONE if LINGMO_TOOLCHAIN_USES_UCLIBC || LINGMO_TOOLCHAIN_USES_MUSL
	help
	  A free development environment for the Bus Coupling Units of
	  the European Installation Bus.

	  The European Installation Bus EIB is a home and building
	  automation bus system. It is optimized for low-speed control
	  applications like lighting and blinds control.

	  BCUs (Bus Coupling Units) are standardized, generic
	  platforms for embedded EIB devices. They include the entire
	  physical layer network interface, power supply and a
	  microcontroller with an implementation of the EIB protocol
	  stack stored in the ROM.

	  http://www.auto.tuwien.ac.at/~mkoegler/eib/

comment "bcusdk needs a toolchain w/ C++"
	depends on LINGMO_USE_MMU
	depends on !LINGMO_INSTALL_LIBSTDCPP
```

## package/beecrypt/Config.in
```kconfig
comment "beecrypt needs a toolchain w/ threads"
	depends on !LINGMO_TOOLCHAIN_HAS_THREADS

config LINGMO_PACKAGE_BEECRYPT
	bool "beecrypt"
	depends on LINGMO_TOOLCHAIN_HAS_THREADS
	help
	  Beecrypt is a general-purpose cryptography library.

	  http://beecrypt.sf.net
```
