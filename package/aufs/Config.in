## package/belle-sip/Config.in
```kconfig
config LINGMO_PACKAGE_BELLE_SIP
	bool "belle-sip"
	depends on LINGMO_INSTALL_LIBSTDCPP
	depends on !LINGMO_STATIC_LIBS # dlfcn.h
	depends on LINGMO_TOOLCHAIN_HAS_THREADS
	depends on !LINGMO_TOOLCHAIN_HAS_GCC_BUG_64735 # bctoolbox
	depends on LINGMO_USE_WCHAR
	select LINGMO_PACKAGE_BCTOOLBOX
	# needs crypto support in bctoolbox
	select LINGMO_PACKAGE_MBEDTLS
	help
	  Belle-sip is a modern library implementing SIP (RFC 3261)
	  transport, transaction and dialog layers.

	  http://www.linphone.org/technical-corner/belle-sip

comment "belle-sip needs a toolchain w/ threads, C++, dynamic library, wchar"
	depends on !LINGMO_INSTALL_LIBSTDCPP || LINGMO_STATIC_LIBS || \
		!LINGMO_TOOLCHAIN_HAS_THREADS || !LINGMO_USE_WCHAR

comment "belle-sip needs a toolchain not affected by GCC bug 64735"
	depends on LINGMO_TOOLCHAIN_HAS_GCC_BUG_64735
```

## package/belr/Config.in
```kconfig
config LINGMO_PACKAGE_BELR
	bool "belr"
	depends on LINGMO_INSTALL_LIBSTDCPP
	depends on LINGMO_TOOLCHAIN_HAS_THREADS # bctoolbox
	depends on !LINGMO_TOOLCHAIN_HAS_GCC_BUG_64735 # bctoolbox
	select LINGMO_PACKAGE_BCTOOLBOX
	help
	  Belr is Belledonne Communications' language recognition
	  library, written in C++11. It parses text inputs formatted
	  according to a language defined by an ABNF grammar, such as
	  the protocols standardized at IETF.

	  https://gitlab.linphone.org/BC/public/belr

comment "belr needs a toolchain w/ threads, C++"
	depends on !LINGMO_INSTALL_LIBSTDCPP || !LINGMO_TOOLCHAIN_HAS_THREADS

comment "belr needs a toolchain not affected by GCC bug 64735"
	depends on LINGMO_TOOLCHAIN_HAS_GCC_BUG_64735
```

## package/berkeleydb/Config.in
```kconfig
config LINGMO_PACKAGE_BERKELEYDB
	bool "berkeleydb"
	help
	  The Berkeley database. A very common library for
	  database applications.

	  http://www.sleepycat.com/products/db.shtml

if LINGMO_PACKAGE_BERKELEYDB

config LINGMO_PACKAGE_BERKELEYDB_COMPAT185
	bool "DB 1.85 compatibility"
	help
	  Build and install DB 1.85 compatibility API.

config LINGMO_PACKAGE_BERKELEYDB_DBM
	bool "historic dbm interface"
	help
	  Enable the historic dbm interface.

config LINGMO_PACKAGE_BERKELEYDB_TOOLS
	bool "install tools"
	help
	  Install berkeleydb tools, mostly useful for debugging
	  purposes.

endif
```

## package/binutils/Config.in
```kconfig
config LINGMO_PACKAGE_BINUTILS
	bool "binutils"
	depends on !LINGMO_nios2
	depends on LINGMO_USE_WCHAR
	select LINGMO_PACKAGE_ZLIB
	help
	  Install binutils on the target

if LINGMO_PACKAGE_BINUTILS

config LINGMO_PACKAGE_BINUTILS_TARGET
	bool "binutils binaries"
	help
	  The GNU Binutils are a collection of binary tools:

	  ld - the GNU linker.
	  as - the GNU assembler.
	  and others...

	  http://www.gnu.org/software/binutils/

endif

comment "binutils needs a toolchain w/ wchar"
	depends on !LINGMO_nios2
	depends on !LINGMO_USE_WCHAR
```

## package/binutils/Config.in.host
```kconfig
comment "Binutils Options"

config LINGMO_PACKAGE_HOST_BINUTILS_SUPPORTS_CFI
	bool
	default y
	depends on !LINGMO_microblaze

config LINGMO_PACKAGE_BINUTILS_HAS_NO_LIBSFRAME
	bool

choice
	prompt "Binutils Version"
	default LINGMO_BINUTILS_VERSION_2_40_X if !LINGMO_arc
	default LINGMO_BINUTILS_VERSION_ARC if LINGMO_arc
	help
	  Select the version of binutils you wish to use.

config LINGMO_BINUTILS_VERSION_2_39_X
	bool "binutils 2.39"
	select LINGMO_PACKAGE_BINUTILS_HAS_NO_LIBSFRAME

config LINGMO_BINUTILS_VERSION_2_40_X
	bool "binutils 2.40"

config LINGMO_BINUTILS_VERSION_2_41_X
	bool "binutils 2.41"

config LINGMO_BINUTILS_VERSION_ARC
	bool "binutils arc (2.41)"
	depends on LINGMO_arc

endchoice

config LINGMO_BINUTILS_VERSION
	string
	default "arc-2023.09-release"	if LINGMO_BINUTILS_VERSION_ARC
	default "2.39"		if LINGMO_BINUTILS_VERSION_2_39_X
	default "2.40"		if LINGMO_BINUTILS_VERSION_2_40_X
	default "2.41"		if LINGMO_BINUTILS_VERSION_2_41_X

config LINGMO_BINUTILS_GPROFNG
	bool "gprofng support"
	depends on !LINGMO_BINUTILS_VERSION_ARC
	help
	  This option enables support for gprofng, a new profiler.

config LINGMO_BINUTILS_EXTRA_CONFIG_OPTIONS
	string "Additional binutils options"
	default ""
	help
	  Any additional binutils options you may want to include.
```

## package/biosdevname/Config.in
```kconfig
config LINGMO_PACKAGE_BIOSDEVNAME
	bool "biosdevname"
	depends on LINGMO_i386 || LINGMO_x86_64
	depends on LINGMO_PACKAGE_HAS_UDEV
	select LINGMO_PACKAGE_PCIUTILS
	select LINGMO_PACKAGE_ZLIB
	help
	  Biosdevname is a udev helper that looks at various BIOS tables
	  to figure out what the actual hardware names are for Ethernet
	  ports and renames the ports accordingly. This has the
	  advantage of always referring to the same port regardless of
	  system or hardware changes that might otherwise alter the
	  typical ethX naming.

	  https://github.com/dell/biosdevname/
```
