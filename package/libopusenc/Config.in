## package/libopusenc/Config.in
```kconfig
config LINGMO_PACKAGE_LIBOPUSENC
	bool "libopusenc"
	select LINGMO_PACKAGE_OPUS
	help
	  The libopusenc library provides a high-level API for
	  encoding opus audio files and live streams.

	  http://opus-codec.org
```

## package/libosmium/Config.in
```kconfig
config LINGMO_PACKAGE_LIBOSMIUM
	bool "libosmium"
	depends on LINGMO_INSTALL_LIBSTDCPP
	depends on LINGMO_TOOLCHAIN_GCC_AT_LEAST_4_7 # C++11
	depends on LINGMO_TOOLCHAIN_HAS_THREADS # boost
	depends on LINGMO_USE_WCHAR # boost
	select LINGMO_PACKAGE_BOOST
	select LINGMO_PACKAGE_PROTOZERO
	select LINGMO_PACKAGE_LZ4
	help
	  A fast and flexible C++ library for working with OpenStreetMap
	  data. Libosmium works on Linux, macOS and Windows.

	  https://osmcode.org/libosmium/

comment "libosmium needs a toolchain w/ C++, wchar, threads, gcc >= 4.7"
	depends on !LINGMO_INSTALL_LIBSTDCPP || !LINGMO_USE_WCHAR || \
		!LINGMO_TOOLCHAIN_GCC_AT_LEAST_4_7 || !LINGMO_TOOLCHAIN_HAS_THREADS
```

## package/libostree/Config.in
```kconfig
config LINGMO_PACKAGE_LIBOSTREE
	bool "libostree"
	depends on LINGMO_PACKAGE_LIBGPG_ERROR_ARCH_SUPPORTS # libgpgme, libgpg-error
	depends on LINGMO_TOOLCHAIN_HAS_THREADS # libglib2
	depends on LINGMO_USE_WCHAR # libglib2
	depends on LINGMO_USE_MMU # e2fsprogs, libglib2, libgpgme
	# doesn't build with musl due to lack of TEMP_FAILURE_RETRY()
	depends on !LINGMO_TOOLCHAIN_USES_MUSL
	depends on LINGMO_TOOLCHAIN_HEADERS_AT_LEAST_5_8 # loop_config
	select LINGMO_PACKAGE_E2FSPROGS
	select LINGMO_PACKAGE_LIBARCHIVE if LINGMO_s390x
	select LINGMO_PACKAGE_LIBGLIB2
	select LINGMO_PACKAGE_LIBGPG_ERROR
	select LINGMO_PACKAGE_LIBGPGME
	select LINGMO_PACKAGE_XZ
	help
	  OSTree is an upgrade system for Linux-based operating
	  systems.

	  https://ostree.readthedocs.io/en/latest/

comment "libostree needs a uClibc or glibc toolchain w/ threads, dynamic library, wchar, headers >= 5.8"
	depends on !LINGMO_TOOLCHAIN_HAS_THREADS || LINGMO_STATIC_LIBS \
		|| !LINGMO_USE_WCHAR || LINGMO_TOOLCHAIN_USES_MUSL || \
		!LINGMO_TOOLCHAIN_HEADERS_AT_LEAST_5_8
	depends on LINGMO_PACKAGE_LIBGPG_ERROR_ARCH_SUPPORTS
	depends on LINGMO_USE_MMU
```

## package/libp11/Config.in
```kconfig
config LINGMO_PACKAGE_LIBP11
	bool "libp11"
	depends on !LINGMO_STATIC_LIBS # dlopen
	depends on LINGMO_TOOLCHAIN_HAS_THREADS
	select LINGMO_PACKAGE_OPENSSL
	select LINGMO_PACKAGE_OPENSSL_FORCE_LIBOPENSSL
	help
	  OpenSSL engine for PKCS#11 modules. Part of the OpenSC
	  project.

	  https://github.com/OpenSC/OpenSC/wiki

comment "libp11 needs a toolchain w/ dynamic library, threads"
	depends on LINGMO_STATIC_LIBS || !LINGMO_TOOLCHAIN_HAS_THREADS
```

## package/libpam-nfc/Config.in
```kconfig
config LINGMO_PACKAGE_LIBPAM_NFC
	bool "libpam-nfc"
	select LINGMO_PACKAGE_LIBNFC
	help
	  NFC-based PAM authentification module.

	  https://github.com/nfc-tools/pam_nfc
```

## package/libpcap/Config.in
```kconfig
config LINGMO_PACKAGE_LIBPCAP
	bool "libpcap"
	select LINGMO_PACKAGE_BLUEZ5_UTILS_HEADERS if LINGMO_PACKAGE_BLUEZ5_UTILS
	help
	  A system-independent library for user-level network packet
	  capture.

	  https://www.tcpdump.org/
```

## package/libpeas/Config.in
```kconfig
config LINGMO_PACKAGE_LIBPEAS
	bool "libpeas"
	depends on LINGMO_USE_MMU # gobject-introspection
	depends on LINGMO_PACKAGE_GOBJECT_INTROSPECTION_ARCH_SUPPORTS
	depends on LINGMO_TOOLCHAIN_GCC_AT_LEAST_4_9 # gobject-introspection
	depends on LINGMO_HOST_GCC_AT_LEAST_8 # gobject-introspection -> host-qemu
	depends on LINGMO_TOOLCHAIN_USES_GLIBC # gobject-introspection
	depends on LINGMO_PACKAGE_PYTHON3 # gobject-introspection
	select LINGMO_PACKAGE_GOBJECT_INTROSPECTION
	select LINGMO_PACKAGE_LIBGLIB2
	help
	  libpeas is a gobject-based plugins engine, and is targetted at
	  giving every application the chance to assume its own
	  extensibility. It also has a set of features including, but
	  not limited to:
	    - multiple extension points
	    - On demand (lazy) programming language support for C,
	      Python and Lua
	    - Simplicity of the API

	  https://wiki.gnome.org/Projects/Libpeas

if LINGMO_PACKAGE_LIBPEAS

config LINGMO_PACKAGE_LIBPEAS_WIDGETS
	bool "widgets"
	depends on LINGMO_PACKAGE_LIBGTK3
	help
	  Build GTK+ widgetry

comment "widget support needs libgtk3"
	depends on !LINGMO_PACKAGE_LIBGTK3

endif

comment "libpeas needs python3"
	depends on LINGMO_PACKAGE_GOBJECT_INTROSPECTION_ARCH_SUPPORTS
	depends on LINGMO_USE_MMU
	depends on !LINGMO_PACKAGE_PYTHON3

comment "libpeas needs a glibc toolchain, gcc >= 4.9, host gcc >= 8"
	depends on LINGMO_PACKAGE_GOBJECT_INTROSPECTION_ARCH_SUPPORTS
	depends on LINGMO_USE_MMU
	depends on !LINGMO_TOOLCHAIN_USES_GLIBC || \
		!LINGMO_TOOLCHAIN_GCC_AT_LEAST_4_9 || !LINGMO_HOST_GCC_AT_LEAST_8
```

## package/libphidget/Config.in
```kconfig
config LINGMO_PACKAGE_LIBPHIDGET
	bool "libphidget"
	depends on LINGMO_TOOLCHAIN_HAS_THREADS # libusb
	depends on LINGMO_TOOLCHAIN_GCC_AT_LEAST_4_9 # libusb
	depends on !LINGMO_STATIC_LIBS
	select LINGMO_PACKAGE_LIBUSB
	help
	  The libphidget library provides an API for controlling
	  Phidgets USB devices. The library translates API function
	  calls to libusb function calls to control attached Phidgets
	  devices that provide GPIO's, DAC's, accelerometers, servo
	  motors, and other capabilities either singly or on combo
	  devices.

	  To use libphidget for controlling locally attached devices you
	  need to set up the userspace USB device tree /dev/bus/usb. See
	  file udev/99-phidgets.rules.

	  The libphidget library also contains an API for sending
	  commands to a local or remote phidgetwebservice using HTTP.
	  The phidgetwebservice then translates HTTP requests to
	  libphidget API function calls to control locally attached
	  Phidgets devices.

	  http://phidgets.com/

comment "libphidget needs a toolchain w/ threads, dynamic library, gcc >= 4.9"
	depends on !LINGMO_TOOLCHAIN_HAS_THREADS || LINGMO_STATIC_LIBS || \
		!LINGMO_TOOLCHAIN_GCC_AT_LEAST_4_9
```

## package/libpjsip/Config.in
```kconfig
config LINGMO_PACKAGE_LIBPJSIP
	bool "libpjsip"
	depends on LINGMO_INSTALL_LIBSTDCPP
	depends on LINGMO_TOOLCHAIN_HAS_THREADS
	help
	  PJSIP is a free and open source multimedia communication
	  library written in C language implementing standard based
	  protocols such as: SIP, SDP, RTP, STUN, TURN, and ICE.

	  http://www.pjsip.org

comment "libpjsip needs a toolchain w/ C++, threads"
	depends on !LINGMO_INSTALL_LIBSTDCPP || !LINGMO_TOOLCHAIN_HAS_THREADS
```

## package/libplist/Config.in
```kconfig
config LINGMO_PACKAGE_LIBPLIST
	bool "libplist"
	depends on LINGMO_INSTALL_LIBSTDCPP
	depends on LINGMO_TOOLCHAIN_HAS_THREADS
	help
	  libplist is a client for manipulating Apple Property List
	  (.plist) files

	  http://www.libimobiledevice.org/

comment "libplist needs a toolchain w/ C++, threads"
	depends on !LINGMO_INSTALL_LIBSTDCPP || !LINGMO_TOOLCHAIN_HAS_THREADS
```

## package/libpng/Config.in
```kconfig
config LINGMO_PACKAGE_LIBPNG
	bool "libpng"
	select LINGMO_PACKAGE_ZLIB
	help
	  Library for handling PNG (Portable Network Graphics)
	  images.

	  http://www.libpng.org/
```

## package/libpqxx/Config.in
```kconfig
config LINGMO_PACKAGE_LIBPQXX
	bool "libpqxx"
	depends on LINGMO_PACKAGE_POSTGRESQL
	depends on LINGMO_TOOLCHAIN_HAS_THREADS
	depends on LINGMO_TOOLCHAIN_GCC_AT_LEAST_7 # C++17
	depends on LINGMO_INSTALL_LIBSTDCPP
	help
	  libpqxx is the official C++ client API for PostgreSQL, the
	  enterprise-strength open-source relational database.

	  http://pqxx.org/development/libpqxx/

comment "libpqxx needs toolchain w/ C++, gcc >= 7, threads"
	depends on LINGMO_PACKAGE_POSTGRESQL
	depends on !LINGMO_INSTALL_LIBSTDCPP || \
		!LINGMO_TOOLCHAIN_GCC_AT_LEAST_7 || \
		!LINGMO_TOOLCHAIN_HAS_THREADS
```

## package/libpri/Config.in
```kconfig
config LINGMO_PACKAGE_LIBPRI
	bool "libpri"
	depends on LINGMO_USE_MMU # fork()
	depends on LINGMO_LINUX_KERNEL
	depends on LINGMO_TOOLCHAIN_HAS_THREADS
	select LINGMO_PACKAGE_DAHDI_LINUX
	select LINGMO_PACKAGE_DAHDI_TOOLS
	help
	  libpri is an open source library that encapsulates the
	  protocols used to communicate over ISDN Primary Rate
	  Interfaces (T1, E1, J1).

	  http://www.asterisk.org/downloads/libpri

comment "libpri needs a Linux kernel to be built"
	depends on LINGMO_USE_MMU
	depends on !LINGMO_LINUX_KERNEL

comment "libpri needs a toolchain w/ threads"
	depends on LINGMO_USE_MMU
	depends on !LINGMO_TOOLCHAIN_HAS_THREADS
```

## package/libpsl/Config.in
```kconfig
config LINGMO_PACKAGE_LIBPSL
	bool "libpsl"
	depends on LINGMO_USE_WCHAR # libunistring, icu
	select LINGMO_PACKAGE_LIBICONV if !LINGMO_ENABLE_LOCALE
	select LINGMO_PACKAGE_LIBIDN2 if !LINGMO_PACKAGE_ICU && !LINGMO_PACKAGE_LIBIDN
	select LINGMO_PACKAGE_LIBUNISTRING if !LINGMO_PACKAGE_ICU
	help
	  C library to handle the Public Suffix List of TLDs.

	  https://github.com/rockdaboot/libpsl

comment "libpsl needs a toolchain w/ wchar"
	depends on !LINGMO_USE_WCHAR
```

## package/libpthread-stubs/Config.in
```kconfig
config LINGMO_PACKAGE_LIBPTHREAD_STUBS
	bool "libpthread-stubs"
	depends on LINGMO_TOOLCHAIN_HAS_THREADS
	help
	  This library provides weak aliases for pthread functions not
	  provided in libc or otherwise available by default.

	  http://xcb.freedesktop.org/

comment "libpthread-stubs needs a toolchain w/ threads"
	depends on !LINGMO_TOOLCHAIN_HAS_THREADS
```

## package/libpthsem/Config.in
```kconfig
config LINGMO_PACKAGE_LIBPTHSEM
	bool "libpthsem"
	depends on LINGMO_USE_MMU # fork()
	help
	  GNU pth is a user mode multi threading library. pthsem is an
	  extend version, with support for semaphores added.

	  http://www.auto.tuwien.ac.at/~mkoegler/pth/

if LINGMO_PACKAGE_LIBPTHSEM

config LINGMO_PACKAGE_LIBPTHSEM_COMPAT
	bool "libpth compatibility"
	help
	  This option enables the compatibility with the original
	  libpth library.

endif
```

## package/libpwquality/Config.in
```kconfig
config LINGMO_PACKAGE_LIBPWQUALITY
	bool "libpwquality"
	select LINGMO_PACKAGE_CRACKLIB
	help
	  This is a library for password quality checks and generation
	  of random passwords that pass the checks.  This library uses
	  the cracklib and cracklib dictionaries to perform some of
	  the checks.

	  https://github.com/libpwquality/libpwquality

if LINGMO_PACKAGE_LIBPWQUALITY

config LINGMO_PACKAGE_LIBPWQUALITY_TOOLS
	bool "install tools"
	help
	  Install libpwquality command line tools generating/checking
	  passwords.

endif
```

## package/libqb/Config.in
```kconfig
config LINGMO_PACKAGE_LIBQB
	bool "libqb"
	depends on LINGMO_TOOLCHAIN_HAS_THREADS
	depends on !LINGMO_STATIC_LIBS
	select LINGMO_PACKAGE_LIBXML2
	help
	  Library for client-server applications

	  https://github.com/ClusterLabs/libqb

comment "libqb needs a toolchain w/ threads, dynamic library"
	depends on !LINGMO_TOOLCHAIN_HAS_THREADS || LINGMO_STATIC_LIBS
```

## package/libqmi/Config.in
```kconfig
config LINGMO_PACKAGE_LIBQMI
	bool "libqmi"
	depends on LINGMO_USE_WCHAR # libglib2
	depends on LINGMO_TOOLCHAIN_HAS_THREADS # libglib2
	depends on LINGMO_USE_MMU # libglib2
	select LINGMO_PACKAGE_LIBGLIB2
	help
	  libqmi is a glib-based library for talking to WWAN modems and
	  devices which speak the Qualcomm MSM Interface (QMI) protocol.

	  http://www.freedesktop.org/wiki/Software/libqmi/

comment "libqmi needs a toolchain w/ wchar, threads"
	depends on LINGMO_USE_MMU
	depends on !LINGMO_USE_WCHAR || !LINGMO_TOOLCHAIN_HAS_THREADS
```

## package/libqrencode/Config.in
```kconfig
config LINGMO_PACKAGE_LIBQRENCODE
	bool "libqrencode"
	help
	  libqrencode is a C library for encoding data in a QR Code
	  symbol, a kind of 2D symbology that can be scanned by handy
	  terminals such as a mobile phone with CCD. The capacity of
	  QR Code is up to 7000 digits or 4000 characters, and is
	  highly robust.

	  http://fukuchi.org/works/qrencode/index.html

if LINGMO_PACKAGE_LIBQRENCODE

config LINGMO_PACKAGE_LIBQRENCODE_TOOLS
	bool "libqrencode tools"
	select LINGMO_PACKAGE_LIBPNG
	help
	  Build command-line tools

endif #LINGMO_PACKAGE_LIBQRENCODE
```

## package/libqrtr-glib/Config.in
```kconfig
config LINGMO_PACKAGE_LIBQRTR_GLIB
	bool "libqrtr-glib"
	depends on LINGMO_USE_WCHAR # glib2
	depends on LINGMO_TOOLCHAIN_HAS_THREADS # glib2
	depends on LINGMO_USE_MMU # glib2
	depends on LINGMO_TOOLCHAIN_HEADERS_AT_LEAST_4_15 # da7653f0faab
	select LINGMO_PACKAGE_LIBGLIB2
	help
	  Qualcomm IPC Router protocol helper library.
	  Optional dependency for libqmi >= 1.28.0.

	  https://www.freedesktop.org/software/libqmi/libqrtr-glib/latest/

comment "libqrtr-glib needs a toolchain w/ wchar, threads, headers >= 4.15"
	depends on LINGMO_USE_MMU
	depends on !LINGMO_USE_WCHAR || !LINGMO_TOOLCHAIN_HAS_THREADS || \
		!LINGMO_TOOLCHAIN_HEADERS_AT_LEAST_4_15
```

## package/libraw/Config.in
```kconfig
config LINGMO_PACKAGE_LIBRAW
	bool "libraw"
	depends on LINGMO_TOOLCHAIN_HAS_SYNC_4
	depends on LINGMO_INSTALL_LIBSTDCPP
	help
	  libraw is a raw image manipulation library

	  http://www.libraw.org/

comment "libraw needs a toolchain w/ C++"
	depends on LINGMO_TOOLCHAIN_HAS_SYNC_4
	depends on !LINGMO_INSTALL_LIBSTDCPP
```

## package/librelp/Config.in
```kconfig
config LINGMO_PACKAGE_LIBRELP
	bool "librelp"
	depends on LINGMO_TOOLCHAIN_HAS_THREADS
	help
	  Reliable Event Logging Protocol library

	  https://www.rsyslog.com/librelp/

comment "librelp needs a toolchain w/ threads"
	depends on !LINGMO_TOOLCHAIN_HAS_THREADS
```

## package/libressl/Config.in
```kconfig
if LINGMO_PACKAGE_LIBRESSL

config LINGMO_PACKAGE_LIBRESSL_BIN
	bool "openssl binary"
	help
	  Install the openssl binary to the target file system. This is
	  a command line tool for doing various cryptographic stuff.

endif
```

## package/libroxml/Config.in
```kconfig
config LINGMO_PACKAGE_LIBROXML
	bool "roxml"
	depends on LINGMO_TOOLCHAIN_HAS_THREADS
	help
	  libroxml is a light and powerful xml parsing library with
	  xpath handling. Roxml is a binary using libroxml to explore
	  xml file from shell scripts.

	  http://www.libroxml.net

comment "libroxml needs a toolchain w/ threads"
	depends on !LINGMO_TOOLCHAIN_HAS_THREADS
```
