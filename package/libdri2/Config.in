## package/libdri2/Config.in
```kconfig
config LINGMO_PACKAGE_LIBDRI2
	bool "libdri2"
	depends on LINGMO_TOOLCHAIN_HAS_THREADS # libdrm
	depends on LINGMO_PACKAGE_XORG7
	select LINGMO_PACKAGE_LIBDRM
	select LINGMO_PACKAGE_XLIB_LIBXDAMAGE
	select LINGMO_PACKAGE_XLIB_LIBXEXT
	select LINGMO_PACKAGE_XORGPROTO
	help
	  Library for the DRI2 extension to the X Window System.

	  https://github.com/robclark/libdri2

comment "libdri2 needs a toolchain w/ threads"
	depends on !LINGMO_TOOLCHAIN_HAS_THREADS
```

## package/libdrm/Config.in
```kconfig
menuconfig LINGMO_PACKAGE_LIBDRM
	bool "libdrm"
	depends on LINGMO_TOOLCHAIN_HAS_THREADS # libpthread-stubs
	select LINGMO_PACKAGE_LIBPTHREAD_STUBS
	help
	  Direct Rendering Manager

	  http://dri.freedesktop.org/libdrm/

if LINGMO_PACKAGE_LIBDRM

config LINGMO_PACKAGE_LIBDRM_HAS_ATOMIC
	bool
	default y if LINGMO_PACKAGE_LIBATOMIC_OPS_ARCH_SUPPORTS || \
		LINGMO_TOOLCHAIN_HAS_SYNC_4

config LINGMO_PACKAGE_LIBDRM_ENABLE_ATOMIC
	bool
	select LINGMO_PACKAGE_LIBATOMIC_OPS if !LINGMO_TOOLCHAIN_HAS_SYNC_4

config LINGMO_PACKAGE_LIBDRM_INTEL
	bool "intel"
	depends on LINGMO_PACKAGE_LIBDRM_HAS_ATOMIC
	select LINGMO_PACKAGE_LIBDRM_ENABLE_ATOMIC
	select LINGMO_PACKAGE_LIBPCIACCESS
	help
	  Install intel graphics driver.

config LINGMO_PACKAGE_LIBDRM_RADEON
	bool "radeon"
	depends on LINGMO_PACKAGE_LIBDRM_HAS_ATOMIC
	select LINGMO_PACKAGE_LIBDRM_ENABLE_ATOMIC
	help
	  Install AMD/ATI graphics driver.

config LINGMO_PACKAGE_LIBDRM_AMDGPU
	bool "amdgpu"
	depends on LINGMO_USE_MMU # fork()
	depends on LINGMO_PACKAGE_LIBDRM_HAS_ATOMIC
	select LINGMO_PACKAGE_LIBDRM_ENABLE_ATOMIC
	help
	  Install AMD GPU driver.

config LINGMO_PACKAGE_LIBDRM_NOUVEAU
	bool "nouveau"
	depends on LINGMO_PACKAGE_LIBDRM_HAS_ATOMIC
	select LINGMO_PACKAGE_LIBDRM_ENABLE_ATOMIC
	help
	  Install NVIDIA graphics driver.

config LINGMO_PACKAGE_LIBDRM_VMWGFX
	bool "vmwgfx"
	depends on LINGMO_i386 || LINGMO_x86_64
	help
	  Installs Vmware graphics driver.

config LINGMO_PACKAGE_LIBDRM_OMAP
	bool "omap (experimental)"
	depends on LINGMO_arm
	depends on LINGMO_PACKAGE_LIBDRM_HAS_ATOMIC
	select LINGMO_PACKAGE_LIBDRM_ENABLE_ATOMIC
	help
	  Install the TI OMAP driver using an experimental API.

config LINGMO_PACKAGE_LIBDRM_ETNAVIV
	bool "etnaviv (experimental)"
	depends on LINGMO_PACKAGE_LIBDRM_HAS_ATOMIC
	select LINGMO_PACKAGE_LIBDRM_ENABLE_ATOMIC
	help
	  Install the Etnaviv/Vivante driver using an experimental API.

config LINGMO_PACKAGE_LIBDRM_EXYNOS
	bool "exynos (experimental)"
	depends on LINGMO_arm
	help
	  Install Samsung Exynos driver using an experimental API.

config LINGMO_PACKAGE_LIBDRM_FREEDRENO
	bool "freedreno"
	depends on LINGMO_arm || LINGMO_aarch64 || LINGMO_aarch64_be
	depends on LINGMO_PACKAGE_LIBDRM_HAS_ATOMIC
	select LINGMO_PACKAGE_LIBDRM_ENABLE_ATOMIC
	help
	  Install Qualcomm Snapdragon driver.

config LINGMO_PACKAGE_LIBDRM_TEGRA
	bool "tegra (experimental)"
	depends on LINGMO_arm
	depends on LINGMO_PACKAGE_LIBDRM_HAS_ATOMIC
	select LINGMO_PACKAGE_LIBDRM_ENABLE_ATOMIC
	help
	  Install NVIDIA Tegra driver using an experimental API.

config LINGMO_PACKAGE_LIBDRM_VC4
	bool "vc4"
	depends on LINGMO_aarch64 || LINGMO_arm
	help
	  Install vc4 (Raspberry Pi) driver.

config LINGMO_PACKAGE_LIBDRM_INSTALL_TESTS
	bool "Install test programs"
	help
	  This option allows to install the libdrm test programs.

endif

comment "libdrm needs a toolchain w/ threads"
	depends on !LINGMO_TOOLCHAIN_HAS_THREADS
```

## package/libdvbsi/Config.in
```kconfig
config LINGMO_PACKAGE_LIBDVBSI
	bool "libdvbsi"
	depends on LINGMO_INSTALL_LIBSTDCPP
	depends on LINGMO_USE_WCHAR
	depends on LINGMO_TOOLCHAIN_HAS_THREADS
	help
	  C++ parsing library for Service Information (SI) in DVB
	  systems. With libdvbsi++ you can convert raw DVB service
	  information to a set of C++ objects, removing the need to
	  parse data manually.

	  http://www.saftware.de/

comment "libdvbsi++ needs a toolchain w/ C++, wchar, threads"
	depends on !LINGMO_INSTALL_LIBSTDCPP || !LINGMO_USE_WCHAR || !LINGMO_TOOLCHAIN_HAS_THREADS
```

## package/libdvdnav/Config.in
```kconfig
config LINGMO_PACKAGE_LIBDVDNAV
	bool "libdvdnav"
	depends on LINGMO_TOOLCHAIN_HAS_THREADS
	select LINGMO_PACKAGE_LIBDVDREAD
	help
	  libdvdnav is a library that allows easy use of sophisticated
	  DVD navigation features such as DVD menus, multiangle
	  playback and even interactive DVD games.

	  https://www.videolan.org/developers/libdvdnav.html

comment "libdvdnav needs a toolchain w/ threads"
	depends on !LINGMO_TOOLCHAIN_HAS_THREADS
```

## package/libdvdread/Config.in
```kconfig
config LINGMO_PACKAGE_LIBDVDREAD
	bool "libdvdread"
	select LINGMO_PACKAGE_LIBDVDCSS
	help
	  libdvdread provides a simple foundation for reading
	  DVD-Video images.

	  https://www.videolan.org/developers/libdvdnav.html
```

## package/libeastl/Config.in
```kconfig
config LINGMO_PACKAGE_LIBEASTL_ARCH_SUPPORTS
	bool
	default y if LINGMO_i386
	default y if LINGMO_x86_64
	default y if LINGMO_aarch64
	default y if LINGMO_powerpc
	default y if LINGMO_powerpc64

config LINGMO_PACKAGE_LIBEASTL
	bool "libeastl"
	depends on LINGMO_PACKAGE_LIBEASTL_ARCH_SUPPORTS
	depends on LINGMO_INSTALL_LIBSTDCPP
	depends on LINGMO_TOOLCHAIN_GCC_AT_LEAST_4_9 # C++14
	depends on LINGMO_TOOLCHAIN_HAS_THREADS
	help
	  EASTL stands for Electronic Arts Standard Template
	  Library. It is a C++ template library of containers,
	  algorithms, and iterators useful for runtime and tool
	  development across multiple platforms.  It is an extensive
	  and robust implementation that has an emphasis on high
	  performance.

	  https://github.com/electronicarts/EASTL

comment "libeastl needs a toolchain w/ C++, threads, gcc >= 4.9"
	depends on LINGMO_PACKAGE_LIBEASTL_ARCH_SUPPORTS
	depends on !LINGMO_TOOLCHAIN_GCC_AT_LEAST_4_9 || \
		!LINGMO_TOOLCHAIN_HAS_THREADS || !LINGMO_INSTALL_LIBSTDCPP
```

## package/libebml/Config.in
```kconfig
config LINGMO_PACKAGE_LIBEBML
	bool "libebml"
	depends on LINGMO_INSTALL_LIBSTDCPP
	depends on LINGMO_USE_WCHAR
	depends on LINGMO_TOOLCHAIN_GCC_AT_LEAST_4_9 # C++14
	help
	  Access library for the EBML (Extensible Binary Meta
	  Language, a binary derivative of XML) format.

	  http://matroska.org

comment "libebml needs a toolchain w/ C++, wchar, gcc >= 4.9"
	depends on !LINGMO_INSTALL_LIBSTDCPP || !LINGMO_USE_WCHAR || \
		!LINGMO_TOOLCHAIN_GCC_AT_LEAST_4_9
```

## package/libebur128/Config.in
```kconfig
config LINGMO_PACKAGE_LIBEBUR128
	bool "libebur128"
	# build system has no support to disable shared linking
	# leading to a build error with a static-only toolchain
	depends on !LINGMO_STATIC_LIBS
	help
	  libebur128 is a library that implements the EBU R 128 standard
	  for loudness normalization.

	  https://github.com/jiixyj/libebur128

comment "libebur128 needs a toolchain w/ dynamic library"
	depends on LINGMO_STATIC_LIBS
```

## package/libedit/Config.in
```kconfig
config LINGMO_PACKAGE_LIBEDIT
	bool "libedit"
	depends on LINGMO_USE_WCHAR
	depends on LINGMO_USE_MMU # fork()
	select LINGMO_PACKAGE_NCURSES
	help
	  The editline library (from BSD) provides generic line editing
	  and history functions. It slightly resembles GNU readline.

	  The official homepage is at:
	  http://ftp.netbsd.org/pub/NetBSD/NetBSD-release-5-0/src/lib/libedit/

	  Jess Thrysoee maintains an autotoolified package, which we use
	  in Buildroot as it makes it much simpler than using the
	  upstream sources which require pmake.

	  http://www.thrysoee.dk/editline

comment "libedit needs a toolchain w/ wchar"
	depends on LINGMO_USE_MMU
	depends on !LINGMO_USE_WCHAR
```

## package/liberation/Config.in
```kconfig
config LINGMO_PACKAGE_LIBERATION
	bool "Liberation (Free fonts)"
	help
	  The Liberation Fonts are intended to be replacements for the
	  three most commonly used fonts on Microsoft systems:
	  Times New Roman, Arial, and Courier New.

	  https://github.com/liberationfonts/liberation-fonts

if LINGMO_PACKAGE_LIBERATION

config LINGMO_PACKAGE_LIBERATION_MONO
	bool "mono fonts"
	default y

config LINGMO_PACKAGE_LIBERATION_SANS
	bool "sans fonts"
	default y

config LINGMO_PACKAGE_LIBERATION_SERIF
	bool "serif fonts"
	default y

endif
```

## package/libesmtp/Config.in
```kconfig
config LINGMO_PACKAGE_LIBESMTP
	bool "libesmtp"
	depends on !LINGMO_STATIC_LIBS
	select LINGMO_PACKAGE_LIBOPENSSL_ENABLE_DES if LINGMO_PACKAGE_LIBOPENSSL
	select LINGMO_PACKAGE_LIBOPENSSL_ENABLE_MD4 if LINGMO_PACKAGE_LIBOPENSSL
	help
	  Library for sending emails through SMTP.

	  https://libesmtp.github.io

comment "libesmtp needs a toolchain w/ dynamic library"
	depends on LINGMO_STATIC_LIBS
```

## package/libest/Config.in
```kconfig
comment "libest needs a toolchain w/ dynamic library"
	depends on LINGMO_STATIC_LIBS

config LINGMO_PACKAGE_LIBEST
	bool "libest"
	depends on !LINGMO_STATIC_LIBS # libexecinfo or glibc
	select LINGMO_PACKAGE_LIBEXECINFO if !LINGMO_TOOLCHAIN_USES_GLIBC
	select LINGMO_PACKAGE_OPENSSL
	select LINGMO_PACKAGE_OPENSSL_FORCE_LIBOPENSSL
	select LINGMO_PACKAGE_SAFECLIB
	help
	  libest is a C implementation of RFC 7030 (Enrollment over
	  Secure Transport).

	  It can be used to provision public key certificates from
	  a certificate authority (CA) or registration authority (RA)
	  to end-user devices and network infrastructure devices.

	  https://github.com/cisco/libest

if LINGMO_PACKAGE_LIBEST

config LINGMO_PACKAGE_LIBEST_BRSKI
	bool "BRSKI support"

config LINGMO_PACKAGE_LIBEST_MODE_CLIENT_ONLY
	bool "client-only mode"
	# The client-only mode fails to build with OpenJDK/JNI
	# bindings
	depends on !LINGMO_PACKAGE_OPENJDK

endif # LINGMO_PACKAGE_LIBEST
```

## package/libev/Config.in
```kconfig
config LINGMO_PACKAGE_LIBEV
	bool "libev"
	help
	  Userspace library for handling asynchronous notifications

	  http://software.schmorp.de/pkg/libev.html
```

## package/libevent/Config.in
```kconfig
config LINGMO_PACKAGE_LIBEVENT
	bool "libevent"
	help
	  Userspace library for handling asynchronous notifications

	  http://libevent.org
```

## package/libexecinfo/Config.in
```kconfig
config LINGMO_PACKAGE_LIBEXECINFO
	bool "libexecinfo"
	depends on !LINGMO_STATIC_LIBS # dlfcn.h
	depends on !LINGMO_TOOLCHAIN_USES_GLIBC
	help
	  Library for inspecting program's backtrace

	  https://github.com/mikroskeem/libexecinfo

comment "libexecinfo needs a musl or uclibc toolchain w/ dynamic library"
	depends on LINGMO_TOOLCHAIN_USES_GLIBC || LINGMO_STATIC_LIBS
```

## package/libfcgi/Config.in
```kconfig
config LINGMO_PACKAGE_LIBFCGI
	bool "libfcgi"
	depends on LINGMO_USE_MMU # fork()
	help
	  FCGI, a fastcgi developer library for C/C++

	  https://fastcgi-archives.github.io/
```

## package/libfm/Config.in
```kconfig
config LINGMO_PACKAGE_LIBFM
	bool "libfm"
	depends on LINGMO_PACKAGE_XORG7
	depends on LINGMO_USE_WCHAR # libglib2
	depends on LINGMO_TOOLCHAIN_HAS_THREADS # libglib2
	depends on LINGMO_USE_MMU # libglib2
	depends on LINGMO_INSTALL_LIBSTDCPP # libgtk2
	depends on LINGMO_TOOLCHAIN_HAS_SYNC_4 # libgtk2 -> pango -> harfbuzz
	depends on LINGMO_TOOLCHAIN_GCC_AT_LEAST_4_9 # libgtk2 -> pango -> harfbuzz
	select LINGMO_PACKAGE_CAIRO
	select LINGMO_PACKAGE_LIBGLIB2
	select LINGMO_PACKAGE_LIBGTK2 if !LINGMO_PACKAGE_LIBGTK3_X11
	select LINGMO_PACKAGE_MENU_CACHE
	help
	  A glib/gio-based library providing some file management
	  utilities and related-widgets missing in gtk+/glib. This is
	  the core of PCManFM.  The library is desktop independent
	  (not LXDE specific) and has clean API. It can be used to
	  develop other applications requiring file management
	  functionality. For example, you can create your own file
	  manager with facilities provided by libfm.

	  http://wiki.lxde.org/en/Libfm

comment "libfm needs X.org and a toolchain w/ wchar, threads, C++, gcc >= 4.9"
	depends on LINGMO_USE_MMU
	depends on LINGMO_TOOLCHAIN_HAS_SYNC_4
	depends on !LINGMO_USE_WCHAR || !LINGMO_INSTALL_LIBSTDCPP || \
		!LINGMO_TOOLCHAIN_GCC_AT_LEAST_4_9 || \
		!LINGMO_TOOLCHAIN_HAS_THREADS || !LINGMO_PACKAGE_XORG7
```

## package/libfreefare/Config.in
```kconfig
config LINGMO_PACKAGE_LIBFREEFARE
	bool "libfreefare"
	select LINGMO_PACKAGE_OPENSSL
	select LINGMO_PACKAGE_LIBOPENSSL_ENABLE_DES if LINGMO_PACKAGE_LIBOPENSSL
	select LINGMO_PACKAGE_LIBNFC
	help
	  Library for high level manipulation of MIFARE cards.

	  http://nfc-tools.org/index.php?title=Libfreefare
```

## package/libfreeglut/Config.in
```kconfig
config LINGMO_PACKAGE_LIBFREEGLUT
	bool "libfreeglut"
	depends on LINGMO_PACKAGE_HAS_LIBGL
	depends on LINGMO_PACKAGE_XORG7
	select LINGMO_PACKAGE_LIBGLU
	select LINGMO_PACKAGE_XLIB_LIBXI
	select LINGMO_PACKAGE_XLIB_LIBXRANDR
	select LINGMO_PACKAGE_XLIB_LIBXXF86VM
	help
	  FreeGLUT is a free-software/open-source alternative to the
	  OpenGL Utility Toolkit (GLUT) library. GLUT (and hence
	  FreeGLUT) takes care of all the system-specific chores
	  required for creating windows, initializing OpenGL contexts,
	  and handling input events, to allow for trully portable OpenGL
	  programs.

	  http://freeglut.sourceforge.net

comment "libfreeglut depends on X.org and needs an OpenGL backend"
	depends on !LINGMO_PACKAGE_XORG7 || !LINGMO_PACKAGE_HAS_LIBGL
```

## package/libfreeimage/Config.in
```kconfig
config LINGMO_PACKAGE_LIBFREEIMAGE
	bool "libfreeimage"
	depends on LINGMO_INSTALL_LIBSTDCPP
	depends on !LINGMO_STATIC_LIBS
	depends on LINGMO_USE_WCHAR
	# compiler issue: "Error: invalid register number `63'"
	depends on !LINGMO_arc
	help
	  FreeImage is an Open Source library project for developers who
	  would like to support popular graphics image formats like PNG,
	  BMP, JPEG, TIFF and others as needed by today's multimedia
	  applications.

	  http://freeimage.sourceforge.net

comment "libfreeimage needs a toolchain w/ C++, dynamic library, wchar"
	depends on !LINGMO_arc
	depends on LINGMO_STATIC_LIBS || !LINGMO_INSTALL_LIBSTDCPP || !LINGMO_USE_WCHAR
```

## package/libfribidi/Config.in
```kconfig
config LINGMO_PACKAGE_LIBFRIBIDI
	bool "libfribidi"
	help
	  GNU FriBidi is an implementation of the Unicode
	  Bidirectional Algorithm (bidi).

	  http://www.fribidi.org/
```

## package/libftdi/Config.in
```kconfig
config LINGMO_PACKAGE_LIBFTDI
	bool "libftdi"
	depends on LINGMO_TOOLCHAIN_HAS_THREADS # libusb
	depends on LINGMO_TOOLCHAIN_GCC_AT_LEAST_4_9 # libusb
	select LINGMO_PACKAGE_LIBUSB
	select LINGMO_PACKAGE_LIBUSB_COMPAT
	help
	  Userspace access to FTDI USB interface chips

	  http://www.intra2net.com/en/developer/libftdi/index.php

if LINGMO_PACKAGE_LIBFTDI

config LINGMO_PACKAGE_LIBFTDI_CPP
	bool "C++ bindings"
	depends on LINGMO_INSTALL_LIBSTDCPP
	depends on LINGMO_USE_WCHAR
	select LINGMO_PACKAGE_BOOST
	help
	  C++ bindings for libftdi

comment "libftdi C++ bindings need a toolchain w/ wchar, C++"
	depends on !LINGMO_USE_WCHAR || !LINGMO_INSTALL_LIBSTDCPP

endif # LINGMO_PACKAGE_LIBFTDI

comment "libftdi needs a toolchain w/ threads, gcc >= 4.9"
	depends on !LINGMO_TOOLCHAIN_HAS_THREADS || \
		!LINGMO_TOOLCHAIN_GCC_AT_LEAST_4_9
```
