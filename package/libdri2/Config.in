## package/libftdi1/Config.in
```kconfig
config LINGMO_PACKAGE_LIBFTDI1
	bool "libftdi1"
	depends on LINGMO_TOOLCHAIN_HAS_THREADS # libusb
	depends on LINGMO_TOOLCHAIN_GCC_AT_LEAST_4_9 # libusb
	select LINGMO_PACKAGE_LIBUSB
	help
	  Userspace access to FTDI USB interface chips (version 1.x)

	  http://www.intra2net.com/en/developer/libftdi/index.php

if LINGMO_PACKAGE_LIBFTDI1

config LINGMO_PACKAGE_LIBFTDI1_LIBFTDIPP1
	bool "libftdipp1"
	depends on LINGMO_INSTALL_LIBSTDCPP # boost
	depends on LINGMO_TOOLCHAIN_HAS_THREADS # boost
	depends on LINGMO_USE_WCHAR # boost
	select LINGMO_PACKAGE_BOOST
	help
	  C++ bindings for libftdi

comment "libftdipp1 needs a toolchain w/ C++, wchar"
	depends on !LINGMO_INSTALL_LIBSTDCPP || !LINGMO_USE_WCHAR

config LINGMO_PACKAGE_LIBFTDI1_PYTHON_BINDINGS
	bool "python bindings"
	depends on LINGMO_PACKAGE_PYTHON3
	help
	  Python bindings for libftdi

config LINGMO_PACKAGE_LIBFTDI1_FDTI_EEPROM
	bool "ftdi_eeprom tool"
	select LINGMO_PACKAGE_LIBCONFUSE

endif # LINGMO_PACKAGE_LIBFTDI1

comment "libftdi1 needs a toolchain w/ threads, gcc >= 4.9"
	depends on !LINGMO_TOOLCHAIN_HAS_THREADS || \
		!LINGMO_TOOLCHAIN_GCC_AT_LEAST_4_9
```

## package/libfuse/Config.in
```kconfig
config LINGMO_PACKAGE_LIBFUSE
	bool "libfuse"
	# Really doesn't like static, see fuse/lib/fuse.c
	depends on !LINGMO_STATIC_LIBS
	depends on LINGMO_TOOLCHAIN_HAS_THREADS
	depends on LINGMO_USE_MMU # fork()
	help
	  FUSE (Filesystem in UserSpacE)

	  https://github.com/libfuse/libfuse

comment "libfuse needs a toolchain w/ threads, dynamic library"
	depends on LINGMO_USE_MMU
	depends on !LINGMO_TOOLCHAIN_HAS_THREADS || LINGMO_STATIC_LIBS
```

## package/libfuse3/Config.in
```kconfig
config LINGMO_PACKAGE_LIBFUSE3
	bool "libfuse3"
	depends on !LINGMO_STATIC_LIBS
	depends on LINGMO_TOOLCHAIN_HAS_THREADS
	depends on LINGMO_USE_MMU # fork()
	help
	  The reference implementation of the Linux FUSE
	  (Filesystem in Userspace) interface.

	  https://github.com/libfuse/libfuse

comment "libfuse3 needs a toolchain w/ threads, dynamic library"
	depends on LINGMO_USE_MMU
	depends on !LINGMO_TOOLCHAIN_HAS_THREADS || LINGMO_STATIC_LIBS
```
