## package/libmemcached/Config.in
```kconfig
config LINGMO_PACKAGE_LIBMEMCACHED
	bool "libmemcached"
	depends on LINGMO_INSTALL_LIBSTDCPP
	depends on LINGMO_TOOLCHAIN_HAS_THREADS
	help
	  libMemcached is an open source C/C++ client library and tools
	  for the memcached server.
	  It has been designed to be light on memory usage, thread safe,
	  and provide full access to server side methods.

	  https://awesomized.github.io/libmemcached

comment "libmemcached needs a toolchain w/ C++, threads"
	depends on !LINGMO_INSTALL_LIBSTDCPP || !LINGMO_TOOLCHAIN_HAS_THREADS
```

## package/libmicrohttpd/Config.in
```kconfig
config LINGMO_PACKAGE_LIBMICROHTTPD
	bool "libmicrohttpd"
	help
	  GNU libmicrohttpd is a small C library that makes it easy to
	  run an HTTP server as part of another application.

	  http://www.gnu.org/software/libmicrohttpd/

if LINGMO_PACKAGE_LIBMICROHTTPD

config LINGMO_PACKAGE_LIBMICROHTTPD_SSL
	bool "https support"
	depends on !LINGMO_STATIC_LIBS # gnutls
	depends on LINGMO_USE_WCHAR
	select LINGMO_PACKAGE_GNUTLS
	help
	  Enable HTTPS (SSL) support.

comment "libmicrohttpd https support needs a toolchain w/ wchar, dynamic library"
	depends on !LINGMO_USE_WCHAR || LINGMO_STATIC_LIBS

endif
```

## package/libmms/Config.in
```kconfig
config LINGMO_PACKAGE_LIBMMS
	bool "libmms"
	depends on LINGMO_USE_WCHAR # glib2
	depends on LINGMO_TOOLCHAIN_HAS_THREADS # glib2
	depends on LINGMO_USE_MMU # glib2
	select LINGMO_PACKAGE_LIBGLIB2
	help
	  LibMMS is a common library for parsing mms:// and mmsh://
	  type network streams. These are commonly used to stream
	  Windows Media Video content over the web. LibMMS itself is
	  only for receiving MMS stream, it doesn't handle sending at
	  all.

	  http://launchpad.net/libmms

comment "libmms needs a toolchain w/ wchar, threads"
	depends on LINGMO_USE_MMU
	depends on !LINGMO_USE_WCHAR || !LINGMO_TOOLCHAIN_HAS_THREADS
```

## package/libmng/Config.in
```kconfig
config LINGMO_PACKAGE_LIBMNG
	bool "libmng"
	select LINGMO_PACKAGE_JPEG
	select LINGMO_PACKAGE_ZLIB
	help
	  The reference library for reading, displaying, writing and
	  examining Multiple-Image Network Graphics.

	  http://sourceforge.net/projects/libmng/
```

## package/libmnl/Config.in
```kconfig
config LINGMO_PACKAGE_LIBMNL
	bool "libmnl"
	help
	  libmnl is a minimalistic user-space library oriented
	  to Netlink developers.

	  http://netfilter.org/projects/libmnl/

if LINGMO_PACKAGE_LIBMNL

config LINGMO_PACKAGE_LIBMNL_EXAMPLES
	bool "install examples"
	help
	  Install binary examples.

endif
```

## package/libmodplug/Config.in
```kconfig
config LINGMO_PACKAGE_LIBMODPLUG
	bool "libmodplug"
	depends on LINGMO_INSTALL_LIBSTDCPP
	help
	  MOD music file decoder

	  http://modplug-xmms.sourceforge.net/

comment "libmodplug needs a toolchain w/ C++"
	depends on !LINGMO_INSTALL_LIBSTDCPP
```

## package/libnatpmp/Config.in
```kconfig
config LINGMO_PACKAGE_LIBNATPMP
	bool "libnatpmp"
	depends on !LINGMO_BINFMT_FLAT
	depends on !LINGMO_STATIC_LIBS
	help
	  libnatpmp is an attempt to make a portable and fully compliant
	  implementation of the NAT-PMP protocol for the client side. It
	  is based on non blocking sockets and all calls of the API are
	  asynchronous. It is therefore very easy to integrate the
	  NAT-PMP code to any event driven code.

	  http://miniupnp.free.fr/libnatpmp.html

comment "libnatpmp needs a toolchain w/ dynamic library"
	depends on LINGMO_STATIC_LIBS
	depends on !LINGMO_BINFMT_FLAT
```

## package/libnetconf2/Config.in
```kconfig
config LINGMO_PACKAGE_LIBNETCONF2
	bool "libnetconf2"
	depends on LINGMO_TOOLCHAIN_HAS_SYNC_4 # libyang
	depends on LINGMO_TOOLCHAIN_HAS_THREADS
	depends on !LINGMO_STATIC_LIBS
	depends on LINGMO_USE_MMU
	select LINGMO_PACKAGE_LIBYANG
	help
	  libnetconf2 is a NETCONF library in C intended for building
	  NETCONF clients and servers.

	  https://github.com/CESNET/libnetconf2

comment "libnetconf2 needs a toolchain w/ threads, dynamic libraray"
	depends on LINGMO_USE_MMU
	depends on LINGMO_TOOLCHAIN_HAS_SYNC_4
	depends on LINGMO_STATIC_LIBS || !LINGMO_TOOLCHAIN_HAS_THREADS
```

## package/libnetfilter_acct/Config.in
```kconfig
config LINGMO_PACKAGE_LIBNETFILTER_ACCT
	bool "libnetfilter_acct"
	select LINGMO_PACKAGE_LIBMNL
	help
	  libnetfilter_acct is the userspace library providing interface
	  to extended accounting infrastructure.

	  https://www.netfilter.org/projects/libnetfilter_acct/
```

## package/libnetfilter_cthelper/Config.in
```kconfig
config LINGMO_PACKAGE_LIBNETFILTER_CTHELPER
	bool "libnetfilter_cthelper"
	select LINGMO_PACKAGE_LIBMNL
	help
	  libnetfilter_cthelper is the userspace library that provides
	  the programming interface to the user-space helper
	  infrastructure available since Linux kernel 3.6.

	  http://www.netfilter.org/projects/libnetfilter_cthelper/
```

## package/libnetfilter_cttimeout/Config.in
```kconfig
config LINGMO_PACKAGE_LIBNETFILTER_CTTIMEOUT
	bool "libnetfilter_cttimeout"
	select LINGMO_PACKAGE_LIBMNL
	help
	  libnetfilter_cttimeout is the userspace library that provides
	  the programming interface to the fine-grain
	  connection tracking timeout infrastructure.

	  http://www.netfilter.org/projects/libnetfilter_cttimeout/
```

## package/libnetfilter_queue/Config.in
```kconfig
config LINGMO_PACKAGE_LIBNETFILTER_QUEUE
	bool "libnetfilter_queue"
	select LINGMO_PACKAGE_LIBNFNETLINK
	select LINGMO_PACKAGE_LIBMNL
	help
	  libnetfilter_queue is the userspace library that provides
	  the programming interface to the fine-grain
	  connection tracking timeout infrastructure.

	  http://www.netfilter.org/projects/libnetfilter_queue/
```

## package/libnfs/Config.in
```kconfig
config LINGMO_PACKAGE_LIBNFS
	bool "libnfs"
	depends on LINGMO_TOOLCHAIN_HAS_NATIVE_RPC || LINGMO_TOOLCHAIN_HAS_THREADS # libtirpc
	select LINGMO_PACKAGE_LIBTIRPC if !LINGMO_TOOLCHAIN_HAS_NATIVE_RPC
	help
	  nfs userspace implementation.

	  http://github.com/sahlberg/libnfs

comment "libnfs needs a toolchain w/ threads"
	depends on !(LINGMO_TOOLCHAIN_HAS_THREADS || LINGMO_TOOLCHAIN_HAS_NATIVE_RPC)
```

## package/libnice/Config.in
```kconfig
config LINGMO_PACKAGE_LIBNICE
	bool "libnice"
	depends on !LINGMO_STATIC_LIBS # gnutls
	depends on LINGMO_USE_WCHAR # libglib2
	depends on LINGMO_TOOLCHAIN_HAS_THREADS # libglib2
	depends on LINGMO_USE_MMU # fork()
	select LINGMO_PACKAGE_OPENSSL if !LINGMO_PACKAGE_GNUTLS
	select LINGMO_PACKAGE_LIBGLIB2
	help
	  Libnice is an implementation of the IETF's Interactive
	  Connectivity Establishment (ICE) standard (RFC 5245) and the
	  Session Traversal Utilities for NAT (STUN) standard (RFC
	  5389).

	  It provides a GLib-based library, libnice and a Glib-free
	  library, libstun as well as GStreamer elements.

	  http://nice.freedesktop.org/wiki/

comment "libnice needs a toolchain w/ wchar, threads, dynamic library"
	depends on LINGMO_USE_MMU
	depends on !LINGMO_USE_WCHAR || !LINGMO_TOOLCHAIN_HAS_THREADS || \
		LINGMO_STATIC_LIBS
```

## package/libnpth/Config.in
```kconfig
config LINGMO_PACKAGE_LIBNPTH
	bool "libnpth"
	depends on LINGMO_TOOLCHAIN_HAS_THREADS
	depends on LINGMO_USE_MMU # fork()
	help
	  nPth is a library to provide the GNU Pth API and thus a
	  non-preemptive threads implementation.

	  https://www.gnupg.org/related_software/npth/index.html

comment "libnpth needs a toolchain w/ threads support"
	depends on !LINGMO_TOOLCHAIN_HAS_THREADS
	depends on LINGMO_USE_MMU
```

## package/libnpupnp/Config.in
```kconfig
config LINGMO_PACKAGE_LIBNPUPNP
	bool "libnpupnp"
	depends on LINGMO_INSTALL_LIBSTDCPP
	depends on LINGMO_TOOLCHAIN_HAS_THREADS
	depends on LINGMO_TOOLCHAIN_GCC_AT_LEAST_4_9 # C++11
	select LINGMO_PACKAGE_EXPAT
	select LINGMO_PACKAGE_LIBCURL
	select LINGMO_PACKAGE_LIBMICROHTTPD
	help
	  npupnp (new pupnp or not pupnp ?) is an UPnP library derived
	  from the venerable pupnp (https://github.com/pupnp/pupnp),
	  based on its 1.6.x branch (around 1.6.25).

	  https://www.lesbonscomptes.com/upmpdcli/libnpupnp.html

comment "libnpupnp needs a toolchain w/ C++, threads, gcc >= 4.9"
	depends on !LINGMO_INSTALL_LIBSTDCPP || !LINGMO_TOOLCHAIN_HAS_THREADS || \
		!LINGMO_TOOLCHAIN_GCC_AT_LEAST_4_9
```

## package/libnspr/Config.in
```kconfig
config LINGMO_PACKAGE_LIBNSPR_ARCH_SUPPORT
	def_bool y

if LINGMO_PACKAGE_LIBNSPR_ARCH_SUPPORT

config LINGMO_PACKAGE_LIBNSPR
	bool "libnspr"
	depends on LINGMO_TOOLCHAIN_HAS_THREADS
	depends on !LINGMO_STATIC_LIBS
	help
	  NSPR is the Netscape Portable Runtime library which provides
	  a platform-neutral API for system level and libc like
	  functions. The library is used by the Mozilla project as well
	  as others.

	  http://www.mozilla.org/projects/nspr/

comment "libnspr needs a toolchain w/ threads, dynamic library"
	depends on !LINGMO_TOOLCHAIN_HAS_THREADS || LINGMO_STATIC_LIBS

endif
```

## package/libnss/Config.in
```kconfig
config LINGMO_PACKAGE_LIBNSS
	bool "libnss"
	depends on LINGMO_TOOLCHAIN_HAS_THREADS # libnspr
	depends on LINGMO_PACKAGE_LIBNSPR_ARCH_SUPPORT # libnspr
	depends on !LINGMO_STATIC_LIBS
	select LINGMO_PACKAGE_LIBNSPR
	select LINGMO_PACKAGE_SQLITE
	select LINGMO_PACKAGE_ZLIB
	help
	  Network Security Services (NSS) is a set of libraries designed
	  to support development of security-enabled client and server
	  applications. Applications built with NSS can support SSL v2
	  and v3, TLS, PKCS #5, PKCS #7, PKCS #11, PKCS #12, S/MIME,
	  and X.509 v3 certificates.

	  http://www.mozilla.org/projects/security/pki/nss/

if LINGMO_PACKAGE_LIBNSS

config LINGMO_PACKAGE_LIBNSS_ARCH
	string
	default "aarch64" if LINGMO_aarch64_be
	default "ppc"     if LINGMO_powerpc
	default "ppc64"   if LINGMO_powerpc64
	default "ppc64le" if LINGMO_powerpc64le
	default LINGMO_ARCH

endif

comment "libnss needs a toolchain w/ threads, dynamic library"
	depends on LINGMO_PACKAGE_LIBNSPR_ARCH_SUPPORT
	depends on !LINGMO_TOOLCHAIN_HAS_THREADS || LINGMO_STATIC_LIBS
```

## package/libodb-boost/Config.in
```kconfig
config LINGMO_PACKAGE_LIBODB_BOOST
	bool "libodb-boost"
	depends on LINGMO_TOOLCHAIN_HAS_THREADS
	depends on LINGMO_INSTALL_LIBSTDCPP
	depends on LINGMO_PACKAGE_BOOST
	select LINGMO_PACKAGE_LIBODB
	help
	  This package contains the common ODB runtime library. Every
	  application that includes code generated by the ODB compiler
	  will need to link to this library.

	  https://www.codesynthesis.com/products/odb/

comment "libodb-boost needs a toolchain w/ C++, threads"
	depends on !LINGMO_INSTALL_LIBSTDCPP || !LINGMO_TOOLCHAIN_HAS_THREADS
	depends on LINGMO_PACKAGE_BOOST
```

## package/libodb-mysql/Config.in
```kconfig
config LINGMO_PACKAGE_LIBODB_MYSQL
	bool "libodb-mysql"
	depends on LINGMO_TOOLCHAIN_HAS_THREADS
	depends on LINGMO_INSTALL_LIBSTDCPP
	depends on LINGMO_PACKAGE_MARIADB
	select LINGMO_PACKAGE_LIBODB
	help
	  This package contains the MySQL ODB runtime library. Every
	  application that includes code generated for the MySQL
	  database will need to link to this library.

	  https://www.codesynthesis.com/products/odb/

comment "libodb-mysql needs a toolchain w/ C++, threads"
	depends on !LINGMO_INSTALL_LIBSTDCPP || !LINGMO_TOOLCHAIN_HAS_THREADS
	depends on LINGMO_PACKAGE_MARIADB
```

## package/libodb-pgsql/Config.in
```kconfig
config LINGMO_PACKAGE_LIBODB_PGSQL
	bool "libodb-pgsql"
	depends on LINGMO_TOOLCHAIN_HAS_THREADS
	depends on LINGMO_INSTALL_LIBSTDCPP
	depends on LINGMO_PACKAGE_POSTGRESQL
	select LINGMO_PACKAGE_LIBODB
	help
	  This package contains the PostgreSQL ODB runtime library.
	  Every application that includes code generated for the
	  PostgreSQL database will need to link to this library.

	  https://www.codesynthesis.com/products/odb/

comment "libodb-pgsql needs a toolchain w/ C++, threads"
	depends on !LINGMO_INSTALL_LIBSTDCPP || !LINGMO_TOOLCHAIN_HAS_THREADS
	depends on LINGMO_PACKAGE_POSTGRESQL
```

## package/libodb/Config.in
```kconfig
config LINGMO_PACKAGE_LIBODB
	bool "libodb"
	depends on LINGMO_TOOLCHAIN_HAS_THREADS
	depends on LINGMO_INSTALL_LIBSTDCPP
	help
	  This package contains the common ODB runtime library. Every
	  application that includes code generated by the ODB compiler
	  will need to link to this library.

	  https://www.codesynthesis.com/products/odb/

comment "libodb needs a toolchain w/ C++, threads"
	depends on !LINGMO_INSTALL_LIBSTDCPP || !LINGMO_TOOLCHAIN_HAS_THREADS
```

## package/libolm/Config.in
```kconfig
config LINGMO_PACKAGE_LIBOLM
	bool "libolm"
	depends on LINGMO_INSTALL_LIBSTDCPP
	depends on LINGMO_TOOLCHAIN_GCC_AT_LEAST_4_8 # C++11
	help
	  libolm is an implementation of the Double Ratchet
	  cryptographic ratchet in C++

	  https://gitlab.matrix.org/matrix-org/olm

comment "libolm needs a toolchain w/ C++, gcc >= 4.8"
	depends on !LINGMO_INSTALL_LIBSTDCPP || !LINGMO_TOOLCHAIN_GCC_AT_LEAST_4_8
```

## package/libopenh264/Config.in
```kconfig
config LINGMO_PACKAGE_LIBOPENH264_ARCH_SUPPORTS
	bool
	default y if LINGMO_arm || LINGMO_armeb || LINGMO_aarch64 || LINGMO_i386 || \
		LINGMO_mips || LINGMO_mipsel || LINGMO_mips64 || LINGMO_mips64el || \
		LINGMO_x86_64

config LINGMO_PACKAGE_LIBOPENH264
	bool "libopenh264"
	depends on LINGMO_INSTALL_LIBSTDCPP
	depends on !LINGMO_STATIC_LIBS
	depends on LINGMO_TOOLCHAIN_HAS_THREADS
	depends on LINGMO_PACKAGE_LIBOPENH264_ARCH_SUPPORTS
	help
	  OpenH264 is a codec library which supports H.264 encoding and
	  decoding.

	  http://www.openh264.org

comment "libopenh264 needs a toolchain w/ C++, dynamic library, threads"
	depends on !LINGMO_INSTALL_LIBSTDCPP || !LINGMO_TOOLCHAIN_HAS_THREADS || \
		LINGMO_STATIC_LIBS
	depends on LINGMO_PACKAGE_LIBOPENH264_ARCH_SUPPORTS
```
