## package/latencytop/Config.in
```kconfig
config LINGMO_PACKAGE_LATENCYTOP
	bool "latencytop"
	depends on LINGMO_USE_WCHAR # libglib2
	depends on LINGMO_TOOLCHAIN_HAS_THREADS # libglib2
	depends on LINGMO_USE_MMU # libglib2
	select LINGMO_PACKAGE_NCURSES
	select LINGMO_PACKAGE_LIBGLIB2
	help
	  There are many types and causes of latency. LatencyTOP
	  focuses on the type of latency that causes skips in audio,
	  stutters in your desktop experience or that overloads your
	  server (while you have plenty of CPU power left).

	  LatencyTOP focuses on the cases where the applications want
	  to run and execute useful code, but there's some resource
	  that's not currently available (and the kernel then blocks
	  the process). This is done both on a system level and on a
	  per process level, so that you can see what's happening to
	  the system, and which process is suffering and/or causing
	  the delays.

	  http://www.latencytop.org

comment "latencytop needs a toolchain w/ wchar, threads"
	depends on LINGMO_USE_MMU
	depends on !LINGMO_USE_WCHAR || !LINGMO_TOOLCHAIN_HAS_THREADS
```

## package/lcdapi/Config.in
```kconfig
config LINGMO_PACKAGE_LCDAPI
	bool "lcdapi"
	depends on LINGMO_INSTALL_LIBSTDCPP
	depends on LINGMO_TOOLCHAIN_HAS_THREADS
	help
	  C++ client API for lcdproc, containing a set of widget
	  classes.

	  https://github.com/spdawson/lcdapi

comment "lcdapi needs a toolchain w/ C++, threads"
	depends on !LINGMO_INSTALL_LIBSTDCPP || !LINGMO_TOOLCHAIN_HAS_THREADS
```

## package/lcdproc/Config.in
```kconfig
comment "lcdproc needs a toolchain w/ dynamic library"
	depends on LINGMO_STATIC_LIBS

config LINGMO_PACKAGE_LCDPROC
	bool "lcdproc"
	depends on LINGMO_USE_MMU # fork()
	depends on !LINGMO_STATIC_LIBS
	select LINGMO_PACKAGE_FREETYPE
	select LINGMO_PACKAGE_NCURSES
	select LINGMO_PACKAGE_ZLIB
	help
	  LCD display driver daemon and clients

	  http://lcdproc.org/

if LINGMO_PACKAGE_LCDPROC

config LINGMO_PACKAGE_LCDPROC_DRIVERS
	string "List of drivers to build"
	default "all"
	help
	  Specify a comma-separated list of lcdproc drivers to be built

config LINGMO_PACKAGE_LCDPROC_MENUS
	bool "Menu support"
	help
	  Enable support for lcdproc menus

endif
```

## package/leafnode2/Config.in
```kconfig
config LINGMO_PACKAGE_LEAFNODE2
	bool "leafnode2"
	depends on LINGMO_USE_MMU # fork()
	select LINGMO_PACKAGE_PCRE
	help
	  Leafnode-2 is a store-and-forward NNTP (or Usenet) proxy
	  server designed for small sites with just a few active
	  newsgroups.

	  https://gitlab.com/leafnode-2/leafnode-2
```

## package/leafpad/Config.in
```kconfig
config LINGMO_PACKAGE_LEAFPAD
	bool "leafpad"
	depends on LINGMO_PACKAGE_LIBGTK2
	help
	  GTK+ based simple text editor

	  http://savannah.nongnu.org/download/leafpad
```

## package/ledmon/Config.in
```kconfig
config LINGMO_PACKAGE_LEDMON
	bool "ledmon"
	depends on LINGMO_PACKAGE_HAS_UDEV
	depends on LINGMO_TOOLCHAIN_HAS_THREADS # sg3_utils
	select LINGMO_PACKAGE_PCIUTILS
	select LINGMO_PACKAGE_SG3_UTILS
	help
	  Enclosure LED Utilities. The ledmon application is
	  a daemon process used to monitor a state of software
	  RAID devices (md only) or a state of block devices.

	  https://github.com/intel/ledmon

comment "ledmon needs udev and a toolchain w/ threads"
	depends on !LINGMO_PACKAGE_HAS_UDEV || !LINGMO_TOOLCHAIN_HAS_THREADS
```

## package/lensfun/Config.in
```kconfig
config LINGMO_PACKAGE_LENSFUN
	bool "lensfun"
	depends on LINGMO_INSTALL_LIBSTDCPP
	depends on LINGMO_USE_WCHAR # libglib2
	depends on LINGMO_TOOLCHAIN_HAS_THREADS # libglib2
	depends on LINGMO_USE_MMU # libglib2
	select LINGMO_PACKAGE_LIBGLIB2
	help
	  Lensfun itself is only a library for correcting several
	  artefacts and a database for storing lens profiles. To
	  actually use Lensfun to process your images you need an
	  image editing application with Lensfun support.

	  https://lensfun.github.io

if LINGMO_PACKAGE_LENSFUN

config LINGMO_PACKAGE_LENSFUN_TOOLS
	bool "lensfun tools"
	select LINGMO_PACKAGE_LIBPNG
	help
	  Build 'lenstool'.

endif

comment "lensfun needs a toolchain w/ C++, threads, wchar"
	depends on LINGMO_USE_MMU
	depends on !LINGMO_INSTALL_LIBSTDCPP || !LINGMO_TOOLCHAIN_HAS_THREADS \
		|| !LINGMO_USE_WCHAR
```

## package/less/Config.in
```kconfig
config LINGMO_PACKAGE_LESS
	bool "less"
	depends on LINGMO_PACKAGE_BUSYBOX_SHOW_OTHERS
	select LINGMO_PACKAGE_NCURSES
	help
	  Excellent text file viewer.

	  http://www.greenwoodsoftware.com/
```

## package/lesstif/Config.in
```kconfig
config LINGMO_PACKAGE_LESSTIF
	bool "lesstif"
	depends on LINGMO_USE_MMU # fork()
	depends on LINGMO_PACKAGE_XORG7
	select LINGMO_PACKAGE_XLIB_LIBXT
	select LINGMO_PACKAGE_XLIB_LIBXEXT
	select LINGMO_PACKAGE_FREETYPE
	help
	  lesstif is the Hungry Programmers' version of OSF/Motif

	  http://lesstif.sourceforge.net/
```

## package/let-me-create/Config.in
```kconfig
comment "let-me-create needs a toolchain w/ C++, threads, dynamic library"
	depends on !LINGMO_INSTALL_LIBSTDCPP || !LINGMO_TOOLCHAIN_HAS_THREADS \
		|| LINGMO_STATIC_LIBS

config LINGMO_PACKAGE_LET_ME_CREATE
	bool "let-me-create"
	# build issues in static libs configuration
	# see https://github.com/CreatorDev/LetMeCreate/issues/28
	depends on !LINGMO_STATIC_LIBS
	depends on LINGMO_INSTALL_LIBSTDCPP
	depends on LINGMO_TOOLCHAIN_HAS_THREADS
	help
	  This library is collection of small wrappers for some
	  interfaces on the Creator Ci40 board. It aims at making
	  easier to develop on this platform. It also provides
	  wrappers for a few clicks.

	  https://github.com/CreatorDev/LetMeCreate

if LINGMO_PACKAGE_LET_ME_CREATE

config LINGMO_PACKAGE_LET_ME_CREATE_EXAMPLES
	bool "Build and install examples"
	help
	  Build and install examples

endif
```

## package/leveldb/Config.in
```kconfig
config LINGMO_PACKAGE_LEVELDB
	bool "leveldb"
	depends on LINGMO_INSTALL_LIBSTDCPP
	depends on LINGMO_TOOLCHAIN_GCC_AT_LEAST_4_8 # C++11
	depends on LINGMO_TOOLCHAIN_HAS_THREADS
	help
	  LevelDB is a fast key-value storage library written at Google
	  that provides an ordered mapping from string keys to string
	  values.

	  https://github.com/google/leveldb

comment "leveldb needs a toolchain w/ C++, threads, gcc >= 4.8"
	depends on !LINGMO_INSTALL_LIBSTDCPP || \
		!LINGMO_TOOLCHAIN_HAS_THREADS || !LINGMO_TOOLCHAIN_GCC_AT_LEAST_4_8
```

## package/lft/Config.in
```kconfig
config LINGMO_PACKAGE_LFT
	bool "lft"
	select LINGMO_PACKAGE_LIBPCAP
	help
	  LFT, short for Layer Four Traceroute, is a sort of
	  'traceroute' that often works much faster (than the
	  commonly-used Van Jacobson method) and goes through many
	  configurations of packet-filters (firewalls).

	  http://pwhois.org/lft/
```

## package/lftp/Config.in
```kconfig
config LINGMO_PACKAGE_LFTP
	bool "lftp"
	depends on LINGMO_USE_WCHAR
	depends on LINGMO_INSTALL_LIBSTDCPP
	depends on LINGMO_USE_MMU # fork()
	select LINGMO_PACKAGE_READLINE
	select LINGMO_PACKAGE_ZLIB
	select LINGMO_PACKAGE_OPENSSL if !LINGMO_PACKAGE_GNUTLS
	help
	  LFTP is a sophisticated ftp/http client, and a file transfer
	  program supporting a number of network protocols. Like BASH,
	  it has job control and uses the readline library for input. It
	  has bookmarks, a built-in mirror command, and can transfer
	  several files in parallel.
	  It was designed with reliability in mind.

	  http://lftp.yar.ru/

if LINGMO_PACKAGE_LFTP

comment "Commands"

config LINGMO_PACKAGE_LFTP_CMD_MIRROR
	bool "Mirror command"
	default y
	help
	  Enable mirror command

config LINGMO_PACKAGE_LFTP_CMD_SLEEP
	bool "Sleep command"
	default y
	help
	  Enable sleep command

config LINGMO_PACKAGE_LFTP_CMD_TORRENT
	bool "Torrent command"
	help
	  Enable torrent command

comment "Protocols"

config LINGMO_PACKAGE_LFTP_PROTO_FISH
	bool "FISH protocol"
	help
	  Enable FISH protocol

config LINGMO_PACKAGE_LFTP_PROTO_FTP
	bool "FTP protocol"
	default y
	help
	  Enable FTP protocol

config LINGMO_PACKAGE_LFTP_PROTO_HTTP
	bool "HTTP protocol"
	help
	  Enable HTTP protocol

config LINGMO_PACKAGE_LFTP_PROTO_SFTP
	bool "SFTP protocol"
	help
	  Enable SFTP protocol

endif  # LINGMO_PACKAGE_LFTP

comment "lftp requires a toolchain w/ C++, wchar"
	depends on LINGMO_USE_MMU
	depends on !(LINGMO_USE_WCHAR && LINGMO_INSTALL_LIBSTDCPP)
```

## package/libaacs/Config.in
```kconfig
config LINGMO_PACKAGE_LIBAACS
	bool "libaacs"
	depends on LINGMO_PACKAGE_LIBGPG_ERROR_ARCH_SUPPORTS # libgcrypt
	depends on !LINGMO_STATIC_LIBS
	select LINGMO_PACKAGE_LIBGCRYPT
	help
	  libaacs is a research project to implement the Advanced Access
	  Content System specification.
	  NB: this project doesn't offer any key or certificate that
	  could be used to decode encrypted copyrighted material.

	  http://www.videolan.org/developers/libaacs.html

comment "libaacs needs a toolchain w/ dynamic library"
	depends on LINGMO_STATIC_LIBS
```

## package/libabseil-cpp/Config.in
```kconfig
# see absl/debugging/internal/examine_stack.cc for the list of
# architectures that are supported, and for which ucontext is used.
config LINGMO_PACKAGE_LIBABSEIL_CPP_ARCH_SUPPORTS
	bool
	default y if LINGMO_aarch64 || LINGMO_aarch64_be
	default y if LINGMO_arm || LINGMO_armeb
	default y if LINGMO_i386
	default y if LINGMO_m68k
	default y if LINGMO_mips || LINGMO_mipsel || LINGMO_mips64 || LINGMO_mips64el
	default y if LINGMO_powerpc || LINGMO_powerpc64 || LINGMO_powerpc64le
	default y if LINGMO_riscv
	default y if LINGMO_s390x
	default y if LINGMO_sh
	default y if LINGMO_sparc || LINGMO_sparc64
	default y if LINGMO_x86_64
	depends on LINGMO_TOOLCHAIN_HAS_UCONTEXT

config LINGMO_PACKAGE_LIBABSEIL_CPP
	bool "libabseil-cpp"
	depends on LINGMO_INSTALL_LIBSTDCPP
	depends on LINGMO_TOOLCHAIN_GCC_AT_LEAST_8 # C++14
	depends on LINGMO_TOOLCHAIN_HAS_THREADS
	depends on !LINGMO_STATIC_LIBS # uses dlfcn.h
	depends on LINGMO_PACKAGE_LIBABSEIL_CPP_ARCH_SUPPORTS
	help
	  Abseil is an open-source collection of C++ library code
	  designed to augment the C++ standard library. The Abseil
	  library code is collected from Google's own C++ code base,
	  has been extensively tested and used in production, and is
	  the same code we depend on in our daily coding lives.

	  https://github.com/abseil/abseil-cpp

comment "libabseil-cpp needs a toolchain w/ gcc >= 8, C++, threads, dynamic library"
	depends on LINGMO_PACKAGE_LIBABSEIL_CPP_ARCH_SUPPORTS
	depends on !LINGMO_INSTALL_LIBSTDCPP || !LINGMO_TOOLCHAIN_HAS_THREADS || \
		LINGMO_STATIC_LIBS || !LINGMO_TOOLCHAIN_GCC_AT_LEAST_8
```

## package/libaio/Config.in
```kconfig
config LINGMO_PACKAGE_LIBAIO
	bool "libaio"
	help
	  Library for doing asynchronous I/O

	  https://pagure.io/libaio/
```

## package/libapparmor/Config.in
```kconfig
config LINGMO_PACKAGE_LIBAPPARMOR
	bool "libapparmor"
	depends on LINGMO_TOOLCHAIN_HAS_SYNC_4
	depends on LINGMO_TOOLCHAIN_HAS_THREADS
	depends on LINGMO_TOOLCHAIN_HEADERS_AT_LEAST_3_16
	help
	  AppArmor is an effective and easy-to-use Linux application
	  security system. AppArmor proactively protects the operating
	  system and applications from external or internal threats,
	  even zero-day attacks, by enforcing good behavior and
	  preventing even unknown application flaws from being
	  exploited.

	  This package installs only the library.

	  http://wiki.apparmor.net

comment "libapparmor needs a toolchain w/ headers >= 3.16, threads"
	depends on LINGMO_TOOLCHAIN_HAS_SYNC_4
	depends on !LINGMO_TOOLCHAIN_HAS_THREADS \
		|| !LINGMO_TOOLCHAIN_HEADERS_AT_LEAST_3_16
```

## package/libarchive/Config.in
```kconfig
comment "libarchive needs a toolchain w/ wchar"
	depends on !LINGMO_USE_WCHAR

config LINGMO_PACKAGE_LIBARCHIVE
	bool "libarchive"
	depends on LINGMO_USE_WCHAR
	help
	  Libarchive is a reusable C library for reading and writing a
	  variety of streaming archive formats.

	  https://www.libarchive.org/

if LINGMO_PACKAGE_LIBARCHIVE

config LINGMO_PACKAGE_LIBARCHIVE_BSDTAR
	bool "bsdtar"
	help
	  The 'bsdtar' program is a full-featured 'tar'
	  replacement built on libarchive.

config LINGMO_PACKAGE_LIBARCHIVE_BSDCPIO
	bool "bsdcpio"
	help
	  The 'bsdcpio' program is a different interface to
	  essentially the same functionality as 'bsdtar'.

config LINGMO_PACKAGE_LIBARCHIVE_BSDCAT
	bool "bsdcat"
	help
	  The 'bsdcat' program is a simple replacement tool
	  for zcat, bzcat, xzcat, and such.

endif
```

## package/libargon2/Config.in
```kconfig
config LINGMO_PACKAGE_LIBARGON2
	bool "libargon2"
	depends on LINGMO_USE_MMU
	depends on !LINGMO_STATIC_LIBS
	help
	  A modern password hashing algorithm

	  https://password-hashing.net/#argon2

comment "libargon needs a toolchain w/ dynamic library"
	depends on LINGMO_USE_MMU
	depends on LINGMO_STATIC_LIBS
```

## package/libass/Config.in
```kconfig
config LINGMO_PACKAGE_LIBASS
	bool "libass"
	depends on LINGMO_INSTALL_LIBSTDCPP # harfbuzz
	depends on LINGMO_TOOLCHAIN_HAS_SYNC_4 # harfbuzz
	depends on LINGMO_TOOLCHAIN_GCC_AT_LEAST_4_9 # harfbuzz
	select LINGMO_PACKAGE_FREETYPE
	select LINGMO_PACKAGE_HARFBUZZ
	select LINGMO_PACKAGE_LIBFRIBIDI
	help
	  libass is a portable subtitle renderer for the ASS/SSA
	  (Advanced Substation Alpha/Substation Alpha) subtitle format

	  https://github.com/libass/libass

comment "libass needs a toolchain w/ C++, gcc >= 4.9"
	depends on LINGMO_TOOLCHAIN_HAS_SYNC_4
	depends on !LINGMO_INSTALL_LIBSTDCPP || \
		!LINGMO_TOOLCHAIN_GCC_AT_LEAST_4_9
```

## package/libassuan/Config.in
```kconfig
config LINGMO_PACKAGE_LIBASSUAN
	bool "libassuan"
	depends on LINGMO_PACKAGE_LIBGPG_ERROR_ARCH_SUPPORTS # libgpg-error
	depends on LINGMO_USE_MMU # fork()
	select LINGMO_PACKAGE_LIBGPG_ERROR
	help
	  Libassuan is a small library implementing the so-called
	  Assuan protocol.

	  This protocol is used for IPC between most newer GnuPG
	  components. Both, server and client side functions are
	  provided.

	  http://www.gnupg.org/related_software/libassuan/
```

## package/libatasmart/Config.in
```kconfig
config LINGMO_PACKAGE_LIBATASMART
	bool "libatasmart"
	depends on LINGMO_PACKAGE_HAS_UDEV # libudev is configure dependency
	help
	  The libatasmart package is a disk reporting library.
	  It only supports a subset of the ATA S.M.A.R.T. functionality.

	  http://0pointer.de/blog/projects/being-smart.html

comment "libatasmart requires udev to be enabled"
	depends on !LINGMO_PACKAGE_HAS_UDEV
```

## package/libatomic_ops/Config.in
```kconfig
config LINGMO_PACKAGE_LIBATOMIC_OPS_ARCH_SUPPORTS
	bool
	default y if LINGMO_aarch64 || LINGMO_arm || LINGMO_armeb
	default y if LINGMO_i386 || LINGMO_x86_64
	default y if LINGMO_powerpc || LINGMO_powerpc64 || LINGMO_powerpc64le
	default y if LINGMO_mips || LINGMO_mipsel || LINGMO_mips64 || LINGMO_mips64el
	default y if LINGMO_riscv
	default y if LINGMO_sparc || LINGMO_sparc64
	# Unsupported for MIPS R6
	depends on !LINGMO_MIPS_CPU_MIPS32R6 && !LINGMO_MIPS_CPU_MIPS64R6

config LINGMO_PACKAGE_LIBATOMIC_OPS
	bool "libatomic_ops"
	depends on LINGMO_PACKAGE_LIBATOMIC_OPS_ARCH_SUPPORTS
	help
	  Atomic operations library

	  https://github.com/ivmai/libatomic_ops
```

## package/libavl/Config.in
```kconfig
config LINGMO_PACKAGE_LIBAVL
	bool "libavl"
	depends on !LINGMO_STATIC_LIBS
	help
	  AVLTree is a small implementation of AVL trees for the C
	  programming language.

	  https://packages.debian.org/buster/libavl1

	  This is not the GNU AVL library by Ben Pfaff.

comment "libavl needs a toolchain w/ dynamic library"
	depends on LINGMO_STATIC_LIBS
```
