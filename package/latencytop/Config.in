## package/libbdplus/Config.in
```kconfig
config LINGMO_PACKAGE_LIBBDPLUS
	bool "libbdplus"
	depends on LINGMO_PACKAGE_LIBGPG_ERROR_ARCH_SUPPORTS # libgcrypt
	depends on LINGMO_TOOLCHAIN_HAS_THREADS
	depends on !LINGMO_STATIC_LIBS
	select LINGMO_PACKAGE_LIBGCRYPT
	help
	  libbdplus is a research project to implement the BD+ System
	  Specifications.
	  This research project provides, through an open-source
	  library, a way to understand how the BD+ works.
	  NB: this project doesn't offer any key, configuration file or
	  certificate that could be used to decode encrypted copyrighted
	  material.

	  http://www.videolan.org/developers/libbdplus.html

comment "libbdplus needs a toolchain w/ threads, dynamic library"
	depends on LINGMO_PACKAGE_LIBGPG_ERROR_ARCH_SUPPORTS
	depends on !LINGMO_TOOLCHAIN_HAS_THREADS || LINGMO_STATIC_LIBS
```
