## package/spirv-headers/Config.in
```kconfig
config LINGMO_PACKAGE_SPIRV_HEADERS
	bool "spirv-headers"
	depends on LINGMO_INSTALL_LIBSTDCPP
	help
	  Machine-readable files for the SPIR-V Registry

	  https://www.khronos.org/registry/spir-v

comment "spirv-headers needs a toolchain w/ C++"
	depends on !LINGMO_INSTALL_LIBSTDCPP
```

## package/spirv-tools/Config.in
```kconfig
config LINGMO_PACKAGE_SPIRV_TOOLS
	bool "spirv-tools"
	depends on LINGMO_INSTALL_LIBSTDCPP
	depends on !LINGMO_STATIC_LIBS
	depends on LINGMO_TOOLCHAIN_GCC_AT_LEAST_8 # C++17 filesystem
	select LINGMO_PACKAGE_SPIRV_HEADERS
	help
	  The SPIR-V Tools project provides an API and commands for
	  processing SPIR-V modules.

	  https://github.com/KhronosGroup/SPIRV-Tools

comment "spirv-tools needs a toolchain w/ C++, dynamic library, gcc >= 8"
	depends on !LINGMO_INSTALL_LIBSTDCPP || LINGMO_STATIC_LIBS || \
		!LINGMO_TOOLCHAIN_GCC_AT_LEAST_8
```

## package/sqlcipher/Config.in
```kconfig
config LINGMO_PACKAGE_SQLCIPHER
	bool "sqlcipher"
	depends on !LINGMO_PACKAGE_SQLITE
	depends on LINGMO_TOOLCHAIN_HAS_THREADS
	select LINGMO_PACKAGE_OPENSSL
	help
	  SQLCipher is an SQLite extension that provides 256 bits AES
	  encryption of database files. Note that it is a fork of
	  SQLite and they cannot be installed side-by-side.

	  http://sqlcipher.net

if LINGMO_PACKAGE_SQLCIPHER

config LINGMO_PACKAGE_SQLCIPHER_READLINE
	bool "Command-line editing"
	select LINGMO_PACKAGE_NCURSES
	select LINGMO_PACKAGE_READLINE
	help
	  Enable command-line editing. This requires ncurses and
	  readline.

config LINGMO_PACKAGE_SQLCIPHER_STAT3
	bool "Additional query optimizations (stat3)"
	help
	  Adds additional logic to the ANALYZE command and to the
	  query planner that can help SQLite to choose a better query
	  plan under certain situations.

endif

comment "sqlcipher conflicts with sqlite"
	depends on LINGMO_PACKAGE_SQLITE

comment "sqlcipher needs a toolchain w/ threads"
	depends on !LINGMO_PACKAGE_SQLITE
	depends on !LINGMO_TOOLCHAIN_HAS_THREADS
```

## package/squashfs/Config.in
```kconfig
config LINGMO_PACKAGE_SQUASHFS
	bool "squashfs"
	depends on LINGMO_TOOLCHAIN_HAS_THREADS
	depends on LINGMO_USE_MMU # fork()
	# ensure at least on compression backend (defaults to gzip)
	select LINGMO_PACKAGE_SQUASHFS_GZIP if !( \
	       LINGMO_PACKAGE_SQUASHFS_LZ4 || \
	       LINGMO_PACKAGE_SQUASHFS_LZMA || \
	       LINGMO_PACKAGE_SQUASHFS_LZO || \
	       LINGMO_PACKAGE_SQUASHFS_XZ || \
	       LINGMO_PACKAGE_SQUASHFS_ZSTD)
	help
	  Tools to generate SquashFS filesystems.

	  https://github.com/plougher/squashfs-tools

if LINGMO_PACKAGE_SQUASHFS

config LINGMO_PACKAGE_SQUASHFS_GZIP
	bool "gzip support"
	default y
	select LINGMO_PACKAGE_ZLIB
	help
	  Support GZIP compression algorithm

config LINGMO_PACKAGE_SQUASHFS_LZ4
	bool "lz4 support"
	select LINGMO_PACKAGE_LZ4
	help
	  Support LZ4 compression algorithm

config LINGMO_PACKAGE_SQUASHFS_LZMA
	bool "lzma support"
	select LINGMO_PACKAGE_XZ
	help
	  Support LZMA compression algorithm

config LINGMO_PACKAGE_SQUASHFS_LZO
	bool "lzo support"
	select LINGMO_PACKAGE_LZO
	help
	  Support LZO compression algorithm

config LINGMO_PACKAGE_SQUASHFS_XZ
	bool "xz support"
	select LINGMO_PACKAGE_XZ
	help
	  Support XZ compression algorithm

config LINGMO_PACKAGE_SQUASHFS_ZSTD
	bool "zstd support"
	select LINGMO_PACKAGE_ZSTD
	help
	  Support ZSTD compression algorithm

endif

comment "squashfs needs a toolchain w/ threads"
	depends on !LINGMO_TOOLCHAIN_HAS_THREADS
	depends on LINGMO_USE_MMU
```

## package/squeezelite/Config.in
```kconfig
config LINGMO_PACKAGE_SQUEEZELITE
	bool "squeezelite"
	depends on LINGMO_USE_WCHAR # flac
	depends on LINGMO_TOOLCHAIN_HAS_THREADS_NPTL
	depends on LINGMO_USE_MMU # mpg123
	depends on !LINGMO_STATIC_LIBS # dlopen
	select LINGMO_PACKAGE_ALSA_LIB
	select LINGMO_PACKAGE_ALSA_LIB_MIXER
	select LINGMO_PACKAGE_FLAC
	select LINGMO_PACKAGE_LIBMAD
	select LINGMO_PACKAGE_LIBVORBIS
	select LINGMO_PACKAGE_MPG123
	help
	  Logitech Media Server client

	  https://github.com/ralph-irving/squeezelite/

if LINGMO_PACKAGE_SQUEEZELITE

config LINGMO_PACKAGE_SQUEEZELITE_FFMPEG
	bool "Enable WMA and ALAC decoding"
	default y
	depends on LINGMO_PACKAGE_FFMPEG_ARCH_SUPPORTS
	select LINGMO_PACKAGE_FFMPEG

config LINGMO_PACKAGE_SQUEEZELITE_DSD
	bool "Enable DSD decoding"

config LINGMO_PACKAGE_SQUEEZELITE_LIRC
	bool "Enable lirc support"
	depends on LINGMO_INSTALL_LIBSTDCPP
	select LINGMO_PACKAGE_LIRC_TOOLS

comment "lirc support needs a toolchain with C++"
	depends on !LINGMO_INSTALL_LIBSTDCPP

config LINGMO_PACKAGE_SQUEEZELITE_RESAMPLE
	bool "Enable resampling support"
	select LINGMO_PACKAGE_LIBSOXR

config LINGMO_PACKAGE_SQUEEZELITE_VISEXPORT
	bool "Enable visualiser support"

endif

comment "squeezelite needs a toolchain w/ wchar, NPTL, dynamic library"
	depends on LINGMO_USE_MMU
	depends on !LINGMO_USE_WCHAR || !LINGMO_TOOLCHAIN_HAS_THREADS_NPTL \
		|| LINGMO_STATIC_LIBS
```

## package/squid/Config.in
```kconfig
comment "squid needs a toolchain w/ C++, threads, gcc >= 8, host gcc >= 8"
	depends on LINGMO_USE_MMU
	depends on LINGMO_TOOLCHAIN_HAS_ATOMIC
	depends on !LINGMO_INSTALL_LIBSTDCPP || \
		!LINGMO_TOOLCHAIN_HAS_THREADS || \
		!LINGMO_TOOLCHAIN_GCC_AT_LEAST_8 || \
		!LINGMO_HOST_GCC_AT_LEAST_8

config LINGMO_PACKAGE_SQUID
	bool "squid"
	depends on LINGMO_TOOLCHAIN_HAS_ATOMIC
	depends on LINGMO_INSTALL_LIBSTDCPP
	depends on LINGMO_TOOLCHAIN_HAS_THREADS
	depends on LINGMO_TOOLCHAIN_GCC_AT_LEAST_8 # C++17
	depends on LINGMO_HOST_GCC_AT_LEAST_8 # C++17
	# needs fork()
	depends on LINGMO_USE_MMU
	select LINGMO_PACKAGE_LIBCAP
	select LINGMO_PACKAGE_LIBTOOL
	select LINGMO_PACKAGE_LIBXML2
	help
	  Caching proxy for the Web supporting HTTP, HTTPS, FTP, and
	  more.

	  http://www.squid-cache.org/
```

## package/sratom/Config.in
```kconfig
config LINGMO_PACKAGE_SRATOM
	bool "sratom"
	select LINGMO_PACKAGE_LV2
	select LINGMO_PACKAGE_SERD
	select LINGMO_PACKAGE_SORD
	help
	  Sratom is a library for serialising LV2 atoms to and from
	  RDF, particularly the Turtle syntax.

	  https://drobilla.net/software/sratom.html
```

## package/sscep/Config.in
```kconfig
config LINGMO_PACKAGE_SSCEP
	bool "sscep"
	select LINGMO_PACKAGE_LIBOPENSSL_ENABLE_BLOWFISH if LINGMO_PACKAGE_LIBOPENSSL
	select LINGMO_PACKAGE_LIBOPENSSL_ENABLE_DES if LINGMO_PACKAGE_LIBOPENSSL
	select LINGMO_PACKAGE_OPENSSL
	help
	  SSCEP is a client-only implementation of the SCEP
	  (Cisco System's Simple Certificate Enrollment Protocol).

	  https://github.com/certnanny/sscep
```

## package/sshfs/Config.in
```kconfig
config LINGMO_PACKAGE_SSHFS
	bool "sshfs (FUSE)"
	depends on LINGMO_USE_WCHAR # glib2
	depends on LINGMO_TOOLCHAIN_HAS_THREADS # libfuse3, glib2
	depends on LINGMO_USE_MMU # libfuse3, glib2
	depends on !LINGMO_STATIC_LIBS # libfuse3
	select LINGMO_PACKAGE_LIBFUSE3
	select LINGMO_PACKAGE_LIBGLIB2
	select LINGMO_PACKAGE_LIBICONV if !LINGMO_ENABLE_LOCALE
	select LINGMO_PACKAGE_OPENSSH
	help
	  FUSE filesystem client based on the SSH File Transfer
	  Protocol.

	  https://github.com/libfuse/sshfs

comment "sshfs needs a toolchain w/ wchar, threads, dynamic library"
	depends on LINGMO_USE_MMU
	depends on !LINGMO_USE_WCHAR || !LINGMO_TOOLCHAIN_HAS_THREADS || LINGMO_STATIC_LIBS
```

## package/sshguard/Config.in
```kconfig
config LINGMO_PACKAGE_SSHGUARD
	bool "sshguard"
	depends on LINGMO_TOOLCHAIN_HAS_THREADS
	select LINGMO_PACKAGE_IPTABLES # runtime
	help
	  sshguard protects hosts from brute-force attacks against SSH
	  and other services. It aggregates system logs and blocks
	  repeat offenders using one of several firewall backends,
	  including iptables, ipfw, and pf.

	  https://www.sshguard.net

comment "sshguard needs a toolchain w/ threads"
	depends on !LINGMO_TOOLCHAIN_HAS_THREADS
```

## package/sshpass/Config.in
```kconfig
config LINGMO_PACKAGE_SSHPASS
	bool "sshpass"
	depends on LINGMO_USE_MMU # fork()
	help
	  Sshpass is a tool for non-interactivly performing
	  password authentication with SSH's so called
	  "interactive keyboard password authentication".

	  http://sshpass.sourceforge.net
```

## package/sslh/Config.in
```kconfig
config LINGMO_PACKAGE_SSLH
	bool "sslh"
	depends on LINGMO_USE_MMU # fork()
	select LINGMO_PACKAGE_LIBCONFIG if LINGMO_PACKAGE_SYSTEMD
	select LINGMO_PACKAGE_PCRE2
	help
	  Applicative protocol multiplexer

	  http://www.rutschle.net/tech/sslh.shtml
```

## package/start-stop-daemon/Config.in
```kconfig
config LINGMO_PACKAGE_START_STOP_DAEMON
	bool "start-stop-daemon"
	depends on LINGMO_USE_MMU # fork()
	depends on LINGMO_PACKAGE_BUSYBOX_SHOW_OTHERS
	help
	  start-stop-daemon is used to control the creation and
	  termination of system-level processes.

	  https://tracker.debian.org/pkg/dpkg
```

## package/startup-notification/Config.in
```kconfig
config LINGMO_PACKAGE_STARTUP_NOTIFICATION
	bool "startup-notification"
	depends on LINGMO_PACKAGE_XORG7
	depends on LINGMO_USE_MMU # fork()
	select LINGMO_PACKAGE_XCB_UTIL
	select LINGMO_PACKAGE_XLIB_LIBX11
	help
	  Startup-notification is a library used to monitor
	  application startup.

	  http://freedesktop.org/software/startup-notification/releases
```

## package/stella/Config.in
```kconfig
config LINGMO_PACKAGE_STELLA
	bool "stella"
	depends on !LINGMO_STATIC_LIBS # sdl2
	depends on LINGMO_INSTALL_LIBSTDCPP
	depends on LINGMO_TOOLCHAIN_HAS_THREADS
	depends on LINGMO_TOOLCHAIN_GCC_AT_LEAST_7 # C++17
	depends on !LINGMO_TOOLCHAIN_HAS_GCC_BUG_64735 # exception_ptr
	select LINGMO_PACKAGE_SDL2
	help
	  Stella is a multi-platform Atari 2600 VCS emulator.

	  https://stella-emu.github.io/

comment "stella needs a toolchain w/ dynamic library, C++, threads, gcc >= 7"
	depends on LINGMO_STATIC_LIBS || !LINGMO_INSTALL_LIBSTDCPP || \
		!LINGMO_TOOLCHAIN_HAS_THREADS || \
		!LINGMO_TOOLCHAIN_GCC_AT_LEAST_7

comment "stella needs a toolchain not affected by GCC bug 64735"
	depends on LINGMO_TOOLCHAIN_HAS_GCC_BUG_64735
```

## package/stellarium/Config.in
```kconfig
config LINGMO_PACKAGE_STELLARIUM
	bool "stellarium"
	depends on LINGMO_PACKAGE_QT5
	depends on LINGMO_PACKAGE_QT5_GL_AVAILABLE
	depends on LINGMO_PACKAGE_HAS_LIBGL # does not support OpenGL ES
	select LINGMO_PACKAGE_QT5BASE_CONCURRENT
	select LINGMO_PACKAGE_QT5BASE_GUI
	select LINGMO_PACKAGE_QT5BASE_NETWORK
	select LINGMO_PACKAGE_QT5BASE_OPENGL
	select LINGMO_PACKAGE_QT5BASE_PRINTSUPPORT
	select LINGMO_PACKAGE_QT5BASE_WIDGETS
	select LINGMO_PACKAGE_QT5CHARTS
	select LINGMO_PACKAGE_QT5LOCATION
	select LINGMO_PACKAGE_QT5MULTIMEDIA
	select LINGMO_PACKAGE_ZLIB
	help
	  Stellarium is a free open source planetarium for your
	  computer. It shows a realistic sky in 3D, just like what
	  you see with the naked eye, binoculars or a telescope.

	  https://stellarium.org

comment "stellarium needs Qt5 and an OpenGL provider"
	depends on !LINGMO_PACKAGE_QT5 || !LINGMO_PACKAGE_HAS_LIBGL
```

## package/strace/Config.in
```kconfig
config LINGMO_PACKAGE_STRACE
	bool "strace"
	# needs at least kernel headers 4.0 on nios2
	depends on LINGMO_TOOLCHAIN_HEADERS_AT_LEAST_4_0 || !LINGMO_nios2
	# needs at least kernel headers 5.0 on xtensa
	depends on LINGMO_TOOLCHAIN_HEADERS_AT_LEAST_5_0 || !LINGMO_xtensa
	# needs at least kernel headers 5.0 on musl aarch64
	depends on LINGMO_TOOLCHAIN_HEADERS_AT_LEAST_5_0 || \
		!(LINGMO_aarch64 || LINGMO_aarch64_be) || \
		!LINGMO_TOOLCHAIN_USES_MUSL
	depends on !LINGMO_RISCV_32
	help
	  A useful diagnostic, instructional, and debugging tool.
	  Allows you to track what system calls a program makes
	  while it is running.

	  If you want 'strace -k' to work, make sure to enable the
	  'libunwind' package.

	  https://strace.io

comment "strace needs a toolchain w/ headers >= 4.0 on nios2"
	depends on LINGMO_nios2
	depends on !LINGMO_TOOLCHAIN_HEADERS_AT_LEAST_4_0

comment "strace needs a toolchain w/ headers >= 5.0 on xtensa"
	depends on LINGMO_xtensa
	depends on !LINGMO_TOOLCHAIN_HEADERS_AT_LEAST_5_0

comment "strace needs a musl toolchain w/ headers >= 5.0 on aarch64"
	depends on LINGMO_aarch64 || LINGMO_aarch64_be
	depends on LINGMO_TOOLCHAIN_USES_MUSL
	depends on !LINGMO_TOOLCHAIN_HEADERS_AT_LEAST_5_0
```

## package/stress-ng/Config.in
```kconfig
config LINGMO_PACKAGE_STRESS_NG
	bool "stress-ng"
	depends on LINGMO_USE_MMU # fork()
	# perf.c needs PERF_COUNT_HW_REF_CPU_CYCLES
	depends on LINGMO_TOOLCHAIN_HAS_SYNC_4
	depends on LINGMO_TOOLCHAIN_HEADERS_AT_LEAST_3_3
	# fenv.h lacks FE_INVALID, FE_OVERFLOW & FE_UNDERFLOW on nios2 and ARC
	depends on !LINGMO_nios2
	depends on !LINGMO_arc
	help
	  stress-ng will stress test a computer system in various
	  selectable ways. It was designed to exercise various physical
	  subsystems of a computer as well as the various operating
	  system kernel interfaces.

	  https://github.com/ColinIanKing/stress-ng

comment "stress-ng needs a toolchain w/ headers >= 3.3"
	depends on !LINGMO_nios2 && !LINGMO_arc
	depends on LINGMO_TOOLCHAIN_HAS_SYNC_4
	depends on LINGMO_USE_MMU
	depends on !LINGMO_TOOLCHAIN_HEADERS_AT_LEAST_3_3
```

## package/stress/Config.in
```kconfig
config LINGMO_PACKAGE_STRESS
	bool "stress"
	depends on LINGMO_USE_MMU # fork()
	help
	  A deliberately simple workload generator for POSIX systems.
	  It imposes a configurable amount of CPU, memory, I/O, and
	  disk stress on the system.

	  https://github.com/resurrecting-open-source-projects/stress/
```
