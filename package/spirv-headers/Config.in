## package/strongswan/Config.in
```kconfig
comment "strongswan needs a toolchain w/ threads, dynamic library"
	depends on LINGMO_USE_MMU
	depends on LINGMO_TOOLCHAIN_HAS_ATOMIC
	depends on !LINGMO_TOOLCHAIN_HAS_THREADS || LINGMO_STATIC_LIBS

menuconfig LINGMO_PACKAGE_STRONGSWAN
	bool "strongswan"
	depends on LINGMO_USE_MMU # fork()
	depends on LINGMO_TOOLCHAIN_HAS_THREADS
	depends on LINGMO_TOOLCHAIN_HAS_ATOMIC
	depends on !LINGMO_STATIC_LIBS
	help
	  strongSwan is an OpenSource IPsec implementation for the
	  Linux operating system. It is based on the discontinued
	  FreeS/WAN project and the X.509 patch.

	  The focus is on:
	   - simplicity of configuration
	   - strong encryption and authentication methods
	   - powerful IPsec policies supporting large and complex
	     VPN networks

	  strongSwan provide many plugins. Only a few are presented
	  here.

	  http://www.strongswan.org/

if LINGMO_PACKAGE_STRONGSWAN

choice
	prompt "Cryptographic backend"
	default LINGMO_PACKAGE_STRONGSWAN_GMP

config LINGMO_PACKAGE_STRONGSWAN_BOTAN
	bool "botan"
	depends on LINGMO_PACKAGE_BOTAN_ARCH_SUPPORTS
	depends on LINGMO_INSTALL_LIBSTDCPP
	depends on LINGMO_TOOLCHAIN_GCC_AT_LEAST_10 # botan
	select LINGMO_PACKAGE_BOTAN

comment "botan backend needs a toolchain w/ C++, gcc >= 10"
	depends on !LINGMO_INSTALL_LIBSTDCPP \
		|| !LINGMO_TOOLCHAIN_GCC_AT_LEAST_10
	depends on LINGMO_PACKAGE_BOTAN_ARCH_SUPPORTS

config LINGMO_PACKAGE_STRONGSWAN_OPENSSL
	bool "OpenSSL"
	select LINGMO_PACKAGE_OPENSSL

config LINGMO_PACKAGE_STRONGSWAN_GCRYPT
	bool "libgcrypt"
	depends on LINGMO_PACKAGE_LIBGPG_ERROR_ARCH_SUPPORTS # libgcrypt
	select LINGMO_PACKAGE_LIBGCRYPT

config LINGMO_PACKAGE_STRONGSWAN_GMP
	bool "GNU MP (libgmp)"
	select LINGMO_PACKAGE_GMP

config LINGMO_PACKAGE_STRONGSWAN_WOLFSSL
	bool "wolfssl"
	select LINGMO_PACKAGE_WOLFSSL

endchoice

config LINGMO_PACKAGE_STRONGSWAN_AF_ALG
	bool "Enable AF_ALG crypto interface to Linux Crypto API"

config LINGMO_PACKAGE_STRONGSWAN_CURL
	bool "Enable CURL fetcher plugin to fetch files via libcurl"
	select LINGMO_PACKAGE_LIBCURL

config LINGMO_PACKAGE_STRONGSWAN_MD4
	bool "Enable MD4 hash algorithm"

config LINGMO_PACKAGE_STRONGSWAN_CHARON
	bool "Enable the IKEv1/IKEv2 keying daemon charon"
	default y

if LINGMO_PACKAGE_STRONGSWAN_CHARON

config LINGMO_PACKAGE_STRONGSWAN_TNCCS_11
	bool "Enable TNCCS 1.1 protocol module"
	select LINGMO_PACKAGE_LIBXML2

config LINGMO_PACKAGE_STRONGSWAN_TNCCS_20
	bool "Enable TNCCS 2.0 protocol module"

config LINGMO_PACKAGE_STRONGSWAN_TNCCS_DYNAMIC
	bool "Enable dynamic TNCCS protocol discovery module"

config LINGMO_PACKAGE_STRONGSWAN_SYSTIME_FIX
	bool "Enable systime-fix plugin"

config LINGMO_PACKAGE_STRONGSWAN_EAP_SIM
	bool "Enable EAP-SIM"
	default y if LINGMO_PACKAGE_STRONGSWAN_EAP # legacy

config LINGMO_PACKAGE_STRONGSWAN_EAP_SIM_FILE
	bool "Enable EAP-SIM file backend"
	default y if LINGMO_PACKAGE_STRONGSWAN_EAP # legacy
	select LINGMO_PACKAGE_STRONGSWAN_EAP_SIM

config LINGMO_PACKAGE_STRONGSWAN_EAP_SIM_PCSC
	bool "Enable EAP-SIM smart card backend"
	depends on !LINGMO_STATIC_LIBS # pcsc-lite
	depends on LINGMO_TOOLCHAIN_GCC_AT_LEAST_4_9 # pcsc-lite
	select LINGMO_PACKAGE_PCSC_LITE
	select LINGMO_PACKAGE_STRONGSWAN_EAP_SIM

comment "EAP-SIM smart backend needs a toolchain w/ dynamic library, gcc >= 4.9"
	depends on LINGMO_STATIC_LIBS || !LINGMO_TOOLCHAIN_GCC_AT_LEAST_4_9

config LINGMO_PACKAGE_STRONGSWAN_EAP_AKA
	bool "Enable EAP-AKA"
	default y if LINGMO_PACKAGE_STRONGSWAN_EAP # legacy

config LINGMO_PACKAGE_STRONGSWAN_EAP_AKA_3GPP2
	bool "Enable EAP-AKA 3GPP2 algorithms"
	default y if LINGMO_PACKAGE_STRONGSWAN_EAP # legacy
	select LINGMO_PACKAGE_GMP
	select LINGMO_PACKAGE_STRONGSWAN_EAP_AKA

config LINGMO_PACKAGE_STRONGSWAN_EAP_SIMAKA_SQL
	bool "Enable EAP-SIM/AKA backend based on a triplet/quintuplet SQL database"
	default y if LINGMO_PACKAGE_STRONGSWAN_EAP # legacy
	select LINGMO_PACKAGE_STRONGSWAN_EAP_AKA
	select LINGMO_PACKAGE_STRONGSWAN_EAP_SIM

config LINGMO_PACKAGE_STRONGSWAN_EAP_SIMAKA_PSEUDONYM
	bool "Enable EAP-SIM/AKA pseudonym storage"
	default y if LINGMO_PACKAGE_STRONGSWAN_EAP # legacy
	select LINGMO_PACKAGE_STRONGSWAN_EAP_AKA
	select LINGMO_PACKAGE_STRONGSWAN_EAP_SIM

config LINGMO_PACKAGE_STRONGSWAN_EAP_SIMAKA_REAUTH
	bool "Enable EAP-SIM/AKA reauthentication data storage"
	default y if LINGMO_PACKAGE_STRONGSWAN_EAP # legacy
	select LINGMO_PACKAGE_STRONGSWAN_EAP_AKA
	select LINGMO_PACKAGE_STRONGSWAN_EAP_SIM

config LINGMO_PACKAGE_STRONGSWAN_EAP_IDENTITY
	bool "Enable EAP-Identity"
	default y if LINGMO_PACKAGE_STRONGSWAN_EAP # legacy

config LINGMO_PACKAGE_STRONGSWAN_EAP_MD5
	bool "Enable EAP-MD5"
	default y if LINGMO_PACKAGE_STRONGSWAN_EAP # legacy

config LINGMO_PACKAGE_STRONGSWAN_EAP_GTC
	bool "Enable EAP-GDC"
	default y if LINGMO_PACKAGE_STRONGSWAN_EAP # legacy

config LINGMO_PACKAGE_STRONGSWAN_EAP_MSCHAPV2
	bool "Enable EAP-MSCHAPv2"
	default y if LINGMO_PACKAGE_STRONGSWAN_EAP # legacy
	select LINGMO_PACKAGE_STRONGSWAN_MD4

config LINGMO_PACKAGE_STRONGSWAN_EAP_PEAP
	bool "Enable EAP-PEAP"
	default y if LINGMO_PACKAGE_STRONGSWAN_EAP # legacy

config LINGMO_PACKAGE_STRONGSWAN_EAP_RADIUS
	bool "Enable EAP-RADIUS"
	default y if LINGMO_PACKAGE_STRONGSWAN_EAP # legacy

config LINGMO_PACKAGE_STRONGSWAN_EAP_TLS
	bool "Enable EAP-TLS"
	default y if LINGMO_PACKAGE_STRONGSWAN_EAP # legacy

config LINGMO_PACKAGE_STRONGSWAN_EAP_TTLS
	bool "Enable EAP-TTLS"
	default y if LINGMO_PACKAGE_STRONGSWAN_EAP # legacy

config LINGMO_PACKAGE_STRONGSWAN_EAP_DYNAMIC
	bool "Enable EAP-DYNAMIC"
	default y if LINGMO_PACKAGE_STRONGSWAN_EAP # legacy

config LINGMO_PACKAGE_STRONGSWAN_EAP_TNC
	bool "Enable EAP-TNC"
	default y if LINGMO_PACKAGE_STRONGSWAN_EAP # legacy

config LINGMO_PACKAGE_STRONGSWAN_UNITY
	bool "Enables Cisco Unity extension plugin"

config LINGMO_PACKAGE_STRONGSWAN_STROKE
	bool "Enable charons stroke configuration backend"
	default y

config LINGMO_PACKAGE_STRONGSWAN_SQL
	bool "Enable SQL database configuration backend"
	depends on LINGMO_PACKAGE_SQLITE || LINGMO_PACKAGE_MARIADB

config LINGMO_PACKAGE_STRONGSWAN_BYPASS_LAN
	bool "Enable BYPASS-LAN plugin"

endif

config LINGMO_PACKAGE_STRONGSWAN_PKI
	bool "Enable pki certificate utility"
	default y

config LINGMO_PACKAGE_STRONGSWAN_SCRIPTS
	bool "Enable additional utilities (found in scripts directory)"
	default y
	depends on LINGMO_PACKAGE_STRONGSWAN_CHARON

config LINGMO_PACKAGE_STRONGSWAN_VICI
	bool "Enable vici/swanctl"
	default y
	depends on LINGMO_PACKAGE_STRONGSWAN_CHARON

endif
```

## package/stunnel/Config.in
```kconfig
config LINGMO_PACKAGE_STUNNEL
	bool "stunnel"
	depends on LINGMO_USE_MMU # fork()
	select LINGMO_PACKAGE_OPENSSL
	select LINGMO_PACKAGE_OPENSSL_FORCE_LIBOPENSSL
	select LINGMO_PACKAGE_LIBOPENSSL_ENABLE_DES
	help
	  Stunnel is a program that wraps any TCP connection with an SSL
	  connection.

	  http://www.stunnel.org/
```

## package/subversion/Config.in
```kconfig
config LINGMO_PACKAGE_SUBVERSION
	bool "subversion"
	# apr really needs shared library support
	depends on !LINGMO_STATIC_LIBS
	depends on LINGMO_USE_MMU # apr
	select LINGMO_PACKAGE_APR
	select LINGMO_PACKAGE_APR_UTIL
	select LINGMO_PACKAGE_EXPAT
	select LINGMO_PACKAGE_LZ4
	select LINGMO_PACKAGE_UTF8PROC
	select LINGMO_PACKAGE_ZLIB
	select LINGMO_PACKAGE_SQLITE
	help
	  Subversion is an open source version control system

	  http://subversion.apache.org/

comment "subversion needs a toolchain w/ dynamic library"
	depends on LINGMO_USE_MMU
	depends on LINGMO_STATIC_LIBS
```

## package/sunxi-cedarx/Config.in
```kconfig
config LINGMO_PACKAGE_SUNXI_CEDARX
	bool "sunxi-cedarx"
	depends on LINGMO_arm
	depends on LINGMO_TOOLCHAIN_USES_GLIBC
	help
	  Sunxi CedarX decoder libraries. CedarX is Allwinner's
	  multimedia co-processing technology for hardware accelerated
	  video and image decoding, as used inside their A10 SoC's and
	  others.

	  http://github.com/linux-sunxi/cedarx-libs
	  http://linux-sunxi.org/CedarX

comment "sunxi-cedarx needs a glibc toolchain"
	depends on LINGMO_arm
	depends on !LINGMO_TOOLCHAIN_USES_GLIBC
```

## package/sunxi-mali-utgard/Config.in
```kconfig
config LINGMO_PACKAGE_SUNXI_MALI_UTGARD
	bool "sunxi-mali-utgard"
	depends on LINGMO_aarch64 || (LINGMO_ARM_EABIHF && LINGMO_arm)
	depends on LINGMO_TOOLCHAIN_USES_GLIBC
	select LINGMO_PACKAGE_HAS_LIBEGL
	select LINGMO_PACKAGE_HAS_LIBGLES
	help
	  Install userspace Allwinner OpenGL libraries for Mali
	  Utgard GPUs.

	  https://github.com/bootlin/mali-blobs

if LINGMO_PACKAGE_SUNXI_MALI_UTGARD

config LINGMO_PACKAGE_PROVIDES_LIBEGL
	default "sunxi-mali-utgard"

config LINGMO_PACKAGE_PROVIDES_LIBGLES
	default "sunxi-mali-utgard"

config LINGMO_PACKAGE_PROVIDES_LIBGBM
	default "sunxi-mali-utgard" if LINGMO_PACKAGE_SUNXI_MALI_UTGARD_WAYLAND

choice
	prompt "Version"
	default LINGMO_PACKAGE_SUNXI_MALI_UTGARD_R6P2 if LINGMO_PACKAGE_SUNXI_MALI_MAINLINE_R6P2 # legacy
	default LINGMO_PACKAGE_SUNXI_MALI_UTGARD_R8P1 if LINGMO_PACKAGE_SUNXI_MALI_MAINLINE_R8P1 # legacy
	default LINGMO_PACKAGE_SUNXI_MALI_UTGARD_R6P2
	help
	  Select the version of the userspace module.

config LINGMO_PACKAGE_SUNXI_MALI_UTGARD_R6P2
	bool "r6p2"
config LINGMO_PACKAGE_SUNXI_MALI_UTGARD_R8P1
	bool "r8p1"

endchoice

config LINGMO_PACKAGE_SUNXI_MALI_UTGARD_REVISION
	string
	default "r6p2"	if LINGMO_PACKAGE_SUNXI_MALI_UTGARD_R6P2
	default "r8p1"	if LINGMO_PACKAGE_SUNXI_MALI_UTGARD_R8P1

choice
	prompt "Platform"
	default LINGMO_PACKAGE_SUNXI_MALI_UTGARD_FBDEV
	help
	  Select the target EGL platform.

config LINGMO_PACKAGE_SUNXI_MALI_UTGARD_FBDEV
	bool "fbdev"

config LINGMO_PACKAGE_SUNXI_MALI_UTGARD_WAYLAND
	bool "wayland"
	depends on LINGMO_PACKAGE_SUNXI_MALI_UTGARD_R6P2
	select LINGMO_PACKAGE_HAS_LIBEGL_WAYLAND
	select LINGMO_PACKAGE_HAS_LIBGBM
	select LINGMO_PACKAGE_WAYLAND

comment "wayland support requires version r6p2"
	depends on !LINGMO_PACKAGE_SUNXI_MALI_UTGARD_R6P2

endchoice

config LINGMO_PACKAGE_SUNXI_MALI_UTGARD_PLATFORM
	string
	default "fbdev" if LINGMO_PACKAGE_SUNXI_MALI_UTGARD_FBDEV
	default "wayland" if LINGMO_PACKAGE_SUNXI_MALI_UTGARD_WAYLAND

endif

comment "sunxi-mali-utgard needs an EABIhf glibc toolchain"
	depends on LINGMO_arm
	depends on !LINGMO_TOOLCHAIN_USES_GLIBC || !LINGMO_ARM_EABIHF
```

## package/sunxi-tools/Config.in
```kconfig
config LINGMO_PACKAGE_SUNXI_TOOLS
	bool "sunxi-tools"
	depends on LINGMO_arm
	help
	  Tools for Allwinner A10 (aka sun4i) and A13 (aka sun5i)
	  based devices.

	  http://linux-sunxi.org/Sunxi-tools

if LINGMO_PACKAGE_SUNXI_TOOLS

config LINGMO_PACKAGE_SUNXI_TOOLS_FEXC
	bool "sunxi-fexc (fex2bin & bin2fex)"
	help
	  Convert between .fex board definition files and binary
	  format. These tools are specific for the linux-sunxi kernel
	  and do not apply to the mainline Linux kernel version.

config LINGMO_PACKAGE_SUNXI_TOOLS_BOOTINFO
	bool "sunxi-bootinfo"
	help
	  Displays information about sunxi boot code.

config LINGMO_PACKAGE_SUNXI_TOOLS_FEL
	bool "sunxi-fel"
	depends on LINGMO_TOOLCHAIN_HAS_THREADS # libusb
	depends on LINGMO_TOOLCHAIN_GCC_AT_LEAST_4_9 # libusb
	select LINGMO_PACKAGE_DTC
	select LINGMO_PACKAGE_LIBUSB
	select LINGMO_PACKAGE_ZLIB
	help
	  The sunxi-fel command can interact with a sunxi device in
	  fel mode. This allows do download code to memory and execute
	  it.

comment "sunxi-fel needs a toolchain w/ threads, gcc >= 4.9"
	depends on !LINGMO_TOOLCHAIN_HAS_THREADS || \
		!LINGMO_TOOLCHAIN_GCC_AT_LEAST_4_9

config LINGMO_PACKAGE_SUNXI_TOOLS_NAND_PART
	bool "sunxi-nand-part"
	default y
	help
	  The sunxi-nand-part command allows to repartition the internal
	  NAND on sunxi devices.

config LINGMO_PACKAGE_SUNXI_TOOLS_PIO
	bool "sunxi-pio"
	help
	  GPIO manipulation tool for sunxi boards.

config LINGMO_PACKAGE_SUNXI_TOOLS_MEMINFO
	bool "sunxi-meminfo"
	help
	  Utility to retrieve DRAM information from registers on
	  Allwinner SoCs. Specific for the linux-sunxi kernel - does
	  not apply to the mainline Linux kernel version.

config LINGMO_PACKAGE_SUNXI_TOOLS_PHOENIX_INFO
	bool "phoenix_info"
	help
	  Display information about self-installing SD card images
	  (created with Phoenix Card).

	  https://linux-sunxi.org/PhoenixCard

config LINGMO_PACKAGE_SUNXI_TOOLS_NAND_IMAGE_BUILDER
	bool "sunxi-nand-image-builder"
	help
	  Creates a raw NAND image that can be read by the sunxi NAND
	  controller.

endif # LINGMO_PACKAGE_SUNXI_TOOLS
```
