## package/perl-x10/Config.in
```kconfig
config LINGMO_PACKAGE_PERL_X10
	bool "perl-x10"
	depends on !LINGMO_STATIC_LIBS
	select LINGMO_PACKAGE_PERL_ASTRO_SUNTIME # runtime
	select LINGMO_PACKAGE_PERL_DEVICE_SERIALPORT # runtime
	select LINGMO_PACKAGE_PERL_TIME_PARSEDATE # runtime
	help
	  creates a server used to receive events from an x10 client.

	  https://metacpan.org/release/X10

comment "perl-x10 needs a toolchain w/ dynamic library"
	depends on LINGMO_STATIC_LIBS
```

## package/perl-xml-libxml/Config.in
```kconfig
config LINGMO_PACKAGE_PERL_XML_LIBXML
	bool "perl-xml-libxml"
	depends on !LINGMO_STATIC_LIBS
	select LINGMO_PACKAGE_LIBXML2
	select LINGMO_PACKAGE_ZLIB
	select LINGMO_PACKAGE_PERL_XML_NAMESPACESUPPORT # runtime
	select LINGMO_PACKAGE_PERL_XML_SAX # runtime
	select LINGMO_PACKAGE_PERL_XML_SAX_BASE # runtime
	help
	  Interface to Gnome libxml2 xml parsing and DOM library.

	  https://github.com/shlomif/perl-XML-LibXML

comment "perl-xml-libxml needs a toolchain w/ dynamic library"
	depends on LINGMO_STATIC_LIBS
```

## package/perl-xml-sax/Config.in
```kconfig
config LINGMO_PACKAGE_PERL_XML_SAX
	bool "perl-xml-sax"
	select LINGMO_PACKAGE_PERL_XML_NAMESPACESUPPORT # runtime
	select LINGMO_PACKAGE_PERL_XML_SAX_BASE # runtime
	help
	  Simple API for XML.

	  https://metacpan.org/release/XML-SAX
```

## package/petitboot/Config.in
```kconfig
config LINGMO_PACKAGE_PETITBOOT
	bool "petitboot"
	depends on LINGMO_PACKAGE_KEXEC_ARCH_SUPPORTS || LINGMO_PACKAGE_KEXEC_LITE_ARCH_SUPPORTS
	depends on LINGMO_USE_MMU # lvm2
	depends on LINGMO_USE_WCHAR # elfutils, kexec-lite
	depends on !LINGMO_STATIC_LIBS # elfutils, kexec-lite, lvm2
	depends on LINGMO_TOOLCHAIN_HAS_THREADS # elfutils, kexec-lite, lvm2
	depends on LINGMO_PACKAGE_HAS_UDEV
	depends on LINGMO_TOOLCHAIN_HEADERS_AT_LEAST_3_17 || !LINGMO_PACKAGE_KEXEC_ARCH_SUPPORTS # kexec
	select LINGMO_PACKAGE_ELFUTILS
	select LINGMO_PACKAGE_LVM2 # devmapper
	select LINGMO_PACKAGE_NCURSES
	select LINGMO_PACKAGE_NCURSES_WCHAR
	# run-time dependencies
	select LINGMO_PACKAGE_KEXEC if !LINGMO_PACKAGE_KEXEC_LITE_ARCH_SUPPORTS
	select LINGMO_PACKAGE_KEXEC_LITE if LINGMO_PACKAGE_KEXEC_LITE_ARCH_SUPPORTS && !LINGMO_PACKAGE_KEXEC
	select LINGMO_PACKAGE_NVME if ( LINGMO_powerpc || LINGMO_powerpc64 || LINGMO_powerpc64le )
	select LINGMO_PACKAGE_POWERPC_UTILS if ( LINGMO_powerpc || LINGMO_powerpc64 || LINGMO_powerpc64le )
	help
	  Petitboot is a small kexec-based bootloader

	  NOTE: petitboot looks best in a UTF-8 locale; be sure there
	  is one listed in LINGMO_GENERATE_LOCALE.

	  http://www.kernel.org/pub/linux/kernel/people/geoff/petitboot/petitboot.html

if LINGMO_PACKAGE_PETITBOOT

config LINGMO_PACKAGE_PETITBOOT_GETTY_PORT
	string "TTY port(s)"
	default "console"
	help
	  Specify a space-separated list of ports to run the petitboot
	  UI on. Wildcards are allowed. Example: "hvc* ttys0 ttyS*"

endif # LINGMO_PACKAGE_PETITBOOT

comment "petitboot needs a toolchain w/ wchar, dynamic library, threads, udev /dev management"
	depends on LINGMO_PACKAGE_KEXEC_ARCH_SUPPORTS
	depends on LINGMO_USE_MMU
	depends on !LINGMO_USE_WCHAR || LINGMO_STATIC_LIBS || \
		!LINGMO_TOOLCHAIN_HAS_THREADS || \
		!LINGMO_PACKAGE_HAS_UDEV

comment "petitboot w/ kexec needs a toolchain w/ headers >= 3.17"
	depends on LINGMO_PACKAGE_KEXEC_ARCH_SUPPORTS && !LINGMO_PACKAGE_KEXEC_LITE_ARCH_SUPPORTS
	depends on !LINGMO_TOOLCHAIN_HEADERS_AT_LEAST_3_17
```

## package/php-amqp/Config.in
```kconfig
config LINGMO_PACKAGE_PHP_AMQP
	bool "php-amqp"
	depends on LINGMO_TOOLCHAIN_HAS_THREADS # rabbitmq-c
	select LINGMO_PACKAGE_OPENSSL # rabbitmq-c: amqp_ssl_socket.h
	select LINGMO_PACKAGE_RABBITMQ_C
	help
	  Communicate with any AMQP compliant server.

	  http://pecl.php.net/package/amqp

comment "php-amqp needs a toolchain w/ threads"
	depends on !LINGMO_TOOLCHAIN_HAS_THREADS
```

## package/php-apcu/Config.in
```kconfig
config LINGMO_PACKAGE_PHP_APCU
	bool "php-apcu"
	depends on LINGMO_TOOLCHAIN_HAS_THREADS
	help
	  APCu is an in-memory key-value store for PHP.

	  https://pecl.php.net/package/APCu

comment "php-apcu needs a toolchain w/ threads"
	depends on !LINGMO_TOOLCHAIN_HAS_THREADS
```

## package/php-gnupg/Config.in
```kconfig
config LINGMO_PACKAGE_PHP_GNUPG
	bool "php-gnupg"
	depends on LINGMO_PACKAGE_LIBGPG_ERROR_ARCH_SUPPORTS # ligpgme
	depends on LINGMO_USE_MMU # libassuan
	select LINGMO_PACKAGE_LIBGPGME
	help
	  PHP wrapper around the gpgme library.

	  http://pecl.php.net/package/gnupg
```

## package/php-imagick/Config.in
```kconfig
config LINGMO_PACKAGE_PHP_IMAGICK
	bool "php-imagick"
	depends on LINGMO_USE_MMU # imagemagick
	depends on LINGMO_TOOLCHAIN_HAS_THREADS # imagemagick
	select LINGMO_PACKAGE_IMAGEMAGICK
	help
	  PHP wrapper to the ImageMagick library.

	  http://pecl.php.net/package/imagick

comment "php-imagemagick needs a toolchain w/ threads"
	depends on LINGMO_USE_MMU
	depends on !LINGMO_TOOLCHAIN_HAS_THREADS
```

## package/php-lua/Config.in
```kconfig
config LINGMO_PACKAGE_PHP_LUA
	bool "php-lua"
	depends on LINGMO_PACKAGE_HAS_LUAINTERPRETER
	help
	  This extension embeds the lua interpreter and offers an
	  OO-API to lua variables and functions.

	  https://pecl.php.net/package/lua
```

## package/php-memcached/Config.in
```kconfig
config LINGMO_PACKAGE_PHP_MEMCACHED
	bool "php-memcached"
	depends on LINGMO_INSTALL_LIBSTDCPP # libmemcached
	depends on LINGMO_TOOLCHAIN_HAS_THREADS # libmemcached
	select LINGMO_PACKAGE_PHP_EXT_SESSION
	select LINGMO_PACKAGE_LIBMEMCACHED
	select LINGMO_PACKAGE_ZLIB
	help
	  PHP extension for interfacing with memcached via
	  libmemcached library.

	  http://pecl.php.net/package/memcached

comment "php-memcached needs a toolchain w/ C++, threads"
	depends on !LINGMO_INSTALL_LIBSTDCPP || !LINGMO_TOOLCHAIN_HAS_THREADS
```

## package/php-pam/Config.in
```kconfig
config LINGMO_PACKAGE_PHP_PAM
	bool "php-pam"
	depends on LINGMO_ENABLE_LOCALE # linux-pam
	depends on LINGMO_USE_WCHAR # linux-pam
	depends on LINGMO_USE_MMU # linux-pam
	depends on !LINGMO_STATIC_LIBS # linux-pam
	depends on LINGMO_TOOLCHAIN_GCC_AT_LEAST_4_9 # linux-pam
	select LINGMO_PACKAGE_LINUX_PAM
	help
	  PHP PAM (Pluggable Authentication Modules) integration

	  https://pecl.php.net/package/PAM

comment "php-pam needs a toolchain w/ wchar, locale, dynamic library, gcc >= 4.9"
	depends on LINGMO_USE_MMU
	depends on !LINGMO_ENABLE_LOCALE || !LINGMO_USE_WCHAR \
		|| LINGMO_STATIC_LIBS || !LINGMO_TOOLCHAIN_GCC_AT_LEAST_4_9
```

## package/php-pecl-dbus/Config.in
```kconfig
config LINGMO_PACKAGE_PHP_PECL_DBUS
	bool "php-pecl-dbus"
	depends on LINGMO_TOOLCHAIN_HAS_THREADS # dbus
	depends on LINGMO_USE_MMU # dbus
	select LINGMO_PACKAGE_DBUS
	select LINGMO_PACKAGE_LIBXML2
	select LINGMO_PACKAGE_PHP_EXT_LIBXML2 # Runtime dependency
	help
	  PHP extension for interaction with D-Bus busses.

	  https://github.com/derickr/pecl-dbus

comment "php-pecl-dbus needs a toolchain w/ threads"
	depends on LINGMO_USE_MMU
	depends on !LINGMO_TOOLCHAIN_HAS_THREADS
```

## package/php-yaml/Config.in
```kconfig
config LINGMO_PACKAGE_PHP_YAML
	bool "php-yaml"
	select LINGMO_PACKAGE_LIBYAML
	help
	  PHP YAML-1.1 parser and emitter.

	  http://pecl.php.net/package/yaml
```

## package/php-zmq/Config.in
```kconfig
comment "php-zmq needs a toolchain w/ C++, threads"
	depends on !(LINGMO_INSTALL_LIBSTDCPP && LINGMO_TOOLCHAIN_HAS_THREADS)

config LINGMO_PACKAGE_PHP_ZMQ
	bool "php-zmq"
	depends on LINGMO_INSTALL_LIBSTDCPP
	depends on LINGMO_TOOLCHAIN_HAS_THREADS
	select LINGMO_PACKAGE_ZEROMQ
	help
	  ZeroMQ messaging bindings for PHP

	  http://pecl.php.net/package/zmq
```

## package/php/Config.in
```kconfig
config LINGMO_PACKAGE_PHP_ARCH_SUPPORTS
	bool
	# see fiber_cpu in configure.ac
	default y if LINGMO_aarch64 || LINGMO_aarch64_be
	default y if LINGMO_arm || LINGMO_armeb
	default y if LINGMO_i386 || LINGMO_x86_64
	default y if LINGMO_mips || LINGMO_mipsel || LINGMO_mips64 || LINGMO_mips64el
	default y if LINGMO_powerpc || LINGMO_powerpc64 || LINGMO_powerpc64le
	default y if LINGMO_RISCV_64
	default y if LINGMO_s390x
	default y if LINGMO_TOOLCHAIN_HAS_UCONTEXT
	default y if LINGMO_PACKAGE_LIBUCONTEXT_ARCH_SUPPORTS

config LINGMO_PACKAGE_PHP
	bool "php"
	depends on LINGMO_PACKAGE_PHP_ARCH_SUPPORTS
	# PHP uses -export-dynamic, which breaks with elf2flt with a
	# message like "ld.real: section .junk LMA [...,...] overlaps
	# section .text LMA [...,...]"
	depends on !LINGMO_BINFMT_FLAT
	depends on LINGMO_USE_WCHAR
	select LINGMO_PACKAGE_PHP_SAPI_CGI if \
	       !LINGMO_PACKAGE_PHP_SAPI_APACHE && \
	       !LINGMO_PACKAGE_PHP_SAPI_CLI && \
	       !LINGMO_PACKAGE_PHP_SAPI_FPM &&  \
	       LINGMO_USE_MMU
	select LINGMO_PACKAGE_PHP_SAPI_CLI if !LINGMO_USE_MMU
	select LINGMO_PACKAGE_PCRE2
	select LINGMO_PACKAGE_LIBUCONTEXT if \
		LINGMO_PACKAGE_LIBUCONTEXT_ARCH_SUPPORTS
	help
	  PHP  is a widely-used general-purpose scripting
	  language that is especially suited for Web development
	  and can be embedded into HTML.

	  http://www.php.net

if LINGMO_PACKAGE_PHP

config LINGMO_PACKAGE_PHP_SAPI_APACHE
	bool "Apache interface"
	depends on LINGMO_PACKAGE_APACHE
	help
	  Apache module

config LINGMO_PACKAGE_PHP_SAPI_CGI
	bool "CGI interface"
	# CGI uses fork()
	depends on LINGMO_USE_MMU
	help
	  Common Gateway Interface

config LINGMO_PACKAGE_PHP_SAPI_CLI
	bool "CLI interface"
	help
	  Command Line Interface

config LINGMO_PACKAGE_PHP_SAPI_FPM
	bool "FPM interface"
	depends on LINGMO_USE_MMU
	# "Sparc v8 and predecessors are not and will not be supported"
	depends on !LINGMO_sparc
	help
	  PHP-FPM (FastCGI Process Manager)

source "package/php/Config.ext"

endif

comment "php needs a toolchain w/ wchar"
	depends on LINGMO_PACKAGE_PHP_ARCH_SUPPORTS
	depends on !LINGMO_BINFMT_FLAT
	depends on !LINGMO_USE_WCHAR
```

## package/physfs/Config.in
```kconfig
config LINGMO_PACKAGE_PHYSFS
	bool "physfs"
	depends on LINGMO_INSTALL_LIBSTDCPP
	depends on LINGMO_TOOLCHAIN_HAS_THREADS
	help
	  PhysicsFS; a portable, flexible file i/o abstraction.

	  http://icculus.org/physfs

comment "physfs needs a toolchain w/ C++, threads"
	depends on !LINGMO_INSTALL_LIBSTDCPP || !LINGMO_TOOLCHAIN_HAS_THREADS
```

## package/phytool/Config.in
```kconfig
config LINGMO_PACKAGE_PHYTOOL
	bool "phytool"
	depends on LINGMO_TOOLCHAIN_HEADERS_AT_LEAST_3_7 # linux/mdio.h
	help
	  Linux MDIO register access utility.

	  https://github.com/wkz/phytool

comment "phytool needs a toolchain w/ headers >= 3.7"
	depends on !LINGMO_TOOLCHAIN_HEADERS_AT_LEAST_3_7
```

## package/picocom/Config.in
```kconfig
config LINGMO_PACKAGE_PICOCOM
	bool "picocom"
	depends on LINGMO_USE_MMU # fork()
	help
	  picocom is a minimal dumb-terminal emulation program. It is,
	  in principle, very much like minicom, only it's pico instead
	  of mini!

	  https://gitlab.com/wsakernel/picocom
```

## package/pifmrds/Config.in
```kconfig
config LINGMO_PACKAGE_PIFMRDS
	bool "pifmrds"
	depends on LINGMO_arm
	select LINGMO_PACKAGE_LIBSNDFILE
	help
	  pifmrds, FM-RDS transmitter using the Raspberry Pi's PWM

	  https://github.com/ChristopheJacquet/PiFmRds
```

## package/piglit/Config.in
```kconfig
config LINGMO_PACKAGE_PIGLIT
	bool "piglit"
	depends on LINGMO_PACKAGE_PYTHON3 # python3 only script
	depends on LINGMO_PACKAGE_PYTHON_NUMPY_ARCH_SUPPORTS
	depends on LINGMO_PACKAGE_WAFFLE_SUPPORTS_GLX || \
		LINGMO_PACKAGE_WAFFLE_SUPPORTS_WAYLAND || \
		LINGMO_PACKAGE_WAFFLE_SUPPORTS_X11_EGL || \
		LINGMO_PACKAGE_WAFFLE_SUPPORTS_GBM
	depends on LINGMO_INSTALL_LIBSTDCPP # mesa3d-demos, python-numpy
	depends on LINGMO_TOOLCHAIN_USES_GLIBC || LINGMO_TOOLCHAIN_USES_MUSL # python-numpy
	depends on LINGMO_TOOLCHAIN_GCC_AT_LEAST_9 # python-numpy
	depends on LINGMO_HOST_GCC_AT_LEAST_9 # host-python-numpy
	select LINGMO_PACKAGE_LIBDRM if LINGMO_PACKAGE_HAS_LIBGL
	select LINGMO_PACKAGE_LIBPNG
	select LINGMO_PACKAGE_LIBXKBCOMMON if LINGMO_PACKAGE_WAYLAND
	select LINGMO_PACKAGE_MESA3D_DEMOS # glxinfo
	select LINGMO_PACKAGE_PYTHON_MAKO
	select LINGMO_PACKAGE_PYTHON_NUMPY
	select LINGMO_PACKAGE_PYTHON_SIX
	select LINGMO_PACKAGE_PYTHON3_BZIP2
	select LINGMO_PACKAGE_PYTHON3_PYEXPAT
	select LINGMO_PACKAGE_PYTHON3_XZ
	select LINGMO_PACKAGE_PYTHON3_ZLIB
	select LINGMO_PACKAGE_UTIL_LINUX # runtime
	select LINGMO_PACKAGE_UTIL_LINUX_BINARIES # requires real dmesg tool
	select LINGMO_PACKAGE_WAFFLE # wflinfo, libwaffle-1
	select LINGMO_PACKAGE_XLIB_LIBX11 if LINGMO_PACKAGE_XORG7
	select LINGMO_PACKAGE_XLIB_LIBXEXT if LINGMO_PACKAGE_XORG7
	select LINGMO_PACKAGE_XORGPROTO if LINGMO_PACKAGE_XORG7
	select LINGMO_PACKAGE_ZLIB
	help
	  Piglit is an open-source test suite for OpenGL
	  implementations.

	  https://piglit.freedesktop.org

comment "piglit needs a glibc or musl toolchain w/ C++, gcc >= 9, host gcc >= 9"
	depends on !LINGMO_INSTALL_LIBSTDCPP || \
		!LINGMO_TOOLCHAIN_GCC_AT_LEAST_9 || \
		!LINGMO_HOST_GCC_AT_LEAST_9 || \
		!(LINGMO_TOOLCHAIN_USES_GLIBC || LINGMO_TOOLCHAIN_USES_MUSL)
```

## package/pigpio/Config.in
```kconfig
config LINGMO_PACKAGE_PIGPIO
	bool "pigpio"
	depends on LINGMO_aarch64 || LINGMO_arm
	depends on LINGMO_TOOLCHAIN_HAS_THREADS
	depends on !LINGMO_STATIC_LIBS
	help
	  Pigpio is a library for the Raspberry Pi which allows
	  control of the General Purpose Input Outputs (GPIO).

	  http://abyz.me.uk/rpi/pigpio/

comment "pigpio needs a toolchain w/ threads, dynamic library"
	depends on LINGMO_aarch64 || LINGMO_arm
	depends on !LINGMO_TOOLCHAIN_HAS_THREADS || LINGMO_STATIC_LIBS
```

## package/pigz/Config.in
```kconfig
config LINGMO_PACKAGE_PIGZ
	bool "pigz"
	depends on LINGMO_TOOLCHAIN_HAS_THREADS
	select LINGMO_PACKAGE_ZLIB
	help
	  pigz, which stands for parallel implementation of gzip, is a
	  fully functional replacement for gzip that exploits multiple
	  processors and multiple cores to the hilt when compressing
	  data.

	  http://www.zlib.net/pigz/

comment "pigz needs a toolchain w/ threads"
	depends on !LINGMO_TOOLCHAIN_HAS_THREADS
```

## package/pimd/Config.in
```kconfig
config LINGMO_PACKAGE_PIMD
	bool "pimd"
	depends on LINGMO_USE_MMU # fork()
	help
	  pimd is a lightweight stand-alone PIM-SM v2 multicast routing
	  daemon.

	  http://troglobit.com/projects/pimd/
```
