## package/libblockdev/Config.in
```kconfig
config LINGMO_PACKAGE_LIBBLOCKDEV
	bool "libblockdev"
	depends on !LINGMO_STATIC_LIBS # kmod
	depends on LINGMO_USE_WCHAR # libglib2
	depends on LINGMO_TOOLCHAIN_HAS_THREADS # libglib2
	depends on LINGMO_USE_MMU # libglib2
	depends on LINGMO_PACKAGE_HAS_UDEV
	depends on LINGMO_ENABLE_LOCALE
	select LINGMO_PACKAGE_KMOD
	select LINGMO_PACKAGE_LIBGLIB2
	select LINGMO_PACKAGE_UTIL_LINUX
	select LINGMO_PACKAGE_UTIL_LINUX_LIBUUID
	help
	  libblockdev is a C library supporting GObject introspection
	  for manipulation of block devices. It has a plugin-based
	  architecture where each technology (like LVM, Btrfs, MD RAID,
	  Swap,...) is implemented in a separate plugin, possibly with
	  multiple implementations.

	  https://github.com/storaged-project/libblockdev/

if LINGMO_PACKAGE_LIBBLOCKDEV

comment "plugins"

config LINGMO_PACKAGE_LIBBLOCKDEV_CRYPTO
	bool "crypto"
	depends on LINGMO_TOOLCHAIN_HAS_SYNC_4 # cryptsetup -> json-c
	select LINGMO_PACKAGE_CRYPTSETUP
	select LINGMO_PACKAGE_KEYUTILS

config LINGMO_PACKAGE_LIBBLOCKDEV_FS
	bool "filesystem"
	depends on LINGMO_ENABLE_LOCALE # parted
	depends on LINGMO_TOOLCHAIN_GCC_AT_LEAST_5 # parted
	select LINGMO_PACKAGE_UTIL_LINUX_LIBMOUNT
	select LINGMO_PACKAGE_PARTED
	select LINGMO_PACKAGE_E2FSPROGS

comment "filesystem plugin needs a toolchain w/ locale, gcc >= 5"
	depends on !LINGMO_ENABLE_LOCALE || !LINGMO_TOOLCHAIN_GCC_AT_LEAST_5

config LINGMO_PACKAGE_LIBBLOCKDEV_LOOP
	bool "loop"

config LINGMO_PACKAGE_LIBBLOCKDEV_LVM2
	bool "lvm2"
	depends on LINGMO_ENABLE_LOCALE # parted
	depends on LINGMO_TOOLCHAIN_GCC_AT_LEAST_5 # parted
	select LINGMO_PACKAGE_PARTED
	select LINGMO_PACKAGE_LVM2

comment "lvm2 support needs a toolchain w/ locale, gcc >= 5"
	depends on !LINGMO_ENABLE_LOCALE || !LINGMO_TOOLCHAIN_GCC_AT_LEAST_5

config LINGMO_PACKAGE_LIBBLOCKDEV_MDRAID
	bool "mdraid"
	select LINGMO_PACKAGE_LIBBYTESIZE

config LINGMO_PACKAGE_LIBBLOCKDEV_NVME
	bool "nvme"
	select LINGMO_PACKAGE_LIBNVME

config LINGMO_PACKAGE_LIBBLOCKDEV_PART
	bool "part"
	depends on LINGMO_ENABLE_LOCALE # parted
	depends on LINGMO_TOOLCHAIN_GCC_AT_LEAST_5 # parted
	select LINGMO_PACKAGE_PARTED
	select LINGMO_PACKAGE_UTIL_LINUX_LIBFDISK

comment "part plugin needs a toolchain w/ locale, gcc >= 5"
	depends on !LINGMO_ENABLE_LOCALE || !LINGMO_TOOLCHAIN_GCC_AT_LEAST_5

config LINGMO_PACKAGE_LIBBLOCKDEV_SWAP
	bool "swap"
	select LINGMO_PACKAGE_UTIL_LINUX_LIBBLKID

endif

comment "libblockdev needs udev /dev management and a toolchain w/ wchar, threads, dynamic library, locale"
	depends on LINGMO_USE_MMU
	depends on !LINGMO_PACKAGE_HAS_UDEV || LINGMO_STATIC_LIBS || \
		!LINGMO_USE_WCHAR || !LINGMO_TOOLCHAIN_HAS_THREADS || \
		!LINGMO_ENABLE_LOCALE
```

## package/libbluray/Config.in
```kconfig
config LINGMO_PACKAGE_LIBBLURAY
	bool "libbluray"
	depends on LINGMO_TOOLCHAIN_HAS_THREADS
	depends on !LINGMO_STATIC_LIBS
	help
	  libbluray is a client library for accessing bluray disks.

	  http://www.videolan.org/developers/libbluray.html

comment "libbluray needs a toolchain w/ threads, dynamic library"
	depends on !LINGMO_TOOLCHAIN_HAS_THREADS || LINGMO_STATIC_LIBS
```

## package/libbpf/Config.in
```kconfig
config LINGMO_PACKAGE_LIBBPF
	bool "libbpf"
	depends on LINGMO_TOOLCHAIN_HAS_SYNC_4
	depends on LINGMO_USE_WCHAR # elfutils
	depends on !LINGMO_STATIC_LIBS # elfutils
	depends on LINGMO_TOOLCHAIN_HAS_THREADS # elfutils
	depends on LINGMO_TOOLCHAIN_HEADERS_AT_LEAST_4_13
	select LINGMO_PACKAGE_ELFUTILS
	select LINGMO_PACKAGE_ZLIB
	help
	  libbpf library.
	  A mirror of bpf-next linux tree bpf-next/tools/lib/bpf
	  directory plus its supporting header files. The version
	  of the package reflects the version of ABI.

	  https://github.com/libbpf/libbpf

comment "libbpf needs a toolchain w/ wchar, dynamic library, threads, headers >= 4.13"
	depends on LINGMO_TOOLCHAIN_HAS_SYNC_4
	depends on !LINGMO_USE_WCHAR || LINGMO_STATIC_LIBS \
		|| !LINGMO_TOOLCHAIN_HAS_THREADS \
		|| !LINGMO_TOOLCHAIN_HEADERS_AT_LEAST_4_13
```

## package/libbsd/Config.in
```kconfig
config LINGMO_PACKAGE_LIBBSD_ARCH_SUPPORTS
	bool
	default y
	# libbsd does not support those architectures (see src/local-elf.h)
	depends on !LINGMO_microblaze
	depends on !LINGMO_arc
	depends on !LINGMO_xtensa

config LINGMO_PACKAGE_LIBBSD
	bool "libbsd"
	depends on LINGMO_PACKAGE_LIBBSD_ARCH_SUPPORTS
	depends on !LINGMO_STATIC_LIBS
	depends on LINGMO_TOOLCHAIN_HAS_THREADS
	depends on LINGMO_USE_WCHAR
	select LINGMO_PACKAGE_LIBMD
	help
	  This library provides useful functions commonly found on BSD
	  systems, and lacking on others like GNU systems, thus making
	  it easier to port projects with strong BSD origins, without
	  needing to embed the same code over and over again on each
	  project.

	  http://libbsd.freedesktop.org/

comment "libbsd needs a toolchain w/ dynamic library, threads, wchar"
	depends on LINGMO_PACKAGE_LIBBSD_ARCH_SUPPORTS
	depends on LINGMO_STATIC_LIBS || !LINGMO_TOOLCHAIN_HAS_THREADS || \
		!LINGMO_USE_WCHAR
```

## package/libbson/Config.in
```kconfig
config LINGMO_PACKAGE_LIBBSON
	bool "libbson"
	depends on LINGMO_TOOLCHAIN_HAS_THREADS
	help
	  libbson is a library providing useful routines related to
	  building, parsing, and iterating BSON documents.

	  http://mongoc.org/libbson/

comment "libbson needs a toolchain w/ threads"
	depends on !LINGMO_TOOLCHAIN_HAS_THREADS
```

## package/libbytesize/Config.in
```kconfig
config LINGMO_PACKAGE_LIBBYTESIZE
	bool "libbytesize"
	select LINGMO_PACKAGE_GMP
	select LINGMO_PACKAGE_MPFR
	select LINGMO_PACKAGE_PCRE2
	help
	  A tiny library that facilitates the common operations with
	  sizes in bytes

	  https://github.com/storaged-project/libbytesize/
```

## package/libcamera-apps/Config.in
```kconfig
config LINGMO_PACKAGE_LIBCAMERA_APPS
	bool "libcamera-apps"
	depends on LINGMO_PACKAGE_LIBCAMERA_ARCH_SUPPORTS # libcamera
	depends on LINGMO_INSTALL_LIBSTDCPP # libcamera/boost
	depends on LINGMO_TOOLCHAIN_HAS_THREADS # libcamera/boost
	depends on LINGMO_TOOLCHAIN_GCC_AT_LEAST_8 # libcamera
	depends on !LINGMO_STATIC_LIBS # gnutls/libcamera
	depends on LINGMO_USE_WCHAR # gnutls/libcamera/boost
	select LINGMO_PACKAGE_BOOST
	select LINGMO_PACKAGE_BOOST_PROGRAM_OPTIONS
	select LINGMO_PACKAGE_JPEG
	select LINGMO_PACKAGE_LIBCAMERA
	select LINGMO_PACKAGE_LIBEXIF
	select LINGMO_PACKAGE_LIBPNG
	select LINGMO_PACKAGE_TIFF
	select LINGMO_PACKAGE_XLIB_LIBX11 if LINGMO_PACKAGE_XORG7 && (LINGMO_PACKAGE_HAS_LIBEGL || LINGMO_PACKAGE_HAS_LIBGL)
	select LINGMO_PACKAGE_LIBDRM if LINGMO_PACKAGE_XORG7 && (LINGMO_PACKAGE_HAS_LIBEGL || LINGMO_PACKAGE_HAS_LIBGL)
	select LINGMO_PACKAGE_LIBEPOXY if LINGMO_PACKAGE_XORG7 && (LINGMO_PACKAGE_HAS_LIBEGL || LINGMO_PACKAGE_HAS_LIBGL)
	select LINGMO_PACKAGE_QT5BASE_GUI if LINGMO_PACKAGE_QT5
	select LINGMO_PACKAGE_QT5BASE_WIDGETS if LINGMO_PACKAGE_QT5
	help
	  This is a small suite of libcamera-based apps that aim to copy
	  the functionality of the existing "raspicam" apps.

	  https://github.com/raspberrypi/libcamera-apps

comment "libcamera-apps needs a toolchain w/ C++, threads, wchar, dynamic library, gcc >= 8"
	depends on LINGMO_PACKAGE_LIBCAMERA_ARCH_SUPPORTS
	depends on !LINGMO_INSTALL_LIBSTDCPP || !LINGMO_TOOLCHAIN_HAS_THREADS || \
		!LINGMO_TOOLCHAIN_GCC_AT_LEAST_8 || LINGMO_STATIC_LIBS || !LINGMO_USE_WCHAR
```

## package/libcamera/Config.in
```kconfig
config LINGMO_PACKAGE_LIBCAMERA_ARCH_SUPPORTS
	bool
	default y
	# Invalid packing size of ControlValue struct on m68k
	depends on !LINGMO_m68k
	depends on !LINGMO_TOOLCHAIN_HAS_BINUTILS_BUG_27597

menuconfig LINGMO_PACKAGE_LIBCAMERA
	bool "libcamera"
	depends on LINGMO_PACKAGE_LIBCAMERA_ARCH_SUPPORTS
	depends on LINGMO_INSTALL_LIBSTDCPP
	depends on LINGMO_TOOLCHAIN_HAS_THREADS
	depends on LINGMO_TOOLCHAIN_GCC_AT_LEAST_8 # C++17
	depends on !LINGMO_STATIC_LIBS # gnutls
	depends on LINGMO_USE_WCHAR # gnutls
	select LINGMO_PACKAGE_GNUTLS
	select LINGMO_PACKAGE_LIBYAML
	select LINGMO_PACKAGE_LIBCAMERA_PIPELINE_UVCVIDEO if !LINGMO_PACKAGE_LIBCAMERA_HAS_PIPELINE
	help
	  libcamera provides a software stack to support
	  complex devices that need heavy hardware image
	  processing operations.

	  http://www.libcamera.org/

if LINGMO_PACKAGE_LIBCAMERA

config LINGMO_PACKAGE_LIBCAMERA_V4L2
	bool "libcamera v4l2 compatibility layer"
	help
	  libcamera v4l2 compatibility layer

config LINGMO_PACKAGE_LIBCAMERA_HAS_PIPELINE
	bool

config LINGMO_PACKAGE_LIBCAMERA_PIPELINE_IMX8_ISI
	bool "imx8-isi pipeline"
	depends on LINGMO_arm || LINGMO_aarch64
	select LINGMO_PACKAGE_LIBCAMERA_HAS_PIPELINE
	help
	  Pipeline for i.MX8 SoC ISI capture interface.

config LINGMO_PACKAGE_LIBCAMERA_PIPELINE_IPU3
	bool "ipu3 pipeline"
	depends on LINGMO_i386 || LINGMO_x86_64
	select LINGMO_PACKAGE_LIBCAMERA_HAS_PIPELINE
	help
	  Pipeline for Intel IPU3.

config LINGMO_PACKAGE_LIBCAMERA_PIPELINE_RKISP1
	bool "rkisp1 pipeline"
	depends on LINGMO_arm || LINGMO_aarch64
	select LINGMO_PACKAGE_LIBCAMERA_HAS_PIPELINE
	help
	  Pipeline for Rockchip ISP1.

config LINGMO_PACKAGE_LIBCAMERA_PIPELINE_RPI_VC4
	bool "rpi/vc4 pipeline"
	depends on LINGMO_arm || LINGMO_aarch64
	depends on LINGMO_USE_WCHAR # boost (already enforced for gnutls)
	select LINGMO_PACKAGE_BOOST
	select LINGMO_PACKAGE_LIBCAMERA_HAS_PIPELINE
	help
	  Pipeline for Raspberry Pi devices.

config LINGMO_PACKAGE_LIBCAMERA_PIPELINE_SIMPLE
	bool "simple pipeline"
	select LINGMO_PACKAGE_LIBCAMERA_HAS_PIPELINE
	help
	  Pipeline for simple pipelines.

config LINGMO_PACKAGE_LIBCAMERA_PIPELINE_UVCVIDEO
	bool "uvcvideo pipeline"
	help
	  Pipeline for uvcvideo devices.

config LINGMO_PACKAGE_LIBCAMERA_PIPELINE_VIMC
	bool "vimc pipeline"
	select LINGMO_PACKAGE_LIBCAMERA_HAS_PIPELINE
	help
	  Pipeline for the vimc device.

config LINGMO_PACKAGE_LIBCAMERA_COMPLIANCE
	bool "lc-compliance test application"
	depends on LINGMO_USE_WCHAR # gtest
	depends on LINGMO_TOOLCHAIN_HAS_THREADS # gtest
	depends on LINGMO_INSTALL_LIBSTDCPP # gtest
	depends on LINGMO_TOOLCHAIN_GCC_AT_LEAST_5 # gtest
	depends on LINGMO_USE_MMU # gtest
	select LINGMO_PACKAGE_GTEST
	select LINGMO_PACKAGE_LIBEVENT
	help
	  lc-compliance test application

comment "lc-compliance test application needs a toolchain w/ C++, wchar, threads, gcc >= 5"
	depends on LINGMO_USE_MMU
	depends on !LINGMO_USE_WCHAR || !LINGMO_TOOLCHAIN_HAS_THREADS || \
		!LINGMO_INSTALL_LIBSTDCPP || !LINGMO_TOOLCHAIN_GCC_AT_LEAST_5

endif # LINGMO_PACKAGE_LIBCAMERA

comment "libcamera needs a toolchain w/ C++, threads, wchar, dynamic library, gcc >= 8"
	depends on LINGMO_PACKAGE_LIBCAMERA_ARCH_SUPPORTS
	depends on !LINGMO_INSTALL_LIBSTDCPP || !LINGMO_TOOLCHAIN_HAS_THREADS || \
		!LINGMO_TOOLCHAIN_GCC_AT_LEAST_8 || LINGMO_STATIC_LIBS || !LINGMO_USE_WCHAR
```

## package/libcanberra/Config.in
```kconfig
comment "libcanberra needs a toolchain w/ wchar, threads, dynamic library"
	depends on !LINGMO_USE_WCHAR || !LINGMO_TOOLCHAIN_HAS_THREADS || \
		LINGMO_STATIC_LIBS

config LINGMO_PACKAGE_LIBCANBERRA
	bool "libcanberra"
	depends on LINGMO_USE_WCHAR
	depends on LINGMO_TOOLCHAIN_HAS_THREADS
	depends on !LINGMO_STATIC_LIBS
	# We need at least one audio backend
	select LINGMO_PACKAGE_ALSA_LIB if \
	       !LINGMO_PACKAGE_PULSEAUDIO && \
	       !LINGMO_PACKAGE_GSTREAMER1
	# We need libltdl
	select LINGMO_PACKAGE_LIBTOOL
	select LINGMO_PACKAGE_LIBVORBIS
	help
	  libcanberra defines a simple abstract interface for playing
	  event sounds.

	  http://0pointer.de/lennart/projects/libcanberra/
```

## package/libcdio-paranoia/Config.in
```kconfig
config LINGMO_PACKAGE_LIBCDIO_PARANOIA
	bool "libcdio-paranoia"
	depends on LINGMO_USE_MMU # libcdio
	select LINGMO_PACKAGE_LIBCDIO
	help
	  CD paranoia on top of libcdio

	  http://www.gnu.org/software/libcdio/
```

## package/libcdio/Config.in
```kconfig
config LINGMO_PACKAGE_LIBCDIO
	bool "libcdio"
	depends on LINGMO_USE_MMU # fork()
	select LINGMO_PACKAGE_LIBICONV if !LINGMO_ENABLE_LOCALE
	help
	  The GNU Compact Disc Input and Control library.

	  http://www.gnu.org/software/libcdio/
```

## package/libcec/Config.in
```kconfig
config LINGMO_PACKAGE_LIBCEC
	bool "libcec"
	depends on LINGMO_INSTALL_LIBSTDCPP
	depends on LINGMO_TOOLCHAIN_HAS_THREADS
	depends on LINGMO_USE_WCHAR
	depends on !LINGMO_STATIC_LIBS
	depends on LINGMO_TOOLCHAIN_GCC_AT_LEAST_4_7 # C++11
	select LINGMO_PACKAGE_LIBPLATFORM
	help
	  libcec allows you in combination with the right hardware to
	  control your home theater devices with your TV remote
	  control utilizing existing HDMI cabling.

	  http://libcec.pulse-eight.com

comment "libcec needs a toolchain w/ C++, wchar, threads, dynamic library, gcc >= 4.7"
	depends on !LINGMO_INSTALL_LIBSTDCPP || !LINGMO_TOOLCHAIN_HAS_THREADS || \
		!LINGMO_USE_WCHAR || !LINGMO_TOOLCHAIN_GCC_AT_LEAST_4_7 || \
		LINGMO_STATIC_LIBS
```

## package/libcgroup/Config.in
```kconfig
config LINGMO_PACKAGE_LIBCGROUP
	bool "libcgroup"
	depends on LINGMO_INSTALL_LIBSTDCPP
	depends on LINGMO_TOOLCHAIN_HAS_THREADS
	select LINGMO_PACKAGE_MUSL_FTS if !LINGMO_TOOLCHAIN_USES_GLIBC
	help
	  libcgroup is a library that abstracts the control
	  group file system in Linux.

	  http://libcg.sourceforge.net/

if LINGMO_PACKAGE_LIBCGROUP

config LINGMO_PACKAGE_LIBCGROUP_TOOLS
	bool "install tools"
	help
	  Include a set of command-line tools for managing cgroups.

endif

comment "libcgroup needs a toolchain w/ C++, threads"
	depends on !LINGMO_INSTALL_LIBSTDCPP || !LINGMO_TOOLCHAIN_HAS_THREADS
```

## package/libcofi/Config.in
```kconfig
config LINGMO_PACKAGE_LIBCOFI
	bool "libcofi"
	depends on LINGMO_arm
	# builds a shared library
	depends on !LINGMO_STATIC_LIBS
	help
	  A replacement for memcpy and memset functionality for the
	  Raspberry Pi with the intention of gaining greater
	  performance.

	  https://github.com/simonjhall/copies-and-fills

comment "libcofi needs a toolchain w/ dynamic library"
	depends on LINGMO_arm
	depends on LINGMO_STATIC_LIBS
```

## package/libcorrect/Config.in
```kconfig
config LINGMO_PACKAGE_LIBCORRECT
	bool "libcorrect"
	depends on !LINGMO_STATIC_LIBS
	help
	  A C library for Forward Error Correction, providing
	  convolutional codes and Reed-Solomon codes. It is part
	  of the Quiet Modem Project.

	  https://github.com/quiet/libcorrect

comment "libcorrect needs a toolchain w/ dynamic library"
	depends on LINGMO_STATIC_LIBS
```

## package/libcpprestsdk/Config.in
```kconfig
config LINGMO_PACKAGE_LIBCPPRESTSDK
	bool "libcpprestsdk"
	depends on LINGMO_ENABLE_LOCALE
	depends on LINGMO_INSTALL_LIBSTDCPP
	depends on LINGMO_USE_WCHAR # boost
	depends on LINGMO_TOOLCHAIN_SUPPORTS_ALWAYS_LOCKFREE_ATOMIC_INTS # boost-atomic, boost-filesystem
	depends on !LINGMO_TOOLCHAIN_HAS_GCC_BUG_64735 # exception_ptr
	depends on LINGMO_TOOLCHAIN_HAS_THREADS_NPTL
	select LINGMO_PACKAGE_BOOST
	select LINGMO_PACKAGE_BOOST_ATOMIC
	select LINGMO_PACKAGE_BOOST_CHRONO
	select LINGMO_PACKAGE_BOOST_DATE_TIME
	select LINGMO_PACKAGE_BOOST_FILESYSTEM
	select LINGMO_PACKAGE_BOOST_RANDOM
	select LINGMO_PACKAGE_BOOST_REGEX
	select LINGMO_PACKAGE_BOOST_THREAD
	select LINGMO_PACKAGE_OPENSSL
	help
	  The C++ REST SDK is a Microsoft project for cloud-based
	  client-server communication in native code using a modern
	  asynchronous C++ API design. This project aims to help C++
	  developers connect to and interact with services.

	  https://github.com/Microsoft/cpprestsdk

comment "libcpprestsdk needs a toolchain w/ NPTL, C++, wchar, locale"
	depends on LINGMO_TOOLCHAIN_SUPPORTS_ALWAYS_LOCKFREE_ATOMIC_INTS
	depends on !LINGMO_TOOLCHAIN_HAS_THREADS_NPTL || \
		!LINGMO_INSTALL_LIBSTDCPP || \
		!LINGMO_USE_WCHAR || !LINGMO_ENABLE_LOCALE

comment "libcpprestsdk needs exception_ptr"
	depends on LINGMO_TOOLCHAIN_HAS_GCC_BUG_64735
```
