## package/libcrossguid/Config.in
```kconfig
config LINGMO_PACKAGE_LIBCROSSGUID
	bool "libcrossguid"
	depends on LINGMO_INSTALL_LIBSTDCPP
	depends on LINGMO_TOOLCHAIN_GCC_AT_LEAST_4_7 # C++11
	select LINGMO_PACKAGE_UTIL_LINUX
	select LINGMO_PACKAGE_UTIL_LINUX_LIBUUID
	help
	  Lightweight cross platform C++ GUID/UUID library

	  https://github.com/graeme-hill/crossguid

comment "libcrossguid needs a toolchain w/ C++, gcc >= 4.7"
	depends on !LINGMO_INSTALL_LIBSTDCPP || !LINGMO_TOOLCHAIN_GCC_AT_LEAST_4_7
```

## package/libcue/Config.in
```kconfig
config LINGMO_PACKAGE_LIBCUE
	bool "libcue"
	select LINGMO_PACKAGE_FLEX
	help
	  CUE Sheet Parser Library

	  https://github.com/lipnitsk/libcue
```

## package/libcuefile/Config.in
```kconfig
config LINGMO_PACKAGE_LIBCUEFILE
	bool "libcuefile"
	help
	  Cue File library from Musepack

	  http://www.musepack.net/
```

## package/libdbi-drivers/Config.in
```kconfig
config LINGMO_PACKAGE_LIBDBI_DRIVERS
	bool "libdbi-drivers"
	depends on !LINGMO_STATIC_LIBS # libdbi
	select LINGMO_PACKAGE_LIBDBI
	help
	  The libdbi-drivers project provides the
	  database-specific drivers for the libdbi framework.

	  http://libdbi-drivers.sourceforge.net

comment "libdbi-drivers needs a toolchain w/ dynamic library"
	depends on LINGMO_STATIC_LIBS
```

## package/libdbi/Config.in
```kconfig
config LINGMO_PACKAGE_LIBDBI
	bool "lidbi"
	depends on !LINGMO_STATIC_LIBS
	help
	  libdbi implements a database-independent abstraction layer
	  in C, similar to the DBI/DBD layer in Perl.

	  http://libdbi.sourceforge.net

comment "libdbi needs a toolchain w/ dynamic library"
	depends on LINGMO_STATIC_LIBS
```

## package/libde265/Config.in
```kconfig
config LINGMO_PACKAGE_LIBDE265
	bool "libde265"
	depends on LINGMO_INSTALL_LIBSTDCPP
	depends on LINGMO_TOOLCHAIN_HAS_THREADS
	help
	  libde265 is an open source implementation of the h.265 video
	  codec.

	  https://github.com/strukturag/libde265

comment "libde265 needs a toolchain w/ threads, C++"
	depends on !LINGMO_TOOLCHAIN_HAS_THREADS || !LINGMO_INSTALL_LIBSTDCPP
```

## package/libdecor/Config.in
```kconfig
config LINGMO_PACKAGE_LIBDECOR
	bool "libdecor"
	depends on !LINGMO_STATIC_LIBS # wayland
	depends on LINGMO_USE_MMU # pango
	depends on LINGMO_USE_WCHAR # pango
	depends on LINGMO_TOOLCHAIN_HAS_SYNC_4 # pango
	depends on LINGMO_TOOLCHAIN_GCC_AT_LEAST_4_9 # pango
	depends on LINGMO_INSTALL_LIBSTDCPP # pango
	depends on LINGMO_TOOLCHAIN_HAS_THREADS # pango, wayland
	select LINGMO_PACKAGE_CAIRO
	select LINGMO_PACKAGE_PANGO
	select LINGMO_PACKAGE_WAYLAND
	select LINGMO_PACKAGE_WAYLAND_PROTOCOLS
	help
	  libdecor is a library that can help Wayland clients draw
	  window decorations for them. It aims to provide multiple
	  backends that implements the decoration drawing.

	  https://gitlab.freedesktop.org/libdecor/libdecor

comment "libdecor needs a toolchain w/ wchar, threads, C++, gcc >= 4.9"
	depends on LINGMO_USE_MMU
	depends on LINGMO_TOOLCHAIN_HAS_SYNC_4
	depends on !LINGMO_INSTALL_LIBSTDCPP || !LINGMO_TOOLCHAIN_HAS_THREADS || \
		!LINGMO_USE_WCHAR || !LINGMO_TOOLCHAIN_GCC_AT_LEAST_4_9
```

## package/libdisplay-info/Config.in
```kconfig
config LINGMO_PACKAGE_LIBDISPLAY_INFO
	bool "libdisplay-info"
	select LINGMO_PACKAGE_HWDATA
	select LINGMO_PACKAGE_HWDATA_PNP_IDS
	help
	  EDID and DisplayID library.

	  https://gitlab.freedesktop.org/emersion/libdisplay-info
```

## package/libdnet/Config.in
```kconfig
config LINGMO_PACKAGE_LIBDNET
	bool "libdnet"
	help
	  libdnet - simplified interface to low-level networking
	  routines.

	  http://libdnet.sourceforge.net/

if LINGMO_PACKAGE_LIBDNET

config LINGMO_PACKAGE_LIBDNET_PYTHON
	bool "libdnet python module"
	depends on LINGMO_PACKAGE_LIBBSD_ARCH_SUPPORTS
	depends on LINGMO_PACKAGE_PYTHON3
	depends on !LINGMO_STATIC_LIBS # libbsd
	depends on LINGMO_TOOLCHAIN_HAS_THREADS # libbsd
	depends on LINGMO_USE_WCHAR # libbsd
	select LINGMO_PACKAGE_LIBBSD
	help
	  dnet module for python

comment "dnet module for python requires python3 package"
	depends on LINGMO_PACKAGE_LIBBSD_ARCH_SUPPORTS
	depends on !LINGMO_PACKAGE_PYTHON3

comment "dnet module for python needs a toolchain w/ dynamic library, threads, wchar"
	depends on LINGMO_PACKAGE_LIBBSD_ARCH_SUPPORTS
	depends on LINGMO_STATIC_LIBS || !LINGMO_TOOLCHAIN_HAS_THREADS || \
		!LINGMO_USE_WCHAR

endif
```
