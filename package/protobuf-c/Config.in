## package/protobuf-c/Config.in
```kconfig
config LINGMO_PACKAGE_PROTOBUF_C
	bool "protobuf-c"
	depends on LINGMO_INSTALL_LIBSTDCPP
	depends on LINGMO_TOOLCHAIN_HAS_THREADS
	# host-protobuf only builds on certain architectures
	depends on LINGMO_PACKAGE_HOST_PROTOBUF_ARCH_SUPPORTS
	depends on LINGMO_HOST_GCC_AT_LEAST_7 # c++17 for host variant
	help
	  Code generator and runtime libraries to use Protocol Buffers
	  from pure C (not C++).

	  https://github.com/protobuf-c/protobuf-c

comment "protobuf-c needs a toolchain w/ C++, threads, host gcc >= 7"
	depends on !LINGMO_INSTALL_LIBSTDCPP || !LINGMO_TOOLCHAIN_HAS_THREADS || !LINGMO_HOST_GCC_AT_LEAST_7
	depends on LINGMO_PACKAGE_HOST_PROTOBUF_ARCH_SUPPORTS
```

## package/protobuf/Config.in
```kconfig
# See src/google/protobuf/stubs/platform_macros.h for supported archs.
#
# On PowerPC, the __atomic_*() built-ins for 1-byte, 2-byte and 4-byte
# types are available built-in. However, the __atomic_*() built-ins for
# 8-byte types is implemented via libatomic, so only available since gcc
# 4.8.
#
# In Buildroot, to simplify things, we've decided to simply require gcc
# 4.8 as soon as the architectures has at least one __atomic_*() built-in
# variant that requires libatomic.
#
# Since protobuf most likely only uses the 1, 2 and 4-byte variants, it
# *could* technically build with gcc 4.7. This is probably not a big deal,
# and we can live with requiring gcc 4.8 on PowerPC to build protobuf.
#
# host-protobuf only builds on certain architectures
config LINGMO_PACKAGE_HOST_PROTOBUF_ARCH_SUPPORTS
	bool
	default y if LINGMO_HOSTARCH = "aarch64"
	default y if LINGMO_HOSTARCH = "arm"
	default y if LINGMO_HOSTARCH = "mips"
	default y if LINGMO_HOSTARCH = "mipsel"
	default y if LINGMO_HOSTARCH = "powerpc"
	default y if LINGMO_HOSTARCH = "powerpc64"
	default y if LINGMO_HOSTARCH = "powerpc64le"
	default y if LINGMO_HOSTARCH = "sparc"
	default y if LINGMO_HOSTARCH = "sparc64"
	default y if LINGMO_HOSTARCH = "x86"
	default y if LINGMO_HOSTARCH = "x86_64"

config LINGMO_PACKAGE_PROTOBUF_ARCH_SUPPORTS
	bool
	default y if LINGMO_arm
	default y if LINGMO_i386
	default y if LINGMO_mipsel
	default y if LINGMO_x86_64
	default y if LINGMO_sparc64
	default y if LINGMO_TOOLCHAIN_HAS_ATOMIC
	depends on LINGMO_PACKAGE_HOST_PROTOBUF_ARCH_SUPPORTS
	depends on LINGMO_USE_MMU # fork()

config LINGMO_PACKAGE_PROTOBUF
	bool "protobuf"
	depends on LINGMO_INSTALL_LIBSTDCPP
	depends on LINGMO_TOOLCHAIN_HAS_THREADS
	depends on LINGMO_PACKAGE_PROTOBUF_ARCH_SUPPORTS
	depends on LINGMO_TOOLCHAIN_GCC_AT_LEAST_4_8 # C++11
	depends on !LINGMO_STATIC_LIBS
	help
	  Protocol buffers are Google's language-neutral,
	  platform-neutral, extensible mechanism for serializing
	  structured data.

	  https://developers.google.com/protocol-buffers

comment "protobuf needs a toolchain w/ C++, threads, dynamic library, gcc >= 4.8"
	depends on !LINGMO_INSTALL_LIBSTDCPP || !LINGMO_TOOLCHAIN_HAS_THREADS \
		|| LINGMO_STATIC_LIBS || !LINGMO_TOOLCHAIN_GCC_AT_LEAST_4_8
	depends on LINGMO_PACKAGE_PROTOBUF_ARCH_SUPPORTS
```

## package/proxychains-ng/Config.in
```kconfig
config LINGMO_PACKAGE_PROXYCHAINS_NG
	bool "proxychains-ng"
	depends on LINGMO_TOOLCHAIN_HAS_THREADS
	depends on !LINGMO_STATIC_LIBS
	help
	  Force any tcp connections to flow through a proxy (or proxy
	  chain)

	  https://github.com/rofl0r/proxychains

comment "proxychains-ng needs a toolchain w/ threads, dynamic library"
	depends on !LINGMO_TOOLCHAIN_HAS_THREADS || LINGMO_STATIC_LIBS
```

## package/pru-software-support/Config.in
```kconfig
config LINGMO_PACKAGE_PRU_SOFTWARE_SUPPORT
	bool "pru-software-support"
	depends on LINGMO_PACKAGE_HOST_TI_CGT_PRU_ARCH_SUPPORTS
	select LINGMO_PACKAGE_HOST_PRU_SOFTWARE_SUPPORT
	help
	  PRU firmware examples extracted from TI's PRU software
	  support package. See readme.txt for installation details.

	  https://git.ti.com/pru-software-support-package/pru-software-support-package
```

## package/psmisc/Config.in
```kconfig
config LINGMO_PACKAGE_PSMISC
	bool "psmisc"
	depends on LINGMO_PACKAGE_BUSYBOX_SHOW_OTHERS
	select LINGMO_PACKAGE_NCURSES
	help
	  Helpful /proc related utilities such as pstree, fuser, and
	  killall

	  https://gitlab.com/psmisc/psmisc
```

## package/ptm2human/Config.in
```kconfig
config LINGMO_PACKAGE_PTM2HUMAN_ARCH_SUPPORTS
	bool
	default y if LINGMO_arm
	default y if LINGMO_armeb
	default y if LINGMO_aarch64
	default y if LINGMO_aarch64_be

config LINGMO_PACKAGE_PTM2HUMAN
	bool "ptm2human"
	depends on LINGMO_PACKAGE_PTM2HUMAN_ARCH_SUPPORTS
	help
	  ptm2human is a decoder for trace data outputted by Program
	  Trace Macrocell (PTM) and Embedded Trace Macrocell
	  (ETMv4). It deconstructs ID packets and data packets
	  from the formatter of ARM Coresight ETB, and then
	  translates the trace data to a human-readable format.

	  https://github.com/hwangcc23/ptm2human
```

## package/pulseaudio/Config.in
```kconfig
config LINGMO_PACKAGE_PULSEAUDIO_HAS_ATOMIC
	bool
	default y if LINGMO_PACKAGE_LIBATOMIC_OPS_ARCH_SUPPORTS || \
		LINGMO_TOOLCHAIN_HAS_SYNC_4

config LINGMO_PACKAGE_PULSEAUDIO_ENABLE_ATOMIC
	bool
	select LINGMO_PACKAGE_LIBATOMIC_OPS if !LINGMO_TOOLCHAIN_HAS_SYNC_4

config LINGMO_PACKAGE_PULSEAUDIO
	bool "pulseaudio"
	depends on LINGMO_PACKAGE_PULSEAUDIO_HAS_ATOMIC
	depends on LINGMO_USE_WCHAR
	depends on LINGMO_TOOLCHAIN_HAS_THREADS
	depends on !LINGMO_STATIC_LIBS
	depends on LINGMO_USE_MMU # fork()
	select LINGMO_PACKAGE_ALSA_LIB_PCM if LINGMO_PACKAGE_ALSA_LIB
	select LINGMO_PACKAGE_ALSA_LIB_MIXER if LINGMO_PACKAGE_ALSA_LIB
	select LINGMO_PACKAGE_ALSA_LIB_UCM if LINGMO_PACKAGE_ALSA_LIB
	select LINGMO_PACKAGE_BLUEZ5_UTILS_PLUGINS_AUDIO if LINGMO_PACKAGE_BLUEZ5_UTILS # runtime
	select LINGMO_PACKAGE_LIBGLIB2
	select LINGMO_PACKAGE_LIBTOOL
	select LINGMO_PACKAGE_LIBSNDFILE
	select LINGMO_PACKAGE_PULSEAUDIO_ENABLE_ATOMIC
	help
	  PulseAudio is a sound system for POSIX OSes, meaning that it
	  is a proxy for your sound applications. It allows you to do
	  advanced operations on your sound data as it passes between
	  your application and your hardware. Things like transferring
	  the audio to a different machine, changing the sample format
	  or channel count and mixing several sounds into one are
	  easily achieved using a sound server.

	  http://pulseaudio.org

if LINGMO_PACKAGE_PULSEAUDIO

config LINGMO_PACKAGE_PULSEAUDIO_DAEMON
	bool "start as a system daemon"
	help
	  PulseAudio can be started as a system daemon. This is not the
	  recommended way of using PulseAudio unless you are building a
	  headless system.

endif

comment "pulseaudio needs a toolchain w/ wchar, threads, dynamic library"
	depends on LINGMO_USE_MMU
	depends on LINGMO_PACKAGE_PULSEAUDIO_HAS_ATOMIC
	depends on !LINGMO_USE_WCHAR || !LINGMO_TOOLCHAIN_HAS_THREADS || LINGMO_STATIC_LIBS
```

## package/pulseview/Config.in
```kconfig
config LINGMO_PACKAGE_PULSEVIEW
	bool "pulseview"
	depends on LINGMO_PACKAGE_QT5
	# libsigrok->libglib2:
	depends on LINGMO_USE_WCHAR
	depends on LINGMO_TOOLCHAIN_HAS_THREADS
	depends on LINGMO_TOOLCHAIN_SUPPORTS_ALWAYS_LOCKFREE_ATOMIC_INTS # boost-filesystem
	depends on LINGMO_USE_MMU
	depends on LINGMO_INSTALL_LIBSTDCPP
	# libsigrok->libzip
	depends on !LINGMO_STATIC_LIBS
	# libsigrok
	depends on LINGMO_TOOLCHAIN_GCC_AT_LEAST_7
	depends on LINGMO_HOST_GCC_AT_LEAST_4_9
	depends on LINGMO_ENABLE_LOCALE
	select LINGMO_PACKAGE_LIBSIGROK
	select LINGMO_PACKAGE_LIBSIGROKCXX
	select LINGMO_PACKAGE_QT5BASE_WIDGETS
	select LINGMO_PACKAGE_QT5BASE_PNG
	select LINGMO_PACKAGE_QT5SVG
	select LINGMO_PACKAGE_QT5TOOLS
	select LINGMO_PACKAGE_QT5TOOLS_LINGUIST_TOOLS
	select LINGMO_PACKAGE_BOOST
	select LINGMO_PACKAGE_BOOST_FILESYSTEM
	select LINGMO_PACKAGE_BOOST_SYSTEM
	select LINGMO_PACKAGE_BOOST_SERIALIZATION
	help
	  PulseView is a Qt based logic analyzer, oscilloscope
	  and MSO GUI for sigrok.

	  http://sigrok.org/wiki/PulseView

comment "pulseview needs a toolchain w/ locale, wchar, threads, dynamic library, C++, gcc >= 7, host gcc >= 4.9"
	depends on LINGMO_USE_MMU
	depends on LINGMO_PACKAGE_QT5
	depends on LINGMO_TOOLCHAIN_SUPPORTS_ALWAYS_LOCKFREE_ATOMIC_INTS
	depends on !LINGMO_TOOLCHAIN_GCC_AT_LEAST_7 || !LINGMO_USE_WCHAR \
		|| !LINGMO_TOOLCHAIN_HAS_THREADS || !LINGMO_INSTALL_LIBSTDCPP \
		|| LINGMO_STATIC_LIBS || !LINGMO_ENABLE_LOCALE || \
		!LINGMO_HOST_GCC_AT_LEAST_4_9
```

## package/python-aexpect/Config.in
```kconfig
config LINGMO_PACKAGE_PYTHON_AEXPECT
	bool "python-aexpect"
	help
	  Aexpect.

	  http://avocado-framework.github.io/
```

## package/python-aiocoap/Config.in
```kconfig
config LINGMO_PACKAGE_PYTHON_AIOCOAP
	bool "python-aiocoap"
	help
	  Python CoAP library.

	  https://github.com/chrysn/aiocoap
```

## package/python-aiodns/Config.in
```kconfig
config LINGMO_PACKAGE_PYTHON_AIODNS
	bool "python-aiodns"
	select LINGMO_PACKAGE_PYTHON_PYCARES # runtime
	help
	  Simple DNS resolver for asyncio.

	  http://github.com/saghul/aiodns
```

## package/python-aiohttp-cors/Config.in
```kconfig
config LINGMO_PACKAGE_PYTHON_AIOHTTP_CORS
	bool "python-aiohttp-cors"
	select LINGMO_PACKAGE_PYTHON_AIOHTTP # runtime
	help
	  CORS support for aiohttp.

	  https://github.com/aio-libs/aiohttp-cors
```

## package/python-aiohttp-debugtoolbar/Config.in
```kconfig
config LINGMO_PACKAGE_PYTHON_AIOHTTP_DEBUGTOOLBAR
	bool "python-aiohttp-debugtoolbar"
	select LINGMO_PACKAGE_PYTHON_AIOHTTP # runtime
	select LINGMO_PACKAGE_PYTHON_AIOHTTP_JINJA2 # runtime
	help
	  debugtoolbar for aiohttp.

	  https://github.com/aio-libs/aiohttp_debugtoolbar
```

## package/python-aiohttp-jinja2/Config.in
```kconfig
config LINGMO_PACKAGE_PYTHON_AIOHTTP_JINJA2
	bool "python-aiohttp-jinja2"
	select LINGMO_PACKAGE_PYTHON_AIOHTTP # runtime
	select LINGMO_PACKAGE_PYTHON_JINJA2 # runtime
	help
	  Jinja2 template renderer for aiohttp.web (http server for
	  asyncio).

	  https://github.com/aio-libs/aiohttp_jinja2/
```

## package/python-aiohttp-mako/Config.in
```kconfig
config LINGMO_PACKAGE_PYTHON_AIOHTTP_MAKO
	bool "python-aiohttp-mako"
	select LINGMO_PACKAGE_PYTHON_AIOHTTP # runtime
	select LINGMO_PACKAGE_PYTHON_MAKO # runtime
	help
	  mako template renderer for aiohttp.web (http server for
	  asyncio).

	  https://github.com/aio-libs/aiohttp-mako/
```

## package/python-aiohttp-sse/Config.in
```kconfig
config LINGMO_PACKAGE_PYTHON_AIOHTTP_SSE
	bool "python-aiohttp-sse"
	select LINGMO_PACKAGE_PYTHON_AIOHTTP # runtime
	help
	  Server-sent events support for aiohttp.

	  https://github.com/aio-libs/aiohttp_sse/
```

## package/python-aiohttp/Config.in
```kconfig
config LINGMO_PACKAGE_PYTHON_AIOHTTP
	bool "python-aiohttp"
	select LINGMO_PACKAGE_PYTHON_AIODNS # runtime
	select LINGMO_PACKAGE_PYTHON_AIOSIGNAL # runtime
	select LINGMO_PACKAGE_PYTHON_ASYNC_TIMEOUT # runtime
	select LINGMO_PACKAGE_PYTHON_ATTRS # runtime
	select LINGMO_PACKAGE_PYTHON_BROTLI # runtime
	select LINGMO_PACKAGE_PYTHON_FROZENLIST # runtime
	select LINGMO_PACKAGE_PYTHON_MULTIDICT # runtime
	select LINGMO_PACKAGE_PYTHON_YARL # runtime
	select LINGMO_PACKAGE_PYTHON3_ZLIB # runtime
	help
	  Async http client/server framework (asyncio).

	  https://github.com/aio-libs/aiohttp
```

## package/python-aiologstash/Config.in
```kconfig
config LINGMO_PACKAGE_PYTHON_AIOLOGSTASH
	bool "python-aiologstash"
	select LINGMO_PACKAGE_PYTHON_ASYNC_TIMEOUT # runtime
	select LINGMO_PACKAGE_PYTHON_LOGSTASH # runtime
	help
	  asyncio-compatible logstash logging handler.

	  https://github.com/aio-libs/aiologstash
```

## package/python-aiomonitor/Config.in
```kconfig
config LINGMO_PACKAGE_PYTHON_AIOMONITOR
	bool "python-aiomonitor"
	select LINGMO_PACKAGE_PYTHON_AIOCONSOLE # runtime
	select LINGMO_PACKAGE_PYTHON_AIOHTTP # runtime
	select LINGMO_PACKAGE_PYTHON_ATTRS # runtime
	select LINGMO_PACKAGE_PYTHON_CLICK # runtime
	select LINGMO_PACKAGE_PYTHON_JANUS # runtime
	select LINGMO_PACKAGE_PYTHON_JINJA2 # runtime
	select LINGMO_PACKAGE_PYTHON_PROMPT_TOOLKIT # runtime
	select LINGMO_PACKAGE_PYTHON_TERMINALTABLES # runtime
	select LINGMO_PACKAGE_PYTHON_TRAFARET # runtime
	select LINGMO_PACKAGE_PYTHON_TYPING_EXTENSIONS # runtime
	help
	  aiomonitor adds monitor and python REPL capabilities for
	  asyncio application.

	  https://github.com/aio-libs/aiomonitor
```

## package/python-aioredis/Config.in
```kconfig
config LINGMO_PACKAGE_PYTHON_AIOREDIS
	bool "python-aioredis"
	select LINGMO_PACKAGE_PYTHON_ASYNC_TIMEOUT # runtime
	select LINGMO_PACKAGE_PYTHON_HIREDIS # runtime
	help
	  Provides simple and clear interface to Redis based on asyncio.

	  https://github.com/aio-libs/aioredis
```

## package/python-aiosignal/Config.in
```kconfig
config LINGMO_PACKAGE_PYTHON_AIOSIGNAL
	bool "python-aiosignal"
	select LINGMO_PACKAGE_PYTHON_FROZENLIST # runtime
	help
	  aiosignal: a list of registered asynchronous callbacks.

	  https://github.com/aio-libs/aiosignal
```

## package/python-aiozipkin/Config.in
```kconfig
config LINGMO_PACKAGE_PYTHON_AIOZIPKIN
	bool "python-aiozipkin"
	select LINGMO_PACKAGE_PYTHON_AIOHTTP # runtime
	help
	  Distributed tracing instrumentation for asyncio application
	  with zipkin.

	  https://github.com/aio-libs/aiozipkin
```

## package/python-alembic/Config.in
```kconfig
config LINGMO_PACKAGE_PYTHON_ALEMBIC
	bool "python-alembic"
	select LINGMO_PACKAGE_PYTHON_MAKO # runtime
	select LINGMO_PACKAGE_PYTHON_SQLALCHEMY # runtime
	select LINGMO_PACKAGE_PYTHON_TYPING_EXTENSIONS # runtime
	help
	  Alembic is a database migrations tool written by the author
	  of SQLAlchemy.

	  https://alembic.sqlalchemy.org
```

## package/python-alsaaudio/Config.in
```kconfig
comment "python-alsaaudio needs a toolchain w/ threads"
	depends on !LINGMO_TOOLCHAIN_HAS_THREADS

config LINGMO_PACKAGE_PYTHON_ALSAAUDIO
	bool "python-alsaaudio"
	depends on LINGMO_TOOLCHAIN_HAS_THREADS # alsa-lib
	select LINGMO_PACKAGE_ALSA_LIB
	select LINGMO_PACKAGE_ALSA_LIB_PCM
	select LINGMO_PACKAGE_ALSA_LIB_MIXER
	help
	  The PyAlsaAudio package contains bindings for the ALSA sound
	  API.

	  http://larsimmisch.github.io/pyalsaaudio/
```

## package/python-annotated-types/Config.in
```kconfig
config LINGMO_PACKAGE_PYTHON_ANNOTATED_TYPES
	bool "python-annotated-types"
	help
	  Reusable constraint types to use with typing.Annotated.

	  https://github.com/annotated-types/annotated-types
```
