## package/conmon/Config.in
```kconfig
config LINGMO_PACKAGE_CONMON
	bool "conmon"
	depends on LINGMO_TOOLCHAIN_HAS_THREADS # libglib2
	depends on LINGMO_USE_MMU # libglib2
	depends on LINGMO_USE_WCHAR # libglib2
	select LINGMO_PACKAGE_LIBGLIB2
	help
	  Conmon is an OCI container runtime monitor.

	  https://github.com/containers/conmon

comment "conmon needs a toolchain w/ threads, wchar"
	depends on !LINGMO_USE_WCHAR || !LINGMO_TOOLCHAIN_HAS_THREADS
	depends on LINGMO_USE_MMU
```

## package/connman-gtk/Config.in
```kconfig
comment "connman-gtk needs libgtk3 and a glibc or uClibc toolchain w/ wchar, threads, resolver, dynamic library"
	depends on LINGMO_USE_MMU
	depends on LINGMO_TOOLCHAIN_HAS_SYNC_4
	depends on !LINGMO_USE_WCHAR || !LINGMO_TOOLCHAIN_HAS_THREADS || \
		LINGMO_STATIC_LIBS || !LINGMO_PACKAGE_LIBGTK3 || \
		LINGMO_TOOLCHAIN_USES_MUSL

config LINGMO_PACKAGE_CONNMAN_GTK
	bool "connman-gtk"
	depends on LINGMO_USE_WCHAR # libglib2, connman
	depends on LINGMO_TOOLCHAIN_HAS_THREADS # libglib2, connman
	depends on LINGMO_USE_MMU # libglib2
	depends on !LINGMO_STATIC_LIBS # connman
	depends on LINGMO_TOOLCHAIN_HAS_SYNC_4 # connman
	depends on !LINGMO_TOOLCHAIN_USES_MUSL # connman
	depends on LINGMO_PACKAGE_LIBGTK3
	select LINGMO_PACKAGE_CONNMAN
	select LINGMO_PACKAGE_LIBGLIB2
	help
	  GTK GUI for ConnMan.

	  https://github.com/jgke/connman-gtk
```

## package/connman/Config.in
```kconfig
config LINGMO_PACKAGE_CONNMAN
	bool "connman"
	depends on LINGMO_USE_WCHAR # libglib2
	depends on LINGMO_TOOLCHAIN_HAS_THREADS # dbus, libglib2
	depends on LINGMO_USE_MMU # dbus, libglib2
	depends on !LINGMO_STATIC_LIBS # needs dlopen()
	depends on LINGMO_TOOLCHAIN_HAS_SYNC_4
	depends on !LINGMO_TOOLCHAIN_USES_MUSL # missing res_ninit()
	select LINGMO_PACKAGE_DBUS
	select LINGMO_PACKAGE_LIBGLIB2
	help
	  The Connection Manager (ConnMan) project provides a daemon
	  for managing internet connections within embedded devices
	  running the Linux operating system.

	  https://01.org/connman

if LINGMO_PACKAGE_CONNMAN

choice
	prompt "Firewall type"
	default LINGMO_PACKAGE_CONNMAN_IPTABLES
	help
	  Select which firewall type is used.

config LINGMO_PACKAGE_CONNMAN_IPTABLES
	bool "iptables"
	select LINGMO_PACKAGE_IPTABLES
	help
	  Use iptables as firewall.

config LINGMO_PACKAGE_CONNMAN_NFTABLES
	bool "nftables"
	depends on LINGMO_USE_WCHAR
	depends on LINGMO_TOOLCHAIN_HEADERS_AT_LEAST_3_12
	select LINGMO_PACKAGE_LIBMNL
	select LINGMO_PACKAGE_NFTABLES
	help
	  Use nftables as firewall.
endchoice

config LINGMO_PACKAGE_CONNMAN_ETHERNET
	bool "enable Ethernet support"
	default y

config LINGMO_PACKAGE_CONNMAN_WIFI
	bool "enable WiFi support"
	select LINGMO_PACKAGE_WPA_SUPPLICANT # runtime
	select LINGMO_PACKAGE_WPA_SUPPLICANT_DBUS # runtime
	help
	  Enable WiFi support (scan and static/dhcp interface
	  setup). ConnMan detects the start of wpa_supplicant
	  automatically.

config LINGMO_PACKAGE_CONNMAN_WIREGUARD
	bool "enable wireguard support"
	select LINGMO_PACKAGE_LIBMNL

config LINGMO_PACKAGE_CONNMAN_WISPR
	bool "enable WISPr support"
	depends on !LINGMO_STATIC_LIBS # gnutls
	select LINGMO_PACKAGE_GNUTLS
	help
	  Enable support for Wireless Internet Service Provider
	  roaming (WISPr). A RADIUS server is used to authenticate the
	  subscriber's credentials.

comment "connman WISPr needs a toolchain w/ dynamic library"
	depends on LINGMO_STATIC_LIBS

config LINGMO_PACKAGE_CONNMAN_BLUETOOTH
	bool "enable Bluetooth support"
	help
	  Enable Bluetooth support. The start of bluetoothd is
	  automatically detected and only a runtime dependency.

config LINGMO_PACKAGE_CONNMAN_LOOPBACK
	bool "enable loopback support"

config LINGMO_PACKAGE_CONNMAN_NEARD
	bool "enable neard support"
	depends on LINGMO_TOOLCHAIN_HAS_SYNC_4 # neard
	select LINGMO_PACKAGE_NEARD

config LINGMO_PACKAGE_CONNMAN_OFONO
	bool "enable ofono support"
	depends on LINGMO_TOOLCHAIN_HAS_SYNC_4 # ofono
	depends on LINGMO_TOOLCHAIN_HEADERS_AT_LEAST_4_12 # ofono
	select LINGMO_PACKAGE_OFONO

comment "ofono support needs a toolchain w/ headers >= 4.12"
	depends on !LINGMO_TOOLCHAIN_HEADERS_AT_LEAST_4_12

config LINGMO_PACKAGE_CONNMAN_DEBUG
	bool "enable compiling with debugging information"

config LINGMO_PACKAGE_CONNMAN_STATS
	bool "enable statistics round robin file generation"
	help
	  Enable generation of statistics in a round robin file.

	  This is enabled by default upstream but is marked as
	  experimental.

config LINGMO_PACKAGE_CONNMAN_CLIENT
	bool "enable command line client"
	select LINGMO_PACKAGE_READLINE

endif # LINGMO_PACKAGE_CONNMAN

comment "connman needs a glibc or uClibc toolchain w/ wchar, threads, resolver, dynamic library"
	depends on LINGMO_USE_MMU
	depends on LINGMO_TOOLCHAIN_HAS_SYNC_4
	depends on !LINGMO_USE_WCHAR || !LINGMO_TOOLCHAIN_HAS_THREADS || LINGMO_STATIC_LIBS \
		|| LINGMO_TOOLCHAIN_USES_MUSL
```

## package/conntrack-tools/Config.in
```kconfig
config LINGMO_PACKAGE_CONNTRACK_TOOLS
	bool "conntrack-tools"
	depends on LINGMO_USE_MMU # fork()
	depends on LINGMO_TOOLCHAIN_HAS_NATIVE_RPC || LINGMO_TOOLCHAIN_HAS_THREADS # libtirpc
	depends on !LINGMO_STATIC_LIBS # dlopen()
	select LINGMO_PACKAGE_LIBNETFILTER_CONNTRACK
	select LINGMO_PACKAGE_LIBNETFILTER_CTHELPER
	select LINGMO_PACKAGE_LIBNETFILTER_CTTIMEOUT
	select LINGMO_PACKAGE_LIBNETFILTER_QUEUE
	select LINGMO_PACKAGE_LIBTIRPC if !LINGMO_TOOLCHAIN_HAS_NATIVE_RPC
	help
	  The conntrack-tools are a set of tools targeted at
	  system administrators.
	  They are conntrack, the userspace command line interface,
	  and conntrackd, the userspace daemon.

	  http://www.netfilter.org/projects/conntrack-tools/

comment "conntrack-tools needs a toolchain w/ threads, dynamic library"
	depends on LINGMO_USE_MMU
	depends on !(LINGMO_TOOLCHAIN_HAS_THREADS || LINGMO_TOOLCHAIN_HAS_NATIVE_RPC) || \
		LINGMO_STATIC_LIBS
```

## package/coremark-pro/Config.in
```kconfig
config LINGMO_PACKAGE_COREMARK_PRO
	bool "coremark-pro"
	depends on LINGMO_USE_MMU # perl uses fork()
	select LINGMO_PACKAGE_PERL
	help
	  CoreMark-PRO is a comprehensive, advanced processor benchmark.

	  https://www.eembc.org/coremark-pro/
```

## package/cpio/Config.in
```kconfig
config LINGMO_PACKAGE_CPIO
	bool "cpio"
	depends on LINGMO_USE_WCHAR
	# Need argp.h support
	select LINGMO_PACKAGE_ARGP_STANDALONE if LINGMO_TOOLCHAIN_USES_UCLIBC || LINGMO_TOOLCHAIN_USES_MUSL
	help
	  cpio archive utility for creation and extraction.

	  https://www.gnu.org/software/cpio/

comment "cpio needs a toolchain w/ wchar"
	depends on !LINGMO_USE_WCHAR
```

## package/cppcms/Config.in
```kconfig
config LINGMO_PACKAGE_CPPCMS
	bool "cppcms"
	depends on LINGMO_INSTALL_LIBSTDCPP
	depends on LINGMO_TOOLCHAIN_HAS_THREADS_NPTL
	depends on !LINGMO_STATIC_LIBS # dlopen()
	depends on LINGMO_USE_WCHAR
	select LINGMO_PACKAGE_PCRE
	help
	  CppCMS is a Free High Performance Web Development Framework
	  (not a CMS) aimed for Rapid Web Application Development. It
	  differs from most of other web development frameworks like:
	  Python Django or Java Servlets on  the following aspects:

	   - It is designed and tuned to handle extremely high loads.
	   - It uses modern C++ as primary development language in
	     order to achieve the above goal.
	   - It is aimed on development of both Web Sites and Web
	     Services.

	  http://cppcms.com

if LINGMO_PACKAGE_CPPCMS

config LINGMO_PACKAGE_CPPCMS_ICU
	bool "enable icu support"
	depends on !LINGMO_BINFMT_FLAT # icu
	depends on LINGMO_HOST_GCC_AT_LEAST_4_9 # icu
	depends on LINGMO_TOOLCHAIN_GCC_AT_LEAST_4_9 # icu
	select LINGMO_PACKAGE_ICU
	help
	  Using ICU allows advanced localization features into CppCMS,
	  in another hand ICU is heavier than iconv.

comment "icu support needs a toolchain w/ gcc >= 4.9, host gcc >= 4.9"
	depends on !LINGMO_BINFMT_FLAT
	depends on !LINGMO_TOOLCHAIN_GCC_AT_LEAST_4_9 || \
		!LINGMO_HOST_GCC_AT_LEAST_4_9

endif

comment "cppcms needs a toolchain w/ C++, NPTL, wchar, dynamic library"
	depends on !LINGMO_INSTALL_LIBSTDCPP || !LINGMO_TOOLCHAIN_HAS_THREADS_NPTL || \
		!LINGMO_USE_WCHAR || LINGMO_STATIC_LIBS
```

## package/cppdb/Config.in
```kconfig
config LINGMO_PACKAGE_CPPDB
	bool "cppdb"
	# dlfcn.h
	depends on !LINGMO_STATIC_LIBS
	depends on LINGMO_INSTALL_LIBSTDCPP
	depends on LINGMO_TOOLCHAIN_HAS_THREADS
	# Can be built without them but it's useless
	depends on LINGMO_PACKAGE_MARIADB || LINGMO_PACKAGE_POSTGRESQL || LINGMO_PACKAGE_SQLITE
	help
	  CppDB is an SQL connectivity library that is designed to
	  provide platform and Database independent connectivity API
	  similarly to what JDBC, ODBC and other connectivity libraries
	  do.

	  http://cppcms.com/sql/cppdb/

comment "cppdb needs a toolchain w/ C++, threads, dynamic library"
	depends on LINGMO_PACKAGE_MARIADB || LINGMO_PACKAGE_POSTGRESQL || LINGMO_PACKAGE_SQLITE
	depends on !LINGMO_INSTALL_LIBSTDCPP || !LINGMO_TOOLCHAIN_HAS_THREADS || \
		LINGMO_STATIC_LIBS
```

## package/cppunit/Config.in
```kconfig
config LINGMO_PACKAGE_CPPUNIT
	bool "cppunit"
	depends on LINGMO_INSTALL_LIBSTDCPP
	# currently the static situation is not correctly detected.
	depends on !LINGMO_STATIC_LIBS
	help
	  CppUnit is the C++ port of the famous JUnit framework for
	  unit testing. Test output is in XML or text format for
	  automatic testing and GUI based for supervised tests.

	  http://www.freedesktop.org/wiki/Software/cppunit/

comment "cppunit needs a toolchain w/ C++, dynamic library"
	depends on !LINGMO_INSTALL_LIBSTDCPP || LINGMO_STATIC_LIBS
```

## package/cppzmq/Config.in
```kconfig
config LINGMO_PACKAGE_CPPZMQ
	bool "cppzmq"
	depends on LINGMO_INSTALL_LIBSTDCPP
	depends on LINGMO_TOOLCHAIN_HAS_THREADS # zeromq
	select LINGMO_PACKAGE_ZEROMQ
	help
	  C++ binding for zeromq (ZeroMQ, 0MQ, zmq).

	  http://github.com/zeromq/cppzmq

comment "cppzmq needs a toolchain w/ C++, threads"
	depends on !(LINGMO_INSTALL_LIBSTDCPP && LINGMO_TOOLCHAIN_HAS_THREADS)
```

## package/cpuburn-arm/Config.in
```kconfig
config LINGMO_PACKAGE_CPUBURN_ARM_ARCH_SUPPORTS
	bool
	default y if LINGMO_cortex_a7
	default y if LINGMO_cortex_a8
	default y if LINGMO_cortex_a9
	default y if LINGMO_cortex_a53

config LINGMO_PACKAGE_CPUBURN_ARM
	bool "cpuburn-arm"
	depends on LINGMO_PACKAGE_CPUBURN_ARM_ARCH_SUPPORTS
	help
	  Make ARM cores generate as much heat as possible. Supports
	  Cortex A7/A8/A9/A53.

	  https://github.com/ssvb/cpuburn-arm
```

## package/cpulimit/Config.in
```kconfig
comment "cpulimit needs a toolchain w/ threads"
	depends on LINGMO_USE_MMU
	depends on !LINGMO_TOOLCHAIN_HAS_THREADS

config LINGMO_PACKAGE_CPULIMIT
	bool "cpulimit"
	depends on LINGMO_USE_MMU # fork()
	depends on LINGMO_TOOLCHAIN_HAS_THREADS
	help
	  Cpulimit is a tool which limits the CPU usage of a process
	  (expressed in percentage, not in CPU time)

	  https://github.com/opsengine/cpulimit
```

## package/crda/Config.in
```kconfig
config LINGMO_PACKAGE_CRDA
	bool "crda"
	depends on LINGMO_PACKAGE_LIBGPG_ERROR_ARCH_SUPPORTS # libgcrypt
	depends on LINGMO_TOOLCHAIN_HAS_THREADS # libnl
	depends on !LINGMO_STATIC_LIBS
	select LINGMO_PACKAGE_LIBGCRYPT
	select LINGMO_PACKAGE_LIBNL
	# regdb is a runtime dependency
	select LINGMO_PACKAGE_WIRELESS_REGDB
	help
	  Central Regulatory Domain Agent.

	  This package provides a Central Regulatory Domain Agent (CRDA)
	  to be used by the Linux kernel cf80211 wireless subsystem to
	  query and apply the regulatory domain settings wireless
	  devices may operate within for a given location.

	  https://wireless.wiki.kernel.org/en/developers/regulatory/crda

comment "crda needs a toolchain w/ threads, dynamic library"
	depends on !LINGMO_TOOLCHAIN_HAS_THREADS || LINGMO_STATIC_LIBS
```

## package/criu/Config.in
```kconfig
# criu only builds on certain architectures
config LINGMO_PACKAGE_CRIU_ARCH_SUPPORTS
	bool
	default y if LINGMO_ARM_CPU_ARMV6
	default y if LINGMO_ARM_CPU_ARMV7A
	default y if LINGMO_ARM_CPU_ARMV7M
	default y if LINGMO_ARM_CPU_ARMV8A && !LINGMO_aarch64_be
	default y if LINGMO_aarch64
	default y if LINGMO_x86_64
	default y if LINGMO_powerpc64le # Only support powerpc64 with LE
	# CRIU has "some" support for s390 but it is not included due to
	# BE/LE endian issues.
	depends on LINGMO_USE_MMU # libcap
	depends on LINGMO_PACKAGE_HOST_PROTOBUF_ARCH_SUPPORTS # protobuf-c
	depends on LINGMO_PACKAGE_PROTOBUF_ARCH_SUPPORTS
	depends on LINGMO_PACKAGE_LIBBSD_ARCH_SUPPORTS

config LINGMO_PACKAGE_CRIU
	bool "criu"
	depends on LINGMO_PACKAGE_CRIU_ARCH_SUPPORTS
	depends on LINGMO_HOST_GCC_AT_LEAST_7 # protobuf-c
	depends on LINGMO_TOOLCHAIN_GCC_AT_LEAST_8 # -march=armv7-a+fp
	depends on LINGMO_TOOLCHAIN_HEADERS_AT_LEAST_4_18 # rseq.h
	depends on !LINGMO_TOOLCHAIN_USES_UCLIBC # no aio.h
	depends on !LINGMO_STATIC_LIBS # protobuf, libbsd
	depends on LINGMO_INSTALL_LIBSTDCPP # protobuf
	depends on LINGMO_TOOLCHAIN_HAS_THREADS # protobuf, libnl
	depends on LINGMO_USE_WCHAR # libbsd
	select LINGMO_PACKAGE_HOST_PYTHON3
	select LINGMO_PACKAGE_HOST_PYTHON3_SSL
	select LINGMO_PACKAGE_PROTOBUF
	select LINGMO_PACKAGE_PROTOBUF_C
	select LINGMO_PACKAGE_LIBAIO
	select LINGMO_PACKAGE_LIBBSD
	select LINGMO_PACKAGE_LIBCAP
	select LINGMO_PACKAGE_LIBNET
	select LINGMO_PACKAGE_LIBNL
	select LINGMO_PACKAGE_PYTHON3
	help
	  Checkpoint/Restore In Userspace (CRIU), is a software
	  tool for the Linux operating system to make it possible
	  to freeze a running application and checkpoint it to
	  persistent storage as a collection of files.

	  https://criu.org/Main_Page

comment "criu needs a glibc or musl toolchain w/ threads, host gcc >= 7, gcc >= 8, headers >= 4.18, C++, dynamic library, wchar"
	depends on LINGMO_PACKAGE_CRIU_ARCH_SUPPORTS
	depends on !LINGMO_TOOLCHAIN_GCC_AT_LEAST_8 || !LINGMO_TOOLCHAIN_HAS_THREADS \
		|| !LINGMO_TOOLCHAIN_HEADERS_AT_LEAST_4_18 \
		|| LINGMO_TOOLCHAIN_USES_UCLIBC || !LINGMO_INSTALL_LIBSTDCPP \
		|| LINGMO_STATIC_LIBS || !LINGMO_USE_WCHAR \
		|| LINGMO_HOST_GCC_AT_LEAST_7
```

## package/crucible/Config.in
```kconfig
config LINGMO_PACKAGE_CRUCIBLE
	bool "crucible"
	depends on LINGMO_PACKAGE_HOST_GO_TARGET_ARCH_SUPPORTS
	help
	  Crucible is a One-Time-Programmable (OTP) fusing tool for the
	  i.MX family.

	  https://github.com/usbarmory/crucible
```

## package/crudini/Config.in
```kconfig
config LINGMO_PACKAGE_CRUDINI
	bool "crudini"
	depends on LINGMO_PACKAGE_PYTHON3
	select LINGMO_PACKAGE_PYTHON_INIPARSE # runtime
	help
	  A utility for handling ini files from the command line and
	  shell scripts

	  https://pypi.python.org/pypi/crudini
```

## package/crudini/Config.in.host
```kconfig
config LINGMO_PACKAGE_HOST_CRUDINI
	bool "host crudini"
	select LINGMO_PACKAGE_HOST_PYTHON3
	select LINGMO_PACKAGE_HOST_PYTHON_INIPARSE # runtime
	help
	  A utility for handling ini files from the command line and
	  shell scripts

	  https://pypi.python.org/pypi/crudini
```

## package/crun/Config.in
```kconfig
config LINGMO_PACKAGE_CRUN
	bool "crun"
	depends on LINGMO_USE_MMU # fork()
	depends on LINGMO_TOOLCHAIN_GCC_AT_LEAST_4_9 # C11/stdatomic.h
	select LINGMO_PACKAGE_ARGP_STANDALONE if !LINGMO_TOOLCHAIN_USES_GLIBC
	select LINGMO_PACKAGE_YAJL # libocispec
	help
	  crun is a fast and low-memory OCI Container Runtime in C.

	  https://github.com/containers/crun

comment "crun needs a glibc or musl toolchain, gcc >= 4.9"
	depends on LINGMO_USE_MMU
	depends on LINGMO_TOOLCHAIN_USES_UCLIBC || \
		!LINGMO_TOOLCHAIN_GCC_AT_LEAST_4_9
```

## package/cryptodev-linux/Config.in
```kconfig
config LINGMO_PACKAGE_CRYPTODEV_LINUX
	bool "cryptodev-linux"
	depends on !LINGMO_microblaze
	depends on LINGMO_LINUX_KERNEL
	help
	  Cryptodev-linux is a device that allows access to Linux kernel
	  cryptographic drivers; thus allowing userspace applications
	  to take advantage of hardware accelerators.

	  http://cryptodev-linux.org/index.html

comment "cryptodev-linux needs a Linux kernel to be built"
	depends on !LINGMO_microblaze
	depends on !LINGMO_LINUX_KERNEL
```
