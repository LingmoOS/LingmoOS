## package/cmake/Config.in.host
```kconfig
config LINGMO_PACKAGE_HOST_CMAKE
	bool "host cmake"
	help
	  CMake is an open-source, cross-platform family of tools
	  designed to build, test and package software. CMake is used
	  to control the software compilation process using simple
	  platform and compiler independent configuration files, and
	  generate native makefiles and workspaces that can be used in
	  the compiler environment of your choice.

	  http://www.cmake.org/

# The minimum system cmake version we expect if 3.18 as provided by
# Debian bullseye, that we use in our reference build docker image.
config LINGMO_HOST_CMAKE_AT_LEAST_3_19
	bool

config LINGMO_HOST_CMAKE_AT_LEAST_3_20
	bool
	select LINGMO_HOST_CMAKE_AT_LEAST_3_19

config LINGMO_HOST_CMAKE_AT_LEAST_3_21
	bool
	select LINGMO_HOST_CMAKE_AT_LEAST_3_20

config LINGMO_HOST_CMAKE_AT_LEAST_3_22
	bool
	select LINGMO_HOST_CMAKE_AT_LEAST_3_21

config LINGMO_HOST_CMAKE_AT_LEAST_3_23
	bool
	select LINGMO_HOST_CMAKE_AT_LEAST_3_22

config LINGMO_HOST_CMAKE_AT_LEAST_3_24
	bool
	select LINGMO_HOST_CMAKE_AT_LEAST_3_23

config LINGMO_HOST_CMAKE_AT_LEAST_3_25
	bool
	select LINGMO_HOST_CMAKE_AT_LEAST_3_24

config LINGMO_HOST_CMAKE_AT_LEAST_3_26
	bool
	select LINGMO_HOST_CMAKE_AT_LEAST_3_25

config LINGMO_HOST_CMAKE_AT_LEAST_3_27
	bool
	select LINGMO_HOST_CMAKE_AT_LEAST_3_26

config LINGMO_HOST_CMAKE_AT_LEAST_3_28
	bool
	select LINGMO_HOST_CMAKE_AT_LEAST_3_27

# This order guarantees that the highest version is set, as kconfig
# stops affecting a value on the first matching default.
config LINGMO_HOST_CMAKE_AT_LEAST
	string
	default "3.28"	if LINGMO_HOST_CMAKE_AT_LEAST_3_28
	default "3.27"	if LINGMO_HOST_CMAKE_AT_LEAST_3_27
	default "3.26"	if LINGMO_HOST_CMAKE_AT_LEAST_3_26
	default "3.25"	if LINGMO_HOST_CMAKE_AT_LEAST_3_25
	default "3.24"	if LINGMO_HOST_CMAKE_AT_LEAST_3_24
	default "3.23"	if LINGMO_HOST_CMAKE_AT_LEAST_3_23
	default "3.22"	if LINGMO_HOST_CMAKE_AT_LEAST_3_22
	default "3.21"	if LINGMO_HOST_CMAKE_AT_LEAST_3_21
	default "3.20"	if LINGMO_HOST_CMAKE_AT_LEAST_3_20
	default "3.19"	if LINGMO_HOST_CMAKE_AT_LEAST_3_19
	default "3.18"
```

## package/cni-plugins/Config.in
```kconfig
config LINGMO_PACKAGE_CNI_PLUGINS
	bool "cni-plugins"
	depends on LINGMO_PACKAGE_HOST_GO_TARGET_ARCH_SUPPORTS
	depends on LINGMO_PACKAGE_HOST_GO_TARGET_CGO_LINKING_SUPPORTS
	depends on LINGMO_TOOLCHAIN_HAS_THREADS
	depends on !LINGMO_TOOLCHAIN_USES_UCLIBC # no fexecve
	depends on LINGMO_USE_MMU
	help
	  Container Networking Interface plugins.

	  https://github.com/containernetworking/plugins

comment "cni-plugins needs a glibc or musl toolchain w/ threads"
	depends on LINGMO_PACKAGE_HOST_GO_TARGET_ARCH_SUPPORTS && \
		LINGMO_PACKAGE_HOST_GO_TARGET_CGO_LINKING_SUPPORTS
	depends on LINGMO_USE_MMU
	depends on !LINGMO_TOOLCHAIN_HAS_THREADS || LINGMO_TOOLCHAIN_USES_UCLIBC
```

## package/cog/Config.in
```kconfig
comment "cog needs wpewebkit and a toolchain w/ threads"
	depends on LINGMO_USE_MMU
	depends on !LINGMO_PACKAGE_WPEWEBKIT || !LINGMO_TOOLCHAIN_HAS_THREADS

config LINGMO_PACKAGE_COG
	bool "cog"
	depends on LINGMO_PACKAGE_WPEWEBKIT
	depends on LINGMO_TOOLCHAIN_HAS_THREADS # dbus
	depends on LINGMO_USE_MMU # dbus
	select LINGMO_PACKAGE_DBUS
	select LINGMO_PACKAGE_WAYLAND
	help
	  Single "window" launcher for the WebKit WPE port, and
	  helper library for implementing WPE launcher. It does
	  not provide any chrome, and is suitable to be used
	  as a Web application container.

	  https://github.com/Igalia/cog

if LINGMO_PACKAGE_COG

config LINGMO_PACKAGE_COG_PROGRAMS_HOME_URI
	string "home uri"
	default "https://wpewebkit.org"
	help
	  Default URI to open when "cog" is launched. If an empty
	  string is used, there is no default and the URI to open
	  must be always specified in the command line.

config LINGMO_PACKAGE_COG_PLATFORM_FDO
	bool "Wayland backend"
	default y
	select LINGMO_PACKAGE_LIBXKBCOMMON
	select LINGMO_PACKAGE_WAYLAND_PROTOCOLS
	help
	  Enable the Wayland backend. Cog will interface with
	  a compositor over the Wayland protocol.

config LINGMO_PACKAGE_COG_PLATFORM_DRM
	bool "DRM backend"
	depends on LINGMO_PACKAGE_HAS_UDEV # libinput
	depends on LINGMO_PACKAGE_HAS_LIBEGL
	depends on LINGMO_PACKAGE_HAS_LIBGBM
	depends on LINGMO_PACKAGE_LIBGBM_HAS_FEATURE_DMA_BUF
	depends on LINGMO_PACKAGE_LIBGBM_HAS_FEATURE_FORMAT_MODIFIER_PLANE_COUNT
	select LINGMO_PACKAGE_LIBDRM
	select LINGMO_PACKAGE_LIBINPUT
	help
	  Enable the DRM platform backend. Cog will interface directly
	  with video drivers that support kernel mode-setting (KMS)
	  via the DRM user-space API.

config LINGMO_PACKAGE_COG_USE_SYSTEM_DBUS
	bool "expose system D-Bus control interface"
	help
	  Expose remote control interface on system bus

comment "DRM platform needs EGL and GBM"
	depends on \
		!LINGMO_PACKAGE_HAS_LIBEGL || \
		!LINGMO_PACKAGE_HAS_LIBGBM || \
		!LINGMO_PACKAGE_LIBGBM_HAS_FEATURE_DMA_BUF || \
		!LINGMO_PACKAGE_LIBGBM_HAS_FEATURE_FORMAT_MODIFIER_PLANE_COUNT

endif
```
