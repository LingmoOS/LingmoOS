## package/luainterpreter/Config.in
```kconfig
config LINGMO_PACKAGE_HAS_LUAINTERPRETER
	bool

config LINGMO_PACKAGE_PROVIDES_LUAINTERPRETER
	string
	depends on LINGMO_PACKAGE_HAS_LUAINTERPRETER

config LINGMO_PACKAGE_LUAINTERPRETER_ABI_VERSION
	string
	default "5.1" if LINGMO_PACKAGE_LUAINTERPRETER_ABI_VERSION_5_1
	default "5.3" if LINGMO_PACKAGE_LUAINTERPRETER_ABI_VERSION_5_3
	default "5.4" if LINGMO_PACKAGE_LUAINTERPRETER_ABI_VERSION_5_4

config LINGMO_PACKAGE_LUAINTERPRETER_ABI_VERSION_5_1
	bool

config LINGMO_PACKAGE_LUAINTERPRETER_ABI_VERSION_5_3
	bool

config LINGMO_PACKAGE_LUAINTERPRETER_ABI_VERSION_5_4
	bool

config LINGMO_PACKAGE_PROVIDES_HOST_LUAINTERPRETER
	string
	default "host-lua"
```

## package/luajit/Config.in
```kconfig
config LINGMO_PACKAGE_LUAJIT_ARCH_SUPPORTS
	bool
	default y if LINGMO_arm || LINGMO_aarch64 || LINGMO_aarch64_be
	default y if LINGMO_i386 || LINGMO_x86_64
	default y if (LINGMO_mips || LINGMO_mipsel) && !LINGMO_MIPS_SOFT_FLOAT \
		&& !LINGMO_MIPS_CPU_MIPS32R6 && !LINGMO_MIPS_CPU_MIPS64R6
	default y if LINGMO_powerpc
	# -m32 flag is used for 32bit builds and host-luajit has
	# limited architecture support
	depends on LINGMO_HOSTARCH = "x86_64" || LINGMO_HOSTARCH = "x86"
	# Building for 64-bit target requires a 64-bit host
	depends on !LINGMO_ARCH_IS_64 || LINGMO_HOSTARCH = "x86_64"

config LINGMO_PACKAGE_LUAJIT
	bool "luajit"
	depends on !LINGMO_STATIC_LIBS # dlopen
	# Luajit conflicts with the regular lua package
	depends on !LINGMO_PACKAGE_LUA
	# Luajit is only available for some target architectures, and
	# has some complexity wrt 32/64. See luajit.mk for details.
	depends on LINGMO_PACKAGE_LUAJIT_ARCH_SUPPORTS
	# luajit.mk uses the "-m32" compiler option to build 32bit
	# binaries, so check if that option is supported. See
	# luajit.mk for details.
	select LINGMO_PACKAGE_HAS_LUAINTERPRETER
	select LINGMO_PACKAGE_LUAINTERPRETER_ABI_VERSION_5_1
	select LINGMO_HOSTARCH_NEEDS_IA32_COMPILER if !LINGMO_ARCH_IS_64
	help
	  LuaJIT implements the full set of language features defined
	  by Lua 5.1. The virtual machine (VM) is API- and
	  ABI-compatible to the standard Lua interpreter and can be
	  deployed as a drop-in replacement.

	  https://luajit.org/luajit.html

if LINGMO_PACKAGE_LUAJIT

config LINGMO_PACKAGE_PROVIDES_LUAINTERPRETER
	default "luajit"

config LINGMO_PACKAGE_LUAJIT_COMPAT52
	bool "Lua 5.2 compatibility"
	help
	  Compile with Lua 5.2 compatibility.

endif

comment "luajit needs a toolchain w/ dynamic library"
	depends on LINGMO_STATIC_LIBS
```
