## package/ltp-testsuite/Config.in
```kconfig
config LINGMO_PACKAGE_LTP_TESTSUITE_ARCH_SUPPORTS
	bool
	# Needs __sync*() built-ins for 4-byte data, except on a few
	# architectures for which a specific implementation is
	# provided in ltp-testsuite
	default y if LINGMO_TOOLCHAIN_HAS_SYNC_4
	default y if LINGMO_arc
	# does not build on nios2, cachectl.h issue
	depends on !LINGMO_nios2

config LINGMO_PACKAGE_LTP_TESTSUITE
	bool "ltp-testsuite"
	depends on LINGMO_USE_MMU # fork()
	depends on LINGMO_TOOLCHAIN_HAS_THREADS_NPTL
	depends on !LINGMO_TOOLCHAIN_USES_MUSL || LINGMO_TOOLCHAIN_HEADERS_AT_LEAST_5_11
	depends on LINGMO_PACKAGE_LTP_TESTSUITE_ARCH_SUPPORTS
	select LINGMO_PACKAGE_LIBTIRPC if !LINGMO_TOOLCHAIN_HAS_NATIVE_RPC
	select LINGMO_PACKAGE_MUSL_FTS if !LINGMO_TOOLCHAIN_USES_GLIBC
	help
	  The Linux Test Project provides a huge testsuite for Linux.

	  http://linux-test-project.github.io

if LINGMO_PACKAGE_LTP_TESTSUITE

config LINGMO_PACKAGE_LTP_TESTSUITE_OPEN_POSIX
	bool "Open POSIX testsuite"
	default y
	help
	  Test suite for POSIX compliance. Included with the LTP.

config LINGMO_PACKAGE_LTP_TESTSUITE_REALTIME
	bool "Realtime testsuite"
	default y
	help
	  Test suite for realtime kernels. Included with the LTP.

endif

comment "ltp-testsuite needs a toolchain w/ NPTL"
	depends on LINGMO_PACKAGE_LTP_TESTSUITE_ARCH_SUPPORTS
	depends on LINGMO_USE_MMU
	depends on !LINGMO_TOOLCHAIN_HAS_THREADS_NPTL
```

## package/ltrace/Config.in
```kconfig
config LINGMO_PACKAGE_LTRACE_ARCH_SUPPORTS
	bool
	default y if LINGMO_aarch64
	default y if LINGMO_arm
	default y if LINGMO_i386
	default y if LINGMO_mips
	default y if LINGMO_mipsel
	default y if LINGMO_powerpc
	default y if LINGMO_sparc
	default y if LINGMO_x86_64
	default y if LINGMO_xtensa

config LINGMO_PACKAGE_LTRACE
	bool "ltrace"
	depends on LINGMO_USE_WCHAR # elfutils
	depends on !LINGMO_STATIC_LIBS # elfutils
	depends on LINGMO_TOOLCHAIN_HAS_THREADS # elfutils
	depends on LINGMO_PACKAGE_LTRACE_ARCH_SUPPORTS
	select LINGMO_PACKAGE_ELFUTILS
	help
	  Debugging program which runs a specified command until it
	  exits. While the command is executing, ltrace intercepts and
	  records the dynamic library calls which are called by the
	  executed process and the signals received by that process.

	  http://ltrace.org

comment "ltrace needs a toolchain w/ wchar, dynamic library, threads"
	depends on LINGMO_PACKAGE_LTRACE_ARCH_SUPPORTS
	depends on !LINGMO_USE_WCHAR || LINGMO_STATIC_LIBS \
		|| !LINGMO_TOOLCHAIN_HAS_THREADS
```

## package/ltris/Config.in
```kconfig
config LINGMO_PACKAGE_LTRIS
	bool "LTris"
	depends on LINGMO_USE_MMU # fork()
	select LINGMO_PACKAGE_SDL
	help
	  LTris is a tetris clone, using SDL. It optionally requires
	  SDL_mixer for audio support. A display with minimum 640x480
	  resolution and a keyboard are recommended.

	  http://lgames.sourceforge.net/index.php?project=LTris

if LINGMO_PACKAGE_LTRIS

config LINGMO_PACKAGE_LTRIS_AUDIO
	bool "audio support"
	default y
	select LINGMO_PACKAGE_SDL_MIXER
	help
	  Activates audio support in LTris. Will add SDL_mixer.

endif
```

## package/lttng-babeltrace/Config.in
```kconfig
config LINGMO_PACKAGE_LTTNG_BABELTRACE
	bool "lttng-babeltrace"
	depends on LINGMO_USE_WCHAR # libglib2
	depends on LINGMO_TOOLCHAIN_HAS_THREADS # libglib2
	depends on LINGMO_USE_MMU # libglib2
	select LINGMO_PACKAGE_UTIL_LINUX
	select LINGMO_PACKAGE_UTIL_LINUX_LIBUUID
	select LINGMO_PACKAGE_LIBGLIB2
	select LINGMO_PACKAGE_POPT
	help
	  The Babeltrace project provides trace read and write
	  libraries, as well as a trace converter application. Plugins
	  can be created for any trace format to allow its conversion
	  to/from another trace format.

	  Babeltrace is the reference implementation of the Common
	  Trace Format (see <http://diamon.org/ctf/>). Babeltrace
	  can decode and display LTTng traces, since the latter are
	  written using the CTF format.

	  To get support for debugging information, enable the
	  elfutils package.

	  Having this tool on the target is not mandatory. You can
	  transfer the binary trace output from the target to your
	  development workstation, and use babeltrace here.

	  See the lttng-babeltrace host utility to install Babeltrace
	  on the host.

	  http://diamon.org/babeltrace

comment "lttng-babeltrace needs a toolchain w/ wchar, threads"
	depends on LINGMO_USE_MMU
	depends on !LINGMO_USE_WCHAR || !LINGMO_TOOLCHAIN_HAS_THREADS
```

## package/lttng-libust/Config.in
```kconfig
config LINGMO_PACKAGE_LTTNG_LIBUST
	bool "lttng-libust"
	depends on LINGMO_USE_WCHAR # uses wchar_t
	# liburcu only works on some architectures and requires threads support"
	depends on LINGMO_PACKAGE_LIBURCU_ARCH_SUPPORTS
	depends on LINGMO_TOOLCHAIN_HAS_THREADS
	depends on !LINGMO_STATIC_LIBS
	depends on LINGMO_INSTALL_LIBSTDCPP # liburcu
	select LINGMO_PACKAGE_LIBURCU
	select LINGMO_PACKAGE_UTIL_LINUX
	select LINGMO_PACKAGE_UTIL_LINUX_LIBUUID
	help
	  Userspace tracing library for the LTTng 2.x tracing
	  infrastructure. It allows userspace programs to create
	  custom trace events that are integrated with all other
	  events gathered by LTTng.

	  http://lttng.org

comment "lttng-libust needs a toolchain w/ dynamic library, wchar, threads, C++"
	depends on LINGMO_PACKAGE_LIBURCU_ARCH_SUPPORTS
	depends on LINGMO_STATIC_LIBS || !LINGMO_USE_WCHAR || \
		!LINGMO_TOOLCHAIN_HAS_THREADS || !LINGMO_INSTALL_LIBSTDCPP
```

## package/lttng-tools/Config.in
```kconfig
config LINGMO_PACKAGE_LTTNG_TOOLS
	bool "lttng-tools"
	# liburcu only works on some architectures and requires thread support
	depends on LINGMO_PACKAGE_LIBURCU_ARCH_SUPPORTS
	depends on LINGMO_TOOLCHAIN_HAS_THREADS
	depends on !LINGMO_STATIC_LIBS # uses dlfcn
	depends on LINGMO_INSTALL_LIBSTDCPP # liburcu
	select LINGMO_PACKAGE_LIBURCU
	select LINGMO_PACKAGE_LIBXML2
	select LINGMO_PACKAGE_POPT
	select LINGMO_PACKAGE_UTIL_LINUX
	select LINGMO_PACKAGE_UTIL_LINUX_LIBUUID
	help
	  Userspace utilities for the LTTng 2.x tracing
	  infrastructure.

	  Those utilities are required on the target system to start
	  and stop tracing sessions. Analysis of the trace can be done
	  on the host machine using the babeltrace utility. This
	  utility is automatically built by Buildroot in
	  $(O)/host/bin/babeltrace, as a dependency of
	  lttng-tools. However, there is also a lttng-babeltrace
	  package for the target, if babeltrace on the target is
	  interesting.

	  If userspace tracing is desired, you need to enable
	  lttng-libust.

	  http://lttng.org

comment "lttng-tools needs a toolchain w/ threads, dynamic library, C++"
	depends on LINGMO_PACKAGE_LIBURCU_ARCH_SUPPORTS
	depends on !LINGMO_TOOLCHAIN_HAS_THREADS || LINGMO_STATIC_LIBS || \
		!LINGMO_INSTALL_LIBSTDCPP
```

## package/lua-argon2/Config.in
```kconfig
config LINGMO_PACKAGE_LUA_ARGON2
	bool "lua-argon2"
	depends on !LINGMO_STATIC_LIBS
	depends on LINGMO_USE_MMU # libargon2
	select LINGMO_PACKAGE_LIBARGON2
	help
	  Lua C binding for the Argon2 password hashing algorithm.

	  https://github.com/thibaultcha/lua-argon2

comment "lua-argon2 needs a toolchain w/ dynamic library"
	depends on LINGMO_USE_MMU
	depends on LINGMO_STATIC_LIBS
```

## package/lua-augeas/Config.in
```kconfig
config LINGMO_PACKAGE_LUA_AUGEAS
	bool "lua-augeas"
	depends on !LINGMO_arc # augeas
	depends on LINGMO_USE_WCHAR # augeas
	select LINGMO_PACKAGE_AUGEAS
	help
	  Lua binding for augeas library

	  https://github.com/ncopa/lua-augeas

comment "lua-augeas needs a toolchain w/ wchar"
	depends on !LINGMO_arc
	depends on !LINGMO_USE_WCHAR
```

## package/lua-cffi/Config.in
```kconfig
config LINGMO_PACKAGE_LUA_CFFI
	bool "lua-cffi"
	depends on !LINGMO_PACKAGE_LUAJIT
	depends on LINGMO_TOOLCHAIN_HAS_THREADS # libffi
	depends on LINGMO_TOOLCHAIN_GCC_AT_LEAST_4_8
	depends on LINGMO_INSTALL_LIBSTDCPP
	select LINGMO_PACKAGE_LIBFFI
	help
	  This is a portable C FFI for Lua, based on libffi and aiming
	  to be mostly compatible with LuaJIT FFI, but written from
	  scratch.

	  https://github.com/q66/cffi-lua

comment "lua-cffi needs a toolchain w/ C++, gcc >= 4.8, threads"
	depends on !LINGMO_PACKAGE_LUAJIT
	depends on !LINGMO_INSTALL_LIBSTDCPP || \
		!LINGMO_TOOLCHAIN_GCC_AT_LEAST_4_8 || \
		!LINGMO_TOOLCHAIN_HAS_THREADS
```

## package/lua-coatpersistent/Config.in
```kconfig
config LINGMO_PACKAGE_LUA_COATPERSISTENT
	bool "lua-coatpersistent"
	depends on LINGMO_PACKAGE_LSQLITE3 || LINGMO_PACKAGE_LUASQL_SQLITE3
	select LINGMO_PACKAGE_DADO # runtime
	select LINGMO_PACKAGE_LUA_COAT # runtime
	help
	  An ORM for lua-Coat.

	  https://fperrad.frama.io/lua-CoatPersistent/

comment "lua-coatpersistent needs lsqlite3 or luasql-sqlite3"
	depends on !LINGMO_PACKAGE_LSQLITE3 && !LINGMO_PACKAGE_LUASQL_SQLITE3
```

## package/lua-cqueues/Config.in
```kconfig
config LINGMO_PACKAGE_LUA_CQUEUES
	bool "lua-cqueues"
	depends on LINGMO_TOOLCHAIN_HAS_THREADS
	select LINGMO_PACKAGE_OPENSSL
	select LINGMO_PACKAGE_OPENSSL_FORCE_LIBOPENSSL
	help
	  Continuation Queues: Embeddable asynchronous networking,
	  threading, and notification framework for Lua on Unix.

	  http://25thandclement.com/~william/projects/cqueues.html

comment "lua-cqueues needs a toolchain w/ threads"
	depends on !LINGMO_TOOLCHAIN_HAS_THREADS
```

## package/lua-curl/Config.in
```kconfig
config LINGMO_PACKAGE_LUA_CURL
	bool "lua-curl"
	select LINGMO_PACKAGE_LIBCURL
	help
	  Lua binding to libcurl.

	  https://lua-curl.github.io/
```

## package/lua-ev/Config.in
```kconfig
config LINGMO_PACKAGE_LUA_EV
	bool "lua-ev"
	select LINGMO_PACKAGE_LIBEV
	help
	  Get access to the libev library from Lua.

	  https://github.com/brimworks/lua-ev
```

## package/lua-flu/Config.in
```kconfig
config LINGMO_PACKAGE_LUA_FLU
	bool "lua-flu"
	depends on !LINGMO_STATIC_LIBS # libfuse
	depends on LINGMO_TOOLCHAIN_HAS_THREADS # libfuse
	depends on LINGMO_USE_MMU # libfuse
	depends on !LINGMO_PACKAGE_LUA_5_4
	select LINGMO_PACKAGE_ATTR
	select LINGMO_PACKAGE_LIBFUSE
	help
	  Flu is a Lua binding for FUSE, which is a library allowing
	  creation of filesystem drivers run in userspace. Flu is a high
	  level binding, using basic Lua types rather than userdata
	  whenever possible.

	  http://piratery.net/flu/

comment "lua-flu needs a toolchain w/ threads, dynamic library, Lua <= 5.3"
	depends on LINGMO_USE_MMU
	depends on !LINGMO_TOOLCHAIN_HAS_THREADS || LINGMO_STATIC_LIBS || LINGMO_PACKAGE_LUA_5_4
```

## package/lua-http/Config.in
```kconfig
config LINGMO_PACKAGE_LUA_HTTP
	bool "lua-http"
	depends on LINGMO_TOOLCHAIN_HAS_THREADS    # luaossl & lua-cqueues
	select LINGMO_PACKAGE_LPEG # runtime
	select LINGMO_PACKAGE_LUA_BASEXX # runtime
	select LINGMO_PACKAGE_LUA_BINARYHEAP # runtime
	select LINGMO_PACKAGE_LUA_COMPAT53 if LINGMO_PACKAGE_LUAINTERPRETER_ABI_VERSION_5_1 # runtime
	select LINGMO_PACKAGE_LUA_CQUEUES # runtime
	select LINGMO_PACKAGE_LUA_FIFO # runtime
	select LINGMO_PACKAGE_LUA_LPEG_PATTERNS # runtime
	select LINGMO_PACKAGE_LUABITOP if LINGMO_PACKAGE_LUA_5_1 # runtime
	select LINGMO_PACKAGE_LUAOSSL # runtime
	help
	  HTTP library for Lua.

	  https://github.com/daurnimator/lua-http

comment "lua-http needs a toolchain w/ threads"
	depends on !LINGMO_TOOLCHAIN_HAS_THREADS
```

## package/lua-iconv/Config.in
```kconfig
config LINGMO_PACKAGE_LUA_ICONV
	bool "lua-iconv"
	select LINGMO_PACKAGE_LIBICONV if !LINGMO_ENABLE_LOCALE
	help
	  Lua binding to the POSIX 'iconv' library

	  http://ittner.github.io/lua-iconv/
```

## package/lua-livr-extra/Config.in
```kconfig
config LINGMO_PACKAGE_LUA_LIVR_EXTRA
	bool "lua-livr-extra"
	select LINGMO_PACKAGE_LUA_LIVR # runtime
	help
	  more LIVR rules.

	  https://fperrad.frama.io/lua-LIVR-extra
```

## package/lua-sailor/Config.in
```kconfig
config LINGMO_PACKAGE_LUA_SAILOR
	bool "lua-sailor"
	select LINGMO_PACKAGE_CGILUA # runtime
	select LINGMO_PACKAGE_LBASE64 # runtime
	select LINGMO_PACKAGE_LUA_DATAFILE # runtime
	select LINGMO_PACKAGE_LUA_VALUA # runtime
	select LINGMO_PACKAGE_LUAFILESYSTEM # runtime
	select LINGMO_PACKAGE_WSAPI_XAVANTE # runtime
	select LINGMO_PACKAGE_XAVANTE # runtime
	help
	  Sailor is a web framework written in Lua that follows the MVC
	  design pattern.

	  http://sailorproject.org/
```

## package/lua-sdl2/Config.in
```kconfig
config LINGMO_PACKAGE_LUA_SDL2
	bool "lua-sdl2"
	depends on !LINGMO_STATIC_LIBS
	depends on !LINGMO_PACKAGE_LUA_5_4
	select LINGMO_PACKAGE_SDL2
	help
	  Lua-SDL2 is a pure C binding of SDL2 to Lua 5.1, Lua 5.2,
	  Lua 5.3, and LuaJIT.

	  https://github.com/Tangent128/luasdl2

comment "lua-sdl2 needs a toolchain w/ dynamic library, Lua <= 5.3"
	depends on LINGMO_STATIC_LIBS || LINGMO_PACKAGE_LUA_5_4
```

## package/lua-silva/Config.in
```kconfig
config LINGMO_PACKAGE_LUA_SILVA
	bool "lua-silva"
	help
	  your string matcher expert.

	  https://fperrad.frama.io/lua-Silva
```

## package/lua/Config.in
```kconfig
config LINGMO_PACKAGE_LUA
	bool "lua"
	select LINGMO_PACKAGE_HAS_LUAINTERPRETER
	help
	  Lua is a powerful, fast, light-weight, embeddable scripting
	  language.

	  http://www.lua.org/

if LINGMO_PACKAGE_LUA

config LINGMO_PACKAGE_PROVIDES_LUAINTERPRETER
	default "lua"

choice
	prompt "Lua Version"
	default LINGMO_PACKAGE_LUA_5_3 if LINGMO_PACKAGE_LUA_5_2 # legacy
	default LINGMO_PACKAGE_LUA_5_4
	help
	  Select the version of Lua API/ABI you wish to use.

config LINGMO_PACKAGE_LUA_5_1
	bool "Lua 5.1.x"
	select LINGMO_PACKAGE_LUAINTERPRETER_ABI_VERSION_5_1
	select LINGMO_PACKAGE_LUA_CVT_N2S
	select LINGMO_PACKAGE_LUA_CVT_S2N

config LINGMO_PACKAGE_LUA_5_3
	bool "Lua 5.3.x"
	select LINGMO_PACKAGE_LUAINTERPRETER_ABI_VERSION_5_3

config LINGMO_PACKAGE_LUA_5_4
	bool "Lua 5.4.x"
	select LINGMO_PACKAGE_LUAINTERPRETER_ABI_VERSION_5_4

endchoice

if LINGMO_PACKAGE_LUA_5_3 || LINGMO_PACKAGE_LUA_5_4
config LINGMO_PACKAGE_LUA_32BITS
	bool "Use 32 bit numbers"
	default y if !LINGMO_ARCH_IS_64
	help
	  Use a 32 bit data type for numbers / integers instead of the
	  default 64 bit type. This option is particularly attractive
	  for small machines and embedded systems.

endif

config LINGMO_PACKAGE_LUA_CVT_N2S
	bool "automatic coercion from number to string"
	default y  # legacy
	help
	  If unsure, say y, this is the default behavior of the Lua
	  interpreter. See LUA_NOCVTN2S in luaconf.h

config LINGMO_PACKAGE_LUA_CVT_S2N
	bool "automatic coercion from string to number"
	default y  # legacy
	help
	  If unsure, say y, this is the default behavior of the Lua
	  interpreter. See LUA_NOCVTN2S in luaconf.h

choice
	prompt "Lua command-line editing"
	default LINGMO_PACKAGE_LUA_EDITING_NONE

config LINGMO_PACKAGE_LUA_EDITING_NONE
	bool "none"
	help
	  None.

config LINGMO_PACKAGE_LUA_READLINE
	bool "readline support"
	select LINGMO_PACKAGE_READLINE
	select LINGMO_PACKAGE_NCURSES
	help
	  Enables command-line editing in the Lua interpreter.

config LINGMO_PACKAGE_LUA_LINENOISE
	bool "linenoise support"
	select LINGMO_PACKAGE_LINENOISE
	help
	  Enables command-line editing in the Lua interpreter.

endchoice

endif
```

## package/luadbi-sqlite3/Config.in
```kconfig
config LINGMO_PACKAGE_LUADBI_SQLITE3
	bool "luadbi-sqlite3"
	select LINGMO_PACKAGE_SQLITE
	select LINGMO_PACKAGE_LUADBI # runtime
	help
	  LuaDBI is a database interface library for Lua.
	  And this is the SQLite3 backend.

	  https://github.com/mwild1/luadbi
```

## package/luaexpat/Config.in
```kconfig
config LINGMO_PACKAGE_LUAEXPAT
	bool "luaexpat"
	select LINGMO_PACKAGE_EXPAT
	help
	  LuaExpat is a SAX XML parser based on the Expat library.

	  https://lunarmodules.github.io/luaexpat
```
