## package/lshw/Config.in
```kconfig
config LINGMO_PACKAGE_LSHW
	bool "lshw"
	depends on LINGMO_INSTALL_LIBSTDCPP
	depends on LINGMO_USE_WCHAR
	select LINGMO_PACKAGE_HWDATA # runtime
	select LINGMO_PACKAGE_HWDATA_PCI_IDS
	select LINGMO_PACKAGE_HWDATA_PNP_IDS
	select LINGMO_PACKAGE_HWDATA_USB_IDS
	help
	  lshw (Hardware Lister) is a small tool to provide
	  detailed information on the hardware configuration of the
	  machine.

	  http://ezix.org/project/wiki/HardwareLiSter

comment "lshw needs a toolchain w/ C++, wchar"
	depends on !LINGMO_INSTALL_LIBSTDCPP || !LINGMO_USE_WCHAR
```

## package/lsof/Config.in
```kconfig
config LINGMO_PACKAGE_LSOF
	bool "lsof"
	depends on LINGMO_USE_MMU # fork()
	depends on LINGMO_PACKAGE_BUSYBOX_SHOW_OTHERS
	help
	  lsof (LiSt Open Files)
	  The lsof tool lists information about files opened by
	  processes.

	  https://github.com/lsof-org/lsof
```

## package/lsqlite3/Config.in
```kconfig
config LINGMO_PACKAGE_LSQLITE3
	bool "lsqlite3"
	select LINGMO_PACKAGE_SQLITE
	help
	  A binding for Lua to the SQLite3 database library.

	  http://lua.sqlite.org/
```

## package/lsscsi/Config.in
```kconfig
config LINGMO_PACKAGE_LSSCSI
	bool "lsscsi"
	help
	  lsscsi - list SCSI devices (or hosts) and their attributes

	  http://sg.danny.cz/scsi/lsscsi.html
```
