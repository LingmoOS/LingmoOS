## package/linux-pam/Config.in
```kconfig
config LINGMO_PACKAGE_LINUX_PAM
	bool "linux-pam"
	depends on LINGMO_ENABLE_LOCALE
	depends on LINGMO_USE_WCHAR
	depends on !LINGMO_STATIC_LIBS
	depends on LINGMO_USE_MMU # fork()
	depends on LINGMO_TOOLCHAIN_GCC_AT_LEAST_4_9 # C11/stdatomic.h
	select LINGMO_PACKAGE_FLEX
	help
	  A Security Framework that Provides Authentication for
	  Applications

	  http://linux-pam.org

comment "linux-pam needs a toolchain w/ wchar, locale, dynamic library, gcc >= 4.9"
	depends on LINGMO_USE_MMU
	depends on !LINGMO_ENABLE_LOCALE || !LINGMO_USE_WCHAR \
		|| LINGMO_STATIC_LIBS || !LINGMO_TOOLCHAIN_GCC_AT_LEAST_4_9
```

## package/linuxconsoletools/Config.in
```kconfig
config LINGMO_PACKAGE_LINUXCONSOLETOOLS
	bool "linuxconsoletools"
	select LINGMO_PACKAGE_LINUXCONSOLETOOLS_INPUTATTACH if \
	       !LINGMO_PACKAGE_LINUXCONSOLETOOLS_JOYSTICK && \
	       !LINGMO_PACKAGE_LINUXCONSOLETOOLS_FORCEFEEDBACK
	help
	  Linuxconsoletools contains the inputattach utility
	  to attach legacy serial devices to the Linux kernel
	  input layer and joystick utilities to calibrate and
	  test joysticks and joypads.

	  http://sf.net/projects/linuxconsole/

if LINGMO_PACKAGE_LINUXCONSOLETOOLS

config LINGMO_PACKAGE_LINUXCONSOLETOOLS_INPUTATTACH
	bool "inputattach"
	default y
	help
	  The inputattach utility attaches legacy serial devices
	  to the Linux kernel input layer.

config LINGMO_PACKAGE_LINUXCONSOLETOOLS_JOYSTICK
	bool "joystick utilities"
	help
	  Joystick utilities (jstest, jscal, jscal-store,
	  jscal-restore, evdev-joystick).

config LINGMO_PACKAGE_LINUXCONSOLETOOLS_FORCEFEEDBACK
	bool "force-feedback utilities"
	depends on !LINGMO_STATIC_LIBS
	select LINGMO_PACKAGE_SDL2
	help
	  Build force-feedback driver utilities (fftest,
	  ffmvforce, ffset, ffcfstress).

comment "force-feedback utilities need a toolchain w/ dynamic library"
	depends on LINGMO_STATIC_LIBS

endif
```

## package/liquid-dsp/Config.in
```kconfig
comment "liquid-dsp requires a glibc or musl toolchain w/ dynamic library"
	depends on !(LINGMO_TOOLCHAIN_USES_GLIBC || LINGMO_TOOLCHAIN_USES_MUSL) || LINGMO_STATIC_LIBS

config LINGMO_PACKAGE_LIQUID_DSP
	bool "liquid-dsp"
	depends on LINGMO_TOOLCHAIN_USES_GLIBC || LINGMO_TOOLCHAIN_USES_MUSL
	depends on !LINGMO_STATIC_LIBS
	help
	  Liquid-DSP is a free and open-source signal processing
	  library for software-defined radios written in C.  Its
	  purpose is to provide a set of extensible DSP modules that
	  do no rely on external dependencies or cumbersome
	  frameworks.

	  http://liquidsdr.org/

if LINGMO_PACKAGE_LIQUID_DSP

config LINGMO_PACKAGE_LIQUID_DSP_FAST
	bool "optimize for speed over accuracy"
	help
	  Optimize for speed over accuracy.

endif
```

## package/lirc-tools/Config.in
```kconfig
config LINGMO_PACKAGE_LIRC_TOOLS
	bool "lirc-tools"
	depends on LINGMO_USE_MMU # fork()
	depends on LINGMO_TOOLCHAIN_HAS_THREADS
	depends on LINGMO_INSTALL_LIBSTDCPP
	# dlopen()
	depends on !LINGMO_STATIC_LIBS
	help
	  LIRC is a package that supports receiving and sending IR
	  signals of the most common IR remote controls. It contains a
	  daemon that decodes and sends IR signals, a mouse daemon
	  that translates IR signals to mouse movements and a couple
	  of user programs that allow to control your computer with a
	  remote control.

	  It requires the kernel LIRC interface driver, make sure to
	  enable the kernel drivers to support your hardware.

	  http://www.lirc.org/

comment "lirc-tools needs a toolchain w/ threads, dynamic library, C++"
	depends on LINGMO_USE_MMU
	depends on !LINGMO_TOOLCHAIN_HAS_THREADS || LINGMO_STATIC_LIBS \
		|| !LINGMO_INSTALL_LIBSTDCPP
```

## package/ljlinenoise/Config.in
```kconfig
config LINGMO_PACKAGE_LJLINENOISE
	bool "ljlinenoise"
	# ljsyscall is specifically for LuaJIT, not Lua.
	depends on LINGMO_PACKAGE_LUAJIT
	select LINGMO_PACKAGE_LJSYSCALL # runtime
	help
	  ljlinenoise is a pure LuaJIT port of linenoise,
	  a small alternative to readline and libedit.

	  https://fperrad.frama.io/ljlinenoise/

comment "ljlinenoise needs LuaJIT"
	depends on !LINGMO_PACKAGE_LUAJIT
```

## package/ljsyscall/Config.in
```kconfig
config LINGMO_PACKAGE_LJSYSCALL
	bool "ljsyscall"
	# ljsyscall is specifically for LuaJIT, not Lua.
	depends on LINGMO_PACKAGE_LUAJIT
	help
	  An FFI implementation of the Linux and NetBSD kernel ABIs for
	  LuaJIT.

	  http://www.myriabit.com/ljsyscall/

comment "ljsyscall needs LuaJIT"
	depends on !LINGMO_PACKAGE_LUAJIT
```

## package/lksctp-tools/Config.in
```kconfig
config LINGMO_PACKAGE_LKSCTP_TOOLS
	bool "lksctp-tools"
	depends on LINGMO_USE_MMU # fork()
	depends on LINGMO_TOOLCHAIN_HAS_THREADS
	depends on !LINGMO_STATIC_LIBS # dlopen()
	help
	  The lksctp-tools project provides a Linux user space library
	  for SCTP (libsctp) including C language header files
	  (netinet/sctp.h) for accessing SCTP specific application
	  programming interfaces not provided by the standard sockets,
	  and also some helper utilities around SCTP.

	  http://lksctp.sourceforge.net/

comment "lksctp-tools needs a toolchain w/ threads, dynamic library"
	depends on LINGMO_USE_MMU
	depends on !LINGMO_TOOLCHAIN_HAS_THREADS || LINGMO_STATIC_LIBS
```

## package/llvm-project/clang/Config.in
```kconfig
config LINGMO_PACKAGE_CLANG
	bool "clang"
	depends on LINGMO_PACKAGE_LLVM_ARCH_SUPPORTS
	depends on LINGMO_TOOLCHAIN_GCC_AT_LEAST_7
	depends on LINGMO_TOOLCHAIN_HAS_THREADS
	depends on LINGMO_INSTALL_LIBSTDCPP
	depends on !LINGMO_TOOLCHAIN_HAS_GCC_BUG_64735 # std::shared_future
	depends on !LINGMO_STATIC_LIBS
	depends on LINGMO_USE_WCHAR # std::wstring
	depends on LINGMO_HOST_GCC_AT_LEAST_7
	select LINGMO_PACKAGE_LLVM
	help
	  Clang is a C/C++, Objective C/C++ and OpenCL C front-end
	  for the LLVM compiler.

	  http://clang.llvm.org

comment "clang needs a toolchain w/ wchar, threads, C++, gcc >= 7, dynamic library, host gcc >= 7"
	depends on LINGMO_PACKAGE_LLVM_ARCH_SUPPORTS
	depends on !LINGMO_TOOLCHAIN_HAS_THREADS || !LINGMO_INSTALL_LIBSTDCPP || \
		!LINGMO_TOOLCHAIN_GCC_AT_LEAST_7 \
		|| LINGMO_STATIC_LIBS || !LINGMO_USE_WCHAR \
		|| !LINGMO_HOST_GCC_AT_LEAST_7

comment "clang needs a toolchain not affected by GCC bug 64735"
	depends on LINGMO_PACKAGE_LLVM_ARCH_SUPPORTS
	depends on LINGMO_TOOLCHAIN_HAS_GCC_BUG_64735
```

## package/llvm-project/compiler-rt/Config.in
```kconfig
config LINGMO_PACKAGE_COMPILER_RT
	bool "compiler-rt"
	depends on LINGMO_PACKAGE_LLVM
	depends on LINGMO_TOOLCHAIN_USES_GLIBC # asan lib requires
	depends on LINGMO_HOST_GCC_AT_LEAST_7 # host-clang
	help
	  A collection of runtime libraries primarily used by clang and
	  llvm to provide builtins, sanitizer runtimes, and profiling
	  at runtime.

	  https://compiler-rt.llvm.org/

comment "compiler-rt requires llvm to be enabled, a glibc toolchain, host gcc >= 7"
	depends on !LINGMO_PACKAGE_LLVM
	depends on !LINGMO_TOOLCHAIN_USES_GLIBC ||	!LINGMO_HOST_GCC_AT_LEAST_7
```

## package/llvm-project/lld/Config.in.host
```kconfig
config LINGMO_PACKAGE_HOST_LLD
	bool "host lld"
	depends on LINGMO_PACKAGE_LLVM_ARCH_SUPPORTS # llvm
	depends on LINGMO_HOST_GCC_AT_LEAST_7 # host-llvm
	help
	  LLD is a linker from the LLVM project that is a drop-in
	  replacement for system linkers, and runs much faster than
	  them. It also provides features that are useful for
	  toolchain developers.

	  https://lld.llvm.org/

comment "host lld needs host gcc >= 7"
	depends on LINGMO_PACKAGE_LLVM_ARCH_SUPPORTS
	depends on !LINGMO_HOST_GCC_AT_LEAST_7
```

## package/llvm-project/llvm/Config.in
```kconfig
config LINGMO_PACKAGE_LLVM_ARCH_SUPPORTS
	bool
	default y if LINGMO_i386
	default y if LINGMO_x86_64
	default y if LINGMO_aarch64
	default y if LINGMO_arm || LINGMO_armeb
	default y if LINGMO_riscv

config LINGMO_PACKAGE_LLVM_TARGET_ARCH
	string
	default "AArch64" if LINGMO_aarch64
	default "ARM" if LINGMO_arm || LINGMO_armeb
	default "X86" if LINGMO_i386 || LINGMO_x86_64
	default "riscv32" if LINGMO_riscv && !LINGMO_ARCH_IS_64
	default "riscv64" if LINGMO_riscv && LINGMO_ARCH_IS_64

config LINGMO_PACKAGE_LLVM
	bool "llvm"
	depends on LINGMO_PACKAGE_LLVM_ARCH_SUPPORTS
	depends on LINGMO_TOOLCHAIN_GCC_AT_LEAST_7
	depends on LINGMO_TOOLCHAIN_HAS_THREADS
	depends on LINGMO_INSTALL_LIBSTDCPP
	depends on !LINGMO_TOOLCHAIN_HAS_GCC_BUG_64735 # std::shared_future
	depends on !LINGMO_STATIC_LIBS
	depends on LINGMO_USE_WCHAR # std::wstring
	depends on LINGMO_HOST_GCC_AT_LEAST_7 # host-llvm
	help
	  The LLVM Project is a collection of modular and reusable
	  compiler and toolchain technologies.

	  http://llvm.org

if LINGMO_PACKAGE_LLVM

config LINGMO_PACKAGE_LLVM_AMDGPU
	bool "AMDGPU backend"
	help
	  Build AMDGPU target. Select this option if you are going
	  to install mesa3d with llvm and use Gallium Radeon driver.

config LINGMO_PACKAGE_LLVM_RTTI
	bool "enable rtti"
	help
	  Build LLVM with run-time type information. LLVM can be built
	  without rtti, but turning it off changes the ABI of C++
	  programs.

	  This features is needed to build the Gallium Nouveau driver
	  or the Clover OpenCL state tracker when llvm support is
	  enabled.

	  https://llvm.org/docs/HowToSetUpLLVMStyleRTTI.html

config LINGMO_PACKAGE_LLVM_BPF
	bool "BPF backend"
	help
	  Build BPF target. Select this option if you are going
	  to install bcc on the target.

config LINGMO_PACKAGE_LLVM_DUMP
	bool "enable dump"
	help
	  Build LLVM with dump functions even when assertions are
	  disabled.

endif

comment "llvm needs a toolchain w/ wchar, threads, C++, gcc >= 7, dynamic library, host gcc >= 7"
	depends on LINGMO_PACKAGE_LLVM_ARCH_SUPPORTS
	depends on !LINGMO_TOOLCHAIN_HAS_THREADS || !LINGMO_INSTALL_LIBSTDCPP || \
		!LINGMO_TOOLCHAIN_GCC_AT_LEAST_7 \
		|| LINGMO_STATIC_LIBS || !LINGMO_USE_WCHAR \
		|| !LINGMO_HOST_GCC_AT_LEAST_7

comment "llvm needs a toolchain not affected by GCC bug 64735"
	depends on LINGMO_PACKAGE_LLVM_ARCH_SUPPORTS
	depends on LINGMO_TOOLCHAIN_HAS_GCC_BUG_64735
```

## package/lmbench/Config.in
```kconfig
config LINGMO_PACKAGE_LMBENCH
	bool "lmbench"
	depends on LINGMO_TOOLCHAIN_HAS_NATIVE_RPC || LINGMO_TOOLCHAIN_HAS_THREADS # libtirpc
	depends on LINGMO_USE_MMU # fork()
	select LINGMO_PACKAGE_LIBTIRPC if !LINGMO_TOOLCHAIN_HAS_NATIVE_RPC
	help
	  LMbench is a suite of simple, portable,
	  ANSI/C microbenchmarks for UNIX/POSIX.

	  http://sourceforge.net/projects/lmbench/

comment "lmbench needs a toolchain w/ threads"
	depends on LINGMO_USE_MMU
	depends on !(LINGMO_TOOLCHAIN_HAS_THREADS || LINGMO_TOOLCHAIN_HAS_NATIVE_RPC)
```

## package/lockfile-progs/Config.in
```kconfig
config LINGMO_PACKAGE_LOCKFILE_PROGS
	bool "lockfile programs"
	depends on LINGMO_USE_MMU # liblockfile
	select LINGMO_PACKAGE_LIBLOCKFILE
	help
	  Build lockfile utility programs.
```

## package/log4cplus/Config.in
```kconfig
config LINGMO_PACKAGE_LOG4CPLUS
	bool "log4cplus"
	depends on LINGMO_INSTALL_LIBSTDCPP
	depends on LINGMO_USE_WCHAR
	depends on LINGMO_TOOLCHAIN_HAS_THREADS
	depends on LINGMO_TOOLCHAIN_GCC_AT_LEAST_4_8 # C++11
	depends on !LINGMO_TOOLCHAIN_HAS_GCC_BUG_64735 # std::future
	help
	  log4cplus is a simple to use C++ logging API providing
	  thread-safe, flexible, and arbitrarily granular control
	  over log management and configuration. It is modelled
	  after the Java log4j API.

	  http://sourceforge.net/projects/log4cplus

comment "log4cplus needs a toolchain w/ C++, wchar, threads, gcc >= 4.8"
	depends on !LINGMO_INSTALL_LIBSTDCPP || !LINGMO_USE_WCHAR || \
		!LINGMO_TOOLCHAIN_HAS_THREADS || !LINGMO_TOOLCHAIN_GCC_AT_LEAST_4_8

comment "log4cplus needs a toolchain not affected by GCC bug 64735"
	depends on LINGMO_TOOLCHAIN_HAS_GCC_BUG_64735
```

## package/log4cpp/Config.in
```kconfig
config LINGMO_PACKAGE_LOG4CPP
	bool "log4cpp"
	depends on LINGMO_INSTALL_LIBSTDCPP
	depends on LINGMO_TOOLCHAIN_HAS_THREADS
	help
	  Log4cpp is library of C++ classes for flexible logging to
	  files, syslog, IDSA and other destinations.  It is modeled
	  after the Log4j Java library, staying as close to their API
	  as is reasonable.

	  http://log4cpp.sourceforge.net/

comment "log4cpp needs a toolchain w/ C++, threads"
	depends on !LINGMO_INSTALL_LIBSTDCPP || !LINGMO_TOOLCHAIN_HAS_THREADS
```

## package/log4cxx/Config.in
```kconfig
config LINGMO_PACKAGE_LOG4CXX
	bool "log4cxx"
	# apr really needs shared library support
	depends on !LINGMO_STATIC_LIBS
	depends on LINGMO_INSTALL_LIBSTDCPP
	depends on LINGMO_TOOLCHAIN_HAS_THREADS
	depends on LINGMO_USE_MMU # apr
	depends on LINGMO_USE_WCHAR || LINGMO_TOOLCHAIN_GCC_AT_LEAST_7 # boost
	depends on LINGMO_TOOLCHAIN_SUPPORTS_ALWAYS_LOCKFREE_ATOMIC_INTS || LINGMO_TOOLCHAIN_GCC_AT_LEAST_7 # boost-thread
	depends on !LINGMO_TOOLCHAIN_HAS_GCC_BUG_64735 || LINGMO_TOOLCHAIN_GCC_AT_LEAST_7 # boost-thread
	select LINGMO_PACKAGE_APR
	select LINGMO_PACKAGE_APR_UTIL
	select LINGMO_PACKAGE_BOOST if !LINGMO_TOOLCHAIN_GCC_AT_LEAST_7
	select LINGMO_PACKAGE_BOOST_ATOMIC if !LINGMO_TOOLCHAIN_GCC_AT_LEAST_7
	select LINGMO_PACKAGE_BOOST_CHRONO if !LINGMO_TOOLCHAIN_GCC_AT_LEAST_7
	select LINGMO_PACKAGE_BOOST_DATE_TIME if !LINGMO_TOOLCHAIN_GCC_AT_LEAST_7
	select LINGMO_PACKAGE_BOOST_THREAD if !LINGMO_TOOLCHAIN_GCC_AT_LEAST_7
	help
	  Apache log4cxx is a logging framework for C++ patterned
	  after Apache log4j.

	  https://logging.apache.org/log4cxx/

comment "log4cxx needs a toolchain w/ C++, threads, dynamic library"
	depends on !LINGMO_INSTALL_LIBSTDCPP || !LINGMO_TOOLCHAIN_HAS_THREADS || \
		LINGMO_STATIC_LIBS
	depends on LINGMO_USE_MMU

comment "log4cxx needs a toolchain w/ wchar or gcc >= 7"
	depends on !(LINGMO_USE_WCHAR || LINGMO_TOOLCHAIN_GCC_AT_LEAST_7)
	depends on LINGMO_USE_MMU

comment "log4cxx needs a toolchain not affected by GCC bug 64735"
	depends on !LINGMO_TOOLCHAIN_GCC_AT_LEAST_7
	depends on LINGMO_TOOLCHAIN_HAS_GCC_BUG_64735
```

## package/logrotate/Config.in
```kconfig
config LINGMO_PACKAGE_LOGROTATE
	bool "logrotate"
	depends on LINGMO_USE_WCHAR
	depends on LINGMO_USE_MMU # fork()
	select LINGMO_PACKAGE_POPT
	help
	  A simple program to rotate logs.

	  https://github.com/logrotate/logrotate

comment "logrotate needs a toolchain w/ wchar"
	depends on LINGMO_USE_MMU
	depends on !LINGMO_USE_WCHAR
```

## package/logsurfer/Config.in
```kconfig
config LINGMO_PACKAGE_LOGSURFER
	bool "logsurfer"
	depends on LINGMO_USE_MMU # fork()
	help
	  Logsurfer is a program for monitoring system logs in
	  real-time, and reporting on the occurrence of events.

	  http://www.crypt.gen.nz/logsurfer/
```

## package/lpm/Config.in
```kconfig
config LINGMO_PACKAGE_LPM
        bool "lpm (LingmoOS Package Manager)"
        depends on !LINGMO_STATIC_LIBS # dlfcn.h
        depends on LINGMO_PACKAGE_BUSYBOX_SHOW_OTHERS
        depends on LINGMO_PACKAGE_LUA && !LINGMO_PACKAGE_LUA_5_1
        depends on LINGMO_TOOLCHAIN_HAS_THREADS
        depends on LINGMO_USE_MMU # fork()
        select LINGMO_PACKAGE_OPENSSL if !LINGMO_PACKAGE_LIBGCRYPT
        select LINGMO_PACKAGE_FILE
        select LINGMO_PACKAGE_POPT
        select LINGMO_PACKAGE_ZLIB
        help
          The Pacman Package Manager.
```

## package/lrzip/Config.in
```kconfig
config LINGMO_PACKAGE_LRZIP
	bool "lrzip"
	depends on LINGMO_USE_MMU # fork()
	depends on LINGMO_USE_WCHAR
	depends on LINGMO_TOOLCHAIN_HAS_THREADS
	depends on LINGMO_INSTALL_LIBSTDCPP
	select LINGMO_PACKAGE_ZLIB
	select LINGMO_PACKAGE_LZ4
	select LINGMO_PACKAGE_LZO
	select LINGMO_PACKAGE_BZIP2
	help
	  A compression utility that excels at compressing large files
	  (usually > 10-50 MB). Larger files and/or more free RAM means
	  that the utility will be able to more effectively compress
	  your files (ie: faster / smaller size), especially if the
	  filesize(s) exceed 100 MB. You can either choose to optimise
	  for speed (fast compression / decompression) or size,
	  but not both.

	  https://github.com/ckolivas/lrzip

comment "lrzip needs a toolchain w/ wchar, threads, C++"
	depends on LINGMO_USE_MMU
	depends on !LINGMO_USE_WCHAR || !LINGMO_TOOLCHAIN_HAS_THREADS || \
		!LINGMO_INSTALL_LIBSTDCPP
```
