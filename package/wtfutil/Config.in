## package/wtfutil/Config.in
```kconfig
config LINGMO_PACKAGE_WTFUTIL
	bool "wtfutil"
	depends on LINGMO_USE_MMU  # fork()
	depends on LINGMO_PACKAGE_HOST_GO_TARGET_ARCH_SUPPORTS
	help
	  WTF is the personal information dashboard for your terminal.

	  https://wtfutil.com/
```

## package/x11r7/libxcb/Config.in
```kconfig
config LINGMO_PACKAGE_LIBXCB
	bool "libxcb"
	select LINGMO_PACKAGE_XCB_PROTO
	select LINGMO_PACKAGE_XLIB_LIBXDMCP
	select LINGMO_PACKAGE_XLIB_LIBXAU
	help
	  The X protocol C-language Binding (XCB) is a replacement for
	  Xlib featuring a small footprint, latency hiding, direct
	  access to the protocol, improved threading support, and
	  extensibility.

	  http://xcb.freedesktop.org/
```

## package/x11r7/mcookie/Config.in
```kconfig
config LINGMO_PACKAGE_MCOOKIE
	bool "mcookie"
	help
	  cookie generator for X server

	  http://www.x.org
```

## package/x11r7/xapp_appres/Config.in
```kconfig
config LINGMO_PACKAGE_XAPP_APPRES
	bool "appres"
	select LINGMO_PACKAGE_XLIB_LIBX11
	select LINGMO_PACKAGE_XLIB_LIBXT
	help
	  list X application resource database
```

## package/x11r7/xapp_bdftopcf/Config.in
```kconfig
config LINGMO_PACKAGE_XAPP_BDFTOPCF
	bool "bdftopcf"
	select LINGMO_PACKAGE_XLIB_LIBXFONT
	help
	  X.Org bdftopcf application
```

## package/x11r7/xapp_beforelight/Config.in
```kconfig
config LINGMO_PACKAGE_XAPP_BEFORELIGHT
	bool "beforelight"
	select LINGMO_PACKAGE_XLIB_LIBX11
	select LINGMO_PACKAGE_XLIB_LIBXSCRNSAVER
	select LINGMO_PACKAGE_XLIB_LIBXAW
	select LINGMO_PACKAGE_XLIB_LIBXT
	help
	  screen saver
```

## package/x11r7/xapp_bitmap/Config.in
```kconfig
config LINGMO_PACKAGE_XAPP_BITMAP
	bool "bitmap"
	select LINGMO_PACKAGE_XLIB_LIBX11
	select LINGMO_PACKAGE_XLIB_LIBXAW
	select LINGMO_PACKAGE_XLIB_LIBXMU
	select LINGMO_PACKAGE_XDATA_XBITMAPS
	help
	  X.Org bitmap application
```

## package/x11r7/xapp_editres/Config.in
```kconfig
config LINGMO_PACKAGE_XAPP_EDITRES
	bool "editres"
	select LINGMO_PACKAGE_XLIB_LIBX11
	select LINGMO_PACKAGE_XLIB_LIBXAW
	select LINGMO_PACKAGE_XLIB_LIBXMU
	select LINGMO_PACKAGE_XLIB_LIBXT
	help
	  a dynamic resource editor for X Toolkit applications
```

## package/x11r7/xapp_fonttosfnt/Config.in
```kconfig
config LINGMO_PACKAGE_XAPP_FONTTOSFNT
	bool "fonttosfnt"
	select LINGMO_PACKAGE_FREETYPE
	select LINGMO_PACKAGE_XLIB_LIBX11
	select LINGMO_PACKAGE_XLIB_LIBFONTENC
	help
	  X.Org fonttosfnt application
```

## package/x11r7/xapp_fslsfonts/Config.in
```kconfig
config LINGMO_PACKAGE_XAPP_FSLSFONTS
	bool "fslsfonts"
	select LINGMO_PACKAGE_XLIB_LIBFS
	select LINGMO_PACKAGE_XLIB_LIBX11
	help
	  list fonts served by X font server
```

## package/x11r7/xapp_fstobdf/Config.in
```kconfig
config LINGMO_PACKAGE_XAPP_FSTOBDF
	bool "fstobdf"
	select LINGMO_PACKAGE_XLIB_LIBFS
	select LINGMO_PACKAGE_XLIB_LIBX11
	help
	  generate BDF font from X font server
```

## package/x11r7/xapp_iceauth/Config.in
```kconfig
config LINGMO_PACKAGE_XAPP_ICEAUTH
	bool "iceauth"
	select LINGMO_PACKAGE_XLIB_LIBICE
	select LINGMO_PACKAGE_XLIB_LIBX11
	help
	  ICE authority file utility
```

## package/x11r7/xapp_ico/Config.in
```kconfig
config LINGMO_PACKAGE_XAPP_ICO
	bool "ico"
	select LINGMO_PACKAGE_XLIB_LIBX11
	help
	  animate an icosahedron or other polyhedron
```

## package/x11r7/xapp_listres/Config.in
```kconfig
config LINGMO_PACKAGE_XAPP_LISTRES
	bool "listres"
	select LINGMO_PACKAGE_XLIB_LIBX11
	select LINGMO_PACKAGE_XLIB_LIBXAW
	select LINGMO_PACKAGE_XLIB_LIBXMU
	select LINGMO_PACKAGE_XLIB_LIBXT
	help
	  list resources in widgets
```

## package/x11r7/xapp_luit/Config.in
```kconfig
config LINGMO_PACKAGE_XAPP_LUIT
	bool "luit"
	depends on LINGMO_USE_MMU # fork()
	select LINGMO_PACKAGE_XLIB_LIBX11
	select LINGMO_PACKAGE_XLIB_LIBFONTENC
	help
	  Locale and ISO 2022 support for Unicode terminals
```

## package/x11r7/xapp_mkfontscale/Config.in
```kconfig
config LINGMO_PACKAGE_XAPP_MKFONTSCALE
	bool "mkfontscale"
	select LINGMO_PACKAGE_FREETYPE
	select LINGMO_PACKAGE_XLIB_LIBX11
	select LINGMO_PACKAGE_XLIB_LIBFONTENC
	select LINGMO_PACKAGE_XORGPROTO
	select LINGMO_PACKAGE_ZLIB
	help
	  create an index of scalable font files for X
```

## package/x11r7/xapp_oclock/Config.in
```kconfig
config LINGMO_PACKAGE_XAPP_OCLOCK
	bool "oclock"
	select LINGMO_PACKAGE_XLIB_LIBX11
	select LINGMO_PACKAGE_XLIB_LIBXEXT
	select LINGMO_PACKAGE_XLIB_LIBXMU
	help
	  round X clock
```

## package/x11r7/xapp_rgb/Config.in
```kconfig
config LINGMO_PACKAGE_XAPP_RGB
	bool "rgb"
	select LINGMO_PACKAGE_XORGPROTO
	help
	  uncompile an rgb color-name database
```

## package/x11r7/xapp_rstart/Config.in
```kconfig
config LINGMO_PACKAGE_XAPP_RSTART
	bool "rstart"
	depends on LINGMO_USE_MMU # fork()
	select LINGMO_PACKAGE_XLIB_LIBX11
	help
	  X.Org rstart application
```

## package/x11r7/xapp_scripts/Config.in
```kconfig
config LINGMO_PACKAGE_XAPP_SCRIPTS
	bool "scripts"
	select LINGMO_PACKAGE_XLIB_LIBX11
	help
	  start an X program on a remote machine
```

## package/x11r7/xapp_sessreg/Config.in
```kconfig
config LINGMO_PACKAGE_XAPP_SESSREG
	bool "sessreg"
	select LINGMO_PACKAGE_XLIB_LIBX11
	select LINGMO_PACKAGE_XORGPROTO
	help
	  manage utmp/wtmp entries for non-init clients
```

## package/x11r7/xapp_setxkbmap/Config.in
```kconfig
config LINGMO_PACKAGE_XAPP_SETXKBMAP
	bool "setxkbmap"
	select LINGMO_PACKAGE_XLIB_LIBX11
	select LINGMO_PACKAGE_XLIB_LIBXKBFILE
	select LINGMO_PACKAGE_XLIB_LIBXRANDR
	help
	  Controls the keyboard layout of a running X server.
```

## package/x11r7/xapp_showfont/Config.in
```kconfig
config LINGMO_PACKAGE_XAPP_SHOWFONT
	bool "showfont"
	select LINGMO_PACKAGE_XLIB_LIBFS
	help
	  font dumper for X font server
```

## package/x11r7/xapp_smproxy/Config.in
```kconfig
config LINGMO_PACKAGE_XAPP_SMPROXY
	bool "smproxy"
	select LINGMO_PACKAGE_XLIB_LIBXMU
	select LINGMO_PACKAGE_XLIB_LIBXT
	help
	  Session Manager Proxy
```

## package/x11r7/xapp_twm/Config.in
```kconfig
config LINGMO_PACKAGE_XAPP_TWM
	bool "twm"
	select LINGMO_PACKAGE_XLIB_LIBX11
	select LINGMO_PACKAGE_XLIB_LIBXEXT
	select LINGMO_PACKAGE_XLIB_LIBXT
	select LINGMO_PACKAGE_XLIB_LIBXMU
	help
	  No description available
```
