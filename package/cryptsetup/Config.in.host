## package/cryptsetup/Config.in.host
```kconfig
config LINGMO_PACKAGE_HOST_CRYPTSETUP
	bool "host cryptsetup"
	select LINGMO_PACKAGE_HOST_UTIL_LINUX
	help
	  This tool helps manipulate dm-crypt and luks partitions for
	  on-disk encryption.

	  https://gitlab.com/cryptsetup/cryptsetup
```

## package/ctorrent/Config.in
```kconfig
comment "ctorrent needs a toolchain w/ C++"
	depends on !LINGMO_INSTALL_LIBSTDCPP

config LINGMO_PACKAGE_CTORRENT
	bool "ctorrent"
	depends on LINGMO_INSTALL_LIBSTDCPP
	help
	  CTorrent is a BitTorrent client implemented in C++
	  to be lightweight and quick.
	  http://ctorrent.sourceforge.net/

	  This is the enhanced version from
	  http://www.rahul.net/dholmes/ctorrent/
```

## package/cukinia/Config.in
```kconfig
config LINGMO_PACKAGE_CUKINIA
	bool "cukinia"
	depends on LINGMO_PACKAGE_BUSYBOX || LINGMO_PACKAGE_GAWK
	help
	  Cukinia is designed to help Linux-based embedded firmware
	  developers run system-level validation tests on their product.
	  It provides a simple POSIX shell overlay, and primitives to
	  make sure system integrations and features keep behaving the
	  way they should.

	  By default, cukinia reports colorized test results on stdout,
	  but can also report them as CSV and JUnit-XML for easy
	  integration with CI systems such as Jenkins.

	  https://github.com/savoirfairelinux/cukinia

comment "cukinia needs busybox or gawk"
	depends on !(LINGMO_PACKAGE_BUSYBOX || LINGMO_PACKAGE_GAWK)
```

## package/cunit/Config.in
```kconfig
config LINGMO_PACKAGE_CUNIT
	bool "cunit"
	help
	  An automated testing framework in 'C'.

	  http://cunit.sourceforge.net/
```

## package/cups-filters/Config.in
```kconfig
config LINGMO_PACKAGE_CUPS_FILTERS
	bool "cups-filters"
	# needs fork()
	depends on LINGMO_USE_MMU
	depends on LINGMO_INSTALL_LIBSTDCPP # qpdf
	depends on !LINGMO_STATIC_LIBS
	depends on LINGMO_USE_WCHAR # libglib2
	depends on LINGMO_TOOLCHAIN_HAS_THREADS # libglib2
	depends on LINGMO_PACKAGE_CUPS
	depends on LINGMO_TOOLCHAIN_GCC_AT_LEAST_5 # qpdf
	depends on LINGMO_TOOLCHAIN_HAS_ATOMIC # qpdf
	select LINGMO_PACKAGE_JPEG
	select LINGMO_PACKAGE_FONTCONFIG
	select LINGMO_PACKAGE_FREETYPE
	select LINGMO_PACKAGE_LCMS2
	select LINGMO_PACKAGE_LIBGLIB2
	select LINGMO_PACKAGE_QPDF
	help
	  This project provides backends, filters, and other software
	  that was once part of the core CUPS distribution but is no
	  longer maintained by Apple Inc. In addition it contains
	  additional filters and software developed independently of
	  Apple, especially filters for the PDF-centric printing
	  workflow introduced by OpenPrinting and a daemon to browse
	  Bonjour broadcasts of remote CUPS printers to make these
	  printers available locally and to provide backward
	  compatibility to the old CUPS broadcasting and browsing of
	  CUPS 1.5.x and older.  From CUPS 1.6.0 on, this package is
	  required for using printer drivers with CUPS under Linux.
	  With CUPS 1.5.x and earlier this package can be used
	  optionally to switch over to PDF-based printing.

	  http://www.linuxfoundation.org/collaborate/workgroups/openprinting/cups-filters

comment "cups-filters needs a toolchain w/ wchar, C++, threads and dynamic library, gcc >= 5"
	depends on LINGMO_USE_MMU
	depends on LINGMO_TOOLCHAIN_HAS_ATOMIC
	depends on !LINGMO_INSTALL_LIBSTDCPP || !LINGMO_TOOLCHAIN_HAS_THREADS || \
		!LINGMO_USE_WCHAR || LINGMO_STATIC_LIBS || \
		!LINGMO_TOOLCHAIN_GCC_AT_LEAST_5
```

## package/cups-pk-helper/Config.in
```kconfig
config LINGMO_PACKAGE_CUPS_PK_HELPER
	bool "cups-pk-helper"
	depends on LINGMO_USE_MMU
	depends on LINGMO_TOOLCHAIN_GCC_AT_LEAST_7 # polkit -> c++17
	depends on LINGMO_TOOLCHAIN_HAS_THREADS # libglib2, polkit
	depends on LINGMO_USE_WCHAR # libglib2
	depends on !LINGMO_STATIC_LIBS # polkit -> duktape
	depends on !LINGMO_OPTIMIZE_FAST # polkit -> duktape
	depends on LINGMO_PACKAGE_CUPS
	select LINGMO_PACKAGE_POLKIT
	help
	  cups-pk-helper is a PolicyKit helper to configure cups with
	  fine-grained privileges.

	  https://wiki.freedesktop.org/www/Software/cups-pk-helper/

comment "cups-pk-helper support needs a toolchain with threads, wchar, dynamic library, gcc >= 7"
	depends on LINGMO_USE_MMU
	depends on !LINGMO_USE_WCHAR || !LINGMO_TOOLCHAIN_GCC_AT_LEAST_7 || \
		!LINGMO_TOOLCHAIN_HAS_THREADS || LINGMO_STATIC_LIBS

comment "cups-pk-helper can't be built with Optimize for fast"
	depends on LINGMO_OPTIMIZE_FAST
```

## package/cups/Config.in
```kconfig
config LINGMO_PACKAGE_CUPS
	bool "cups"
	# needs libstdcpp for ppdc
	depends on LINGMO_INSTALL_LIBSTDCPP
	# needs threads for ippserver
	depends on LINGMO_TOOLCHAIN_HAS_THREADS
	# needs fork()
	depends on LINGMO_USE_MMU
	help
	  The Common Unix Printing System

	  https://openprinting.github.io/cups

comment "cups needs a toolchain w/ C++, threads"
	depends on !LINGMO_INSTALL_LIBSTDCPP || !LINGMO_TOOLCHAIN_HAS_THREADS
```

## package/curlftpfs/Config.in
```kconfig
config LINGMO_PACKAGE_CURLFTPFS
	bool "curlftpfs (FUSE)"
	depends on LINGMO_USE_WCHAR # glib2
	depends on LINGMO_TOOLCHAIN_HAS_THREADS # libfuse, glib2
	depends on LINGMO_USE_MMU # libfuse, glib2
	depends on !LINGMO_STATIC_LIBS # libfuse
	select LINGMO_PACKAGE_LIBFUSE
	select LINGMO_PACKAGE_LIBGLIB2
	select LINGMO_PACKAGE_LIBICONV if !LINGMO_ENABLE_LOCALE
	select LINGMO_PACKAGE_OPENSSL
	select LINGMO_PACKAGE_LIBCURL
	help
	  CurlFtpFS is a filesystem for accessing FTP hosts based on
	  FUSE and libcurl.

	  http://curlftpfs.sourceforge.net/

comment "curlftpfs needs a toolchain w/ wchar, threads, dynamic library"
	depends on LINGMO_USE_MMU
	depends on !LINGMO_USE_WCHAR || !LINGMO_TOOLCHAIN_HAS_THREADS || LINGMO_STATIC_LIBS
```

## package/curlpp/Config.in
```kconfig
config LINGMO_PACKAGE_CURLPP
	bool "curlpp"
	depends on LINGMO_INSTALL_LIBSTDCPP
	depends on !LINGMO_STATIC_LIBS
	select LINGMO_PACKAGE_LIBCURL
	help
	  cURLpp is a C++ wrapper for libcURL.

	  http://www.curlpp.org/

comment "curlpp needs a toolchain w/ C++, dynamic library"
	depends on !LINGMO_INSTALL_LIBSTDCPP || LINGMO_STATIC_LIBS
```

## package/cutekeyboard/Config.in
```kconfig
config LINGMO_PACKAGE_CUTEKEYBOARD
	bool "cutekeyboard"
	depends on LINGMO_PACKAGE_QT5
	depends on LINGMO_PACKAGE_QT5_JSCORE_AVAILABLE # qt5declarative
	select LINGMO_PACKAGE_QT5DECLARATIVE
	select LINGMO_PACKAGE_QT5DECLARATIVE_QUICK
	select LINGMO_PACKAGE_QT5QUICKCONTROLS2
	help
	  CuteKeyboard is a Qt virtual keyboard plugin for
	  embedded applications.

	  https://amarula.github.io/cutekeyboard/

if LINGMO_PACKAGE_CUTEKEYBOARD

config LINGMO_PACKAGE_CUTEKEYBOARD_EXAMPLES
	bool "cutekeyboard examples"
	help
	  Compile also application example

endif
```

## package/cutelyst/Config.in
```kconfig
config LINGMO_PACKAGE_CUTELYST
	bool "cutelyst"
	depends on LINGMO_PACKAGE_QT5
	depends on LINGMO_INSTALL_LIBSTDCPP
	depends on LINGMO_TOOLCHAIN_GCC_AT_LEAST_4_8 # C++11
	depends on LINGMO_TOOLCHAIN_HEADERS_AT_LEAST_3_3
	select LINGMO_PACKAGE_QT5BASE_GUI
	help
	  A C++ Web Framework built on top of Qt, using
	  the simple approach of Catalyst (Perl) framework.

	  https://cutelyst.org

comment "cutelyst needs a toolchain w/ C++, gcc >= 4.8, headers >= 3.3"
	depends on LINGMO_PACKAGE_QT5
	depends on !LINGMO_INSTALL_LIBSTDCPP || !LINGMO_TOOLCHAIN_GCC_AT_LEAST_4_8
	depends on !LINGMO_TOOLCHAIN_HEADERS_AT_LEAST_3_3
```

## package/cvs/Config.in
```kconfig
config LINGMO_PACKAGE_CVS
	bool "cvs"
	depends on LINGMO_USE_WCHAR
	# needs fork()
	depends on LINGMO_USE_MMU
	select LINGMO_PACKAGE_NCURSES
	help
	  Concurrent Versions System - source code revision control
	  tools.

	  http://www.nongnu.org/cvs/

if LINGMO_PACKAGE_CVS

config LINGMO_PACKAGE_CVS_SERVER
	bool "server support"
	help
	  Enable cvs server code

endif

comment "cvs needs a toolchain w/ wchar"
	depends on LINGMO_USE_MMU
	depends on !LINGMO_USE_WCHAR
```

## package/cwiid/Config.in
```kconfig
config LINGMO_PACKAGE_CWIID
	bool "cwiid"
	depends on !LINGMO_STATIC_LIBS # bluez5_utils
	depends on LINGMO_USE_WCHAR # bluez5_utils -> libglib2
	depends on LINGMO_TOOLCHAIN_HAS_THREADS # bluez5_utils -> dbus, alsa-lib, libglib2
	depends on LINGMO_USE_MMU # bluez5_utils -> dbus, libglib2
	depends on LINGMO_TOOLCHAIN_HEADERS_AT_LEAST_3_18 # bluez5_utils hid plugin
	depends on LINGMO_TOOLCHAIN_HAS_SYNC_4 # bluez5_utils
	select LINGMO_PACKAGE_BLUEZ5_UTILS
	select LINGMO_PACKAGE_BLUEZ5_UTILS_PLUGINS_HID # runtime
	help
	  A collection of Linux tools written in C for interfacing to
	  the Nintendo Wiimote.

	  https://github.com/abstrakraft/cwiid

if LINGMO_PACKAGE_CWIID
config LINGMO_PACKAGE_CWIID_WMGUI
	bool "wmgui"
	depends on LINGMO_TOOLCHAIN_HAS_SYNC_4 # libgtk2 -> pango -> harfbuzz
	depends on LINGMO_TOOLCHAIN_GCC_AT_LEAST_4_9 # libgtk2 -> pango -> harfbuzz
	depends on LINGMO_PACKAGE_XORG7 # libgtk2
	depends on LINGMO_USE_WCHAR # libgtk2 -> libglib2
	depends on LINGMO_TOOLCHAIN_HAS_THREADS # libgtk2 -> libglib2
	depends on LINGMO_USE_MMU # libgtk2 -> libglib2
	depends on LINGMO_INSTALL_LIBSTDCPP # libgtk2 -> pango
	select LINGMO_PACKAGE_LIBGLIB2
	select LINGMO_PACKAGE_LIBGTK2
endif

comment "cwiid needs a toolchain w/ dynamic lib, threads, wchar, headers >= 3.18"
	depends on LINGMO_TOOLCHAIN_HAS_SYNC_4
	depends on LINGMO_STATIC_LIBS || !LINGMO_USE_WCHAR || \
		!LINGMO_TOOLCHAIN_HAS_THREADS || \
		!LINGMO_TOOLCHAIN_HEADERS_AT_LEAST_3_18
	depends on LINGMO_USE_MMU
```

## package/cxxtest/Config.in
```kconfig
config LINGMO_PACKAGE_CXXTEST
	bool "cxxtest"
	depends on LINGMO_INSTALL_LIBSTDCPP
	help
	  CxxTest is a unit testing framework for C++

	  http://cxxtest.com/

comment "cxxtest needs a toolchain w/ C++ support"
	depends on !LINGMO_INSTALL_LIBSTDCPP
```

## package/czmq/Config.in
```kconfig
config LINGMO_PACKAGE_CZMQ
	bool "czmq"
	depends on LINGMO_USE_MMU # fork()
	depends on LINGMO_INSTALL_LIBSTDCPP # zeromq
	depends on LINGMO_TOOLCHAIN_HAS_THREADS # zeromq
	select LINGMO_PACKAGE_ZEROMQ
	help
	  High-level C Binding for 0MQ

	  http://czmq.zeromq.org/

comment "czmq needs a toolchain w/ C++, threads"
	depends on LINGMO_USE_MMU
	depends on !(LINGMO_INSTALL_LIBSTDCPP && LINGMO_TOOLCHAIN_HAS_THREADS)
```

## package/dacapo/Config.in
```kconfig
config LINGMO_PACKAGE_DACAPO
	bool "dacapo"
	depends on LINGMO_PACKAGE_OPENJDK
	help
	  The DaCapo benchmark suite is intended as a tool for Java
	  benchmarking by the programming language, memory
	  management and computer architecture communities.

	  http://dacapobench.org/

comment "dacapo needs OpenJDK"
	depends on !LINGMO_PACKAGE_OPENJDK
```

## package/daemon/Config.in
```kconfig
config LINGMO_PACKAGE_DAEMON
	bool "daemon"
	depends on LINGMO_USE_MMU # fork()
	depends on LINGMO_TOOLCHAIN_HAS_THREADS
	help
	  Daemon turns other process into daemons.

	  http://www.libslack.org/daemon/

comment "daemon needs a toolchain w/ threads"
	depends on LINGMO_USE_MMU
	depends on !LINGMO_TOOLCHAIN_HAS_THREADS
```

## package/dahdi-tools/Config.in
```kconfig
config LINGMO_PACKAGE_DAHDI_TOOLS
	bool "dahdi-tools"
	depends on LINGMO_TOOLCHAIN_HAS_THREADS
	depends on LINGMO_LINUX_KERNEL # dahdi-linux
	depends on LINGMO_USE_MMU # perl
	select LINGMO_PACKAGE_DAHDI_LINUX
	select LINGMO_PACKAGE_PERL
	help
	  DAHDI (Digium/Asterisk Hardware Device Interface) is the open
	  source device interface technology used to control Digium and
	  other legacy telephony interface cards.

	  DAHDI Tools is a package of utilities for managing and
	  monitoring DAHDI devices.

	  http://www.asterisk.org/downloads/dahdi

comment "dahdi-tools needs a toolchain w/ threads and a Linux kernel to be built"
	depends on !LINGMO_TOOLCHAIN_HAS_THREADS || !LINGMO_LINUX_KERNEL
```

## package/dante/Config.in
```kconfig
config LINGMO_PACKAGE_DANTE
	bool "dante"
	depends on LINGMO_USE_MMU # fork()
	help
	  Dante is a product developed by Inferno Nettverk A/S. It
	  consists of a SOCKS server and a SOCKS client, implementing
	  RFC 1928 and related standards. It is a flexible product
	  that can be used to provide convenient and secure network
	  connectivity.

	  http://www.inet.no/dante/
```

## package/daq/Config.in
```kconfig
config LINGMO_PACKAGE_DAQ
	bool "daq"
	depends on !LINGMO_STATIC_LIBS # dlfcn.h
	help
	  DAQ is a Data Acquisition library for packet I/O from the
	  Snort project.

	  https://www.snort.org

comment "daq needs a toolchain w/ dynamic library"
	depends on LINGMO_STATIC_LIBS
```

## package/daq3/Config.in
```kconfig
config LINGMO_PACKAGE_DAQ3
	bool "daq3"
	depends on !LINGMO_PACKAGE_DAQ
	depends on !LINGMO_STATIC_LIBS # dlfcn.h
	depends on LINGMO_TOOLCHAIN_GCC_AT_LEAST_4_9
	depends on LINGMO_TOOLCHAIN_HAS_THREADS
	help
	  DAQ is a Data Acquisition library for packet I/O from the
	  Snort project.

	  https://www.snort.org

comment "daq3 needs a toolchain w/ dynamic library, gcc >= 4.9, threads"
	depends on !LINGMO_PACKAGE_DAQ
	depends on LINGMO_STATIC_LIBS || !LINGMO_TOOLCHAIN_GCC_AT_LEAST_4_9 \
		|| !LINGMO_TOOLCHAIN_HAS_THREADS
```

## package/dash/Config.in
```kconfig
config LINGMO_PACKAGE_DASH
	bool "dash"
	depends on LINGMO_USE_MMU # fork()
	depends on LINGMO_PACKAGE_BUSYBOX_SHOW_OTHERS
	help
	  DASH is a POSIX-compliant implementation of /bin/sh that
	  aims to be as small as possible. It does this without
	  sacrificing speed where possible. In fact, it is
	  significantly faster than bash (the GNU Bourne-Again SHell)
	  for most tasks.

	  http://gondor.apana.org.au/~herbert/dash
```

## package/datatables/Config.in
```kconfig
config LINGMO_PACKAGE_DATATABLES
	bool "datatables"
	help
	  Javascript library providing advanced interaction controls
	  for your HTML tables.

	  https://datatables.net
```

## package/dav1d/Config.in
```kconfig
config LINGMO_PACKAGE_DAV1D
	bool "dav1d"
	depends on !LINGMO_STATIC_LIBS # dlfcn.h
	depends on LINGMO_TOOLCHAIN_HAS_THREADS # pthread
	help
	  dav1d is a new AV1 cross-platform decoder, open-source, and
	  focused on speed and correctness.

	  https://code.videolan.org/videolan/dav1d

comment "dav1d needs a toolchain w/ threads, dynamic library"
	depends on !LINGMO_TOOLCHAIN_HAS_THREADS || LINGMO_STATIC_LIBS
```

## package/davfs2/Config.in
```kconfig
comment "davfs2 needs a glibc toolchain"
	depends on LINGMO_USE_MMU
	depends on !LINGMO_TOOLCHAIN_USES_GLIBC

config LINGMO_PACKAGE_DAVFS2
	bool "davfs2"
	depends on LINGMO_TOOLCHAIN_USES_GLIBC # fstab.h
	depends on LINGMO_USE_MMU # fork()
	select LINGMO_PACKAGE_NEON
	select LINGMO_PACKAGE_NEON_XML
	help
	  davfs2 is a Linux file system driver that allows to
	  mount a WebDAV resource. WebDAV is an extension to HTTP/1.1
	  that allows remote collaborative authoring of Web resources.
	  To use davfs2 via /etc/fstab, FEATURE_MOUNT_HELPERS
	  must be selected in busybox configuration.

	  http://savannah.nongnu.org/projects/davfs2
```
