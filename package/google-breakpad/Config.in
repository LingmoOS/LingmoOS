## package/gstreamer1/gst1-plugins-good/Config.in
```kconfig
menuconfig LINGMO_PACKAGE_GST1_PLUGINS_GOOD
	bool "gst1-plugins-good"
	select LINGMO_PACKAGE_GST1_PLUGINS_BASE
	select LINGMO_PACKAGE_XLIB_LIBX11 if LINGMO_PACKAGE_XORG7
	select LINGMO_PACKAGE_XLIB_LIBXEXT if LINGMO_PACKAGE_XORG7
	select LINGMO_PACKAGE_XLIB_LIBXV if LINGMO_PACKAGE_XORG7
	help
	  A set of well-supported plug-ins for GStreamer under the
	  preferred license.

	  https://gstreamer.freedesktop.org/

if LINGMO_PACKAGE_GST1_PLUGINS_GOOD

config LINGMO_PACKAGE_GST1_PLUGINS_GOOD_JPEG
	bool "jpeg (JPEG support)"
	select LINGMO_PACKAGE_JPEG
	help
	  JPeg plugin library

config LINGMO_PACKAGE_GST1_PLUGINS_GOOD_PNG
	bool "png (PNG support)"
	select LINGMO_PACKAGE_LIBPNG
	help
	  PNG plugin library

config LINGMO_PACKAGE_GST1_PLUGINS_GOOD_BZ2
	bool "bz2 support"
	depends on LINGMO_PACKAGE_GST1_PLUGINS_GOOD_PLUGIN_MATROSKA
	select LINGMO_PACKAGE_BZIP2
	help
	  Enable bz2 support for the following plugins:
	  matroska

comment "dependency-less plugins"

config LINGMO_PACKAGE_GST1_PLUGINS_GOOD_PLUGIN_ALPHA
	bool "alpha"
	help
	  adds an alpha channel to video - constant or via chroma-keying

config LINGMO_PACKAGE_GST1_PLUGINS_GOOD_PLUGIN_APETAG
	bool "apetag"
	help
	  APEv1/2 tag reader

config LINGMO_PACKAGE_GST1_PLUGINS_GOOD_PLUGIN_AUDIOFX
	bool "audiofx"
	help
	  Audio effects plugin

config LINGMO_PACKAGE_GST1_PLUGINS_GOOD_PLUGIN_AUDIOPARSERS
	bool "audioparsers"
	help
	  Parsers for various audio formats

config LINGMO_PACKAGE_GST1_PLUGINS_GOOD_PLUGIN_AUPARSE
	bool "auparse"
	help
	  parses au streams

config LINGMO_PACKAGE_GST1_PLUGINS_GOOD_PLUGIN_AUTODETECT
	bool "autodetect"
	help
	  Plugin contains auto-detection plugins for video/audio in-
	  and outputs

config LINGMO_PACKAGE_GST1_PLUGINS_GOOD_PLUGIN_AVI
	bool "avi (*.avi video)"
	default y
	help
	  AVI stream handling

config LINGMO_PACKAGE_GST1_PLUGINS_GOOD_PLUGIN_CUTTER
	bool "cutter"
	help
	  Audio Cutter to split audio into non-silent bits

config LINGMO_PACKAGE_GST1_PLUGINS_GOOD_PLUGIN_DEBUGUTILS
	bool "debugutils"
	help
	  elements for testing and debugging

config LINGMO_PACKAGE_GST1_PLUGINS_GOOD_PLUGIN_DEINTERLACE
	bool "deinterlace"
	help
	  Deinterlacer

config LINGMO_PACKAGE_GST1_PLUGINS_GOOD_PLUGIN_DTMF
	bool "dtmf"
	help
	  DTMF plugin

config LINGMO_PACKAGE_GST1_PLUGINS_GOOD_PLUGIN_EFFECTV
	bool "effectv"
	help
	  effect plugins from the effectv project

config LINGMO_PACKAGE_GST1_PLUGINS_GOOD_PLUGIN_EQUALIZER
	bool "equalizer"
	help
	  GStreamer audio equalizers

config LINGMO_PACKAGE_GST1_PLUGINS_GOOD_PLUGIN_FLV
	bool "flv"
	help
	  FLV muxing and demuxing plugin

config LINGMO_PACKAGE_GST1_PLUGINS_GOOD_PLUGIN_FLX
	bool "flx"
	help
	  FLC/FLI/FLX video decoder

config LINGMO_PACKAGE_GST1_PLUGINS_GOOD_PLUGIN_GOOM
	bool "goom"
	help
	  GOOM visualization filter

config LINGMO_PACKAGE_GST1_PLUGINS_GOOD_PLUGIN_GOOM2K1
	bool "goom2k1"
	help
	  GOOM 2k1 visualization filter

config LINGMO_PACKAGE_GST1_PLUGINS_GOOD_PLUGIN_ICYDEMUX
	bool "icydemux"
	help
	  Demux ICY tags from a stream

config LINGMO_PACKAGE_GST1_PLUGINS_GOOD_PLUGIN_ID3DEMUX
	bool "id3demux (*.mp3 audio)"
	help
	  Demux ID3v1 and ID3v2 tags from a file

config LINGMO_PACKAGE_GST1_PLUGINS_GOOD_PLUGIN_IMAGEFREEZE
	bool "imagefreeze"
	help
	  Still frame stream generator

config LINGMO_PACKAGE_GST1_PLUGINS_GOOD_PLUGIN_INTERLEAVE
	bool "interleave"
	help
	  Audio interleaver/deinterleaver

config LINGMO_PACKAGE_GST1_PLUGINS_GOOD_PLUGIN_ISOMP4
	bool "isomp4"
	default y
	help
	  ISO base media file format support (mp4, 3gpp, qt, mj2)

config LINGMO_PACKAGE_GST1_PLUGINS_GOOD_PLUGIN_LAW
	bool "law"

config LINGMO_PACKAGE_GST1_PLUGINS_GOOD_PLUGIN_LEVEL
	bool "level"
	help
	  Audio level plugin

config LINGMO_PACKAGE_GST1_PLUGINS_GOOD_PLUGIN_MATROSKA
	bool "matroska"
	help
	  Matroska and WebM stream handling

config LINGMO_PACKAGE_GST1_PLUGINS_GOOD_PLUGIN_MONOSCOPE
	bool "monoscope"
	help
	  Monoscope visualization

config LINGMO_PACKAGE_GST1_PLUGINS_GOOD_PLUGIN_MULTIFILE
	bool "multifile"
	help
	  Reads/Writes buffers from/to sequentially named files

config LINGMO_PACKAGE_GST1_PLUGINS_GOOD_PLUGIN_MULTIPART
	bool "multipart"
	help
	  multipart stream manipulation

config LINGMO_PACKAGE_GST1_PLUGINS_GOOD_PLUGIN_REPLAYGAIN
	bool "replaygain"
	help
	  ReplayGain volume normalization

config LINGMO_PACKAGE_GST1_PLUGINS_GOOD_PLUGIN_RTP
	bool "rtp"
	help
	  Real-time protocol plugins

config LINGMO_PACKAGE_GST1_PLUGINS_GOOD_PLUGIN_RTPMANAGER
	bool "rtpmanager"
	help
	  RTP session management plugin library

config LINGMO_PACKAGE_GST1_PLUGINS_GOOD_PLUGIN_RTSP
	bool "rtsp"
	help
	  transfer data via RTSP

config LINGMO_PACKAGE_GST1_PLUGINS_GOOD_PLUGIN_SHAPEWIPE
	bool "shapewipe"
	help
	  Shape Wipe transition filter

config LINGMO_PACKAGE_GST1_PLUGINS_GOOD_PLUGIN_SMPTE
	bool "smpte"
	help
	  Apply the standard SMPTE transitions on video images

config LINGMO_PACKAGE_GST1_PLUGINS_GOOD_PLUGIN_SPECTRUM
	bool "spectrum"
	help
	  Run an FFT on the audio signal, output spectrum data

config LINGMO_PACKAGE_GST1_PLUGINS_GOOD_PLUGIN_UDP
	bool "udp"
	help
	  transfer data via UDP

config LINGMO_PACKAGE_GST1_PLUGINS_GOOD_PLUGIN_VIDEOBOX
	bool "videobox"
	help
	  resizes a video by adding borders or cropping

config LINGMO_PACKAGE_GST1_PLUGINS_GOOD_PLUGIN_VIDEOCROP
	bool "videocrop"
	help
	  Crops video into a user-defined region

config LINGMO_PACKAGE_GST1_PLUGINS_GOOD_PLUGIN_VIDEOFILTER
	bool "videofilter"
	help
	  Video filters plugin

config LINGMO_PACKAGE_GST1_PLUGINS_GOOD_PLUGIN_VIDEOMIXER
	bool "videomixer"
	help
	  Video mixer

config LINGMO_PACKAGE_GST1_PLUGINS_GOOD_PLUGIN_WAVENC
	bool "wavenc"
	help
	  Encode raw audio into WAV

config LINGMO_PACKAGE_GST1_PLUGINS_GOOD_PLUGIN_WAVPARSE
	bool "wavparse (*.wav audio)"
	default y
	help
	  Parse a .wav file into raw audio

config LINGMO_PACKAGE_GST1_PLUGINS_GOOD_PLUGIN_XINGMUX
	bool "xingmux"
	help
	  Add XING tags to mpeg audio files

config LINGMO_PACKAGE_GST1_PLUGINS_GOOD_PLUGIN_Y4M
	bool "y4m"
	help
	  Encodes a YUV frame into the yuv4mpeg format (mjpegtools)

comment "plugins with external dependencies"

config LINGMO_PACKAGE_GST1_PLUGINS_GOOD_ADAPTIVEMUX2
	bool "adaptivedemux2 (Adaptive Streaming 2)"
	select LINGMO_PACKAGE_LIBXML2
	select LINGMO_PACKAGE_LIBSOUP3

config LINGMO_PACKAGE_GST1_PLUGINS_GOOD_PLUGIN_LAME
	bool "lame (*.mp3 audio encoder)"
	select LINGMO_PACKAGE_LAME
	help
	  Encode MP3s with LAME

config LINGMO_PACKAGE_GST1_PLUGINS_GOOD_PLUGIN_MPG123
	bool "mpg123 (*.mp3 audio)"
	select LINGMO_PACKAGE_MPG123
	help
	  mp3 decoding based on the mpg123 library

config LINGMO_PACKAGE_GST1_PLUGINS_GOOD_PLUGIN_OSS
	bool "ossaudio (OSS audio)"
	help
	  OSS (Open Sound System) support for GStreamer

config LINGMO_PACKAGE_GST1_PLUGINS_GOOD_PLUGIN_OSS4
	bool "oss4 (Open Sound System 4)"
	help
	  Open Sound System (OSS) version 4 support for GStreamer

config LINGMO_PACKAGE_GST1_PLUGINS_GOOD_PLUGIN_QMLGL
	bool "qmlgl (qt5)"
	depends on LINGMO_PACKAGE_QT5
	depends on LINGMO_PACKAGE_QT5_JSCORE_AVAILABLE # qt5declarative
	depends on LINGMO_PACKAGE_GST1_PLUGINS_BASE_HAS_LIB_OPENGL
	select LINGMO_PACKAGE_QT5BASE_WIDGETS
	select LINGMO_PACKAGE_QT5DECLARATIVE
	select LINGMO_PACKAGE_QT5DECLARATIVE_QUICK
	select LINGMO_PACKAGE_QT5TOOLS
	select LINGMO_PACKAGE_QT5TOOLS_LINGUIST_TOOLS
	select LINGMO_PACKAGE_QT5X11EXTRAS if LINGMO_PACKAGE_QT5BASE_XCB
	help
	  QT5 plugin which includes elements qmlglsrc and qmlglsink

comment "qmlgl (qt5) needs the gst1-plugins-base opengl library"
	depends on !LINGMO_PACKAGE_GST1_PLUGINS_BASE_HAS_LIB_OPENGL

config LINGMO_PACKAGE_GST1_PLUGINS_GOOD_PLUGIN_SHOUT2
	bool "shout2"
	select LINGMO_PACKAGE_LIBSHOUT
	help
	  Elements to send data to an icecast server using libshout2

config LINGMO_PACKAGE_GST1_PLUGINS_GOOD_PLUGIN_V4L2
	bool "v4l2"
	depends on LINGMO_TOOLCHAIN_HEADERS_AT_LEAST_3_0 # multi planar api
	select LINGMO_PACKAGE_LIBGUDEV if LINGMO_PACKAGE_HAS_UDEV
	help
	  elements for Video 4 Linux

comment "v4l2 needs a toolchain w/ headers >= 3.0"
	depends on !LINGMO_TOOLCHAIN_HEADERS_AT_LEAST_3_0

config LINGMO_PACKAGE_GST1_PLUGINS_GOOD_PLUGIN_V4L2_PROBE
	bool "v4l2-probe (m2m)"
	depends on LINGMO_PACKAGE_GST1_PLUGINS_GOOD_PLUGIN_V4L2
	help
	  Enables the V4L2 probe at plugin load time. This enables
	  support for v4l2 transform devices, such as m2m
	  devices. These plugins are registered as v4l2videoNconvert

config LINGMO_PACKAGE_GST1_PLUGINS_GOOD_PLUGIN_CAIRO
	bool "cairo"
	select LINGMO_PACKAGE_CAIRO
	select LINGMO_PACKAGE_CAIRO_PNG
	help
	  Cairo-based elements

config LINGMO_PACKAGE_GST1_PLUGINS_GOOD_PLUGIN_FLAC
	bool "flac (libFLAC)"
	depends on LINGMO_USE_WCHAR # flac
	select LINGMO_PACKAGE_FLAC
	help
	  The FLAC Lossless compressor Codec

comment "flac needs a toolchain w/ wchar"
	depends on !LINGMO_USE_WCHAR

config LINGMO_PACKAGE_GST1_PLUGINS_GOOD_PLUGIN_GDKPIXBUF
	bool "gdkpixbuf"
	depends on LINGMO_USE_WCHAR # gdk-pixbuf -> libglib2
	depends on LINGMO_TOOLCHAIN_HAS_THREADS # gdk-pixbuf -> libglib2
	select LINGMO_PACKAGE_GDK_PIXBUF
	help
	  GdkPixbuf-based image decoder, overlay and sink

comment "gdkpixbuf needs a toolchain w/ wchar, threads"
	depends on !LINGMO_USE_WCHAR || !LINGMO_TOOLCHAIN_HAS_THREADS

config LINGMO_PACKAGE_GST1_PLUGINS_GOOD_PLUGIN_JACK
	bool "jack"
	depends on LINGMO_INSTALL_LIBSTDCPP
	depends on !LINGMO_STATIC_LIBS
	depends on LINGMO_TOOLCHAIN_HAS_SYNC_4
	select LINGMO_PACKAGE_JACK2
	help
	  JACK audio source/sink plugin

comment "jack needs a toolchain w/ C++, dynamic library"
	depends on LINGMO_TOOLCHAIN_HAS_SYNC_4
	depends on !LINGMO_INSTALL_LIBSTDCPP || LINGMO_STATIC_LIBS

config LINGMO_PACKAGE_GST1_PLUGINS_GOOD_PLUGIN_PULSE
	bool "pulseaudio"
	depends on LINGMO_TOOLCHAIN_HAS_THREADS # pulseaudio
	depends on LINGMO_USE_MMU # pulseaudio
	depends on !LINGMO_STATIC_LIBS # pulseaudio
	depends on LINGMO_USE_WCHAR # pulseaudio
	depends on LINGMO_PACKAGE_PULSEAUDIO_HAS_ATOMIC # pulseaudio
	select LINGMO_PACKAGE_PULSEAUDIO
	help
	  PulseAudio plugin library

comment "pulseaudio support needs a toolchain w/ threads, wchar, dynamic library"
	depends on LINGMO_USE_MMU
	depends on LINGMO_PACKAGE_PULSEAUDIO_HAS_ATOMIC
	depends on !LINGMO_TOOLCHAIN_HAS_THREADS || LINGMO_STATIC_LIBS || !LINGMO_USE_WCHAR

config LINGMO_PACKAGE_GST1_PLUGINS_GOOD_PLUGIN_SOUPHTTPSRC
	bool "souphttpsrc (http client)"
	depends on LINGMO_USE_WCHAR # libsoup3 -> glib2
	depends on LINGMO_TOOLCHAIN_HAS_THREADS # libsoup3 -> glib2
	select LINGMO_PACKAGE_LIBSOUP3
	help
	  libsoup3 HTTP client src/sink

comment "souphttpsrc needs a toolchain w/ wchar, threads"
	depends on !LINGMO_USE_WCHAR || !LINGMO_TOOLCHAIN_HAS_THREADS

config LINGMO_PACKAGE_GST1_PLUGINS_GOOD_PLUGIN_SPEEX
	bool "speex"
	select LINGMO_PACKAGE_SPEEX
	help
	  Speex plugin library

config LINGMO_PACKAGE_GST1_PLUGINS_GOOD_PLUGIN_TAGLIB
	bool "taglib"
	depends on LINGMO_INSTALL_LIBSTDCPP
	depends on LINGMO_USE_WCHAR
	select LINGMO_PACKAGE_TAGLIB
	help
	  Taglib tagging plugin library

comment "taglib needs a toolchain w/ C++, wchar"
	depends on !LINGMO_INSTALL_LIBSTDCPP || !LINGMO_USE_WCHAR

config LINGMO_PACKAGE_GST1_PLUGINS_GOOD_PLUGIN_TWOLAME
	bool "twolame"
	select LINGMO_PACKAGE_TWOLAME
	help
	  twolame mp2 audio encoder plugin

config LINGMO_PACKAGE_GST1_PLUGINS_GOOD_PLUGIN_VPX
	bool "vpx (webm)"
	depends on LINGMO_TOOLCHAIN_HAS_THREADS # libvpx
	select LINGMO_PACKAGE_LIBVPX
	help
	  VP8 plugin

comment "libvpx needs a toolchain w/ threads"
	depends on !LINGMO_TOOLCHAIN_HAS_THREADS

config LINGMO_PACKAGE_GST1_PLUGINS_GOOD_PLUGIN_WAVPACK
	bool "wavpack (*.wv audio)"
	select LINGMO_PACKAGE_WAVPACK
	help
	  Wavpack lossless/lossy audio format handling

endif
```
