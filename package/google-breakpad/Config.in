## package/google-breakpad/Config.in
```kconfig
config LINGMO_PACKAGE_GOOGLE_BREAKPAD_ARCH_SUPPORTS
	bool
	default y if LINGMO_i386 || LINGMO_x86_64 || LINGMO_arm || LINGMO_aarch64 || \
		LINGMO_mips || LINGMO_mipsel

config LINGMO_PACKAGE_GOOGLE_BREAKPAD
	bool "google-breakpad"
	depends on LINGMO_INSTALL_LIBSTDCPP
	depends on LINGMO_TOOLCHAIN_GCC_AT_LEAST_7 # C++17
	depends on LINGMO_USE_WCHAR
	depends on LINGMO_TOOLCHAIN_HAS_THREADS
	depends on LINGMO_TOOLCHAIN_USES_GLIBC
	depends on LINGMO_PACKAGE_GOOGLE_BREAKPAD_ARCH_SUPPORTS
	depends on LINGMO_PACKAGE_HOST_GOOGLE_BREAKPAD_ARCH_SUPPORTS
	select LINGMO_PACKAGE_LINUX_SYSCALL_SUPPORT
	select LINGMO_PACKAGE_ZLIB
	help
	  Google-Breakpad is a library and tool suite that allows you
	  to distribute an application to users with compiler-provided
	  debugging information removed, record crashes in compact
	  "minidump" files, send them back to your server, and produce
	  C and C++ stack traces from these minidumps. Breakpad can
	  also write minidumps on request for programs that have not
	  crashed.

	  You may want to set LINGMO_ENABLE_DEBUG, in order to get useful
	  results.

	  This target package installs a static library named
	  libbreakpad_client.a which should be linked into programs
	  willing to use Google Breakpad. A host variant of this
	  package is also available, and provides the different tools
	  needed to extract the debugging symbols from target
	  binaries.

	  https://chromium.googlesource.com/breakpad/breakpad

if LINGMO_PACKAGE_GOOGLE_BREAKPAD

config LINGMO_PACKAGE_GOOGLE_BREAKPAD_TOOLS
	bool "Build target tools"
	help
	  Build processor and tools for target: dump_syms,
	  minidump_stackwalk and microdump_stackwalk.

endif

comment "google-breakpad requires a glibc toolchain w/ wchar, threads, C++, gcc >= 7"
	depends on LINGMO_PACKAGE_GOOGLE_BREAKPAD_ARCH_SUPPORTS
	depends on LINGMO_PACKAGE_HOST_GOOGLE_BREAKPAD_ARCH_SUPPORTS
	depends on !LINGMO_INSTALL_LIBSTDCPP || !LINGMO_USE_WCHAR || \
		!LINGMO_TOOLCHAIN_HAS_THREADS || \
		!LINGMO_TOOLCHAIN_USES_GLIBC || \
		!LINGMO_TOOLCHAIN_GCC_AT_LEAST_7
```

## package/google-breakpad/Config.in.host
```kconfig
config LINGMO_PACKAGE_HOST_GOOGLE_BREAKPAD_ARCH_SUPPORTS
	bool
	default y if LINGMO_HOSTARCH = "x86_64"
	default y if LINGMO_HOSTARCH = "x86"
	default y if LINGMO_HOSTARCH = "arm"
	default y if LINGMO_HOSTARCH = "aarch64"
	default y if LINGMO_HOSTARCH = "mips"
	default y if LINGMO_HOSTARCH = "mipsel"
```

## package/gperf/Config.in
```kconfig
config LINGMO_PACKAGE_GPERF
	bool "gperf"
	depends on LINGMO_INSTALL_LIBSTDCPP
	help
	  A 'perfect hash function' generator

	  http://www.gnu.org/software/gperf/

comment "gperf needs a toolchain w/ C++"
	depends on !LINGMO_INSTALL_LIBSTDCPP
```

## package/gpm/Config.in
```kconfig
config LINGMO_PACKAGE_GPM
	bool "gpm"
	depends on !LINGMO_STATIC_LIBS
	depends on LINGMO_USE_MMU # fork()
	help
	  "gpm" means general purpose mouse (server) and provides mouse
	  support for Linux virtual consoles.
	  gpm-root (to draw menus in current virtual console; config
	  file in /etc/gpm-root.conf) and disable-paste (to disable
	  paste buffer for security reasons), will also be installed.

	  http://www.nico.schottelius.org/software/gpm/

if LINGMO_PACKAGE_GPM

config LINGMO_PACKAGE_GPM_INSTALL_TEST_TOOLS
	bool "install test tools"
	help
	  Install gpm test tools (get-versions, mev, hltest, mouse-test,
	  display-buttons & display-coords).

endif

comment "gpm mouse server needs a toolchain w/ dynamic library"
	depends on LINGMO_STATIC_LIBS
	depends on LINGMO_USE_MMU
```

## package/gpsd/Config.in
```kconfig
comment "gpsd needs a toolchain w/ threads, dynamic library"
	depends on LINGMO_USE_MMU
	depends on !LINGMO_TOOLCHAIN_HAS_THREADS || LINGMO_STATIC_LIBS

menuconfig LINGMO_PACKAGE_GPSD
	bool "gpsd"
	# Uses fork()
	depends on LINGMO_USE_MMU
	depends on LINGMO_TOOLCHAIN_HAS_THREADS
	# Always tries to build a shared library
	depends on !LINGMO_STATIC_LIBS
	help
	  gpsd is a service daemon that monitors one or more GPSes or
	  AIS receivers attached to a host computer through serial or
	  USB ports, making all data on the location/course/velocity of
	  the sensors available to be queried on TCP port 2947 of the
	  host computer.

	  The D-Bus interface is included if dbus-glib is enabled.

	  https://gpsd.gitlab.io/gpsd

if LINGMO_PACKAGE_GPSD

config LINGMO_PACKAGE_GPSD_DEVICES
	string "Where to look for GPSes"
	default "/dev/ttyS1"

comment "Features"

config LINGMO_PACKAGE_GPSD_CLIENT_DEBUG
	bool "client debugging support"

config LINGMO_PACKAGE_GPSD_PROFILING
	bool "profiling support"
	depends on LINGMO_TOOLCHAIN_USES_GLIBC
	depends on !LINGMO_aarch64
	# Needs glibc for ARC arc-2018.03-eng007+ for correct __mcount linking
	depends on !LINGMO_arc

comment "profiling support not available with uClibc-based toolchain"
	depends on !LINGMO_TOOLCHAIN_USES_GLIBC

config LINGMO_PACKAGE_GPSD_USER
	bool "GPSD privilege revocation user"

config LINGMO_PACKAGE_GPSD_USER_VALUE
	string "user to run as"
	default "nobody"
	depends on LINGMO_PACKAGE_GPSD_USER

config LINGMO_PACKAGE_GPSD_GROUP
	bool "GPSD privilege revocation group"

config LINGMO_PACKAGE_GPSD_GROUP_VALUE
	string "group to run as"
	default "nobody"
	depends on LINGMO_PACKAGE_GPSD_GROUP

config LINGMO_PACKAGE_GPSD_MAX_CLIENT
	bool "compile with limited maximum clients"

config LINGMO_PACKAGE_GPSD_MAX_CLIENT_VALUE
	int "maximum number of clients"
	default "10"
	depends on LINGMO_PACKAGE_GPSD_MAX_CLIENT

config LINGMO_PACKAGE_GPSD_MAX_DEV
	bool "compile with maximum allowed devices"

config LINGMO_PACKAGE_GPSD_MAX_DEV_VALUE
	int "maximum allowed devices"
	default "2"
	depends on LINGMO_PACKAGE_GPSD_MAX_DEV

config LINGMO_PACKAGE_GPSD_SQUELCH
	bool "squelch gpsd_report and gpsd_hexdump to save cpu"

config LINGMO_PACKAGE_GPSD_PYTHON
	bool "build Python support and modules"
	depends on LINGMO_USE_WCHAR # python3
	select LINGMO_PACKAGE_PYTHON3
	help
	  Python libraries and tools for the gpsd service daemon
	  including gpsfake test harness.

comment "GPSD python support not available with toolchain w/o wide characters support"
	depends on !LINGMO_USE_WCHAR

comment "Protocols"

config LINGMO_PACKAGE_GPSD_AIVDM
	bool "Aivdm"
	help
	  Aivdm support

config LINGMO_PACKAGE_GPSD_ASHTECH
	bool "Ashtech"
	help
	  Ashtech support

config LINGMO_PACKAGE_GPSD_EARTHMATE
	bool "Earthmate"
	help
	  DeLorme EarthMate Zodiac support

config LINGMO_PACKAGE_GPSD_EVERMORE
	bool "EverMore"
	help
	  EverMore binary support

config LINGMO_PACKAGE_GPSD_FURY
	bool "Fury"
	help
	  Jackson Labs Fury and Firefly support

config LINGMO_PACKAGE_GPSD_FV18
	bool "FV-18"
	help
	  San Jose Navigation FV-18 support

config LINGMO_PACKAGE_GPSD_GARMIN
	bool "Garmin (kernel)"
	help
	  Garmin kernel driver support

config LINGMO_PACKAGE_GPSD_GARMIN_SIMPLE_TXT
	bool "Garmin (simple text)"
	help
	  Garmin Simple Text support

config LINGMO_PACKAGE_GPSD_GEOSTAR
	bool "Geostar"
	help
	  Geostar Protocol support

config LINGMO_PACKAGE_GPSD_GPSCLOCK
	bool "GPSClock"
	help
	  GPSClock support

config LINGMO_PACKAGE_GPSD_GREIS
	bool "Greis"
	help
	  Greis support

config LINGMO_PACKAGE_GPSD_ISYNC
	bool "iSync"
	help
	  Spectratime iSync LNRClok/GRCLOK support

config LINGMO_PACKAGE_GPSD_ITRAX
	bool "iTrax"
	help
	  iTrax support

config LINGMO_PACKAGE_GPSD_NAVCOM
	bool "Navcom"
	help
	  Navcom binary support

config LINGMO_PACKAGE_GPSD_NMEA2000
	bool "NMEA2000"
	select LINGMO_PACKAGE_GPSD_NAVCOM
	select LINGMO_PACKAGE_GPSD_AIVDM
	help
	  NMEA2000/CAN support

config LINGMO_PACKAGE_GPSD_OCEANSERVER
	bool "OceanServer"
	help
	  OceanServer Digital Compass support

config LINGMO_PACKAGE_GPSD_ONCORE
	bool "OnCore"
	help
	  OnCore support

config LINGMO_PACKAGE_GPSD_RTCM104V2
	bool "RTCM104 v2"
	help
	  RTCM104 v2 support

config LINGMO_PACKAGE_GPSD_RTCM104V3
	bool "RTCM104 v3"
	help
	  RTCM104 v3 support

config LINGMO_PACKAGE_GPSD_SIRF
	bool "SiRF"
	help
	  SiRF binary support

config LINGMO_PACKAGE_GPSD_SKYTRAQ
	bool "Skytraq"
	help
	  Skytraq support

config LINGMO_PACKAGE_GPSD_SUPERSTAR2
	bool "SuperStarII"
	help
	  Novatel SuperStarII binary support

config LINGMO_PACKAGE_GPSD_TRIMBLE_TSIP
	bool "Trimble TSIP"
	help
	  Trimble TSIP support

config LINGMO_PACKAGE_GPSD_TRIPMATE
	bool "TripMate"
	help
	  Delorme TripMate support

config LINGMO_PACKAGE_GPSD_TRUE_NORTH
	bool "True North Technologies"
	help
	  True North Technologies support

config LINGMO_PACKAGE_GPSD_UBX
	bool "UBX"
	help
	  uBlox UBX binary support

endif
```

## package/gptfdisk/Config.in
```kconfig
comment "gptfdisk needs a toolchain w/ C++"
	depends on !LINGMO_INSTALL_LIBSTDCPP

config LINGMO_PACKAGE_GPTFDISK
	bool "gptfdisk"
	depends on LINGMO_INSTALL_LIBSTDCPP
	select LINGMO_PACKAGE_UTIL_LINUX
	select LINGMO_PACKAGE_UTIL_LINUX_LIBUUID
	select LINGMO_PACKAGE_GPTFDISK_GDISK if \
		!(LINGMO_PACKAGE_GPTFDISK_SGDISK || LINGMO_PACKAGE_GPTFDISK_CGDISK)
	help
	  GPT fdisk (consisting of the gdisk and sgdisk programs) is a
	  text-mode partitioning tool that works on Globally Unique
	  Identifier (GUID) Partition Table (GPT) disks, rather than on
	  the more common (through 2010) Master Boot Record (MBR)
	  partition tables.

	  http://www.rodsbooks.com/gdisk/

if LINGMO_PACKAGE_GPTFDISK

config LINGMO_PACKAGE_GPTFDISK_GDISK
	bool "interactive gdisk"
	help
	  Install the interactive GUID partition table (GPT) manipulator
	  /usr/sbin/gdisk which is modelled after and quite similar in
	  use to the traditional MBR based fdisk tool.

config LINGMO_PACKAGE_GPTFDISK_SGDISK
	bool "command line sgdisk"
	select LINGMO_PACKAGE_POPT
	help
	  Install the command-line GUID partition table (GPT)
	  manipulator /usr/sbin/sgdisk which is named after the
	  traditional MBR based sfdisk tool albeit with an entirely
	  different option syntax.

config LINGMO_PACKAGE_GPTFDISK_CGDISK
	bool "ncurses cgdisk"
	depends on LINGMO_USE_WCHAR # ncurses wchar
	select LINGMO_PACKAGE_NCURSES
	select LINGMO_PACKAGE_NCURSES_WCHAR # needed because of UTF-16
	help
	  Install the ncurses-based GUID partition table (GPT)
	  manipulator /usr/sbin/cgdisk.

endif
```

## package/gqrx/Config.in
```kconfig
comment "gqrx needs a toolchain w/ C++, threads, wchar, dynamic library, gcc >= 8"
	depends on LINGMO_USE_MMU # gnuradio
	depends on LINGMO_TOOLCHAIN_HAS_SYNC_4 || LINGMO_TOOLCHAIN_HAS_ATOMIC
	depends on LINGMO_TOOLCHAIN_SUPPORTS_ALWAYS_LOCKFREE_ATOMIC_INTS
	depends on !LINGMO_INSTALL_LIBSTDCPP || !LINGMO_TOOLCHAIN_HAS_THREADS || \
		!LINGMO_USE_WCHAR || LINGMO_STATIC_LIBS || \
		!LINGMO_TOOLCHAIN_GCC_AT_LEAST_8

comment "gqrx needs qt5"
	depends on !LINGMO_PACKAGE_QT5

comment "gqrx needs a toolchain not affected by GCC bug 43744"
	depends on LINGMO_TOOLCHAIN_HAS_GCC_BUG_43744

config LINGMO_PACKAGE_GQRX
	bool "gqrx"
	depends on LINGMO_USE_MMU # gnuradio
	depends on !LINGMO_STATIC_LIBS # gnuradio
	depends on LINGMO_INSTALL_LIBSTDCPP # boost
	depends on LINGMO_TOOLCHAIN_HAS_THREADS # boost
	depends on LINGMO_USE_WCHAR # boost
	depends on LINGMO_TOOLCHAIN_HAS_SYNC_4 || LINGMO_TOOLCHAIN_HAS_ATOMIC
	depends on LINGMO_PACKAGE_QT5
	depends on LINGMO_TOOLCHAIN_SUPPORTS_ALWAYS_LOCKFREE_ATOMIC_INTS # gnuradio -> boost-atomic
	depends on LINGMO_TOOLCHAIN_GCC_AT_LEAST_8 # gnuradio
	depends on !LINGMO_TOOLCHAIN_HAS_GCC_BUG_43744 # gnuradio
	select LINGMO_PACKAGE_BOOST
	select LINGMO_PACKAGE_BOOST_PROGRAM_OPTIONS
	select LINGMO_PACKAGE_BOOST_SYSTEM
	select LINGMO_PACKAGE_GNURADIO
	select LINGMO_PACKAGE_GNURADIO_ANALOG
	select LINGMO_PACKAGE_GNURADIO_AUDIO
	select LINGMO_PACKAGE_GNURADIO_BLOCKS
	select LINGMO_PACKAGE_GNURADIO_DIGITAL
	select LINGMO_PACKAGE_GNURADIO_FFT
	select LINGMO_PACKAGE_GNURADIO_FILTER
	select LINGMO_PACKAGE_GNURADIO_NETWORK
	select LINGMO_PACKAGE_GR_OSMOSDR
	select LINGMO_PACKAGE_LIBSNDFILE
	select LINGMO_PACKAGE_QT5BASE_GUI
	select LINGMO_PACKAGE_QT5BASE_WIDGETS
	select LINGMO_PACKAGE_QT5SVG
	help
	  Gqrx is an open source software defined radio (SDR) receiver
	  implemented using GNU Radio and the Qt GUI
	  toolkit. Currently it works on Linux and Mac with hardware
	  supported by gr-osmosdr, including Funcube Dongle, RTL-SDR,
	  Airspy, HackRF, BladeRF, RFSpace, USRP and SoapySDR.

	  Gqrx can operate as an AM/FM/SSB receiver with audio output
	  or as an FFT-only instrument. There are also various hooks
	  for interacting with external application using network
	  sockets.

	  http://gqrx.dk/
```

## package/gr-osmosdr/Config.in
```kconfig
config LINGMO_PACKAGE_GR_OSMOSDR
	bool "gr-osmosdr"
	depends on LINGMO_PACKAGE_GNURADIO
	select LINGMO_PACKAGE_GNURADIO_BLOCKS
	select LINGMO_PACKAGE_GNURADIO_FFT
	select LINGMO_PACKAGE_GNURADIO_FILTER
	help
	  GNU Radio block for interfacing with various radio hardware

	  http://osmocom.org/projects/osmosdr

if LINGMO_PACKAGE_GR_OSMOSDR

config LINGMO_PACKAGE_GR_OSMOSDR_IQFILE
	bool "IQ File Source support"
	help
	  Enable IQ File Source support

config LINGMO_PACKAGE_GR_OSMOSDR_RTLSDR
	bool "Osmocom RTLSDR support"
	depends on LINGMO_TOOLCHAIN_GCC_AT_LEAST_4_9 # librtlsdr -> libusb
	select LINGMO_PACKAGE_LIBRTLSDR
	help
	  Enable Osmocom RTLSDR support

comment "Osmocom RTLSDR support needs a toolchain w/ gcc >= 4.9"
	depends on !LINGMO_TOOLCHAIN_GCC_AT_LEAST_4_9

config LINGMO_PACKAGE_GR_OSMOSDR_RTLSDR_TCP
	bool "RTLSDR TCP Client support"
	help
	  Enable RTLSDR TCP client support

config LINGMO_PACKAGE_GR_OSMOSDR_RFSPACE
	bool "RFSPACE Receivers support"
	help
	  Enable RFSPACE Receivers support

config LINGMO_PACKAGE_GR_OSMOSDR_HACKRF
	bool "Osmocom HACKRF support"
	depends on !LINGMO_STATIC_LIBS # hackrf
	depends on LINGMO_TOOLCHAIN_HAS_THREADS # hackrf
	depends on LINGMO_TOOLCHAIN_GCC_AT_LEAST_4_9 # hackrf
	select LINGMO_PACKAGE_HACKRF
	help
	  Enable Osmocom HACKRF support

comment "hackrf support needs a toolchain w/ threads, dynamic library, gcc >= 4.9"
	depends on LINGMO_STATIC_LIBS || !LINGMO_TOOLCHAIN_HAS_THREADS || \
		!LINGMO_TOOLCHAIN_GCC_AT_LEAST_4_9

endif
```

## package/granite/Config.in
```kconfig
config LINGMO_PACKAGE_GRANITE
	bool "granite"
	depends on LINGMO_USE_WCHAR
	depends on LINGMO_TOOLCHAIN_HAS_THREADS
	depends on LINGMO_USE_MMU # fork()
	depends on LINGMO_TOOLCHAIN_GCC_AT_LEAST_4_9 # libgee
	depends on LINGMO_PACKAGE_LIBGTK3
	select LINGMO_PACKAGE_LIBGEE
	select LINGMO_PACKAGE_LIBGLIB2
	help
	  An extension to GTK+ that provides several useful widgets and
	  classes to ease application development.

	  https://github.com/elementary/granite

comment "granite needs libgtk3 and a toolchain w/ wchar, threads, gcc >= 4.9"
	depends on LINGMO_USE_MMU
	depends on !LINGMO_PACKAGE_LIBGTK3 || !LINGMO_USE_WCHAR \
		|| !LINGMO_TOOLCHAIN_HAS_THREADS \
		|| !LINGMO_TOOLCHAIN_GCC_AT_LEAST_4_9
```

## package/grantlee/Config.in
```kconfig
config LINGMO_PACKAGE_GRANTLEE
	bool "grantlee"
	depends on LINGMO_PACKAGE_QT5_JSCORE_AVAILABLE && LINGMO_PACKAGE_QT5
	select LINGMO_PACKAGE_QT5SCRIPT
	select LINGMO_PACKAGE_QT5BASE_GUI
	help
	  Qt implementation of the Django template framework

	  http://www.grantlee.org
```

## package/graphicsmagick/Config.in
```kconfig
config LINGMO_PACKAGE_GRAPHICSMAGICK
	bool "graphicsmagick"
	depends on LINGMO_USE_MMU # fork()
	depends on LINGMO_TOOLCHAIN_HAS_THREADS
	help
	  GraphicsMagick is the swiss army knife of image processing.
	  It provides a robust and efficient collection of tools
	  and libraries which support reading, writing,
	  and manipulating an image in over 89 major formats
	  including important formats like DPX, GIF, JPEG, JPEG-2000,
	  PNG, PDF, PNM, TIFF, and WebP.

	  http://www.graphicsmagick.org/

comment "graphicsmagick needs a toolchain w/ threads"
	depends on LINGMO_USE_MMU
	depends on !LINGMO_TOOLCHAIN_HAS_THREADS
```
