## package/graphite2/Config.in
```kconfig
config LINGMO_PACKAGE_GRAPHITE2
	bool "graphite2"
	depends on LINGMO_INSTALL_LIBSTDCPP
	help
	  Graphite is a project within SIL's scripts and software dev
	  groups to provide cross-platform rendering for complex
	  writing systems.

	  https://github.com/silnrsi/graphite

comment "graphite2 needs a toolchain w/ C++"
	depends on !LINGMO_INSTALL_LIBSTDCPP
```

## package/grep/Config.in
```kconfig
config LINGMO_PACKAGE_GREP
	bool "grep"
	depends on LINGMO_USE_WCHAR
	depends on LINGMO_PACKAGE_BUSYBOX_SHOW_OTHERS
	help
	  The GNU regular expression matcher.

	  egrep/fgrep aliases need /bin/sh to be available.

	  http://www.gnu.org/software/grep/grep.html

comment "grep needs a toolchain w/ wchar"
	depends on !LINGMO_USE_WCHAR
	depends on LINGMO_PACKAGE_BUSYBOX_SHOW_OTHERS
```

## package/grpc/Config.in
```kconfig
config LINGMO_PACKAGE_GRPC
	bool "grpc"
	depends on LINGMO_INSTALL_LIBSTDCPP
	depends on LINGMO_TOOLCHAIN_HAS_THREADS # protobuf, re2
	depends on LINGMO_PACKAGE_PROTOBUF_ARCH_SUPPORTS # protobuf
	depends on LINGMO_TOOLCHAIN_GCC_AT_LEAST_8 # libabseil-cpp, re2
	depends on !LINGMO_STATIC_LIBS # protobuf, libabseil-cpp, re2
	depends on LINGMO_TOOLCHAIN_HAS_SYNC_4 || LINGMO_TOOLCHAIN_HAS_ATOMIC
	depends on LINGMO_PACKAGE_LIBABSEIL_CPP_ARCH_SUPPORTS
	select LINGMO_PACKAGE_C_ARES
	select LINGMO_PACKAGE_LIBABSEIL_CPP
	select LINGMO_PACKAGE_OPENSSL
	select LINGMO_PACKAGE_PROTOBUF
	select LINGMO_PACKAGE_RE2
	select LINGMO_PACKAGE_ZLIB
	help
	  A language-neutral, platform-neutral, open source, remote
	  procedure call (RPC) system initially developed at Google.

	  http://github.com/grpc/grpc

comment "grpc needs a toolchain w/ C++, threads, dynamic library, gcc >= 8"
	depends on LINGMO_PACKAGE_LIBABSEIL_CPP_ARCH_SUPPORTS
	depends on LINGMO_TOOLCHAIN_HAS_SYNC_4 || LINGMO_TOOLCHAIN_HAS_ATOMIC
	depends on !LINGMO_INSTALL_LIBSTDCPP || !LINGMO_TOOLCHAIN_HAS_THREADS \
		|| LINGMO_STATIC_LIBS || !LINGMO_TOOLCHAIN_GCC_AT_LEAST_8
	depends on LINGMO_PACKAGE_PROTOBUF_ARCH_SUPPORTS
```

## package/gsettings-desktop-schemas/Config.in
```kconfig
config LINGMO_PACKAGE_GSETTINGS_DESKTOP_SCHEMAS
	bool "gsettings-desktop-schemas"
	depends on LINGMO_USE_WCHAR # glib2
	depends on LINGMO_TOOLCHAIN_HAS_THREADS # glib2
	depends on LINGMO_USE_MMU # glib2
	select LINGMO_PACKAGE_LIBGLIB2
	help
	  gsettings-desktop-schemas contains a collection of GSettings
	  schemas for settings shared by various components of a
	  desktop.

	  https://github.com/GNOME/gsettings-desktop-schemas

comment "gsettings-desktop-schemas needs a toolchain w/ wchar, threads"
	depends on LINGMO_USE_MMU
	depends on !LINGMO_USE_WCHAR || !LINGMO_TOOLCHAIN_HAS_THREADS
```

## package/gssdp/Config.in
```kconfig
config LINGMO_PACKAGE_GSSDP
	bool "gssdp"
	depends on LINGMO_USE_WCHAR # glib2, libsoup3
	depends on LINGMO_TOOLCHAIN_HAS_THREADS # glib2, libsoup3
	depends on LINGMO_USE_MMU # glib2, libsoup3
	select LINGMO_PACKAGE_LIBGLIB2
	select LINGMO_PACKAGE_LIBSOUP3
	help
	  GSSDP implements resource discovery and announcement over
	  SSDP.

	  http://www.gupnp.org

comment "gssdp needs a toolchain w/ wchar, threads"
	depends on LINGMO_USE_MMU
	depends on !LINGMO_USE_WCHAR || !LINGMO_TOOLCHAIN_HAS_THREADS
```

## package/gstreamer1/gst-omx/Config.in
```kconfig
config LINGMO_PACKAGE_GST_OMX
	bool "gst-omx"
	depends on LINGMO_PACKAGE_HAS_LIBOPENMAX
	select LINGMO_PACKAGE_GST1_PLUGINS_BASE
	help
	  GStreamer plug-in to use OpenMAX API.

	  https://cgit.freedesktop.org/gstreamer/gst-omx

comment "gst-omx requires a OpenMAX implementation"
	depends on !LINGMO_PACKAGE_HAS_LIBOPENMAX
```

## package/gstreamer1/gst1-devtools/Config.in
```kconfig
config LINGMO_PACKAGE_GST1_DEVTOOLS
	bool "gst1-devtools"
	depends on LINGMO_PACKAGE_PYTHON3
	select LINGMO_PACKAGE_GSTREAMER1_CHECK
	select LINGMO_PACKAGE_GST1_PLUGINS_BASE
	select LINGMO_PACKAGE_JSON_GLIB
	select LINGMO_PACKAGE_PYTHON3_PYEXPAT
	# cairo is autodetected but needs PNG support
	select LINGMO_PACKAGE_CAIRO_PNG if LINGMO_PACKAGE_CAIRO
	help
	  GStreamer development tools (gst-validate).

	  https://gstreamer.freedesktop.org

comment "gst1-devtools depends on python"
	depends on !LINGMO_PACKAGE_PYTHON3
```

## package/gstreamer1/gst1-imx/Config.in
```kconfig
comment "gst1-imx needs a toolchain w/ dynamic library"
	depends on LINGMO_arm
	depends on LINGMO_STATIC_LIBS

menuconfig LINGMO_PACKAGE_GST1_IMX
	bool "gst1-imx"
	depends on LINGMO_arm # Only relevant for i.MX
	depends on !LINGMO_STATIC_LIBS
	select LINGMO_PACKAGE_GST1_PLUGINS_BASE
	help
	  This is a set of GStreamer 1.0 plugins for plugins for
	  Freescale's i.MX platforms, which make use of the i.MX
	  multimedia capabilities.

	  https://github.com/Freescale/gstreamer-imx

if LINGMO_PACKAGE_GST1_IMX

config LINGMO_PACKAGE_GST1_IMX_EGLVISINK
	bool "imxeglvivsink"
	depends on LINGMO_PACKAGE_IMX_GPU_VIV
	help
	  Elements leveraging the 3D GPU

comment "imxeglvivsink needs the Vivante 3D libraries"
	depends on !LINGMO_PACKAGE_IMX_GPU_VIV

config LINGMO_PACKAGE_GST1_IMX_G2D
	bool "imxg2d"
	depends on LINGMO_PACKAGE_IMX_GPU_G2D
	help
	  Elements leveraging the 2D GPU

comment "imxg2d needs the G2D libraries"
	depends on !LINGMO_PACKAGE_IMX_GPU_G2D

config LINGMO_PACKAGE_GST1_IMX_IPU
	bool "imxipu"
	depends on LINGMO_LINUX_KERNEL
	help
	  Elements leveraging the IPU

comment "imxipu needs an imx-specific Linux kernel to be built"
	depends on !LINGMO_LINUX_KERNEL

config LINGMO_PACKAGE_GST1_IMX_MP3ENCODER
	bool "mp3encoder"
	depends on LINGMO_PACKAGE_IMX_CODEC
	help
	  Elements for MP3 encoding

comment "mp3encoder needs the i.MX codec binaries"
	depends on !LINGMO_PACKAGE_IMX_CODEC

config LINGMO_PACKAGE_GST1_IMX_PXP
	bool "imxpxp"
	depends on LINGMO_LINUX_KERNEL
	help
	  Elements leveraging the PXP

comment "imxpxp needs an imx-specific Linux kernel to be built"
	depends on !LINGMO_LINUX_KERNEL

config LINGMO_PACKAGE_GST1_IMX_UNIAUDIODEC
	bool "uniaudiodec"
	depends on LINGMO_PACKAGE_IMX_CODEC
	help
	  Elements for audio decoding

comment "uniaudiodec needs the i.MX codec binaries"
	depends on !LINGMO_PACKAGE_IMX_CODEC

config LINGMO_PACKAGE_GST1_IMX_VPU
	bool "imxvpu"
	depends on LINGMO_PACKAGE_LIBIMXVPUAPI
	help
	  Elements leveraging the VPU

comment "imxvpu needs the VPU imxvpuapi library"
	depends on !LINGMO_PACKAGE_LIBIMXVPUAPI

config LINGMO_PACKAGE_GST1_IMX_V4L2VIDEOSRC
	bool "imxv4l2videosrc"
	depends on LINGMO_INSTALL_LIBSTDCPP # gst1-plugins-bad
	select LINGMO_PACKAGE_GST1_PLUGINS_BAD
	help
	  Elements for V4L2 capture

comment "imxv4l2videosrc needs a toolchain w/ C++"
	depends on !LINGMO_INSTALL_LIBSTDCPP

config LINGMO_PACKAGE_GST1_IMX_V4L2VIDEOSINK
	bool "imxv4l2videosink"
	depends on LINGMO_TOOLCHAIN_HEADERS_AT_LEAST_4_2 # V4L2_COLORSPACE_DEFAULT
	depends on LINGMO_INSTALL_LIBSTDCPP # gst1-plugins-bad
	select LINGMO_PACKAGE_GST1_PLUGINS_BAD
	help
	  Elements for V4L2 output

comment "imxv4l2videosink needs a toolchain w/ headers >= 4.2, C++"
	depends on !LINGMO_TOOLCHAIN_HEADERS_AT_LEAST_4_2 || \
		!LINGMO_INSTALL_LIBSTDCPP

endif
```

## package/gstreamer1/gst1-interpipe/Config.in
```kconfig
config LINGMO_PACKAGE_GST1_INTERPIPE
	bool "gst1-interpipe"
	select LINGMO_PACKAGE_GSTREAMER1_CHECK
	select LINGMO_PACKAGE_GST1_PLUGINS_BASE
	select LINGMO_PACKAGE_GST1_PLUGINS_BASE_PLUGIN_APP
	help
	  GstInterpipe is a Gstreamer plug-in that allows communication
	  between two independent pipelines.

	  https://github.com/RidgeRun/gst-interpipe
```

## package/gstreamer1/gst1-libav/Config.in
```kconfig
config LINGMO_PACKAGE_GST1_LIBAV
	bool "gst1-libav"
	depends on LINGMO_PACKAGE_FFMPEG_ARCH_SUPPORTS
	select LINGMO_PACKAGE_FFMPEG
	select LINGMO_PACKAGE_FFMPEG_SWSCALE
	select LINGMO_PACKAGE_GST1_PLUGINS_BASE
	help
	  GStreamer plugin (formerly gst-ffmpeg).

	  This package contains GStreamer plugins based on
	  the libav project.

	  The codecs, muxers, bitstreams and filters to build can be
	  selected in the ffmpeg package.

	  https://gstreamer.freedesktop.org/
```
