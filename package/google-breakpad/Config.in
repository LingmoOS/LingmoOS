## package/gstreamer1/gst1-plugins-bad/Config.in
```kconfig
menuconfig LINGMO_PACKAGE_GST1_PLUGINS_BAD
	bool "gst1-plugins-bad"
	depends on LINGMO_INSTALL_LIBSTDCPP
	select LINGMO_PACKAGE_GST1_PLUGINS_BASE
	help
	  A set of plug-ins for GStreamer that may be of poor quality
	  or lacking some features.

	  https://gstreamer.freedesktop.org/

if LINGMO_PACKAGE_GST1_PLUGINS_BAD

comment "dependency-less plugins"

config LINGMO_PACKAGE_GST1_PLUGINS_BAD_PLUGIN_ACCURIP
	bool "accurip"
	help
	  Accurip plugin

config LINGMO_PACKAGE_GST1_PLUGINS_BAD_PLUGIN_ADPCMDEC
	bool "adpcmdec"
	help
	  ADPCM decoder

config LINGMO_PACKAGE_GST1_PLUGINS_BAD_PLUGIN_ADPCMENC
	bool "adpcmenc"
	help
	  ADPCM encoder

config LINGMO_PACKAGE_GST1_PLUGINS_BAD_PLUGIN_AIFF
	bool "aiff"
	help
	  Create and parse Audio interchange File Format (AIFF) files

config LINGMO_PACKAGE_GST1_PLUGINS_BAD_PLUGIN_ASFMUX
	bool "asfmux"
	help
	  ASF Muxer Plugin

config LINGMO_PACKAGE_GST1_PLUGINS_BAD_PLUGIN_AUDIOBUFFERSPLIT
	bool "audiobuffersplit"
	help
	  Audio buffersplit plugin

config LINGMO_PACKAGE_GST1_PLUGINS_BAD_PLUGIN_AUDIOFXBAD
	bool "audiofxbad"
	help
	  Audio filters plugin

config LINGMO_PACKAGE_GST1_PLUGINS_BAD_PLUGIN_AUDIOLATENCY
	bool "audiolatency"
	help
	  Audio latency plugin

config LINGMO_PACKAGE_GST1_PLUGINS_BAD_PLUGIN_AUDIOMIXMATRIX
	bool "audiomixmatrix"
	help
	  Audio N:M mixer plugin

config LINGMO_PACKAGE_GST1_PLUGINS_BAD_PLUGIN_AUDIOVISUALIZERS
	bool "audiovisualizers"
	help
	  Creates video visualizations of audio input

config LINGMO_PACKAGE_GST1_PLUGINS_BAD_PLUGIN_AUTOCONVERT
	bool "autoconvert"
	help
	  Selects convertor element based on caps

config LINGMO_PACKAGE_GST1_PLUGINS_BAD_PLUGIN_BAYER
	bool "bayer"
	help
	  Elements to convert Bayer images

config LINGMO_PACKAGE_GST1_PLUGINS_BAD_PLUGIN_CAMERABIN2
	bool "camerabin2"
	help
	  Take image snapshots and record movies from camera

config LINGMO_PACKAGE_GST1_PLUGINS_BAD_PLUGIN_CODECALPHA
	bool "codecalpha"
	help
	  Elements for VP8/VP9 alpha support (codecalphademux,
	  alphacombine, vp8alphadecodebin, vp9alphadecodebin)

config LINGMO_PACKAGE_GST1_PLUGINS_BAD_PLUGIN_COLOREFFECTS
	bool "coloreffects"
	help
	  Color Look-up Table filters

config LINGMO_PACKAGE_GST1_PLUGINS_BAD_PLUGIN_DEBUGUTILS
	bool "debugutils"
	help
	  Collection of elements that may or may not be useful for
	  debugging

config LINGMO_PACKAGE_GST1_PLUGINS_BAD_PLUGIN_DVBSUBENC
	bool "dvbsubenc"
	help
	  DVB subpicture encoding support

config LINGMO_PACKAGE_GST1_PLUGINS_BAD_PLUGIN_DVBSUBOVERLAY
	bool "dvbsuboverlay"
	help
	  DVB subtitle renderer plugin

config LINGMO_PACKAGE_GST1_PLUGINS_BAD_PLUGIN_DVDSPU
	bool "dvdspu"
	help
	  DVD Sub-picture Overlay element

config LINGMO_PACKAGE_GST1_PLUGINS_BAD_PLUGIN_FACEOVERLAY
	bool "faceoverlay"

config LINGMO_PACKAGE_GST1_PLUGINS_BAD_PLUGIN_FESTIVAL
	bool "festival"
	help
	  Synthesizes plain text into audio

config LINGMO_PACKAGE_GST1_PLUGINS_BAD_PLUGIN_FIELDANALYSIS
	bool "fieldanalysis"
	help
	  Video field analysis

config LINGMO_PACKAGE_GST1_PLUGINS_BAD_PLUGIN_FREEVERB
	bool "freeverb"
	help
	  Reverberation/room effect

config LINGMO_PACKAGE_GST1_PLUGINS_BAD_PLUGIN_FREI0R
	bool "frei0r"
	help
	  frei0r plugin library

config LINGMO_PACKAGE_GST1_PLUGINS_BAD_PLUGIN_GAUDIEFFECTS
	bool "gaudieffects"
	help
	  Gaudi video effects

config LINGMO_PACKAGE_GST1_PLUGINS_BAD_PLUGIN_GEOMETRICTRANSFORM
	bool "geometrictransform"
	help
	  Various geometric image transform elements

config LINGMO_PACKAGE_GST1_PLUGINS_BAD_PLUGIN_GDP
	bool "gdp"
	help
	  Payload/depayload GDP packets

config LINGMO_PACKAGE_GST1_PLUGINS_BAD_PLUGIN_ID3TAG
	bool "id3tag"
	help
	  ID3 v1 and v2 muxing plugin

config LINGMO_PACKAGE_GST1_PLUGINS_BAD_PLUGIN_INTER
	bool "inter"
	help
	  plugin for inter-pipeline communication

config LINGMO_PACKAGE_GST1_PLUGINS_BAD_PLUGIN_INTERLACE
	bool "interlace"
	help
	  Create an interlaced video stream

config LINGMO_PACKAGE_GST1_PLUGINS_BAD_PLUGIN_IVFPARSE
	bool "ivfparse"

config LINGMO_PACKAGE_GST1_PLUGINS_BAD_PLUGIN_IVTC
	bool "ivtc"
	help
	  Inverse Telecine plugin

config LINGMO_PACKAGE_GST1_PLUGINS_BAD_PLUGIN_JP2KDECIMATOR
	bool "jp2kdecimator"

config LINGMO_PACKAGE_GST1_PLUGINS_BAD_PLUGIN_JPEGFORMAT
	bool "jpegformat"
	help
	  JPEG interchange format plugin

config LINGMO_PACKAGE_GST1_PLUGINS_BAD_PLUGIN_LIBRFB
	bool "librfb"
	help
	  Connects to a VNC server and decodes RFB stream

config LINGMO_PACKAGE_GST1_PLUGINS_BAD_PLUGIN_MIDI
	bool "midi"
	help
	  MIDI plugin

config LINGMO_PACKAGE_GST1_PLUGINS_BAD_PLUGIN_MPEGDEMUX
	bool "mpegdemux"
	help
	  MPEG-PS demuxer

config LINGMO_PACKAGE_GST1_PLUGINS_BAD_PLUGIN_MPEGTSDEMUX
	bool "mpegtsdemux"
	help
	  MPEG TS demuxer

config LINGMO_PACKAGE_GST1_PLUGINS_BAD_PLUGIN_MPEGTSMUX
	bool "mpegtsmux"
	help
	  MPEG-TS muxer

config LINGMO_PACKAGE_GST1_PLUGINS_BAD_PLUGIN_MPEGPSMUX
	bool "mpegpsmux"
	help
	  MPEG-PS muxer

config LINGMO_PACKAGE_GST1_PLUGINS_BAD_PLUGIN_MXF
	bool "mxf"
	help
	  MXF plugin library

config LINGMO_PACKAGE_GST1_PLUGINS_BAD_PLUGIN_NETSIM
	bool "netsim"

config LINGMO_PACKAGE_GST1_PLUGINS_BAD_PLUGIN_ONVIF
	bool "onvif"

config LINGMO_PACKAGE_GST1_PLUGINS_BAD_PLUGIN_PCAPPARSE
	bool "pcapparse"
	help
	  Element parsing raw pcap streams

config LINGMO_PACKAGE_GST1_PLUGINS_BAD_PLUGIN_PNM
	bool "pnm"
	help
	  PNM plugin

config LINGMO_PACKAGE_GST1_PLUGINS_BAD_PLUGIN_PROXY
	bool "proxy"
	help
	  Proxy plugin

config LINGMO_PACKAGE_GST1_PLUGINS_BAD_PLUGIN_RAWPARSE
	bool "rawparse"
	help
	  Parses byte streams into raw frames

config LINGMO_PACKAGE_GST1_PLUGINS_BAD_PLUGIN_REMOVESILENCE
	bool "removesilence"
	help
	  Removes silence from an audio stream

config LINGMO_PACKAGE_GST1_PLUGINS_BAD_PLUGIN_RIST
	bool "rist"
	help
	  RIST streaming

config LINGMO_PACKAGE_GST1_PLUGINS_BAD_PLUGIN_RTMP2
	bool "rtmp2"
	help
	  RTMP sink/source (rtmp2sink, rtmp2src)

config LINGMO_PACKAGE_GST1_PLUGINS_BAD_PLUGIN_RTP2
	bool "rtp"
	help
	  RTP (rtpsrc/rtpsink)

config LINGMO_PACKAGE_GST1_PLUGINS_BAD_PLUGIN_RTMP
	bool "rtmp"
	select LINGMO_PACKAGE_RTMPDUMP
	help
	  RTMP plugin

config LINGMO_PACKAGE_GST1_PLUGINS_BAD_PLUGIN_SDP
	bool "sdp"
	help
	  configure streaming sessions using SDP

config LINGMO_PACKAGE_GST1_PLUGINS_BAD_PLUGIN_SEGMENTCLIP
	bool "segmentclip"
	help
	  Segment clip elements

config LINGMO_PACKAGE_GST1_PLUGINS_BAD_PLUGIN_SIREN
	bool "siren"
	help
	  Siren encoder/decoder/payloader/depayloader plugins

config LINGMO_PACKAGE_GST1_PLUGINS_BAD_PLUGIN_SMOOTH
	bool "smooth"
	help
	  Apply a smooth filter to an image

config LINGMO_PACKAGE_GST1_PLUGINS_BAD_PLUGIN_SPEED
	bool "speed"
	help
	  Set speed/pitch on audio/raw streams (resampler)

config LINGMO_PACKAGE_GST1_PLUGINS_BAD_PLUGIN_SUBENC
	bool "subenc"
	help
	  subtitle encoders

config LINGMO_PACKAGE_GST1_PLUGINS_BAD_PLUGIN_SWITCHBIN
	bool "switchbin"
	help
	  Switching between paths based on input caps

config LINGMO_PACKAGE_GST1_PLUGINS_BAD_PLUGIN_TIMECODE
	bool "timecode"

config LINGMO_PACKAGE_GST1_PLUGINS_BAD_PLUGIN_VIDEOFILTERS
	bool "videofilters"
	help
	  Video filters in gst-plugins-bad

config LINGMO_PACKAGE_GST1_PLUGINS_BAD_PLUGIN_VIDEOFRAME_AUDIOLEVEL
	bool "videoframe_audiolevel"
	help
	  videoframe_audiolevel

config LINGMO_PACKAGE_GST1_PLUGINS_BAD_PLUGIN_VIDEOPARSERS
	bool "videoparsers"
	help
	  videoparsers

config LINGMO_PACKAGE_GST1_PLUGINS_BAD_PLUGIN_VIDEOSIGNAL
	bool "videosignal"

config LINGMO_PACKAGE_GST1_PLUGINS_BAD_PLUGIN_VMNC
	bool "vmnc"

config LINGMO_PACKAGE_GST1_PLUGINS_BAD_PLUGIN_Y4M
	bool "y4m"
	help
	  Demuxes/decodes YUV4MPEG streams

comment "plugins with external dependencies"

config LINGMO_PACKAGE_GST1_PLUGINS_BAD_PLUGIN_AES
	bool "aes"
	select LINGMO_PACKAGE_OPENSSL
	help
	  "AES encryption/decryption plugin"

config LINGMO_PACKAGE_GST1_PLUGINS_BAD_PLUGIN_ASSRENDER
	bool "assrender"
	depends on LINGMO_INSTALL_LIBSTDCPP # libass -> harfbuzz
	depends on LINGMO_TOOLCHAIN_HAS_SYNC_4 # libass -> harfbuzz
	depends on LINGMO_TOOLCHAIN_GCC_AT_LEAST_4_9 # libass -> harfbuzz
	select LINGMO_PACKAGE_LIBASS

comment "assrender plugin needs a toolchain w/ C++, gcc >= 4.9"
	depends on LINGMO_TOOLCHAIN_HAS_SYNC_4
	depends on !LINGMO_INSTALL_LIBSTDCPP || \
		!LINGMO_TOOLCHAIN_GCC_AT_LEAST_4_9

config LINGMO_PACKAGE_GST1_PLUGINS_BAD_PLUGIN_BLUEZ
	bool "bluez"
	depends on LINGMO_USE_WCHAR # bluez5_utils -> libglib2
	depends on LINGMO_TOOLCHAIN_HAS_THREADS # bluez5_utils -> dbus, libglib2
	depends on LINGMO_USE_MMU # bluez5_utils -> dbus
	depends on !LINGMO_STATIC_LIBS # bluez5_utils -> uses dlfcn
	depends on LINGMO_TOOLCHAIN_HEADERS_AT_LEAST_3_4 # bluez5_utils
	depends on LINGMO_TOOLCHAIN_HAS_SYNC_4 # bluez5_utils
	select LINGMO_PACKAGE_BLUEZ5_UTILS
	select LINGMO_PACKAGE_BLUEZ5_UTILS_PLUGINS_AUDIO # runtime
	help
	  Bluetooth audio A2DP/AVDTP sink, AVDTP source plugin

comment "bluez plugin needs a toolchain w/ wchar, threads, headers >= 3.4, dynamic library"
	depends on !LINGMO_USE_WCHAR || !LINGMO_TOOLCHAIN_HAS_THREADS || \
		!LINGMO_TOOLCHAIN_HEADERS_AT_LEAST_3_4 || LINGMO_STATIC_LIBS
	depends on LINGMO_TOOLCHAIN_HAS_SYNC_4
	depends on LINGMO_USE_MMU

config LINGMO_PACKAGE_GST1_PLUGINS_BAD_PLUGIN_BZ2
	bool "bz2"
	select LINGMO_PACKAGE_BZIP2
	help
	  Compress or decompress streams

config LINGMO_PACKAGE_GST1_PLUGINS_BAD_PLUGIN_CURL
	bool "curl"
	select LINGMO_PACKAGE_LIBCURL
	help
	  libcurl-based elements

config LINGMO_PACKAGE_GST1_PLUGINS_BAD_PLUGIN_DASH
	bool "dash"
	select LINGMO_PACKAGE_LIBXML2
	help
	  DASH demuxer plugin

config LINGMO_PACKAGE_GST1_PLUGINS_BAD_PLUGIN_DECKLINK
	bool "decklink"
	depends on LINGMO_INSTALL_LIBSTDCPP
	depends on !LINGMO_STATIC_LIBS # <dlfcn.h>
	help
	  Blackmagic Decklink plugin

comment "decklink needs a toolchain w/ C++, dynamic library"
	depends on !LINGMO_INSTALL_LIBSTDCPP  || LINGMO_STATIC_LIBS

config LINGMO_PACKAGE_GST1_PLUGINS_BAD_PLUGIN_DIRECTFB
	bool "directfb"
	default y
	depends on LINGMO_PACKAGE_DIRECTFB

config LINGMO_PACKAGE_GST1_PLUGINS_BAD_PLUGIN_DVB
	bool "dvb"
	# FEC_2_5 / QAM_4_NR definitions
	depends on LINGMO_TOOLCHAIN_HEADERS_AT_LEAST_3_7
	select LINGMO_PACKAGE_DTV_SCAN_TABLES
	help
	  DVB elements

comment "dvb needs a toolchain w/ headers >= 3.7"
	depends on !LINGMO_TOOLCHAIN_HEADERS_AT_LEAST_3_7

config LINGMO_PACKAGE_GST1_PLUGINS_BAD_PLUGIN_FAAD
	bool "faad"
	select LINGMO_PACKAGE_FAAD2
	help
	  Free AAC Decoder (FAAD)

config LINGMO_PACKAGE_GST1_PLUGINS_BAD_PLUGIN_FBDEV
	bool "fbdev"
	help
	  Linux framebuffer video sink

config LINGMO_PACKAGE_GST1_PLUGINS_BAD_PLUGIN_FDK_AAC
	bool "fdk-aac"
	depends on LINGMO_PACKAGE_FDK_AAC_ARCH_SUPPORTS
	depends on LINGMO_INSTALL_LIBSTDCPP
	select LINGMO_PACKAGE_FDK_AAC
	help
	  MPEG AAC encoder/decoder

comment "fdk-aac needs a toolchain w/ C++"
	depends on LINGMO_PACKAGE_FDK_AAC_ARCH_SUPPORTS
	depends on !LINGMO_INSTALL_LIBSTDCPP

config LINGMO_PACKAGE_GST1_PLUGINS_BAD_PLUGIN_FLUIDSYNTH
	bool "fluidsynth"
	depends on !LINGMO_STATIC_LIBS # fluidsynth
	depends on LINGMO_USE_WCHAR # fluidsynth
	depends on LINGMO_TOOLCHAIN_HAS_THREADS # fluidsynth
	depends on LINGMO_USE_MMU # fluidsynth
	select LINGMO_PACKAGE_FLUIDSYNTH
	help
	  Fluidsynth MIDI decoder plugin

comment "fluidsynth needs a toolchain w/ threads, wchar, dynamic library"
	depends on LINGMO_USE_MMU
	depends on !LINGMO_USE_WCHAR || !LINGMO_TOOLCHAIN_HAS_THREADS || \
		LINGMO_STATIC_LIBS

config LINGMO_PACKAGE_GST1_PLUGINS_BAD_PLUGIN_GL
	bool "gl"
	default y
	depends on LINGMO_PACKAGE_GST1_PLUGINS_BASE_HAS_LIB_OPENGL

comment "gl needs the gst1-plugins-base opengl library"
	depends on !LINGMO_PACKAGE_GST1_PLUGINS_BASE_HAS_LIB_OPENGL

config LINGMO_PACKAGE_GST1_PLUGINS_BAD_PLUGIN_HLS
	bool "hls"
	select LINGMO_PACKAGE_NETTLE if !(LINGMO_PACKAGE_LIBGCRYPT || LINGMO_PACKAGE_OPENSSL)
	help
	  Fragmented streaming plugins

config LINGMO_PACKAGE_GST1_PLUGINS_BAD_PLUGIN_KMS
	bool "kmssink"
	depends on LINGMO_TOOLCHAIN_HAS_THREADS #  libdrm -> libpthread-stubs
	select LINGMO_PACKAGE_LIBDRM
	help
	  KMS video sink

config LINGMO_PACKAGE_GST1_PLUGINS_BAD_PLUGIN_DTLS
	bool "dtls"
	select LINGMO_PACKAGE_OPENSSL
	help
	  DTLS plugin

config LINGMO_PACKAGE_GST1_PLUGINS_BAD_PLUGIN_TTML
	bool "ttml"
	depends on LINGMO_USE_WCHAR # pango -> glib2
	depends on LINGMO_TOOLCHAIN_HAS_THREADS # pango -> glib2
	depends on LINGMO_USE_MMU # pango -> glib2
	depends on LINGMO_INSTALL_LIBSTDCPP # pango -> freetype
	depends on LINGMO_TOOLCHAIN_HAS_SYNC_4 # pango -> harfbuzz
	depends on LINGMO_TOOLCHAIN_GCC_AT_LEAST_4_9 # pango -> harfbuzz
	select LINGMO_PACKAGE_CAIRO
	select LINGMO_PACKAGE_LIBXML2
	select LINGMO_PACKAGE_PANGO
	help
	  Timed Text Markup Language (TTML) subtitle plugin

comment "ttml needs a toolchain w/ wchar, threads, C++, gcc >= 4.9"
	depends on LINGMO_TOOLCHAIN_HAS_SYNC_4
	depends on LINGMO_USE_MMU
	depends on !LINGMO_USE_WCHAR || !LINGMO_TOOLCHAIN_HAS_THREADS || \
		!LINGMO_INSTALL_LIBSTDCPP || !LINGMO_TOOLCHAIN_GCC_AT_LEAST_4_9

config LINGMO_PACKAGE_GST1_PLUGINS_BAD_PLUGIN_MPEG2ENC
	bool "mpeg2enc"
	depends on LINGMO_USE_MMU # fork
	depends on LINGMO_INSTALL_LIBSTDCPP
	depends on LINGMO_TOOLCHAIN_HAS_THREADS
	select LINGMO_PACKAGE_LIBMPEG2
	select LINGMO_PACKAGE_MJPEGTOOLS
	help
	  High-quality MPEG-1/2 video encoder

comment "mpeg2enc needs a toolchain w/ threads, C++"
	depends on LINGMO_USE_MMU
	depends on !LINGMO_TOOLCHAIN_HAS_THREADS \
		|| !LINGMO_INSTALL_LIBSTDCPP

config LINGMO_PACKAGE_GST1_PLUGINS_BAD_PLUGIN_MUSEPACK
	bool "musepack"
	select LINGMO_PACKAGE_MUSEPACK

config LINGMO_PACKAGE_GST1_PLUGINS_BAD_PLUGIN_NEON
	bool "neon"
	select LINGMO_PACKAGE_NEON
	help
	  lib neon http client src

config LINGMO_PACKAGE_GST1_PLUGINS_BAD_PLUGIN_OPENAL
	bool "openal"
	depends on LINGMO_INSTALL_LIBSTDCPP
	depends on LINGMO_TOOLCHAIN_GCC_AT_LEAST_4_9
	depends on LINGMO_TOOLCHAIN_HAS_THREADS_NPTL
	depends on LINGMO_PACKAGE_OPENAL_ARCH_SUPPORTS
	select LINGMO_PACKAGE_OPENAL

comment "openal plugin needs a toolchain w/ NPTL, C++, gcc >= 4.9"
	depends on LINGMO_PACKAGE_OPENAL_ARCH_SUPPORTS
	depends on !LINGMO_TOOLCHAIN_HAS_THREADS_NPTL \
		|| !LINGMO_INSTALL_LIBSTDCPP \
		|| !LINGMO_TOOLCHAIN_GCC_AT_LEAST_4_9

config LINGMO_PACKAGE_GST1_PLUGINS_BAD_PLUGIN_OPENH264
	bool "openh264"
	depends on LINGMO_PACKAGE_LIBOPENH264_ARCH_SUPPORTS
	depends on LINGMO_INSTALL_LIBSTDCPP # libopenh264
	depends on !LINGMO_STATIC_LIBS # libopenh264
	depends on LINGMO_TOOLCHAIN_HAS_THREADS # libopenh264
	select LINGMO_PACKAGE_LIBOPENH264
	help
	  OpenH264 based encoding/decoding plugin

comment "openh264 plugin needs a toolchain w/ C++, dynamic library, threads"
	depends on !LINGMO_INSTALL_LIBSTDCPP || !LINGMO_TOOLCHAIN_HAS_THREADS || \
		LINGMO_STATIC_LIBS
	depends on LINGMO_PACKAGE_LIBOPENH264_ARCH_SUPPORTS

config LINGMO_PACKAGE_GST1_PLUGINS_BAD_PLUGIN_OPENJPEG
	bool "openjpeg"
	select LINGMO_PACKAGE_OPENJPEG
	help
	  GStreamer OpenJPEG plugin

config LINGMO_PACKAGE_GST1_PLUGINS_BAD_PLUGIN_OPUS
	bool "opus"
	select LINGMO_PACKAGE_OPUS
	help
	  OPUS plugin library

config LINGMO_PACKAGE_GST1_PLUGINS_BAD_PLUGIN_QROVERLAY
	bool "qroverlay"
	select LINGMO_PACKAGE_JSON_GLIB
	select LINGMO_PACKAGE_LIBQRENCODE
	help
	  Elements qroverlay, debugqroverlay (overlay data on top of
	  video in the form of a QR code)

config LINGMO_PACKAGE_GST1_PLUGINS_BAD_PLUGIN_RSVG
	bool "rsvg"
	depends on LINGMO_PACKAGE_HOST_RUSTC_TARGET_ARCH_SUPPORTS # librsvg
	depends on LINGMO_INSTALL_LIBSTDCPP # librsvg -> pango
	depends on LINGMO_TOOLCHAIN_HAS_SYNC_4 # librsvg -> pango -> harfbuzz
	depends on LINGMO_TOOLCHAIN_GCC_AT_LEAST_4_9 # librsvg -> pango -> harfbuzz
	select LINGMO_PACKAGE_LIBRSVG
	help
	  RSVG plugin library

comment "rsvg plugin needs a toolchain w/ C++, gcc >= 4.9"
	depends on LINGMO_PACKAGE_HOST_RUSTC_TARGET_ARCH_SUPPORTS
	depends on !LINGMO_INSTALL_LIBSTDCPP || \
		!LINGMO_TOOLCHAIN_GCC_AT_LEAST_4_9
	depends on LINGMO_TOOLCHAIN_HAS_SYNC_4

config LINGMO_PACKAGE_GST1_PLUGINS_BAD_PLUGIN_SBC
	bool "sbc"
	select LINGMO_PACKAGE_SBC

config LINGMO_PACKAGE_GST1_PLUGINS_BAD_PLUGIN_SCTP
	bool "sctp"
	depends on LINGMO_TOOLCHAIN_HAS_SYNC_4 # __sync_*_4 intrinsics

config LINGMO_PACKAGE_GST1_PLUGINS_BAD_PLUGIN_SHM
	bool "shm"
	help
	  shared memory sink source

config LINGMO_PACKAGE_GST1_PLUGINS_BAD_PLUGIN_SNDFILE
	bool "sndfile"
	select LINGMO_PACKAGE_LIBSNDFILE

config LINGMO_PACKAGE_GST1_PLUGINS_BAD_PLUGIN_SRTP
	bool "srtp"
	select LINGMO_PACKAGE_LIBSRTP

config LINGMO_PACKAGE_GST1_PLUGINS_BAD_PLUGIN_UVCH264
	bool "uvch264"
	depends on LINGMO_PACKAGE_HAS_UDEV # libgudev
	depends on LINGMO_TOOLCHAIN_HAS_THREADS # libgudev, libusb
	depends on LINGMO_TOOLCHAIN_GCC_AT_LEAST_4_9 # libusb
	depends on LINGMO_USE_MMU # libgudev
	depends on LINGMO_USE_WCHAR # libgudev
	select LINGMO_PACKAGE_LIBGUDEV
	select LINGMO_PACKAGE_LIBUSB
	help
	  UVC compliant H.264 camera source plugin

comment "uvch264 needs udev /dev management"
	depends on LINGMO_USE_MMU
	depends on !LINGMO_PACKAGE_HAS_UDEV

comment "uvch264 needs a toolchain w/ threads, wchar, gcc >= 4.9"
	depends on LINGMO_USE_MMU
	depends on !LINGMO_USE_WCHAR || !LINGMO_TOOLCHAIN_HAS_THREADS || \
		!LINGMO_TOOLCHAIN_GCC_AT_LEAST_4_9

config LINGMO_PACKAGE_GST1_PLUGINS_BAD_PLUGIN_VA
	bool "va"
	depends on !LINGMO_STATIC_LIBS # libva
	depends on LINGMO_TOOLCHAIN_HAS_THREADS # libva
	select LINGMO_PACKAGE_LIBVA
	help
	  VA-API new plugin

comment "va needs a toolchain w/ threads, dynamic library"
	depends on LINGMO_STATIC_LIBS || !LINGMO_TOOLCHAIN_HAS_THREADS

config LINGMO_PACKAGE_GST1_PLUGINS_BAD_PLUGIN_VOAACENC
	bool "voaacenc"
	select LINGMO_PACKAGE_VO_AACENC

config LINGMO_PACKAGE_GST1_PLUGINS_BAD_PLUGIN_WAYLAND
	bool "wayland"
	default y
	depends on LINGMO_PACKAGE_WAYLAND
	depends on LINGMO_TOOLCHAIN_HAS_THREADS #  libdrm -> libpthread-stubs
	select LINGMO_PACKAGE_LIBDRM
	select LINGMO_PACKAGE_WAYLAND_PROTOCOLS
	help
	  Wayland Video Sink

config LINGMO_PACKAGE_GST1_PLUGINS_BAD_PLUGIN_WEBP
	bool "webp"
	select LINGMO_PACKAGE_WEBP
	help
	  Webp image format plugin

config LINGMO_PACKAGE_GST1_PLUGINS_BAD_PLUGIN_WEBRTC
	bool "webrtc"
	depends on !LINGMO_STATIC_LIBS # libnice -> gnutls
	select LINGMO_PACKAGE_GST1_PLUGINS_BASE # libgstsdp
	select LINGMO_PACKAGE_LIBNICE
	help
	  WebRTC plugins (webrtcbin - a bin for webrtc connections)

comment "webrtc needs a toolchain w/ dynamic library"
	depends on LINGMO_STATIC_LIBS

config LINGMO_PACKAGE_GST1_PLUGINS_BAD_PLUGIN_WEBRTCDSP
	bool "webrtcdsp"
	# All depends from webrtc-audio-processing
	depends on LINGMO_PACKAGE_WEBRTC_AUDIO_PROCESSING_ARCH_SUPPORTS
	depends on LINGMO_PACKAGE_LIBABSEIL_CPP_ARCH_SUPPORTS
	depends on LINGMO_INSTALL_LIBSTDCPP
	depends on LINGMO_TOOLCHAIN_GCC_AT_LEAST_8
	depends on LINGMO_TOOLCHAIN_HAS_THREADS_NPTL
	depends on !LINGMO_STATIC_LIBS
	select LINGMO_PACKAGE_WEBRTC_AUDIO_PROCESSING
	help
	  WebRTC echo-cancellation, gain control and noise suppression

comment "webrtcdsp needs a toolchain w/ C++, NPTL, dynamic library, gcc >= 8"
	depends on LINGMO_PACKAGE_WEBRTC_AUDIO_PROCESSING_ARCH_SUPPORTS
	depends on LINGMO_PACKAGE_LIBABSEIL_CPP_ARCH_SUPPORTS
	depends on !LINGMO_INSTALL_LIBSTDCPP || !LINGMO_TOOLCHAIN_HAS_THREADS_NPTL \
		|| LINGMO_STATIC_LIBS || !LINGMO_TOOLCHAIN_GCC_AT_LEAST_8

config LINGMO_PACKAGE_GST1_PLUGINS_BAD_PLUGIN_WPE
	bool "wpe"
	default y
	depends on LINGMO_PACKAGE_WPEWEBKIT
	depends on LINGMO_PACKAGE_GST1_PLUGINS_BASE_HAS_LIB_OPENGL
	depends on !LINGMO_PACKAGE_WPEWEBKIT_MEDIA_STREAM

comment "wpe needs the gst1-plugins-base opengl library and wpewebkit"
	depends on !LINGMO_PACKAGE_WPEWEBKIT \
		|| !LINGMO_PACKAGE_GST1_PLUGINS_BASE_HAS_LIB_OPENGL

comment "wpe is incompatible w/ wpewebkit media-stream support"
	depends on LINGMO_PACKAGE_WPEWEBKIT
	depends on LINGMO_PACKAGE_GST1_PLUGINS_BASE_HAS_LIB_OPENGL
	depends on LINGMO_PACKAGE_WPEWEBKIT_MEDIA_STREAM

config LINGMO_PACKAGE_GST1_PLUGINS_BAD_PLUGIN_V4L2CODECS
	bool "v4l2codecs"
	depends on LINGMO_PACKAGE_HAS_UDEV # libgudev
	select LINGMO_PACKAGE_LIBGUDEV
	help
	  Video4Linux Stateless CODECs support

comment "v4l2codecs need udev /dev management"
	depends on !LINGMO_PACKAGE_HAS_UDEV

config LINGMO_PACKAGE_GST1_PLUGINS_BAD_PLUGIN_X265
	bool "x265"
	depends on LINGMO_INSTALL_LIBSTDCPP
	depends on !LINGMO_STATIC_LIBS
	depends on LINGMO_TOOLCHAIN_HAS_SYNC_4 # x265
	select LINGMO_PACKAGE_X265
	help
	  x265 encoding plugin

comment "x265 needs a toolchain w/ C++, dynamic library"
	depends on !LINGMO_INSTALL_LIBSTDCPP || LINGMO_STATIC_LIBS

config LINGMO_PACKAGE_GST1_PLUGINS_BAD_ZBAR
	bool "zbar"
	depends on LINGMO_TOOLCHAIN_HAS_THREADS # zbar-> libv4l
	depends on LINGMO_USE_MMU # zbar-> libv4l
	depends on LINGMO_INSTALL_LIBSTDCPP # zbar-> libv4l
	depends on LINGMO_TOOLCHAIN_HEADERS_AT_LEAST_3_0 # zbar -> libv4l
	select LINGMO_PACKAGE_ZBAR

comment "zbar plugin needs a toolchain w/ threads, C++ and headers >= 3.0"
	depends on LINGMO_USE_MMU
	depends on !LINGMO_TOOLCHAIN_HAS_THREADS \
		|| !LINGMO_INSTALL_LIBSTDCPP || !LINGMO_TOOLCHAIN_HEADERS_AT_LEAST_3_0

config LINGMO_PACKAGE_GST1_PLUGINS_BAD_ZXING
	bool "zxing"
	depends on !LINGMO_STATIC_LIBS # zxing-cpp
	depends on LINGMO_USE_WCHAR # zxing-cpp
	depends on LINGMO_INSTALL_LIBSTDCPP # zxing-cpp
	depends on LINGMO_TOOLCHAIN_HAS_THREADS # zxing-cpp
	select LINGMO_PACKAGE_ZXING_CPP

comment "zxing plugin needs a toolchain w/ C++, wchar, dynamic library, threads"
	depends on LINGMO_STATIC_LIBS || !LINGMO_USE_WCHAR || \
		!LINGMO_INSTALL_LIBSTDCPP || !LINGMO_TOOLCHAIN_HAS_THREADS

endif

comment "gst1-plugins-bad needs a toolchain w/ C++"
	depends on !LINGMO_INSTALL_LIBSTDCPP
```
