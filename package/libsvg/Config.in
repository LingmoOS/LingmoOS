## package/libsvg/Config.in
```kconfig
config LINGMO_PACKAGE_LIBSVG
	bool "libsvg"
	select LINGMO_PACKAGE_LIBPNG
	select LINGMO_PACKAGE_JPEG
	select LINGMO_PACKAGE_LIBXML2 if !LINGMO_PACKAGE_EXPAT
	help
	  Libsvg provides a parser for SVG content in files or buffers.
	  Libsvg does not do any rendering, but instead provides a
	  function-based interface that can be used by various rendering
	  engines.

	  http://cairographics.org/snapshots/
```

## package/libtalloc/Config.in
```kconfig
config LINGMO_PACKAGE_LIBTALLOC
	bool "libtalloc"
	depends on LINGMO_USE_MMU
	depends on !LINGMO_STATIC_LIBS
	help
	  talloc is a hierarchical, reference counted memory pool
	  system with destructors. It is the core memory allocator
	  used in Samba.

	  https://talloc.samba.org/talloc/doc/html/index.html

comment "libtalloc needs a toolchain w/ dynamic library"
	depends on LINGMO_USE_MMU
	depends on LINGMO_STATIC_LIBS
```

## package/libteam/Config.in
```kconfig
config LINGMO_PACKAGE_LIBTEAM
	bool "libteam"
	depends on LINGMO_USE_MMU # fork()
	depends on !LINGMO_STATIC_LIBS # libnl-tools
	depends on LINGMO_TOOLCHAIN_HAS_THREADS # libnl
	select LINGMO_PACKAGE_JANSSON
	select LINGMO_PACKAGE_LIBDAEMON
	select LINGMO_PACKAGE_LIBNL
	select LINGMO_PACKAGE_LIBNL_TOOLS
	help
	  The purpose of the Team driver is to provide a mechanism to
	  team multiple NICs (ports) into one logical one (teamdev) at
	  L2 layer. The process is called "channel bonding", "Ethernet
	  bonding", "channel teaming", "link aggregation", etc.

	  Team tries to provide similar functionality as the bonding
	  driver, however architecturally it is quite different. Team is
	  modular, userspace driven, very lean and efficient, and it
	  does have some distinct advantages over bonding. The way Team
	  is configured differs dramatically from the way bonding is.

	  If building the kernel with Buildroot, basic team support is
	  automatically enabled, but you will still need to enable the
	  modes you need, e.g. activebackup or loadbalance (e.g. with a
	  config fragment or a custom config).

	  https://github.com/jpirko/libteam

comment "libteam needs MMU and a toolchain w/ dynamic library and threads"
	depends on LINGMO_USE_MMU
	depends on LINGMO_STATIC_LIBS || !LINGMO_TOOLCHAIN_HAS_THREADS
```

## package/libtheora/Config.in
```kconfig
config LINGMO_PACKAGE_LIBTHEORA
	bool "libtheora"
	select LINGMO_PACKAGE_LIBOGG
	select LINGMO_PACKAGE_LIBVORBIS
	help
	  A library for the free and open video compression format
	  "Theora" from the Xiph.org Foundation.

	  http://www.theora.org/
```

## package/libtirpc/Config.in
```kconfig
config LINGMO_PACKAGE_LIBTIRPC
	bool "libtirpc"
	depends on LINGMO_TOOLCHAIN_HAS_THREADS
	help
	  Libtirpc is a port of Sun's Transport-Independent RPC
	  library to Linux.

	  http://sourceforge.net/projects/libtirpc/

config LINGMO_PACKAGE_LIBTIRPC_GSS
	bool "gss"
	depends on LINGMO_USE_MMU # libkrb5
	depends on !LINGMO_STATIC_LIBS # libkrb5
	depends on LINGMO_PACKAGE_LIBTIRPC
	select LINGMO_PACKAGE_LIBKRB5
	help
	  Enable GSSAPI support

comment "libtirpc needs a toolchain w/ threads"
	depends on !LINGMO_TOOLCHAIN_HAS_THREADS

comment "libtirpc gss support needs a toolchain w/ dynamic library"
	depends on LINGMO_USE_MMU
	depends on LINGMO_STATIC_LIBS
	depends on LINGMO_PACKAGE_LIBTIRPC
```

## package/libtorrent-rasterbar/Config.in
```kconfig
comment "libtorrent-rasterbar needs a toolchain w/ C++, threads, wchar, gcc >= 4.9"
	depends on LINGMO_TOOLCHAIN_SUPPORTS_VARIADIC_MI_THUNK
	depends on !LINGMO_TOOLCHAIN_HAS_GCC_BUG_64735
	depends on !LINGMO_INSTALL_LIBSTDCPP || !LINGMO_TOOLCHAIN_HAS_THREADS || \
		!LINGMO_USE_WCHAR || !LINGMO_TOOLCHAIN_GCC_AT_LEAST_4_9

comment "libtorrent-rasterbar needs exception_ptr"
	depends on LINGMO_TOOLCHAIN_SUPPORTS_VARIADIC_MI_THUNK
	depends on LINGMO_TOOLCHAIN_HAS_GCC_BUG_64735

config LINGMO_PACKAGE_LIBTORRENT_RASTERBAR
	bool "libtorrent-rasterbar"
	depends on LINGMO_INSTALL_LIBSTDCPP # boost
	depends on LINGMO_TOOLCHAIN_GCC_AT_LEAST_4_9 # C++11
	depends on LINGMO_TOOLCHAIN_HAS_THREADS # boost
	depends on LINGMO_TOOLCHAIN_SUPPORTS_VARIADIC_MI_THUNK
	depends on LINGMO_USE_WCHAR # boost
	depends on !LINGMO_TOOLCHAIN_HAS_GCC_BUG_64735 # exception_ptr
	select LINGMO_PACKAGE_BOOST
	select LINGMO_PACKAGE_BOOST_SYSTEM
	help
	  libtorrent is a feature complete C++ bittorrent implementation
	  focusing on efficiency and scalability.

	  https://www.libtorrent.org/
```

## package/libtorrent/Config.in
```kconfig
config LINGMO_PACKAGE_LIBTORRENT
	bool "libtorrent"
	depends on LINGMO_INSTALL_LIBSTDCPP
	depends on LINGMO_TOOLCHAIN_HAS_THREADS
	depends on LINGMO_TOOLCHAIN_HAS_SYNC_1 && LINGMO_TOOLCHAIN_HAS_SYNC_4
	select LINGMO_PACKAGE_ZLIB
	select LINGMO_PACKAGE_LIBOPENSSL_ENABLE_RC4 if LINGMO_PACKAGE_LIBOPENSSL
	help
	  BitTorrent library written in C++ for *nix

	  https://github.com/rakshasa/libtorrent

comment "libtorrent needs a toolchain w/ C++, threads"
	depends on LINGMO_TOOLCHAIN_HAS_SYNC_1 && LINGMO_TOOLCHAIN_HAS_SYNC_4
	depends on !LINGMO_INSTALL_LIBSTDCPP || !LINGMO_TOOLCHAIN_HAS_THREADS
```

## package/libtracefs/Config.in
```kconfig
config LINGMO_PACKAGE_LIBTRACEFS
	bool "libtracefs"
	depends on LINGMO_TOOLCHAIN_HAS_THREADS
	depends on !LINGMO_STATIC_LIBS # libtraceevent
	select LINGMO_PACKAGE_LIBTRACEEVENT
	help
	  libtracefs is used to easily interface with the ftrace
	  interface through the tracefs virtual filesystem.

	  https://git.kernel.org/pub/scm/libs/libtrace/libtraceevent.git/

comment "libtracefs needs a toolchain w/ threads, dynamic library"
	depends on !LINGMO_TOOLCHAIN_HAS_THREADS || LINGMO_STATIC_LIBS
```

## package/libubox/Config.in
```kconfig
config LINGMO_PACKAGE_LIBUBOX
	bool "libubox"
	depends on !LINGMO_STATIC_LIBS
	help
	  This library originates from the OpenWrt project to
	  handle the configuration file infrastructure, but can
	  also be used for the same purposes in projects other
	  than OpenWrt.

	  https://openwrt.org/docs/techref/libubox

comment "libubox needs a toolchain w/ dynamic library"
	depends on LINGMO_STATIC_LIBS
```

## package/libuci/Config.in
```kconfig
config LINGMO_PACKAGE_LIBUCI
	bool "libuci"
	depends on !LINGMO_STATIC_LIBS
	select LINGMO_PACKAGE_LIBUBOX
	help
	  This library originates from the OpenWrt project to
	  handle the configuration file infrastructure, but can
	  also be used for the same purposes in projects other
	  than OpenWrt.

	  This package will also install CLI tool uci.

	  https://openwrt.org/docs/techref/uci

comment "libuci needs a toolchain w/ dynamic library"
	depends on LINGMO_STATIC_LIBS
```

## package/libucontext/Config.in
```kconfig
config LINGMO_PACKAGE_LIBUCONTEXT_ARCH_SUPPORTS
	bool
	default y if LINGMO_aarch64
	default y if LINGMO_aarch64_be
	default y if LINGMO_arm
	default y if LINGMO_armeb
	default y if LINGMO_m68k
	default y if LINGMO_mips
	default y if LINGMO_mipsel
	default y if LINGMO_mips64
	default y if LINGMO_mips64el
	default y if LINGMO_or1k
	default y if LINGMO_powerpc
	default y if LINGMO_powerpc64
	default y if LINGMO_powerpc64le
	default y if LINGMO_riscv && LINGMO_RISCV_32
	default y if LINGMO_riscv && LINGMO_RISCV_64
	default y if LINGMO_s390x
	default y if LINGMO_sh4
	default y if LINGMO_sh4eb
	default y if LINGMO_sh4a
	default y if LINGMO_sh4aeb
	default y if LINGMO_i386
	default y if LINGMO_x86_64
	depends on LINGMO_TOOLCHAIN_USES_MUSL

config LINGMO_PACKAGE_LIBUCONTEXT
	bool "libucontext"
	depends on LINGMO_PACKAGE_LIBUCONTEXT_ARCH_SUPPORTS
	help
	  Ucontext implementation featuring glibc-compatible ABI.

	  https://github.com/kaniini/libucontext
```

## package/libudfread/Config.in
```kconfig
config LINGMO_PACKAGE_LIBUDFREAD
	bool "libudfread"
	depends on LINGMO_TOOLCHAIN_HAS_SYNC_4 || LINGMO_TOOLCHAIN_HAS_THREADS
	help
	  UDF reader

	  https://code.videolan.org/videolan/libudfread

comment "libudfread needs a toolchain w/ threads"
	depends on !LINGMO_TOOLCHAIN_HAS_SYNC_4 && !LINGMO_TOOLCHAIN_HAS_THREADS
```

## package/libuecc/Config.in
```kconfig
config LINGMO_PACKAGE_LIBUECC
	bool "libuecc"
	depends on !LINGMO_STATIC_LIBS
	help
	  Very small Elliptic Curve Cryptography library

	  http://git.universe-factory.net/libuecc

comment "libuecc needs a toolchain w/ dynamic library"
	depends on LINGMO_STATIC_LIBS
```

## package/libuhttpd/Config.in
```kconfig
config LINGMO_PACKAGE_LIBUHTTPD
	bool "libuhttpd"
	depends on LINGMO_USE_MMU # fork()
	depends on LINGMO_TOOLCHAIN_GCC_AT_LEAST_4_9
	select LINGMO_PACKAGE_LIBEV
	select LINGMO_PACKAGE_WOLFSSL_ALL if LINGMO_PACKAGE_WOLFSSL && \
		!LINGMO_STATIC_LIBS
	help
	  A lightweight and fully asynchronous HTTP server
	  library based on libev

	  https://github.com/zhaojh329/libuhttpd

comment "libuhttpd needs a toolchain w/ gcc >= 4.9"
	depends on LINGMO_USE_MMU
	depends on !LINGMO_TOOLCHAIN_GCC_AT_LEAST_4_9
```

## package/libuio/Config.in
```kconfig
config LINGMO_PACKAGE_LIBUIO
	bool "libuio"
	select LINGMO_PACKAGE_ARGP_STANDALONE if LINGMO_TOOLCHAIN_USES_UCLIBC || LINGMO_TOOLCHAIN_USES_MUSL
	help
	  libuio is a light-weight C programming library to handle UIO
	  (Userspace I/O) device discovery and binding task.

	  http://github.com/Linutronix/libuio
```

## package/libunwind/Config.in
```kconfig
config LINGMO_PACKAGE_LIBUNWIND_MUSL_CONTEXT_REQUIRED
	bool
	default y
	depends on !LINGMO_ARM_CPU_HAS_ARM
	depends on !LINGMO_aarch64
	depends on !LINGMO_aarch64_be
	depends on !LINGMO_mips
	depends on !LINGMO_mipsel
	depends on !LINGMO_mips64
	depends on !LINGMO_mips64el
	depends on !LINGMO_riscv
	depends on !LINGMO_x86_64
	depends on LINGMO_TOOLCHAIN_USES_MUSL

# libunwind is only available for a certain subset of the
# architectures (as visible in the list of architectures supported
# with the glibc C library below).
#
# In addition to this, on some architectures libunwind requires the
# *context() function from the C library, which are only available on
# certain architectures in uClibc, and not available at all on
# musl. But on some other architectures, libunwind works without using
# the *context() functions, which allows it to be built with musl.
config LINGMO_PACKAGE_LIBUNWIND_ARCH_SUPPORTS
	bool
	default y if LINGMO_TOOLCHAIN_USES_GLIBC && \
		(LINGMO_ARM_CPU_HAS_ARM || LINGMO_aarch64 || LINGMO_mips || LINGMO_mipsel || \
		 LINGMO_mips64 || LINGMO_mips64el || LINGMO_powerpc || LINGMO_sh || \
		 LINGMO_i386 || LINGMO_x86_64)
	default y if LINGMO_TOOLCHAIN_USES_UCLIBC && \
		(LINGMO_ARM_CPU_HAS_ARM || LINGMO_mips || LINGMO_mipsel || \
		 LINGMO_mips64 || LINGMO_mips64el || LINGMO_x86_64)
	default y if LINGMO_TOOLCHAIN_USES_MUSL && \
		(!LINGMO_PACKAGE_LIBUNWIND_MUSL_CONTEXT_REQUIRED || \
		 LINGMO_PACKAGE_LIBUCONTEXT_ARCH_SUPPORTS)

config LINGMO_PACKAGE_LIBUNWIND
	bool "libunwind"
	depends on LINGMO_TOOLCHAIN_HAS_THREADS
	depends on LINGMO_PACKAGE_LIBUNWIND_ARCH_SUPPORTS
	depends on LINGMO_TOOLCHAIN_GCC_AT_LEAST_4_9 # C11 atomics
	# forcefully links against libgcc_s, only available in dynamic
	# linking configurations
	depends on !LINGMO_STATIC_LIBS
	select LINGMO_PACKAGE_LIBUCONTEXT if LINGMO_TOOLCHAIN_USES_MUSL && \
		LINGMO_PACKAGE_LIBUNWIND_MUSL_CONTEXT_REQUIRED
	help
	  C API to determine the call-chain of a program.

	  http://www.nongnu.org/libunwind/index.html

comment "libunwind needs a toolchain w/ threads, dynamic library, gcc >= 4.9"
	depends on LINGMO_PACKAGE_LIBUNWIND_ARCH_SUPPORTS
	depends on !LINGMO_TOOLCHAIN_HAS_THREADS || LINGMO_STATIC_LIBS || \
		!LINGMO_TOOLCHAIN_GCC_AT_LEAST_4_9
```

## package/libupnpp/Config.in
```kconfig
config LINGMO_PACKAGE_LIBUPNPP
	bool "libupnpp"
	depends on LINGMO_INSTALL_LIBSTDCPP
	depends on LINGMO_TOOLCHAIN_HAS_THREADS # libnpupnp
	depends on LINGMO_TOOLCHAIN_GCC_AT_LEAST_4_9
	select LINGMO_PACKAGE_EXPAT
	select LINGMO_PACKAGE_LIBCURL
	select LINGMO_PACKAGE_LIBNPUPNP
	help
	  The libupnpp C++ library wraps libupnp for easier use by
	  upmpdcli and upplay.

	  http://www.lesbonscomptes.com/upmpdcli/

comment "libupnpp needs a toolchain w/ C++, threads, gcc >= 4.9"
	depends on !LINGMO_INSTALL_LIBSTDCPP || !LINGMO_TOOLCHAIN_HAS_THREADS || !LINGMO_TOOLCHAIN_GCC_AT_LEAST_4_9
```

## package/liburcu/Config.in
```kconfig
config LINGMO_PACKAGE_LIBURCU_ARCH_SUPPORTS
	bool
	default y
	depends on LINGMO_arm || LINGMO_armeb || LINGMO_aarch64 || LINGMO_aarch64_be || \
		LINGMO_i386 || LINGMO_mips || LINGMO_mips64 || LINGMO_mipsel || \
		LINGMO_mips64el || LINGMO_nios2 || LINGMO_powerpc || LINGMO_powerpc64 || \
		LINGMO_powerpc64le || LINGMO_riscv || LINGMO_sparc64 || LINGMO_s390x || LINGMO_x86_64
	depends on LINGMO_USE_MMU # fork() in test

config LINGMO_PACKAGE_LIBURCU
	bool "liburcu"
	depends on LINGMO_PACKAGE_LIBURCU_ARCH_SUPPORTS
	depends on LINGMO_TOOLCHAIN_HAS_THREADS
	depends on LINGMO_INSTALL_LIBSTDCPP
	help
	  Userspace implementation of the Read-Copy-Update (RCU)
	  synchronization mechanism. This library is mainly used by
	  the LTTng tracing infrastructure, but can be used for other
	  purposes as well.

	  On ARM, because of bug:
	    http://gcc.gnu.org/bugzilla/show_bug.cgi?id=58854
	  liburcu cannot be built using gcc 4.8.0, 4.8.1 or 4.8.2
	  without the following bug fix:
	    http://gcc.gnu.org/viewcvs/gcc?view=revision&revision=204665

	  http://lttng.org/urcu

comment "liburcu needs a toolchain w/ threads, C++"
	depends on LINGMO_PACKAGE_LIBURCU_ARCH_SUPPORTS
	depends on !LINGMO_TOOLCHAIN_HAS_THREADS || \
		!LINGMO_INSTALL_LIBSTDCPP
```

## package/libusb/Config.in
```kconfig
config LINGMO_PACKAGE_LIBUSB
	bool "libusb"
	depends on LINGMO_TOOLCHAIN_HAS_THREADS
	depends on LINGMO_TOOLCHAIN_GCC_AT_LEAST_4_9 # _Thread_local
	help
	  Userspace library for accessing USB devices

	  http://libusb.info/

if LINGMO_PACKAGE_LIBUSB

config LINGMO_PACKAGE_LIBUSB_EXAMPLES
	bool "build libusb examples"

endif

comment "libusb needs a toolchain w/ threads, gcc >= 4.9"
	depends on !LINGMO_TOOLCHAIN_HAS_THREADS || \
		!LINGMO_TOOLCHAIN_GCC_AT_LEAST_4_9
```

## package/libusbgx/Config.in
```kconfig
config LINGMO_PACKAGE_LIBUSBGX
	bool "libusbgx"
	depends on LINGMO_TOOLCHAIN_HAS_THREADS
	select LINGMO_PACKAGE_LIBCONFIG
	help
	  libusbgx is a C library encapsulating the kernel USB
	  gadget-configfs userspace API functionality.

	  https://github.com/libusbgx/libusbgx

comment "libusbgx needs a toolchain w/ threads"
	depends on !LINGMO_TOOLCHAIN_HAS_THREADS
```

## package/libutempter/Config.in
```kconfig
config LINGMO_PACKAGE_LIBUTEMPTER
	bool "libutempter"
	depends on LINGMO_TOOLCHAIN_HEADERS_AT_LEAST_4_14
	depends on !LINGMO_STATIC_LIBS
	help
	  The libutempter library provides interface for terminal
	  emulators such as screen and xterm to record user
	  sessions to utmp and wtmp files.

	  http://ftp.altlinux.org/pub/people/ldv/utempter/

comment "libutempter needs a toolchain w/ headers >= 4.14, dynamic library"
	depends on !LINGMO_TOOLCHAIN_HEADERS_AT_LEAST_4_14 || LINGMO_STATIC_LIBS
```

## package/libutp/Config.in
```kconfig
config LINGMO_PACKAGE_LIBUTP
	bool "libutp"
	depends on LINGMO_INSTALL_LIBSTDCPP
	help
	  uTorrent Transport Protocol library

	  https://github.com/bittorrent/libutp

comment "libutp support needs a toolchain with C++"
	depends on !LINGMO_INSTALL_LIBSTDCPP
```

## package/libuv/Config.in
```kconfig
config LINGMO_PACKAGE_LIBUV
	bool "libuv"
	depends on LINGMO_TOOLCHAIN_HAS_THREADS_NPTL # pthread_barrier_*
	depends on LINGMO_USE_MMU # fork()
	depends on !LINGMO_STATIC_LIBS
	depends on LINGMO_TOOLCHAIN_HAS_SYNC_4
	depends on LINGMO_TOOLCHAIN_GCC_AT_LEAST_4_9 # C11/stdatomic.h
	help
	  libuv is a multi-platform support library with a focus
	  on asynchronous I/O.

	  https://github.com/libuv/libuv

comment "libuv needs a toolchain w/ NPTL, dynamic library, gcc >= 4.9"
	depends on !LINGMO_TOOLCHAIN_HAS_THREADS_NPTL || LINGMO_STATIC_LIBS \
		|| !LINGMO_TOOLCHAIN_GCC_AT_LEAST_4_9
	depends on LINGMO_USE_MMU
	depends on LINGMO_TOOLCHAIN_HAS_SYNC_4
```
