## package/libuwsc/Config.in
```kconfig
config LINGMO_PACKAGE_LIBUWSC
	bool "libuwsc"
	select LINGMO_PACKAGE_LIBEV
	help
	  A Lightweight and fully asynchronous WebSocket client
	  library based on libev.

	  https://github.com/zhaojh329/libuwsc
```

## package/libv4l/Config.in
```kconfig
config LINGMO_PACKAGE_LIBV4L
	bool "libv4l"
	depends on LINGMO_TOOLCHAIN_HAS_THREADS
	depends on LINGMO_INSTALL_LIBSTDCPP
	depends on LINGMO_TOOLCHAIN_HEADERS_AT_LEAST_3_0 # media headers
	select LINGMO_PACKAGE_ARGP_STANDALONE if LINGMO_TOOLCHAIN_USES_UCLIBC || LINGMO_TOOLCHAIN_USES_MUSL
	select LINGMO_PACKAGE_LIBICONV if !LINGMO_ENABLE_LOCALE
	help
	  libv4l is a collection of libraries which adds a thin
	  abstraction layer on top of video4linux2 devices. libv4l
	  consists of 3 different libraries: libv4lconvert, libv4l1 and
	  libv4l2.

	  http://linuxtv.org/wiki/index.php/V4l-utils

if LINGMO_PACKAGE_LIBV4L

comment "libv4l JPEG support not enabled"
	depends on !LINGMO_PACKAGE_JPEG

config LINGMO_PACKAGE_LIBV4L_UTILS
	bool "v4l-utils tools"
	depends on LINGMO_TOOLCHAIN_GCC_AT_LEAST_4_8 # C++11
	help
	  v4l-utils is a collection of various video4linux and DVB
	  utilities.
	  Enable this if you want to build the following tools:
	  - cx18-ctl
	  - dvb-fe-tool, dvbv5-zap, dvbv5-scan, dvb-format-convert
	  - decode_tm6000
	  - ir-keytable
	  - media-ctl
	  - v4l2-compliance
	  - v4l2-ctl, cx18-ctl, ivtv-ctl
	  - v4l2-sysfs-path
	  - rds-ctl
	  - qv4l2 (if Qt is enabled)

comment "v4l-utils tools needs a toolchain w/ C++11"
	depends on !LINGMO_TOOLCHAIN_GCC_AT_LEAST_4_8

endif

comment "libv4l needs a toolchain w/ threads, C++ and headers >= 3.0"
	depends on !LINGMO_TOOLCHAIN_HAS_THREADS \
		|| !LINGMO_INSTALL_LIBSTDCPP || !LINGMO_TOOLCHAIN_HEADERS_AT_LEAST_3_0
```
