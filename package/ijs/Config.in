## package/ijs/Config.in
```kconfig
config LINGMO_PACKAGE_IJS
	bool "ijs"
	depends on LINGMO_USE_MMU # fork()
	help
	  The IJS package contains a library which implements a
	  protocol for transmission of raster page images.

	  http://www.openprinting.org/
```

## package/ima-evm-utils/Config.in
```kconfig
config LINGMO_PACKAGE_IMA_EVM_UTILS
	bool "ima-evm-utils"
	depends on LINGMO_USE_MMU # keyutils
	depends on !LINGMO_STATIC_LIBS # keyutils, tpm2-tss
	select LINGMO_PACKAGE_OPENSSL
	select LINGMO_PACKAGE_KEYUTILS
	select LINGMO_PACKAGE_TPM2_TSS
	help
	  Linux Integrity Measurement Architecture (IMA)
	  Extended Verification Module (EVM) tools.

	  https://sourceforge.net/p/linux-ima/wiki/Home/

comment "ima-evm-utils needs dynamic library support"
	depends on LINGMO_USE_MMU
	depends on LINGMO_STATIC_LIBS
```

## package/imagemagick/Config.in
```kconfig
config LINGMO_PACKAGE_IMAGEMAGICK
	bool "imagemagick"
	depends on LINGMO_USE_MMU # fork()
	depends on LINGMO_TOOLCHAIN_HAS_THREADS
	help
	  ImageMagick(R) is a software suite to create, edit, and
	  compose bitmap images. It can read, convert and write images
	  in a variety of formats (about 100) including DPX, EXR, GIF,
	  JPEG, JPEG-2000, PDF, PhotoCD, PNG, Postscript, SVG, and TIFF.
	  Use ImageMagick to translate, flip, mirror, rotate, scale,
	  shear and transform images, adjust image colors, apply various
	  special effects, or draw text, lines, polygons, ellipses and
	  Bézier curves.

	  http://www.imagemagick.org/

comment "imagemagick needs a toolchain w/ threads"
	depends on LINGMO_USE_MMU
	depends on !LINGMO_TOOLCHAIN_HAS_THREADS
```

## package/imlib2/Config.in
```kconfig
comment "imlib2 needs a toolchain w/ dynamic library"
	depends on LINGMO_STATIC_LIBS

config LINGMO_PACKAGE_IMLIB2
	bool "imlib2"
	depends on !LINGMO_STATIC_LIBS # dlopen()
	select LINGMO_PACKAGE_FREETYPE
	help
	  Imlib 2 is the successor to Imlib. This library provides
	  routines to load, save and render images in various formats.

	  http://freshmeat.net/projects/imlib2/

if LINGMO_PACKAGE_IMLIB2

config LINGMO_PACKAGE_IMLIB2_JPEG
	bool "JPEG support"
	select LINGMO_PACKAGE_JPEG

config LINGMO_PACKAGE_IMLIB2_PNG
	bool "PNG support"
	select LINGMO_PACKAGE_LIBPNG

config LINGMO_PACKAGE_IMLIB2_GIF
	bool "GIF support"
	select LINGMO_PACKAGE_GIFLIB

config LINGMO_PACKAGE_IMLIB2_TIFF
	bool "TIFF support"
	select LINGMO_PACKAGE_TIFF

config LINGMO_PACKAGE_IMLIB2_ID3
	bool "ID3 support"
	select LINGMO_PACKAGE_LIBID3TAG

config LINGMO_PACKAGE_IMLIB2_X
	bool "X support"
	default y
	depends on LINGMO_PACKAGE_XORG7
	select LINGMO_PACKAGE_XLIB_LIBXEXT
	select LINGMO_PACKAGE_XLIB_LIBX11
endif
```

## package/initscripts/Config.in
```kconfig
config LINGMO_PACKAGE_INITSCRIPTS
	bool
	help
	  The basics startup scripts for both SysV and Busybox
```

## package/intel-gmmlib/Config.in
```kconfig
config LINGMO_PACKAGE_INTEL_GMMLIB
	bool "intel-gmmlib"
	depends on LINGMO_x86_64
	depends on !LINGMO_STATIC_LIBS
	depends on LINGMO_INSTALL_LIBSTDCPP
	depends on LINGMO_TOOLCHAIN_HAS_THREADS
	help
	  The Intel(R) Graphics Memory Management Library provides
	  device specific and buffer management for the Intel(R)
	  Graphics Compute Runtime for OpenCL(TM) and the Intel(R)
	  Media Driver for VAAPI.

	  https://github.com/intel/gmmlib

comment "intel-gmmlib needs a toolchain w/ dynamic library, C++, threads"
	depends on LINGMO_STATIC_LIBS || !LINGMO_INSTALL_LIBSTDCPP || \
		!LINGMO_TOOLCHAIN_HAS_THREADS
```

## package/intel-mediadriver/Config.in
```kconfig
config LINGMO_PACKAGE_INTEL_MEDIADRIVER
	bool "intel-mediadriver"
	depends on LINGMO_x86_64
	depends on !LINGMO_STATIC_LIBS # mesa3d, libva
	depends on LINGMO_INSTALL_LIBSTDCPP # intel-gmmlib, mesa3d
	depends on LINGMO_TOOLCHAIN_GCC_AT_LEAST_8 # mesa3d
	depends on LINGMO_TOOLCHAIN_HAS_SYNC_1 # mesa3d
	depends on LINGMO_TOOLCHAIN_HAS_THREADS # intel-gmmlib, libva
	depends on LINGMO_TOOLCHAIN_HAS_THREADS_NPTL # mesa3d
	select LINGMO_PACKAGE_INTEL_GMMLIB
	select LINGMO_PACKAGE_LIBPCIACCESS
	select LINGMO_PACKAGE_LIBVA
	select LINGMO_PACKAGE_MESA3D
	help
	  The Intel(R) Media Driver for VAAPI is a new VA-API (Video
	  Acceleration API) user mode driver supporting hardware
	  accelerated decoding, encoding, and video post processing for
	  GEN based graphics hardware.

	  https://github.com/intel/media-driver

if LINGMO_PACKAGE_INTEL_MEDIADRIVER

config LINGMO_PACKAGE_INTEL_MEDIADRIVER_GEN8
	bool "Gen8 support"
	default y
	help
	  Enable support for Gen8 GPUs (Coffee Lake)

endif # LINGMO_PACKAGE_INTEL_MEDIADRIVER

comment "intel-mediadriver needs a toolchain w/ dynamic library, gcc >= 8, C++, NPTL"
	depends on LINGMO_x86_64 && LINGMO_TOOLCHAIN_HAS_SYNC_1
	depends on LINGMO_STATIC_LIBS || !LINGMO_INSTALL_LIBSTDCPP || \
		!LINGMO_TOOLCHAIN_HAS_THREADS_NPTL || !LINGMO_TOOLCHAIN_GCC_AT_LEAST_8
```

## package/intel-mediasdk/Config.in
```kconfig
config LINGMO_PACKAGE_INTEL_MEDIASDK
	bool "intel-mediasdk"
	depends on LINGMO_x86_64
	depends on !LINGMO_STATIC_LIBS # intel-mediadriver
	depends on LINGMO_INSTALL_LIBSTDCPP # intel-mediadriver
	depends on LINGMO_TOOLCHAIN_HAS_SYNC_1 # intel-mediadriver
	depends on LINGMO_TOOLCHAIN_HAS_THREADS # intel-mediadriver
	depends on LINGMO_TOOLCHAIN_HAS_THREADS_NPTL # intel-mediadriver
	select LINGMO_PACKAGE_INTEL_MEDIADRIVER
	select LINGMO_PACKAGE_LIBDRM_INTEL
	help
	  Intel(R) Media SDK provides an API to access
	  hardware-accelerated video decode, encode and filtering on
	  Intel® platforms with integrated graphics.

	  Supported video encoders: HEVC, AVC, MPEG-2, JPEG
	  Supported Video decoders: HEVC, AVC, VP8, MPEG-2, VC1, JPEG
	  Supported video pre-processing filters: Color Conversion,
	  Deinterlace, Denoise, Resize, Rotate, Composition

	  http://mediasdk.intel.com/

comment "intel-mediasdk needs a toolchain w/ dynamic library, C++, NPTL"
	depends on LINGMO_x86_64 && LINGMO_TOOLCHAIN_HAS_SYNC_1
	depends on LINGMO_STATIC_LIBS || !LINGMO_INSTALL_LIBSTDCPP || \
		!LINGMO_TOOLCHAIN_HAS_THREADS_NPTL
```

## package/intel-microcode/Config.in
```kconfig
config LINGMO_PACKAGE_INTEL_MICROCODE
	bool "intel-microcode"
	depends on LINGMO_x86_64 || LINGMO_i386
	help
	  This package provides an Intel microcode data file that can be
	  used to correct processor errors. The iucode-tool package and
	  proper kernel support are required to upload the microcode.

	  https://github.com/intel/Intel-Linux-Processor-Microcode-Data-Files

config LINGMO_PACKAGE_INTEL_MICROCODE_INSTALL_TARGET
	bool "install microcode files to /lib/firmware in target"
	default y
	depends on LINGMO_PACKAGE_INTEL_MICROCODE
	help
	  Select this option to have the microcode files installed to
	  /lib/firmware/intel-ucode in the target root filesystem, in
	  addition to the images directory.
```

## package/iotop/Config.in
```kconfig
comment "iotop depends on python3"
	depends on !LINGMO_PACKAGE_PYTHON3

config LINGMO_PACKAGE_IOTOP
	bool "iotop"
	depends on LINGMO_PACKAGE_PYTHON3
	select LINGMO_PACKAGE_PYTHON3_CURSES
	help
	  iotop does for I/O usage what top does for CPU usage.

	  http://guichaz.free.fr/iotop/
```

## package/ipcalc/Config.in
```kconfig
config LINGMO_PACKAGE_IPCALC
	bool "ipcalc"
	depends on LINGMO_PACKAGE_BUSYBOX_SHOW_OTHERS
	help
	  A modern IPv4/IPv6 ipcalc tool, assisting in network
	  calculations in command line and as a tool for scripts.

	  https://gitlab.com/ipcalc/ipcalc
```

## package/iperf/Config.in
```kconfig
config LINGMO_PACKAGE_IPERF
	bool "iperf"
	depends on LINGMO_INSTALL_LIBSTDCPP
	# uses fork()
	depends on LINGMO_USE_MMU
	help
	  Internet Protocol bandwidth measuring tool for measuring
	  TCP/UDP performance.

	  https://sourceforge.net/projects/iperf2/

comment "iperf needs a toolchain w/ C++"
	depends on LINGMO_USE_MMU
	depends on !LINGMO_INSTALL_LIBSTDCPP
```

## package/ipmiutil/Config.in
```kconfig
config LINGMO_PACKAGE_IPMIUTIL
	bool "ipmiutil"
	depends on LINGMO_USE_MMU
	depends on !LINGMO_STATIC_LIBS
	depends on LINGMO_TOOLCHAIN_HAS_THREADS
	depends on LINGMO_x86_64 || LINGMO_i386
	help
	  The ipmiutil package provides easy-to-use utilities to view
	  the SEL, perform an IPMI chassis reset, set up the IPMI LAN
	  and Platform Event Filter entries to allow SNMP alerts,
	  Serial-Over-LAN console, event daemon, and other IPMI tasks.

	  http://ipmiutil.sourceforge.net/

comment "ipmiutil needs a toolchain w/ threads, dynamic library"
	depends on LINGMO_USE_MMU
	depends on !LINGMO_TOOLCHAIN_HAS_THREADS || LINGMO_STATIC_LIBS
	depends on LINGMO_x86_64 || LINGMO_i386
```

## package/iproute2/Config.in
```kconfig
config LINGMO_PACKAGE_IPROUTE2
	bool "iproute2"
	depends on LINGMO_USE_MMU # fork()
	depends on LINGMO_TOOLCHAIN_HEADERS_AT_LEAST_3_4 # __kernel_{u,}long_t
	help
	  Kernel routing and traffic control utilities. Provides things
	  like ip and tc.

	  http://www.linuxfoundation.org/collaborate/workgroups/networking/iproute2

comment "iproute2 needs a toolchain w/ headers >= 3.4"
	depends on LINGMO_USE_MMU
	depends on !LINGMO_TOOLCHAIN_HEADERS_AT_LEAST_3_4
```

## package/iprutils/Config.in
```kconfig
config LINGMO_PACKAGE_IPRUTILS
	bool "iprutils"
	depends on LINGMO_USE_MMU # fork()
	select LINGMO_PACKAGE_NCURSES
	select LINGMO_PACKAGE_LIBSYSFS
	select LINGMO_PACKAGE_PCIUTILS
	select LINGMO_PACKAGE_ZLIB
	help
	  System utilities for IBM Power RAID devices

	  http://sourceforge.net/projects/iprdd/
```

## package/iptables/Config.in
```kconfig
config LINGMO_PACKAGE_IPTABLES
	bool "iptables"
	help
	  Linux kernel firewall, NAT, and packet mangling tools.

	  http://www.netfilter.org/projects/iptables/index.html

if LINGMO_PACKAGE_IPTABLES

config LINGMO_PACKAGE_IPTABLES_BPF_NFSYNPROXY
	bool "bpfc and nfsynproxy"
	select LINGMO_PACKAGE_LIBPCAP
	help
	  Build bpf compiler and nfsynproxy configuration tool.

config LINGMO_PACKAGE_IPTABLES_NFTABLES
	bool "nftables compat"
	# uses dlfcn
	depends on !LINGMO_STATIC_LIBS
	depends on LINGMO_USE_WCHAR
	depends on LINGMO_TOOLCHAIN_HEADERS_AT_LEAST_3_12
	select LINGMO_PACKAGE_LIBMNL
	select LINGMO_PACKAGE_LIBNFTNL
	help
	  Build nftables compat utilities.

comment "nftables compat needs a toolchain w/ wchar, dynamic library, headers >= 3.12"
	depends on !LINGMO_TOOLCHAIN_HEADERS_AT_LEAST_3_12 || \
		!LINGMO_USE_WCHAR || LINGMO_STATIC_LIBS

endif
```

## package/iptraf-ng/Config.in
```kconfig
config LINGMO_PACKAGE_IPTRAF_NG
	bool "iptraf-ng"
	depends on LINGMO_USE_MMU # fork()
	depends on LINGMO_TOOLCHAIN_HEADERS_AT_LEAST_3_14
	select LINGMO_PACKAGE_NCURSES
	help
	  IPTraf-ng is a console-based network monitoring program for
	  Linux that gathers displays information about IP traffic.

	  https://github.com/iptraf-ng/iptraf-ng

	  IPTraf-ng is a fork of original IPTraf v3.0.0
	  (http://iptraf.seul.org).

comment "iptraf-ng needs a toolchain w/ kernel headers >= 3.14"
	depends on LINGMO_USE_MMU
	depends on !LINGMO_TOOLCHAIN_HEADERS_AT_LEAST_3_14
```

## package/iputils/Config.in
```kconfig
config LINGMO_PACKAGE_IPUTILS
	bool "iputils"
	depends on LINGMO_USE_MMU # fork()
	help
	  This package is set of small useful utilities for Linux
	  networking. It includes complete versions of ping, arping,
	  etc.

	  https://github.com/iputils/iputils

if LINGMO_PACKAGE_IPUTILS

config LINGMO_PACKAGE_IPUTILS_ARPING
	bool "arping"
	default y
	help
	  Installs arping.

config LINGMO_PACKAGE_IPUTILS_CLOCKDIFF
	bool "clockdiff"
	default y
	help
	  Installs clockdiff.

config LINGMO_PACKAGE_IPUTILS_PING
	bool "ping"
	default y
	help
	  Installs ping.

config LINGMO_PACKAGE_IPUTILS_TRACEPATH
	bool "tracepath"
	default y
	help
	  Installs tracepath.

comment "ninfod needs a toolchain w/ threads"
	depends on !LINGMO_TOOLCHAIN_HAS_THREADS

endif
```

## package/irda-utils/Config.in
```kconfig
config LINGMO_PACKAGE_IRDA_UTILS
	bool "irda-utils"
	help
	  user space utilities which control the IrDA stack

	  http://irda.sourceforge.net/

if LINGMO_PACKAGE_IRDA_UTILS

config LINGMO_PACKAGE_IRDA_UTILS_IRATTACH
	bool "irattach"

config LINGMO_PACKAGE_IRDA_UTILS_IRDAPING
	bool "irdaping"

config LINGMO_PACKAGE_IRDA_UTILS_IRNETD
	bool "irnetd"

endif
```

## package/irqbalance/Config.in
```kconfig
config LINGMO_PACKAGE_IRQBALANCE
	bool "irqbalance"
	depends on LINGMO_USE_WCHAR # libglib2
	depends on LINGMO_TOOLCHAIN_HAS_THREADS # libglib2
	depends on LINGMO_USE_MMU # libglib2
	select LINGMO_PACKAGE_LIBGLIB2
	help
	  Irqbalance is a daemon to help balance the cpu load generated
	  by interrupts across all of a systems cpus.
	  Irqbalance identifies the highest volume interrupt sources,
	  and isolates them to a single unique cpu, so that load is
	  spread as much as possible over an entire processor set, while
	  minimizing cache hit rates for irq handlers.

	  https://github.com/Irqbalance/irqbalance

comment "irqbalance needs a toolchain w/ wchar, threads"
	depends on LINGMO_USE_MMU
	depends on !LINGMO_USE_WCHAR || !LINGMO_TOOLCHAIN_HAS_THREADS
```

## package/irrlicht/Config.in
```kconfig
config LINGMO_PACKAGE_IRRLICHT
	bool "irrlicht"
	depends on LINGMO_INSTALL_LIBSTDCPP
	depends on LINGMO_PACKAGE_XORG7
	depends on LINGMO_PACKAGE_HAS_LIBGL # use GLX
	select LINGMO_PACKAGE_XLIB_LIBXXF86VM # libXxf86vm
	help
	  An open source high performance realtime 3D graphics engine.

	  http://irrlicht.sourceforge.net/

comment "irrlicht needs a toolchain w/ C++"
	depends on !LINGMO_INSTALL_LIBSTDCPP

comment "irrlicht needs X11 and an OpenGL provider"
	depends on !LINGMO_PACKAGE_HAS_LIBGL || !LINGMO_PACKAGE_XORG7
	depends on LINGMO_INSTALL_LIBSTDCPP
```

## package/irssi/Config.in
```kconfig
config LINGMO_PACKAGE_IRSSI
	bool "irssi"
	depends on LINGMO_USE_WCHAR # libglib2
	depends on LINGMO_TOOLCHAIN_HAS_THREADS # libglib2
	depends on LINGMO_USE_MMU # fork()
	select LINGMO_PACKAGE_LIBGLIB2
	select LINGMO_PACKAGE_NCURSES
	select LINGMO_PACKAGE_OPENSSL
	help
	  Irssi is a terminal based IRC client for UNIX systems.

	  http://irssi.org/

if LINGMO_PACKAGE_IRSSI

config LINGMO_PACKAGE_IRSSI_PROXY
	bool "proxy module"
	help
	  Build the irssi proxy module, which allows an IRC connection
	  to be shared among multiple clients.

config LINGMO_PACKAGE_IRSSI_TRUE_COLOR
	bool "true color support"
	help
	  Build with true color support in terminal.

endif

comment "irssi needs a toolchain w/ wchar, threads"
	depends on LINGMO_USE_MMU
	depends on !LINGMO_USE_WCHAR || !LINGMO_TOOLCHAIN_HAS_THREADS
```

## package/iucode-tool/Config.in
```kconfig
config LINGMO_PACKAGE_IUCODE_TOOL
	bool "iucode-tool"
	depends on LINGMO_x86_64 || LINGMO_i386
	select LINGMO_PACKAGE_INTEL_MICROCODE
	select LINGMO_PACKAGE_INTEL_MICROCODE_INSTALL_TARGET
	select LINGMO_PACKAGE_ARGP_STANDALONE \
	       if LINGMO_TOOLCHAIN_USES_UCLIBC || LINGMO_TOOLCHAIN_USES_MUSL
	help
	  Intel processor microcode tool

	  https://gitlab.com/iucode-tool
```

## package/iw/Config.in
```kconfig
config LINGMO_PACKAGE_IW
	bool "iw"
	depends on LINGMO_TOOLCHAIN_HAS_THREADS # libnl
	select LINGMO_PACKAGE_LIBNL
	help
	  Utility for wireless devices using the mac80211 kernel stack

	  https://wireless.wiki.kernel.org/en/users/documentation/iw

comment "iw needs a toolchain w/ threads"
	depends on !LINGMO_TOOLCHAIN_HAS_THREADS
```

## package/iwd/Config.in
```kconfig
config LINGMO_PACKAGE_IWD
	bool "iwd"
	depends on LINGMO_USE_MMU # dbus
	depends on LINGMO_TOOLCHAIN_HAS_THREADS # dbus
	depends on LINGMO_TOOLCHAIN_HAS_SYNC_4 # ell
	depends on LINGMO_TOOLCHAIN_HEADERS_AT_LEAST_4_12 # ell
	depends on LINGMO_USE_WCHAR # ell
	select LINGMO_PACKAGE_DBUS # runtime
	select LINGMO_PACKAGE_ELL
	select LINGMO_PACKAGE_OPENRESOLV if !LINGMO_PACKAGE_SYSTEMD_RESOLVED
	help
	  iNet Wireless daemon (iwd)

	  https://iwd.wiki.kernel.org/

comment "iwd needs a toolchain w/ threads, wchar, headers >= 4.12"
	depends on LINGMO_USE_MMU # dbus
	depends on LINGMO_TOOLCHAIN_HAS_SYNC_4 # ell
	depends on !LINGMO_TOOLCHAIN_HAS_THREADS || !LINGMO_USE_WCHAR || \
		!LINGMO_TOOLCHAIN_HEADERS_AT_LEAST_4_12
```
