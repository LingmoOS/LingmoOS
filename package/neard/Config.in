## package/neard/Config.in
```kconfig
config LINGMO_PACKAGE_NEARD
	bool "neard"
	depends on LINGMO_USE_WCHAR # libglib2
	depends on LINGMO_TOOLCHAIN_HAS_THREADS # libnl, dbus, libglib2
	depends on LINGMO_USE_MMU # dbus, libglib2
	depends on !LINGMO_STATIC_LIBS # dlopen
	depends on LINGMO_TOOLCHAIN_HAS_SYNC_4
	select LINGMO_PACKAGE_DBUS
	select LINGMO_PACKAGE_LIBGLIB2
	select LINGMO_PACKAGE_LIBNL
	help
	  Near Field Communication (NFC) manager. This userspace
	  daemon is a part of the NFC stack provided by the Linux NFC
	  project.

	  https://git.kernel.org/pub/scm/network/nfc/neard.git

if LINGMO_PACKAGE_NEARD

config LINGMO_PACKAGE_NEARD_TOOLS
	bool "neard tools"
	help
	  Build and install neard tools.

endif

comment "neard needs a toolchain w/ wchar, threads, dynamic library"
	depends on LINGMO_USE_MMU
	depends on LINGMO_TOOLCHAIN_HAS_SYNC_4
	depends on !LINGMO_USE_WCHAR || !LINGMO_TOOLCHAIN_HAS_THREADS || LINGMO_STATIC_LIBS
```

## package/neardal/Config.in
```kconfig
config LINGMO_PACKAGE_NEARDAL
	bool "neardal"
	depends on LINGMO_USE_WCHAR # glib2
	depends on LINGMO_TOOLCHAIN_HAS_THREADS # dbus, glib2
	depends on LINGMO_USE_MMU # dbus
	select LINGMO_PACKAGE_DBUS
	select LINGMO_PACKAGE_DBUS_GLIB
	select LINGMO_PACKAGE_LIBEDIT
	help
	  Provides a simple C API to exchange data with the neard NFC
	  manager daemon.

	  https://github.com/connectivity/neardal

if LINGMO_PACKAGE_NEARDAL

config LINGMO_PACKAGE_NEARDAL_NCL
	bool "ncl tool"
	help
	  Build and install neardal ncl command line interpreter tool.

endif

comment "neardal needs a toolchain w/ wchar, threads"
	depends on LINGMO_USE_MMU
	depends on !LINGMO_USE_WCHAR || !LINGMO_TOOLCHAIN_HAS_THREADS
```

## package/neofetch/Config.in
```kconfig
config LINGMO_PACKAGE_NEOFETCH
	bool "neofetch"
	depends on LINGMO_USE_MMU # bash
	depends on LINGMO_PACKAGE_BUSYBOX_SHOW_OTHERS # bash
	select LINGMO_PACKAGE_BASH # runtime dependency
	help
	  Neofetch is a bash script to display system information,
	  including hardware, in a visually pleasing way.

	  https://github.com/dylanaraps/neofetch
```

## package/neon/Config.in
```kconfig
config LINGMO_PACKAGE_NEON
	bool "libneon"
	help
	  HTTP and WebDAV client library, with a C interface.

	  https://notroj.github.io/neon/

if LINGMO_PACKAGE_NEON

config LINGMO_PACKAGE_NEON_ZLIB
	bool "ZLIB support"
	select LINGMO_PACKAGE_ZLIB
	help
	  build with ZLIB support

config LINGMO_PACKAGE_NEON_SSL
	bool "SSL support"
	select LINGMO_PACKAGE_OPENSSL
	select LINGMO_PACKAGE_LIBOPENSSL_ENABLE_DES if LINGMO_PACKAGE_LIBOPENSSL
	select LINGMO_PACKAGE_LIBOPENSSL_ENABLE_MD4 if LINGMO_PACKAGE_LIBOPENSSL
	help
	  build with SSL support

# This is an hidden symbol other packages can select to ensure that
# Neon has XML support, either provided by Expat or libxml2.
config LINGMO_PACKAGE_NEON_XML
	bool
	select LINGMO_PACKAGE_NEON_EXPAT if !LINGMO_PACKAGE_NEON_LIBXML2

config LINGMO_PACKAGE_NEON_EXPAT
	bool "XML support with expat"
	depends on !LINGMO_PACKAGE_NEON_LIBXML2
	select LINGMO_PACKAGE_EXPAT
	help
	  Enable XML support in neon, using the Expat XML library.

config LINGMO_PACKAGE_NEON_LIBXML2
	bool "XML support with libxml2"
	select LINGMO_PACKAGE_LIBXML2
	help
	  Enable XML support in neon, using the libxml2 XML library.

endif
```

## package/nerdctl/Config.in
```kconfig
config LINGMO_PACKAGE_NERDCTL
	bool "nerdctl"
	depends on LINGMO_PACKAGE_HOST_GO_TARGET_ARCH_SUPPORTS
	depends on LINGMO_PACKAGE_HOST_GO_TARGET_CGO_LINKING_SUPPORTS
	depends on LINGMO_TOOLCHAIN_HAS_THREADS
	depends on !LINGMO_TOOLCHAIN_USES_UCLIBC # containerd
	depends on LINGMO_USE_MMU # util-linux
	select LINGMO_PACKAGE_CONTAINERD # runtime
	help
	  Docker-compatible CLI for containerd, controlling runc.

	  https://github.com/containerd/nerdctl

comment "nerdctl needs a glibc or musl toolchain w/ threads"
	depends on LINGMO_PACKAGE_HOST_GO_TARGET_ARCH_SUPPORTS
	depends on LINGMO_PACKAGE_HOST_GO_TARGET_CGO_LINKING_SUPPORTS
	depends on LINGMO_USE_MMU
	depends on !LINGMO_TOOLCHAIN_HAS_THREADS || LINGMO_TOOLCHAIN_USES_UCLIBC
```

## package/netatalk/Config.in
```kconfig
config LINGMO_PACKAGE_NETATALK
	bool "netatalk"
	depends on LINGMO_PACKAGE_LIBGPG_ERROR_ARCH_SUPPORTS # libgpg-error
	depends on LINGMO_TOOLCHAIN_HAS_THREADS
	depends on LINGMO_USE_MMU # fork()
	depends on !LINGMO_STATIC_LIBS
	select LINGMO_PACKAGE_BERKELEYDB
	select LINGMO_PACKAGE_OPENSSL
	select LINGMO_PACKAGE_LIBOPENSSL_ENABLE_CAST if LINGMO_PACKAGE_LIBOPENSSL
	select LINGMO_PACKAGE_LIBOPENSSL_ENABLE_DES if LINGMO_PACKAGE_LIBOPENSSL
	select LINGMO_PACKAGE_LIBEVENT
	select LINGMO_PACKAGE_LIBGCRYPT
	select LINGMO_PACKAGE_LIBGPG_ERROR
	help
	  Netatalk can be used to turn a *NIX machine into an
	  extremely high-performance and reliable file server for
	  Macintosh computers.

	  http://netatalk.sourceforge.net/

comment "netatalk needs a toolchain w/ threads, dynamic library"
	depends on LINGMO_USE_MMU
	depends on !LINGMO_TOOLCHAIN_HAS_THREADS || LINGMO_STATIC_LIBS
```

## package/netcat-openbsd/Config.in
```kconfig
config LINGMO_PACKAGE_NETCAT_OPENBSD
	bool "netcat-openbsd"
	depends on LINGMO_PACKAGE_LIBBSD_ARCH_SUPPORTS
	depends on !LINGMO_STATIC_LIBS # libbsd
	depends on LINGMO_TOOLCHAIN_HAS_THREADS
	depends on LINGMO_TOOLCHAIN_USES_GLIBC
	depends on LINGMO_PACKAGE_BUSYBOX_SHOW_OTHERS
	depends on LINGMO_TOOLCHAIN_HEADERS_AT_LEAST_3_12
	select LINGMO_PACKAGE_LIBBSD
	help
	  A simple Unix utility which reads and writes data across
	  network connections using TCP or UDP protocol. It is
	  designed to be a reliable "back-end" tool that can be used
	  directly or easily driven by other programs and scripts. At
	  the same time it is a feature-rich network debugging and
	  exploration tool, since it can create almost any kind of
	  connection you would need and has several interesting
	  built-in capabilities.

	  This package contains the OpenBSD rewrite of netcat,
	  including support for IPv6, proxies, and Unix sockets.

	  https://packages.debian.org/sid/netcat-openbsd

comment "netcat-openbsd needs a glibc toolchain w/ dynamic library, threads, headers >= 3.12"
	depends on LINGMO_PACKAGE_LIBBSD_ARCH_SUPPORTS
	depends on LINGMO_STATIC_LIBS || !LINGMO_TOOLCHAIN_HAS_THREADS || \
		!LINGMO_TOOLCHAIN_USES_GLIBC || \
		!LINGMO_TOOLCHAIN_HEADERS_AT_LEAST_3_12
	depends on LINGMO_PACKAGE_BUSYBOX_SHOW_OTHERS
```

## package/netdata/Config.in
```kconfig
config LINGMO_PACKAGE_NETDATA
	bool "netdata"
	depends on LINGMO_TOOLCHAIN_HAS_THREADS_NPTL
	depends on LINGMO_USE_MMU # fork()
	depends on !LINGMO_STATIC_LIBS # libuv
	depends on LINGMO_TOOLCHAIN_HAS_SYNC_4 # libuv
	depends on LINGMO_TOOLCHAIN_GCC_AT_LEAST_4_9 # libuv
	select LINGMO_PACKAGE_LIBUV
	select LINGMO_PACKAGE_UTIL_LINUX
	select LINGMO_PACKAGE_UTIL_LINUX_LIBUUID
	select LINGMO_PACKAGE_ZLIB
	help
	  Netdata is distributed, real-time, performance and health
	  monitoring for systems and applications. It is a highly
	  optimized monitoring agent you install on all your systems and
	  containers.

	  https://github.com/netdata/netdata

if LINGMO_PACKAGE_NETDATA

config LINGMO_PACKAGE_NETDATA_PROMETHEUS
	bool "prometheus remote write backend"
	depends on LINGMO_PACKAGE_PROTOBUF_ARCH_SUPPORTS
	depends on LINGMO_INSTALL_LIBSTDCPP # protobuf, snappy
	depends on LINGMO_TOOLCHAIN_GCC_AT_LEAST_4_8 # protobuf
	select LINGMO_PACKAGE_PROTOBUF
	select LINGMO_PACKAGE_SNAPPY
	help
	  Enable prometheus remote write backend

comment "prometheus remote write backend needs a toolchain w/ C++, gcc >= 4.8"
	depends on !LINGMO_INSTALL_LIBSTDCPP || \
		!LINGMO_TOOLCHAIN_GCC_AT_LEAST_4_8
	depends on LINGMO_PACKAGE_PROTOBUF_ARCH_SUPPORTS

endif

comment "netdata needs a toolchain w/ NPTL, dynamic library, gcc >= 4.9"
	depends on !LINGMO_TOOLCHAIN_HAS_THREADS_NPTL || LINGMO_STATIC_LIBS \
		|| !LINGMO_TOOLCHAIN_GCC_AT_LEAST_4_9
	depends on LINGMO_USE_MMU
	depends on LINGMO_TOOLCHAIN_HAS_SYNC_4
```

## package/netifrc/Config.in
```kconfig
config LINGMO_PACKAGE_NETIFRC
	bool "netifrc"
	depends on LINGMO_PACKAGE_OPENRC
	help
	  netifrc is a collection of modules created to configure and
	  manage network interfaces via individual, per-interface
	  scripts.

	  https://wiki.gentoo.org/wiki/Netifrc

comment "netifrc needs openrc as init system"
	depends on !LINGMO_PACKAGE_OPENRC
```

## package/netopeer2/Config.in
```kconfig
comment "netopeer2 needs a toolchain w/ gcc >= 4.8, C++, threads, dynamic library"
	depends on LINGMO_USE_MMU
	depends on LINGMO_TOOLCHAIN_HAS_SYNC_4
	depends on LINGMO_STATIC_LIBS || !LINGMO_INSTALL_LIBSTDCPP \
		|| !LINGMO_TOOLCHAIN_HAS_THREADS_NPTL || !LINGMO_TOOLCHAIN_GCC_AT_LEAST_4_8

config LINGMO_PACKAGE_NETOPEER2
	bool "netopeer2"
	depends on LINGMO_USE_MMU # libnetconf2, libssh, sysrepo
	depends on LINGMO_TOOLCHAIN_HAS_SYNC_4 # libyang
	depends on !LINGMO_STATIC_LIBS # libnetconf2, libssh, libyang, sysrepo
	depends on LINGMO_INSTALL_LIBSTDCPP # sysrepo
	depends on LINGMO_TOOLCHAIN_HAS_THREADS_NPTL
	depends on LINGMO_TOOLCHAIN_GCC_AT_LEAST_4_8 # sysrepo
	select LINGMO_PACKAGE_LIBNETCONF2
	select LINGMO_PACKAGE_LIBSSH
	select LINGMO_PACKAGE_LIBSSH_SERVER # For libnetconf2 to have SSH
	select LINGMO_PACKAGE_LIBYANG
	select LINGMO_PACKAGE_OPENSSL # For libnetconf2 to have TLS
	select LINGMO_PACKAGE_SYSREPO
	help
	  Netopeer2 is a set of tools implementing network configuration
	  tools based on the NETCONF Protocol.

	  This is the server part.

	  https://github.com/CESNET/Netopeer2

if LINGMO_PACKAGE_NETOPEER2

config LINGMO_PACKAGE_NETOPEER2_CLI
	bool "cli"
	help
	  Enable netopeer2 CLI.

endif
```

## package/netsniff-ng/Config.in
```kconfig
config LINGMO_PACKAGE_NETSNIFF_NG
	bool "netsniff-ng"
	depends on LINGMO_TOOLCHAIN_HEADERS_AT_LEAST_3_0
	depends on LINGMO_TOOLCHAIN_HAS_THREADS_NPTL # pthread_spin_lock
	depends on LINGMO_PACKAGE_LIBURCU_ARCH_SUPPORTS
	depends on LINGMO_INSTALL_LIBSTDCPP # liburcu
	select LINGMO_PACKAGE_LIBPCAP
	select LINGMO_PACKAGE_LIBNETFILTER_CONNTRACK
	select LINGMO_PACKAGE_LIBURCU
	help
	  netsniff-ng is a free, performant Linux network analyzer and
	  networking toolkit. If you will, the Swiss army knife for
	  network packets.

	  http://netsniff-ng.org

if LINGMO_PACKAGE_NETSNIFF_NG

config LINGMO_PACKAGE_NETSNIFF_NG_MAUSEZAHN
	bool "mausezahn"
	default y
	# Build with uClibc fails due to missing ceill()
	depends on !LINGMO_TOOLCHAIN_USES_UCLIBC
	select LINGMO_PACKAGE_LIBCLI
	select LINGMO_PACKAGE_LIBNET

comment "mausezahn needs glibc or musl toolchain"
	depends on LINGMO_TOOLCHAIN_USES_UCLIBC

endif

comment "netsniff-ng needs a toolchain w/ NPTL, C++, headers >= 3.0"
	depends on LINGMO_PACKAGE_LIBURCU_ARCH_SUPPORTS
	depends on !LINGMO_TOOLCHAIN_HAS_THREADS_NPTL || \
		!LINGMO_INSTALL_LIBSTDCPP || \
		!LINGMO_TOOLCHAIN_HEADERS_AT_LEAST_3_0
```

## package/netsurf/Config.in
```kconfig
# netsurf mixes up host and target CFLAGS, so it isn't compatible with
# architectures where we pass ABI specific compiler flags (TARGET_ABI)
config LINGMO_PACKAGE_NETSURF_ARCH_SUPPORTS
	bool
	default y if !((LINGMO_arc && LINGMO_ARC_ATOMIC_EXT) || \
		LINGMO_powerpc_8540 || LINGMO_powerpc_8548 || LINGMO_powerpc_e500mc || \
		LINGMO_xtensa)

comment "netsurf needs a toolchain w/ dynamic library"
	depends on LINGMO_STATIC_LIBS
	depends on LINGMO_PACKAGE_NETSURF_ARCH_SUPPORTS

config LINGMO_PACKAGE_NETSURF
	bool "netsurf"
	# static linking support is broken beyond repair
	depends on !LINGMO_STATIC_LIBS
	depends on LINGMO_PACKAGE_NETSURF_ARCH_SUPPORTS
	select LINGMO_PACKAGE_EXPAT
	select LINGMO_PACKAGE_JPEG
	select LINGMO_PACKAGE_LIBICONV if !LINGMO_ENABLE_LOCALE
	select LINGMO_PACKAGE_LIBPNG
	select LINGMO_PACKAGE_OPENSSL if LINGMO_PACKAGE_LIBCURL
	select LINGMO_PACKAGE_OPENSSL_FORCE_LIBOPENSSL if LINGMO_PACKAGE_LIBCURL
	help
	  NetSurf is a compact graphical web browser which aims for
	  HTML5, CSS and JavaScript support.
	  Frontends: GTK (X11), SDL 1.2 (framebuffer)

	  http://www.netsurf-browser.org/

if LINGMO_PACKAGE_NETSURF

choice
	prompt "Netsurf frontend"
	default LINGMO_PACKAGE_NETSURF_SDL

config LINGMO_PACKAGE_NETSURF_SDL
	bool "sdl frontend"
	select LINGMO_PACKAGE_SDL
	help
	  Select SDL 1.2 frontend.

config LINGMO_PACKAGE_NETSURF_GTK
	bool "gtk2 frontend"
	depends on LINGMO_PACKAGE_LIBGTK2
	help
	  Select GTK+ 2 frontend.

config LINGMO_PACKAGE_NETSURF_GTK3
	bool "gtk3 frontend"
	depends on LINGMO_PACKAGE_LIBGTK3
	help
	  Select GTK+ 3 frontend.

endchoice

endif
```

## package/network-manager-openvpn/Config.in
```kconfig
config LINGMO_PACKAGE_NETWORK_MANAGER_OPENVPN
	bool "network-manager-openvpn"
	depends on LINGMO_PACKAGE_NETWORK_MANAGER
	depends on LINGMO_PACKAGE_OPENVPN
	help
	  OpenVPN support for NetworkManager

	  https://gitlab.gnome.org/GNOME/NetworkManager-openvpn
```

## package/network-manager/Config.in
```kconfig
config LINGMO_PACKAGE_NETWORK_MANAGER
	bool "network-manager"
	depends on !LINGMO_STATIC_LIBS # gnutls
	depends on LINGMO_USE_MMU # dbus
	depends on LINGMO_PACKAGE_HAS_UDEV
	depends on LINGMO_TOOLCHAIN_GCC_AT_LEAST_4_9
	depends on LINGMO_TOOLCHAIN_HEADERS_AT_LEAST_4_6
	depends on LINGMO_TOOLCHAIN_USES_GLIBC || LINGMO_TOOLCHAIN_USES_MUSL
	depends on LINGMO_TOOLCHAIN_HAS_THREADS # libglib2
	depends on LINGMO_USE_WCHAR # libglib2
	select LINGMO_PACKAGE_DBUS
	select LINGMO_PACKAGE_GNUTLS if !LINGMO_PACKAGE_LIBNSS
	select LINGMO_PACKAGE_LIBGLIB2
	select LINGMO_PACKAGE_LIBNDP
	select LINGMO_PACKAGE_UTIL_LINUX
	select LINGMO_PACKAGE_UTIL_LINUX_LIBUUID
	help
	  NetworkManager is a set of co-operative tools that make
	  networking simple and straightforward. Whether WiFi, wired,
	  3G, or Bluetooth, NetworkManager allows you to quickly move
	  from one network to another: once a network has been
	  configured and joined once, it can be detected and re-joined
	  automatically the next time it's available.

	  http://projects.gnome.org/NetworkManager/

if LINGMO_PACKAGE_NETWORK_MANAGER

config LINGMO_PACKAGE_NETWORK_MANAGER_TUI
	bool "nmtui support"
	select LINGMO_PACKAGE_NEWT
	help
	  This option enables terminal based UI

config LINGMO_PACKAGE_NETWORK_MANAGER_CLI
	bool "nmcli support"
	select LINGMO_PACKAGE_READLINE
	help
	  This option enables support for the NetworkManager Command
	  Line Interface

config LINGMO_PACKAGE_NETWORK_MANAGER_MODEM_MANAGER
	bool "modem-manager support"
	select LINGMO_PACKAGE_MODEM_MANAGER
	select LINGMO_PACKAGE_MOBILE_BROADBAND_PROVIDER_INFO
	help
	  This option enables support for ModemManager

config LINGMO_PACKAGE_NETWORK_MANAGER_PPPD
	bool "pppd support"
	select LINGMO_PACKAGE_PPPD
	help
	  This option enables support for PPPD daemon

config LINGMO_PACKAGE_NETWORK_MANAGER_OVS
	bool "OpenVSwitch support"
	select LINGMO_PACKAGE_JANSSON
	help
	  This option enables support for OpenVSwitch
endif

comment "NetworkManager needs udev /dev management and a glibc or musl toolchain w/ headers >= 4.6, dynamic library, wchar, threads, gcc >= 4.9"
	depends on LINGMO_USE_MMU
	depends on !LINGMO_PACKAGE_HAS_UDEV || \
		!LINGMO_TOOLCHAIN_HEADERS_AT_LEAST_4_6 || \
		!(LINGMO_TOOLCHAIN_USES_GLIBC || LINGMO_TOOLCHAIN_USES_MUSL) || \
		LINGMO_STATIC_LIBS || \
		!LINGMO_USE_WCHAR || !LINGMO_TOOLCHAIN_HAS_THREADS || \
		!LINGMO_TOOLCHAIN_GCC_AT_LEAST_4_9
```
