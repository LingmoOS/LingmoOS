## package/networkd-dispatcher/Config.in
```kconfig
config LINGMO_PACKAGE_NETWORKD_DISPATCHER
	bool "networkd-dispatcher"
	depends on LINGMO_PACKAGE_GOBJECT_INTROSPECTION_ARCH_SUPPORTS # python-gobject -> gobject-introspection
	depends on LINGMO_HOST_GCC_AT_LEAST_8 # python-gobject -> gobject-introspection -> host-qemu
	depends on LINGMO_TOOLCHAIN_GCC_AT_LEAST_4_9 # python-gobject -> gobject-introspection
	depends on LINGMO_TOOLCHAIN_USES_GLIBC # python-gobject -> gobject-introspection
	depends on LINGMO_PACKAGE_SYSTEMD # runtime
	select LINGMO_PACKAGE_DBUS # dbus-python
	select LINGMO_PACKAGE_DBUS_PYTHON # runtime
	select LINGMO_PACKAGE_PYTHON3 # python-gobject
	select LINGMO_PACKAGE_PYTHON_GOBJECT # runtime
	select LINGMO_PACKAGE_SYSTEMD_NETWORKD # runtime
	help
	  Networkd-dispatcher is a dispatcher daemon for
	  systemd-networkd connection status changes.
	  This daemon is similar to NetworkManager-dispatcher,
	  but is much more limited in the types of events it
	  supports due to the limited nature of systemd-networkd.

	  https://gitlab.com/craftyguy/networkd-dispatcher

comment "networkd-dispatcher needs a glibc toolchain, gcc >= 4.9, host gcc >= 8"
	depends on LINGMO_PACKAGE_GOBJECT_INTROSPECTION_ARCH_SUPPORTS
	depends on LINGMO_PACKAGE_SYSTEMD
	depends on !LINGMO_HOST_GCC_AT_LEAST_8 || \
		!LINGMO_TOOLCHAIN_GCC_AT_LEAST_4_9 || \
		!LINGMO_TOOLCHAIN_USES_GLIBC
```

## package/newt/Config.in
```kconfig
config LINGMO_PACKAGE_NEWT
	bool "newt"
	depends on LINGMO_USE_WCHAR
	depends on LINGMO_USE_MMU # slang
	depends on !LINGMO_STATIC_LIBS # unconditionally creates .so
	select LINGMO_PACKAGE_SLANG
	select LINGMO_PACKAGE_POPT
	help
	  Programming library for color text mode, widget based user
	  interfaces.

	  http://www.redhat.com/

comment "newt needs a toolchain w/ wchar, dynamic library"
	depends on LINGMO_USE_MMU
	depends on !LINGMO_USE_WCHAR || LINGMO_STATIC_LIBS
```

## package/nfs-utils/Config.in
```kconfig
comment "nfs-utils needs a toolchain w/ threads, headers >= 3.17"
	depends on LINGMO_USE_MMU
	depends on !LINGMO_TOOLCHAIN_HAS_THREADS || !LINGMO_TOOLCHAIN_HEADERS_AT_LEAST_3_17

config LINGMO_PACKAGE_NFS_UTILS
	bool "nfs-utils"
	depends on LINGMO_TOOLCHAIN_HAS_THREADS # libtirpc, rpcbind
	depends on LINGMO_USE_MMU # fork()
	depends on LINGMO_TOOLCHAIN_HEADERS_AT_LEAST_3_17 # getrandom()
	select LINGMO_PACKAGE_LIBEVENT
	select LINGMO_PACKAGE_LIBTIRPC # IPv6 requires libtirpc
	select LINGMO_PACKAGE_SQLITE
	select LINGMO_PACKAGE_UTIL_LINUX
	select LINGMO_PACKAGE_UTIL_LINUX_LIBBLKID
	select LINGMO_PACKAGE_UTIL_LINUX_LIBMOUNT
	select LINGMO_PACKAGE_UTIL_LINUX_LIBUUID
	help
	  The NFS Linux kernel server.

	  Supports NFSv3 and optionally NFSv4 (and later).

	  http://linux-nfs.org/

if LINGMO_PACKAGE_NFS_UTILS

config LINGMO_PACKAGE_NFS_UTILS_NFSV4
	bool "NFSv4/NFSv4.1"
	depends on !LINGMO_STATIC_LIBS # keyutils, lvm2
	select LINGMO_PACKAGE_KEYUTILS
	select LINGMO_PACKAGE_LVM2
	help
	  Enable NFSv4/NFSv4.1/NFSv4.2 support

comment "NFSv4/NFSv4.1 support needs a toolchain w/ dynamic library"
	depends on LINGMO_STATIC_LIBS

config LINGMO_PACKAGE_NFS_UTILS_GSS
	bool "gss"
	depends on LINGMO_PACKAGE_NFS_UTILS_NFSV4
	select LINGMO_PACKAGE_LIBTIRPC_GSS
	help
	  Enable GSS support

config LINGMO_PACKAGE_NFS_UTILS_RPCDEBUG
	bool "rpcdebug"
	help
	  The RPC debugging utility

config LINGMO_PACKAGE_NFS_UTILS_RPC_LOCKD
	bool "rpc.lockd"
	help
	  NFS lock manager for Linux kernels older than 2.4

config LINGMO_PACKAGE_NFS_UTILS_RPC_NFSD
	bool "rpc.nfsd"
	default y
	select LINGMO_PACKAGE_RPCBIND # runtime
	help
	  NFS server

config LINGMO_PACKAGE_NFS_UTILS_RPC_RQUOTAD
	bool "rpc.rquotad"
	help
	  NFS remote quota server

endif
```

## package/nftables/Config.in
```kconfig
config LINGMO_PACKAGE_NFTABLES
	bool "nftables"
	depends on LINGMO_USE_WCHAR
	depends on LINGMO_TOOLCHAIN_HEADERS_AT_LEAST_3_12
	select LINGMO_PACKAGE_LIBMNL
	select LINGMO_PACKAGE_LIBNFTNL
	help
	  nftables is the project that aims to replace the existing
	  {ip,ip6,arp,eb}tables framework.
	  Basically, this project provides a new packet filtering
	  framework, a new userspace utility and also a compatibility
	  layer for {ip,ip6}tables.

	  http://www.netfilter.org/projects/nftables/index.html

# Legacy: this used to be handled in nftables.mk
if LINGMO_PACKAGE_NFTABLES
source "package/nftables/nftables-python/Config.in"
endif

comment "nftables needs a toolchain w/ wchar, headers >= 3.12"
	depends on !LINGMO_USE_WCHAR || !LINGMO_TOOLCHAIN_HEADERS_AT_LEAST_3_12
```

## package/nftables/nftables-python/Config.in
```kconfig
config LINGMO_PACKAGE_NFTABLES_PYTHON
	bool "python bindings"
	default y # legacy
	depends on LINGMO_PACKAGE_PYTHON3
```

## package/nginx-dav-ext/Config.in
```kconfig
config LINGMO_PACKAGE_NGINX_DAV_EXT
	bool "nginx-dav-ext"
	depends on LINGMO_PACKAGE_NGINX_HTTP_DAV_MODULE
	select LINGMO_PACKAGE_LIBXSLT
	help
	  NGINX WebDAV missing commands support (PROPFIND & OPTIONS).

	  https://github.com/arut/nginx-dav-ext-module
```

## package/nginx-modsecurity/Config.in
```kconfig
config LINGMO_PACKAGE_NGINX_MODSECURITY
	bool "nginx-modsecurity"
	depends on LINGMO_PACKAGE_NGINX_HTTP
	depends on LINGMO_INSTALL_LIBSTDCPP # libmodsecurity
	depends on LINGMO_TOOLCHAIN_HAS_THREADS # libmodsecurity
	depends on !LINGMO_STATIC_LIBS # libmodsecurity
	select LINGMO_PACKAGE_LIBMODSECURITY
	help
	  The ModSecurity-nginx connector is the connection
	  point between nginx and libmodsecurity
	  (ModSecurity v3).

	  https://github.com/SpiderLabs/ModSecurity-nginx

comment "nginx-modsecurity needs a toolchain w/ C++, threads, dynamic library"
	depends on LINGMO_PACKAGE_NGINX_HTTP
	depends on !LINGMO_INSTALL_LIBSTDCPP || \
		!LINGMO_TOOLCHAIN_HAS_THREADS || LINGMO_STATIC_LIBS
```

## package/nginx-upload/Config.in
```kconfig
config LINGMO_PACKAGE_NGINX_UPLOAD
	bool "nginx-upload"
	depends on LINGMO_PACKAGE_NGINX_HTTP
	select LINGMO_PACKAGE_OPENSSL
	help
	  A module for nginx web server for handling file uploads
	  using multipart/form-data encoding (RFC 1867).

	  https://github.com/vkholodkov/nginx-upload-module
```

## package/ngircd/Config.in
```kconfig
config LINGMO_PACKAGE_NGIRCD
	bool "ngircd"
	depends on LINGMO_USE_MMU # fork()
	help
	  Next Generation IRC server daemon.

	  http://ngircd.barton.de
```

## package/ngrep/Config.in
```kconfig
config LINGMO_PACKAGE_NGREP
	bool "ngrep"
	select LINGMO_PACKAGE_LIBPCAP
	select LINGMO_PACKAGE_PCRE
	help
	  Network grep.

	  https://github.com/jpr5/ngrep/
```
