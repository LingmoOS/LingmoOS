## package/fftw/fftw-quad/Config.in
```kconfig
config LINGMO_PACKAGE_FFTW_QUAD
	bool "fftw-quad"
	# quad-precision needs to have a gcc with libquadmath
	depends on LINGMO_TOOLCHAIN_HAS_LIBQUADMATH && LINGMO_USE_WCHAR
	help
	  Compile fftw in quadruple precision, i.e. use '__float128' for
	  floating point type.
```

## package/filemq/Config.in
```kconfig
config LINGMO_PACKAGE_FILEMQ
	bool "filemq"
	depends on LINGMO_INSTALL_LIBSTDCPP # zeromq
	depends on LINGMO_TOOLCHAIN_HAS_THREADS # zeromq
	depends on LINGMO_USE_MMU # czmq
	select LINGMO_PACKAGE_OPENSSL
	select LINGMO_PACKAGE_CZMQ
	select LINGMO_PACKAGE_ZEROMQ
	help
	  FileMQ is a publish-subscribe file service based on 0MQ.

	  http://github.com/zeromq/filemq

comment "filemq needs a toolchain w/ C++, threads"
	depends on LINGMO_USE_MMU
	depends on !(LINGMO_INSTALL_LIBSTDCPP && LINGMO_TOOLCHAIN_HAS_THREADS)
```

## package/findutils/Config.in
```kconfig
config LINGMO_PACKAGE_FINDUTILS
	bool "findutils"
	depends on LINGMO_USE_WCHAR
	depends on LINGMO_USE_MMU # fork()
	depends on LINGMO_PACKAGE_BUSYBOX_SHOW_OTHERS
	help
	  Basic directory searching utilities. Provides the
	  common 'find', 'xargs', 'locate', and 'updatedb' binaries.

	  http://www.gnu.org/software/findutils/findutils.html

comment "findutils needs a toolchain w/ wchar"
	depends on LINGMO_USE_MMU
	depends on !LINGMO_USE_WCHAR
	depends on LINGMO_PACKAGE_BUSYBOX_SHOW_OTHERS
```

## package/fio/Config.in
```kconfig
config LINGMO_PACKAGE_FIO
	bool "fio"
	depends on LINGMO_USE_MMU # fork()
	depends on !LINGMO_STATIC_LIBS
	depends on LINGMO_TOOLCHAIN_GCC_AT_LEAST_4_9 # C11/stdatomic.h
	depends on LINGMO_TOOLCHAIN_HAS_SYNC_4
	depends on LINGMO_TOOLCHAIN_HAS_THREADS
	# fio uses fallocate() which becomes fallocate64() while compiling with
	# largefile support, but fallocate64() is not available on nios2
	depends on !LINGMO_nios2
	help
	  fio is an I/O tool meant to be used both for benchmark
	  and stress/hardware verification.

	  http://git.kernel.dk/?p=fio.git;a=summary

comment "fio needs a toolchain w/ dynamic library, threads, gcc >= 4.9"
	depends on !LINGMO_TOOLCHAIN_HAS_THREADS || LINGMO_STATIC_LIBS || \
		!LINGMO_TOOLCHAIN_GCC_AT_LEAST_4_9
	depends on LINGMO_TOOLCHAIN_HAS_SYNC_4
	depends on !LINGMO_nios2
	depends on LINGMO_USE_MMU
```

## package/firewalld/Config.in
```kconfig
config LINGMO_PACKAGE_FIREWALLD
	bool "firewalld"
	depends on LINGMO_USE_MMU # gobject-introspection, python3, python-gobject
	depends on LINGMO_PACKAGE_GOBJECT_INTROSPECTION_ARCH_SUPPORTS
	depends on LINGMO_USE_WCHAR # glib2, dbus-python, nftables, python3
	depends on LINGMO_TOOLCHAIN_GCC_AT_LEAST_4_9 # gobject-introspection
	depends on LINGMO_TOOLCHAIN_HAS_THREADS # dbus-python, python3
	depends on LINGMO_TOOLCHAIN_HEADERS_AT_LEAST_3_12
	depends on LINGMO_TOOLCHAIN_USES_GLIBC # gobject-introspection
	depends on LINGMO_HOST_GCC_AT_LEAST_8 # gobject-introspection
	depends on !LINGMO_STATIC_LIBS # python3
	select LINGMO_PACKAGE_DBUS # dbus-python
	select LINGMO_PACKAGE_DBUS_PYTHON
	select LINGMO_PACKAGE_GOBJECT_INTROSPECTION
	select LINGMO_PACKAGE_JANSSON # Uses the nftables json interface
	select LINGMO_PACKAGE_NFTABLES
	select LINGMO_PACKAGE_PYTHON3
	select LINGMO_PACKAGE_PYTHON_GOBJECT
	help
	  Firewalld provides a dynamically managed firewall with
	  support for network or firewall zones to define the trust
	  level of network connections or interfaces. It has support
	  for IPv4, IPv6 firewall settings and for ethernet bridges and
	  a separation of runtime and permanent configuration options.
	  It also provides an interface for services or applications to
	  add ip*tables and ebtables rules directly.

	  Note: Firewalld uses nftables as the backend and requires
	  kernel version >= 5.3.

	  https://github.com/firewalld/firewalld

comment "firewalld needs a glibc toolchain w/ wchar, dynamic library, headers >= 3.12, gcc >= 4.9, host gcc >= 8"
	depends on LINGMO_USE_MMU
	depends on LINGMO_PACKAGE_GOBJECT_INTROSPECTION_ARCH_SUPPORTS
	depends on !LINGMO_TOOLCHAIN_USES_GLIBC || \
		!LINGMO_TOOLCHAIN_HEADERS_AT_LEAST_3_12 || \
		!LINGMO_USE_WCHAR || LINGMO_STATIC_LIBS || \
		!LINGMO_TOOLCHAIN_GCC_AT_LEAST_4_9 || \
		!LINGMO_HOST_GCC_AT_LEAST_8 || LINGMO_STATIC_LIBS
```

## package/flac/Config.in
```kconfig
config LINGMO_PACKAGE_FLAC
	bool "flac"
	depends on LINGMO_USE_WCHAR
	help
	  FLAC is an Open Source lossless audio codec.

	  https://xiph.org/flac/

comment "flac needs a toolchain w/ wchar"
	depends on !LINGMO_USE_WCHAR
```

## package/flann/Config.in
```kconfig
config LINGMO_PACKAGE_FLANN
	bool "flann"
	depends on LINGMO_INSTALL_LIBSTDCPP
	depends on !LINGMO_STATIC_LIBS
	depends on LINGMO_TOOLCHAIN_GCC_AT_LEAST_4_7 # C++11
	select LINGMO_PACKAGE_LZ4
	help
	  FLANN is a library for performing fast approximate nearest
	  neighbor searches in high dimensional spaces. It contains a
	  collection of algorithms we found to work best for nearest
	  neighbor search and a system for automatically choosing the
	  best algorithm and optimum parameters depending on the
	  dataset.

	  http://www.cs.ubc.ca/research/flann/

if LINGMO_PACKAGE_FLANN

config LINGMO_PACKAGE_FLANN_EXAMPLES
	bool "flann examples"
	help
	  Build and install flann example applications.

endif

comment "flann needs a toolchain w/ C++, dynamic library, gcc >= 4.7"
	depends on !LINGMO_INSTALL_LIBSTDCPP || LINGMO_STATIC_LIBS || \
		!LINGMO_TOOLCHAIN_GCC_AT_LEAST_4_7
```

## package/flannel/Config.in
```kconfig
comment "flannel needs a toolchain w/ threads"
	depends on LINGMO_PACKAGE_HOST_GO_TARGET_ARCH_SUPPORTS
	depends on LINGMO_PACKAGE_HOST_GO_TARGET_CGO_LINKING_SUPPORTS
	depends on !LINGMO_TOOLCHAIN_HAS_THREADS

config LINGMO_PACKAGE_FLANNEL
	bool "flannel"
	depends on LINGMO_PACKAGE_HOST_GO_TARGET_ARCH_SUPPORTS
	depends on LINGMO_PACKAGE_HOST_GO_TARGET_CGO_LINKING_SUPPORTS
	depends on LINGMO_TOOLCHAIN_HAS_THREADS
	help
	  Flannel is a virtual network that gives a subnet to each
	  host for use with container runtimes.

	  https://github.com/flannel-io/flannel
```

## package/flare-engine/Config.in
```kconfig
config LINGMO_PACKAGE_FLARE_ENGINE
	bool "flare-engine"
	depends on LINGMO_INSTALL_LIBSTDCPP
	depends on !LINGMO_STATIC_LIBS # SDL2
	select LINGMO_PACKAGE_LIBPNG # SDL2_IMAGE needs libpng support
	select LINGMO_PACKAGE_SDL2
	select LINGMO_PACKAGE_SDL2_IMAGE
	select LINGMO_PACKAGE_SDL2_MIXER
	select LINGMO_PACKAGE_SDL2_TTF
	select LINGMO_PACKAGE_TREMOR # for SDL2_mixer ogg support
	help
	  Flare (Free Libre Action Roleplaying Engine) is a simple game
	  engine built to handle a very specific kind of game:
	  single-player 2D action RPGs.
	  Flare is not a reimplementation of an existing game or engine.
	  It is a tribute to and exploration of the action RPG genre.

	  https://flarerpg.org

comment "flare-engine needs a toolchain w/ C++, dynamic library"
	depends on !LINGMO_INSTALL_LIBSTDCPP || LINGMO_STATIC_LIBS
```

## package/flashrom/Config.in
```kconfig
config LINGMO_PACKAGE_FLASHROM_ARCH_SUPPORTS
	bool
	default y if LINGMO_aarch64 || LINGMO_aarch64_be
	default y if LINGMO_arc
	default y if LINGMO_arm || LINGMO_armeb
	default y if LINGMO_i386 || LINGMO_x86_64
	default y if LINGMO_m68k
	default y if LINGMO_mips || LINGMO_mipsel || LINGMO_mips64 || LINGMO_mips64el
	default y if LINGMO_powerpc || LINGMO_powerpc64 || LINGMO_powerpc64le
	default y if LINGMO_riscv
	default y if LINGMO_sh
	default y if LINGMO_sparc || LINGMO_sparc64

config LINGMO_PACKAGE_FLASHROM
	bool "flashrom"
	depends on LINGMO_PACKAGE_FLASHROM_ARCH_SUPPORTS
	help
	  flashrom is a utility for identifying, reading, writing,
	  verifying and erasing flash chips. It is designed to flash
	  BIOS/EFI/coreboot/firmware/optionROM images on mainboards,
	  network/graphics/storage controller cards, and various other
	  programmer devices.

	  http://flashrom.org/
```

## package/fltk/Config.in
```kconfig
config LINGMO_PACKAGE_FLTK
	bool "fltk"
	depends on LINGMO_INSTALL_LIBSTDCPP
	depends on LINGMO_PACKAGE_XORG7
	depends on LINGMO_USE_MMU # fork()
	select LINGMO_PACKAGE_JPEG
	select LINGMO_PACKAGE_LIBPNG
	select LINGMO_PACKAGE_XLIB_LIBXT
	select LINGMO_PACKAGE_XLIB_LIBX11
	select LINGMO_PACKAGE_XLIB_LIBXEXT
	help
	  A cross-platform C++ GUI toolkit for UNIX/Linux (X11),
	  Microsoft Windows, and MacOS X.

	  http://www.fltk.org/

comment "fltk needs a toolchain w/ C++"
	depends on LINGMO_USE_MMU && LINGMO_PACKAGE_XORG7
	depends on !LINGMO_INSTALL_LIBSTDCPP
```

## package/fluent-bit/Config.in
```kconfig
config LINGMO_PACKAGE_FLUENT_BIT
	bool "fluent-bit"
	depends on LINGMO_TOOLCHAIN_HAS_THREADS
	depends on LINGMO_TOOLCHAIN_HAS_SYNC_4
	depends on !LINGMO_STATIC_LIBS # dlfcn.h
	select LINGMO_PACKAGE_MUSL_FTS if !LINGMO_TOOLCHAIN_USES_GLIBC
	select LINGMO_PACKAGE_OPENSSL
	select LINGMO_PACKAGE_OPENSSL_FORCE_LIBOPENSSL
	select LINGMO_PACKAGE_LIBYAML
	help
	  Fast and Lightweight Logs and Metrics processor.

	  https://github.com/fluent/fluent-bit

if LINGMO_PACKAGE_FLUENT_BIT

config LINGMO_PACKAGE_FLUENT_BIT_WASM_ARCH
	string
	default "AARCH64"    if LINGMO_aarch64 || LINGMO_aarch64_be
	default "ARC"        if LINGMO_arcle || LINGMO_arceb
	default "ARM"        if LINGMO_arm || LINGMO_armeb
	default "MIPS"       if LINGMO_mips || LINGMO_mipsel || LINGMO_mips64 || LINGMO_mips64el
	default "RISCV32"    if LINGMO_riscv && LINGMO_RISCV_32
	default "RISCV64"    if LINGMO_riscv && LINGMO_RISCV_64
	default "X86_32"     if LINGMO_i386
	default "X86_64"     if LINGMO_x86_64
	default "XTENSA"     if LINGMO_xtensa

config LINGMO_PACKAGE_FLUENT_BIT_WASM_ARCH_SUPPORTS
	bool
	default y if LINGMO_PACKAGE_FLUENT_BIT_WASM_ARCH != ""

config LINGMO_PACKAGE_FLUENT_BIT_WASM
	bool "wasm runtime support"
	depends on LINGMO_INSTALL_LIBSTDCPP
	depends on LINGMO_PACKAGE_FLUENT_BIT_WASM_ARCH_SUPPORTS
	help
	  Support for WASM-based plugins.

comment "wasm runtime support needs a toolchain w/ C++"
	depends on LINGMO_PACKAGE_FLUENT_BIT_WASM_ARCH_SUPPORTS
	depends on !LINGMO_INSTALL_LIBSTDCPP

endif

comment "fluent-bit needs a toolchain w/ threads, dynamic library"
	depends on LINGMO_TOOLCHAIN_HAS_SYNC_4
	depends on !LINGMO_TOOLCHAIN_HAS_THREADS || LINGMO_STATIC_LIBS
```

## package/fluidsynth/Config.in
```kconfig
config LINGMO_PACKAGE_FLUIDSYNTH
	bool "fluidsynth"
	depends on LINGMO_USE_WCHAR # libglib2
	depends on LINGMO_TOOLCHAIN_HAS_THREADS # libglib2
	depends on LINGMO_USE_MMU # libglib2
	# the .pc file installed by fluidsynth does not mention its
	# indirect dependencies in Libs.private.
	depends on !LINGMO_STATIC_LIBS
	depends on LINGMO_INSTALL_LIBSTDCPP
	select LINGMO_PACKAGE_LIBGLIB2
	help
	  FluidSynth is a real-time software synthesizer based on the
	  SoundFont 2 specifications and has reached widespread
	  distribution. FluidSynth itself does not have a graphical
	  user interface, but due to its powerful API several
	  applications utilize it and it has even found its way onto
	  embedded systems and is used in some mobile apps.

	  http://www.fluidsynth.org/

if LINGMO_PACKAGE_FLUIDSYNTH

comment "Output support"

config LINGMO_PACKAGE_FLUIDSYNTH_ALSA_LIB
	bool "alsa"
	default y
	depends on LINGMO_TOOLCHAIN_HAS_THREADS
	select LINGMO_PACKAGE_ALSA_LIB
	select LINGMO_PACKAGE_ALSA_LIB_RAWMIDI
	select LINGMO_PACKAGE_ALSA_LIB_SEQ
	help
	  Enable alsa support.

comment "alsa support needs a toolchain w/ threads"
	depends on !LINGMO_TOOLCHAIN_HAS_THREADS

config LINGMO_PACKAGE_FLUIDSYNTH_JACK2
	bool "jack2"
	# See: https://sourceware.org/bugzilla/show_bug.cgi?id=19908
	depends on !LINGMO_TOOLCHAIN_EXTERNAL_CODESOURCERY_MIPS
	depends on LINGMO_TOOLCHAIN_HAS_THREADS # jack2
	depends on LINGMO_USE_MMU # jack2
	depends on LINGMO_INSTALL_LIBSTDCPP # jack2
	depends on !LINGMO_STATIC_LIBS # jack2
	depends on LINGMO_TOOLCHAIN_HAS_SYNC_4 # jack2
	select LINGMO_PACKAGE_JACK2
	help
	  Enable jack support.

comment "jack support needs a toolchain w/ dynamic library, threads, C++"
	depends on LINGMO_TOOLCHAIN_HAS_SYNC_4
	depends on LINGMO_USE_MMU
	depends on !LINGMO_TOOLCHAIN_EXTERNAL_CODESOURCERY_MIPS
	depends on LINGMO_STATIC_LIBS || !LINGMO_INSTALL_LIBSTDCPP || \
		!LINGMO_TOOLCHAIN_HAS_THREADS

config LINGMO_PACKAGE_FLUIDSYNTH_LIBSNDFILE
	bool "libsndfile"
	select LINGMO_PACKAGE_LIBSNDFILE
	help
	  Enable libsndfile support, for writing output to WAV files.

config LINGMO_PACKAGE_FLUIDSYNTH_PORTAUDIO
	bool "portaudio"
	depends on LINGMO_TOOLCHAIN_HAS_THREADS
	select LINGMO_PACKAGE_PORTAUDIO
	help
	  Enable portaudio support.

comment "portaudio support needs a toolchain w/ threads"
	depends on !LINGMO_TOOLCHAIN_HAS_THREADS

config LINGMO_PACKAGE_FLUIDSYNTH_PULSEAUDIO
	bool "pulseaudio"
	# See: https://sourceware.org/bugzilla/show_bug.cgi?id=19908
	depends on !LINGMO_TOOLCHAIN_EXTERNAL_CODESOURCERY_MIPS
	depends on LINGMO_PACKAGE_PULSEAUDIO_HAS_ATOMIC # pulseaudio
	depends on LINGMO_USE_WCHAR # pulseaudio
	depends on LINGMO_TOOLCHAIN_HAS_THREADS # pulseaudio
	depends on !LINGMO_STATIC_LIBS # pulseaudio
	depends on LINGMO_USE_MMU # pulseaudio
	select LINGMO_PACKAGE_PULSEAUDIO
	help
	  Enable PulseAudio support.

comment "pulseaudio support needs a toolchain w/ dynamic library, wchar, threads"
	depends on LINGMO_USE_MMU
	depends on !LINGMO_TOOLCHAIN_EXTERNAL_CODESOURCERY_MIPS
	depends on LINGMO_PACKAGE_PULSEAUDIO_HAS_ATOMIC
	depends on LINGMO_STATIC_LIBS || !LINGMO_USE_MMU || !LINGMO_TOOLCHAIN_HAS_THREADS

config LINGMO_PACKAGE_FLUIDSYNTH_SDL2
	bool "sdl2"
	depends on !LINGMO_STATIC_LIBS
	select LINGMO_PACKAGE_SDL2
	help
	  Enable SDL2 audio support.

comment "SDL2 audio support needs a toolchain w/ dynamic library"
	depends on LINGMO_STATIC_LIBS

comment "Misc options"

config LINGMO_PACKAGE_FLUIDSYNTH_DBUS
	bool "dbus"
	depends on LINGMO_TOOLCHAIN_HAS_THREADS
	depends on LINGMO_USE_MMU
	select LINGMO_PACKAGE_DBUS
	help
	  Enable dbus support.

comment "dbus support needs a toolchain w/ threads"
	depends on LINGMO_USE_MMU
	depends on !LINGMO_TOOLCHAIN_HAS_THREADS

config LINGMO_PACKAGE_FLUIDSYNTH_FLOATS
	bool "32-bit single precision float"
	help
	  Enable 32-bit single precision float support, instead of
	  64-bit double precision floats for DSP samples.

config LINGMO_PACKAGE_FLUIDSYNTH_READLINE
	bool "readline"
	select LINGMO_PACKAGE_READLINE
	help
	  Enable readline support, for better line editing in FluidSynth
	  shell.

endif # LINGMO_PACKAGE_FLUIDSYNTH

comment "fluidsynth needs a toolchain w/ threads, wchar, dynamic library, C++"
	depends on LINGMO_USE_MMU
	depends on !LINGMO_USE_WCHAR || !LINGMO_TOOLCHAIN_HAS_THREADS || \
		LINGMO_STATIC_LIBS || !LINGMO_INSTALL_LIBSTDCPP
```
