## package/flutter-engine/Config.in
```kconfig
# Flutter includes a vender copy of clang which is mandatory to use for
# compiling. These are the supported architectures.
config LINGMO_PACKAGE_FLUTTER_ENGINE_ARCH_SUPPORTS
	bool
	default y if LINGMO_aarch64
	default y if LINGMO_arm && !LINGMO_ARM_CPU_ARMV4 && !LINGMO_ARM_CPU_ARMV5
	default y if LINGMO_x86_64

config LINGMO_PACKAGE_FLUTTER_ENGINE
	bool "flutter-engine"
	depends on LINGMO_PACKAGE_FLUTTER_ENGINE_ARCH_SUPPORTS
	depends on LINGMO_TOOLCHAIN_USES_GLIBC
	depends on LINGMO_TOOLCHAIN_GCC_AT_LEAST_5
	depends on LINGMO_INSTALL_LIBSTDCPP
	depends on !LINGMO_TOOLCHAIN_HAS_GCC_BUG_64735 # std::shared_future
	depends on !LINGMO_STATIC_LIBS
	depends on LINGMO_USE_WCHAR # std::wstring
	depends on LINGMO_HOST_GCC_AT_LEAST_5
	depends on LINGMO_PACKAGE_HAS_LIBGL || LINGMO_PACKAGE_HAS_LIBGLES
	select LINGMO_PACKAGE_FREETYPE
	select LINGMO_PACKAGE_HOST_DEPOT_TOOLS
	select LINGMO_PACKAGE_ZLIB
	help
	  Flutter is Google's SDK for crafting beautiful, fast user
	  experience for mobile, web, and desktop from a single
	  codebase. Flutter works with existing code, is used by
	  developers and organizations around the world, and is
	  free and open source.

	  The Flutter Engine is a portable runtime for hosting
	  Flutter applications. It implements Flutter's core
	  libraries, including animation and graphics, file and
	  network I/O, accessibility support, plugin architecture,
	  and a Dart runtime and compile toolchain. Most developers
	  will interact with Flutter via the Flutter Framework,
	  which provides a modern, reactive framework, and a rich
	  set of platform, layout and foundation widgets.

	  https://github.com/flutter/engine

if LINGMO_PACKAGE_FLUTTER_ENGINE

config FLUTTER_ENGINE_RUNTIME_MODE_PROFILE
	bool "enable profiling"
	help
	  Some debugging ability is maintained—enough to profile your
	  apps performance. Profile mode is disabled on the emulator
	  and simulator, because their behavior is not representative
	  of real performance. Profile mode is similar to release mode,
	  with the following differences:

	  - Some service extensions, such as the one that enables the
	    performance overlay, are enabled.

	  - Tracing is enabled, and tools supporting source-level
	    debugging (such as DevTools) can connect to the process.

	  If this option is left unselected, the global option
	  LINGMO_ENABLE_RUNTIME_DEBUG determines whether to build Flutter
	  in release or debug mode.

	  https://docs.flutter.dev/testing/build-modes#profile

endif

comment "flutter-engine needs an OpenGL or OpenGLES backend"
	depends on LINGMO_PACKAGE_FLUTTER_ENGINE_ARCH_SUPPORTS
	depends on !LINGMO_PACKAGE_HAS_LIBGL && !LINGMO_PACKAGE_HAS_LIBGLES

comment "flutter-engine needs a glibc toolchain w/ wchar, C++, gcc >= 5, dynamic library, host gcc >= 5"
	depends on LINGMO_PACKAGE_FLUTTER_ENGINE_ARCH_SUPPORTS
	depends on !LINGMO_TOOLCHAIN_USES_GLIBC || !LINGMO_INSTALL_LIBSTDCPP \
		|| !LINGMO_TOOLCHAIN_GCC_AT_LEAST_5 || LINGMO_STATIC_LIBS \
		|| !LINGMO_USE_WCHAR || !LINGMO_HOST_GCC_AT_LEAST_5

comment "flutter-engine needs a toolchain not affected by GCC bug 64735"
	depends on LINGMO_PACKAGE_FLUTTER_ENGINE_ARCH_SUPPORTS
	depends on LINGMO_TOOLCHAIN_HAS_GCC_BUG_64735
```

## package/flutter-gallery/Config.in
```kconfig
config LINGMO_PACKAGE_FLUTTER_GALLERY
	bool "flutter-gallery"
	depends on LINGMO_PACKAGE_HOST_FLUTTER_SDK_BIN_ARCH_SUPPORTS
	depends on LINGMO_PACKAGE_FLUTTER_ENGINE
	select LINGMO_PACKAGE_HOST_FLUTTER_SDK_BIN
	help
	  Flutter Gallery is a resource to help developers evaluate
	  and use Flutter. It is a collection of Material Design &
	  Cupertino widgets, behaviors, and vignettes implemented
	  with Flutter.

	  https://github.com/flutter/gallery

comment "flutter-gallery needs flutter-engine"
	depends on LINGMO_PACKAGE_HOST_FLUTTER_SDK_BIN_ARCH_SUPPORTS
	depends on !LINGMO_PACKAGE_FLUTTER_ENGINE
```

## package/flutter-pi/Config.in
```kconfig
menuconfig LINGMO_PACKAGE_FLUTTER_PI
	bool "flutter-pi"
	depends on LINGMO_PACKAGE_HOST_FLUTTER_SDK_BIN_ARCH_SUPPORTS
	depends on LINGMO_PACKAGE_FLUTTER_ENGINE_ARCH_SUPPORTS
	depends on LINGMO_HOST_GCC_AT_LEAST_5 # flutter-engine
	depends on LINGMO_TOOLCHAIN_GCC_AT_LEAST_5 # flutter-engine
	depends on !LINGMO_TOOLCHAIN_HAS_GCC_BUG_64735 # flutter-engine
	depends on LINGMO_TOOLCHAIN_USES_GLIBC # flutter-engine
	depends on LINGMO_INSTALL_LIBSTDCPP # flutter-engine
	depends on !LINGMO_STATIC_LIBS # flutter-engine, wayland
	depends on LINGMO_USE_WCHAR # flutter-engine
	depends on LINGMO_PACKAGE_HAS_LIBGL || LINGMO_PACKAGE_HAS_LIBGLES # flutter-engine
	depends on LINGMO_PACKAGE_HAS_LIBGBM
	depends on LINGMO_PACKAGE_SYSTEMD # Event loop and dbus support
	depends on LINGMO_PACKAGE_HAS_UDEV # libinput
	select LINGMO_PACKAGE_HOST_FLUTTER_SDK_BIN
	select LINGMO_PACKAGE_FLUTTER_ENGINE
	select LINGMO_PACKAGE_LIBDRM
	select LINGMO_PACKAGE_LIBINPUT
	select LINGMO_PACKAGE_LIBXKBCOMMON
	help
	  A light-weight Flutter Engine Embedder. Flutter-pi also
	  runs without X11, so you don't need to boot into a
	  Desktop & have X11 or Wayland load up; just boot into the
	  command-line.

	  Although flutter-pi is only tested on a Rasberry Pi 4
	  2GB, it should work fine on other linux platforms supported
	  by Flutter so long as there is support for KMS and DRI.

	  https://github.com/ardera/flutter-pi

if LINGMO_PACKAGE_FLUTTER_PI

comment "plugins"

config LINGMO_PACKAGE_FLUTTER_PI_CHARSET_CONVERTER_PLUGIN
	bool "charset converter"
	help
	  Adds platform-side implementation of charset_converter plugin.

	  Encode and decode charsets using platform built-in converter.
	  This plugin saves app package size as you don't need external
	  charset maps or whole libraries like iconv.

	  https://pub.dev/packages/charset_converter

config LINGMO_PACKAGE_FLUTTER_PI_GSTREAMER_AUDIO_PLAYER_PLUGIN
	bool "gstreamer audio player"
	select LINGMO_PACKAGE_GSTREAMER1
	select LINGMO_PACKAGE_GST1_PLUGINS_BASE
	select LINGMO_PACKAGE_GST1_PLUGINS_BASE_PLUGIN_ALSA
	select LINGMO_PACKAGE_GST1_PLUGINS_BASE_PLUGIN_AUDIOCONVERT
	select LINGMO_PACKAGE_GST1_PLUGINS_BASE_PLUGIN_AUDIORESAMPLE
	select LINGMO_PACKAGE_GST1_PLUGINS_BASE_PLUGIN_VOLUME
	help
	  Include the gstreamer based audio plugins in the finished
	  binary.

config LINGMO_PACKAGE_FLUTTER_PI_GSTREAMER_VIDEO_PLAYER_PLUGIN
	bool "gstreamer video player"
	depends on LINGMO_PACKAGE_HAS_LIBGLES
	select LINGMO_PACKAGE_GSTREAMER1
	select LINGMO_PACKAGE_GST1_PLUGINS_BASE
	select LINGMO_PACKAGE_GST1_PLUGINS_BASE_LIB_OPENGL
	select LINGMO_PACKAGE_GST1_PLUGINS_BASE_LIB_OPENGL_GLES2
	select LINGMO_PACKAGE_GST1_PLUGINS_BASE_PLUGIN_VIDEOCONVERTSCALE
	help
	  Include the gstreamer based video plugins in the finished
	  binary. Allows for more stable, hardware accelerated
	  video playback in flutter using gstreamer.

comment "gstreamer video player plugin needs an OpenGL ES backend"
	depends on !LINGMO_PACKAGE_HAS_LIBGLES

config LINGMO_PACKAGE_FLUTTER_PI_RAW_KEYBOARD_PLUGIN
	bool "raw keyboard"
	help
	  Include the raw keyboard plugin in the finished binary.
	  Enables raw keycode listening in flutter via the flutter
	  RawKeyboard interface.

config LINGMO_PACKAGE_FLUTTER_PI_TEXT_INPUT_PLUGIN
	bool "text input"
	help
	  Include the text input plugin in the finished binary.
	  Enables text input (to flutter text fields, for example)
	  via attached keyboards.

endif

comment "flutter-pi needs a glibc toolchain w/ wchar, C++, gcc >= 5, dynamic library, host gcc >= 5"
	depends on LINGMO_PACKAGE_HOST_FLUTTER_SDK_BIN_ARCH_SUPPORTS
	depends on LINGMO_PACKAGE_FLUTTER_ENGINE_ARCH_SUPPORTS
	depends on !LINGMO_TOOLCHAIN_USES_GLIBC || !LINGMO_INSTALL_LIBSTDCPP \
		|| !LINGMO_TOOLCHAIN_GCC_AT_LEAST_5 || LINGMO_STATIC_LIBS \
		|| !LINGMO_USE_WCHAR || !LINGMO_HOST_GCC_AT_LEAST_5

comment "flutter-pi needs a toolchain not affected by GCC bug 64735"
	depends on LINGMO_PACKAGE_HOST_FLUTTER_SDK_BIN_ARCH_SUPPORTS
	depends on LINGMO_PACKAGE_FLUTTER_ENGINE_ARCH_SUPPORTS
	depends on LINGMO_TOOLCHAIN_HAS_GCC_BUG_64735

comment "flutter-pi needs an OpenGL or OpenGLES backend"
	depends on LINGMO_PACKAGE_HOST_FLUTTER_SDK_BIN_ARCH_SUPPORTS
	depends on LINGMO_PACKAGE_FLUTTER_ENGINE_ARCH_SUPPORTS
	depends on !LINGMO_PACKAGE_HAS_LIBGL && !LINGMO_PACKAGE_HAS_LIBGLES

comment "flutter-pi needs GBM, systemd, and udev"
	depends on !LINGMO_PACKAGE_HAS_LIBGBM || \
		!LINGMO_PACKAGE_SYSTEMD || \
		!LINGMO_PACKAGE_HAS_UDEV
```

## package/fluxbox/Config.in
```kconfig
config LINGMO_PACKAGE_FLUXBOX
	bool "fluxbox"
	depends on LINGMO_PACKAGE_XORG7
	depends on LINGMO_INSTALL_LIBSTDCPP
	depends on LINGMO_USE_MMU # fork()
	select LINGMO_PACKAGE_XLIB_LIBX11
	# Runtime dependency, needed by startup script
	select LINGMO_PACKAGE_XAPP_XMODMAP
	help
	  The Fluxbox lightweight window manager for X

	  http://fluxbox.org

comment "fluxbox needs a toolchain w/ C++"
	depends on LINGMO_USE_MMU
	depends on LINGMO_PACKAGE_XORG7 && !LINGMO_INSTALL_LIBSTDCPP
```

## package/fmc/Config.in
```kconfig
comment "fmc needs a toolchain w/ C++"
	depends on LINGMO_powerpc_e500mc || LINGMO_powerpc_e6500 || LINGMO_aarch64
	depends on !LINGMO_INSTALL_LIBSTDCPP

comment "fmc needs a Linux kernel to be built"
	depends on LINGMO_powerpc_e500mc || LINGMO_powerpc_e6500 || LINGMO_aarch64
	depends on !LINGMO_LINUX_KERNEL

config LINGMO_PACKAGE_FMC
	bool "fmc"
	depends on LINGMO_powerpc_e500mc || LINGMO_powerpc_e6500 || LINGMO_aarch64
	depends on LINGMO_INSTALL_LIBSTDCPP
	depends on LINGMO_LINUX_KERNEL # fmlib
	select LINGMO_PACKAGE_TCLAP
	select LINGMO_PACKAGE_LIBXML2
	select LINGMO_PACKAGE_FMLIB
	help
	  The Frame Manager Configuration tool is Freescale PowerPC
	  platform software package whose primary purpose is converting
	  Parse-Classify-Police-Distribute (PCD) descriptions of network
	  packets flow into hardware configuration. The tool provides an
	  abstraction layer between the end customer's vision of the PCD
	  task definition and real hardware implementation.
	  See application note:
	  https://www.nxp.com/docs/en/application-note/AN4760.pdf

	  https://github.com/nxp-qoriq/fmc
```

## package/fmlib/Config.in
```kconfig
comment "fmlib needs a Linux kernel to be built"
	depends on LINGMO_powerpc_e500mc || LINGMO_powerpc_e6500 || LINGMO_aarch64
	depends on !LINGMO_LINUX_KERNEL

config LINGMO_PACKAGE_FMLIB
	bool "fmlib"
	depends on LINGMO_powerpc_e500mc || LINGMO_powerpc_e6500 || LINGMO_aarch64
	depends on LINGMO_LINUX_KERNEL
	help
	  The Frame Manager library provides Freescale PowerPC platforms
	  an API on top of the Frame Manager driver ioctl calls, that
	  provides a user space application with a simple way to
	  configure driver parameters and PCD (parse - classify -
	  distribute) rules.

	  https://github.com/nxp-qoriq/fmlib

if LINGMO_PACKAGE_FMLIB
choice
	prompt "QorIQ Target Family"
	help
	  Select the family of QorIQ processor.

config LINGMO_FMLIB_QORIQ_FAMILY_P4080
	bool "p40xx"
	depends on LINGMO_powerpc_e500mc

config LINGMO_FMLIB_QORIQ_FAMILY_T4240
	bool "t42xx"
	depends on LINGMO_powerpc_e500mc

config LINGMO_FMLIB_QORIQ_FAMILY_T2080
	bool "t208x"
	depends on LINGMO_powerpc_e6500

config LINGMO_FMLIB_QORIQ_FAMILY_ARM
	bool "arm"
	depends on LINGMO_aarch64

endchoice

config LINGMO_PACKAGE_FMLIB_ARCHTYPE
	string
	default "ppce500mc" if LINGMO_powerpc_e500mc
	default "ppc64e6500" if LINGMO_powerpc_e6500 && LINGMO_powerpc64
	default "ppc32e6500" if LINGMO_powerpc_e6500 && LINGMO_powerpc
	default "arm" if LINGMO_aarch64

config LINGMO_PACKAGE_FMLIB_PLATFORM
	string
	default "P4080" if LINGMO_FMLIB_QORIQ_FAMILY_P4080
	default "T4240" if LINGMO_FMLIB_QORIQ_FAMILY_T4240
	default "FMAN_V3H" if LINGMO_FMLIB_QORIQ_FAMILY_T2080
	default "arm" if LINGMO_aarch64

endif
```

## package/fmt/Config.in
```kconfig
config LINGMO_PACKAGE_FMT
	bool "fmt"
	depends on LINGMO_INSTALL_LIBSTDCPP
	depends on LINGMO_USE_WCHAR
	help
	  fmt is an open-source formatting library for C++. It can be
	  used as a safe alternative to printf or as a fast alternative
	  to IOStreams.

	  https://fmt.dev

comment "fmt needs a toolchain w/ C++, wchar"
	depends on !LINGMO_INSTALL_LIBSTDCPP || !LINGMO_USE_WCHAR
```

## package/fontconfig/Config.in
```kconfig
config LINGMO_PACKAGE_FONTCONFIG
	bool "fontconfig"
	select LINGMO_PACKAGE_FREETYPE
	select LINGMO_PACKAGE_EXPAT
	select LINGMO_PACKAGE_UTIL_LINUX
	select LINGMO_PACKAGE_UTIL_LINUX_LIBUUID
	help
	  Fontconfig is a library for configuring and customizing font
	  access.

	  http://www.fontconfig.org/
```

## package/foot/Config.in
```kconfig
config LINGMO_PACKAGE_FOOT
	bool "foot"
	depends on LINGMO_TOOLCHAIN_USES_GLIBC || LINGMO_TOOLCHAIN_USES_MUSL # fcft
	depends on !LINGMO_STATIC_LIBS # wayland
	select LINGMO_PACKAGE_FCFT
	select LINGMO_PACKAGE_FONTCONFIG
	select LINGMO_PACKAGE_FREETYPE
	select LINGMO_PACKAGE_LIBXKBCOMMON
	select LINGMO_PACKAGE_PIXMAN
	select LINGMO_PACKAGE_TLLIST
	select LINGMO_PACKAGE_WAYLAND
	select LINGMO_PACKAGE_WAYLAND_PROTOCOLS
	help
	  A fast, lightweight and minimalistic Wayland terminal
	  emulator.
	  NOTE: foot needs a working UTF-8 locale (LINGMO_GENERATE_LOCALE)

	  https://codeberg.org/dnkl/foot

if LINGMO_PACKAGE_FOOT

config LINGMO_PACKAGE_FOOT_GRAPHEME_CLUSTERING
	bool "grapheme-clustering"
	select LINGMO_PACKAGE_UTF8PROC
	help
	  Enables grapheme clustering.

config LINGMO_PACKAGE_FOOT_THEMES
	bool "themes"
	help
	  Install themes (predefined color schemes)

endif # LINGMO_PACKAGE_FOOT

comment "foot needs a glibc or musl toolchain w/ dynamic library"
	depends on !(LINGMO_TOOLCHAIN_USES_GLIBC || LINGMO_TOOLCHAIN_USES_MUSL) || \
		LINGMO_STATIC_LIBS
```

## package/freeipmi/Config.in
```kconfig
config LINGMO_PACKAGE_FREEIPMI
	bool "freeipmi"
	depends on LINGMO_USE_MMU # fork()
	depends on LINGMO_TOOLCHAIN_HAS_THREADS
	select LINGMO_PACKAGE_ARGP_STANDALONE if LINGMO_TOOLCHAIN_USES_UCLIBC || LINGMO_TOOLCHAIN_USES_MUSL
	help
	  FreeIPMI provides in-band and out-of-band IPMI software based
	  on the IPMI v1.5/2.0 specification.

	  The IPMI specification defines a set of interfaces for
	  platform management and is implemented by a number vendors
	  for system management. The features of IPMI that most users
	  will be interested in are sensor monitoring, system event
	  monitoring, power control, and serial-over-LAN (SOL).

	  https://www.gnu.org/software/freeipmi/

comment "freeipmi needs a toolchain w/ threads"
	depends on LINGMO_USE_MMU
	depends on !LINGMO_TOOLCHAIN_HAS_THREADS
```

## package/freeradius-server/Config.in
```kconfig
config LINGMO_PACKAGE_FREERADIUS_SERVER
	bool "freeradius-server"
	depends on LINGMO_USE_MMU # fork()
	depends on !LINGMO_STATIC_LIBS # libtalloc
	depends on LINGMO_TOOLCHAIN_HAS_THREADS
	depends on LINGMO_TOOLCHAIN_USES_GLIBC
	select LINGMO_PACKAGE_LIBOPENSSL_ENABLE_MD4 if LINGMO_PACKAGE_LIBOPENSSL
	select LINGMO_PACKAGE_LIBTALLOC
	help
	  FreeRADIUS is an open source server which implements
	  a protocol for remote user Authorization, Authentication
	  and Accounting.

	  http://wiki.freeradius.org/

comment "freeradius-server needs a glibc toolchain w/ threads"
	depends on LINGMO_USE_MMU
	depends on !LINGMO_TOOLCHAIN_HAS_THREADS || \
		!LINGMO_TOOLCHAIN_USES_GLIBC
```
