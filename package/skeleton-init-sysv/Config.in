## package/skeleton-init-sysv/Config.in
```kconfig
config LINGMO_PACKAGE_SKELETON_INIT_SYSV
	bool
	select LINGMO_PACKAGE_HAS_SKELETON
	select LINGMO_PACKAGE_SKELETON_INIT_COMMON

config LINGMO_PACKAGE_PROVIDES_SKELETON
	default "skeleton-init-sysv" if LINGMO_PACKAGE_SKELETON_INIT_SYSV
```

## package/skeleton/Config.in
```kconfig
config LINGMO_PACKAGE_SKELETON
	bool
	default y

config LINGMO_PACKAGE_HAS_SKELETON
	bool

config LINGMO_PACKAGE_PROVIDES_SKELETON
	string
```

## package/sl/Config.in
```kconfig
config LINGMO_PACKAGE_SL
	bool "sl"
	select LINGMO_PACKAGE_NCURSES
	help
	  SL (Steam Locomotive) runs across your terminal when you
	  type "sl" as you meant to type "ls". It's just a joke
	  command, and not useful at all.

	  https://github.com/mtoyoda/sl
```

## package/slang/Config.in
```kconfig
config LINGMO_PACKAGE_SLANG
	bool "slang"
	depends on LINGMO_USE_MMU # fork()
	help
	  Multi-platform console display library.

	  http://www.jedsoft.org/slang/index.html

if LINGMO_PACKAGE_SLANG

config LINGMO_PACKAGE_SLANG_SLSH
	bool "enable slsh"
	help
	  Enable the S-lang interpreter

endif
```

## package/slirp4netns/Config.in
```kconfig
config LINGMO_PACKAGE_SLIRP4NETNS
	bool "slirp4netns"
	depends on LINGMO_USE_MMU # libcap, libglib2, slirp
	depends on LINGMO_USE_WCHAR # libglib2, slirp
	depends on LINGMO_TOOLCHAIN_HAS_THREADS # libglib2, slirp
	depends on LINGMO_PACKAGE_LIBSECCOMP_ARCH_SUPPORTS # libseccomp
	depends on LINGMO_TOOLCHAIN_HEADERS_AT_LEAST_3_17 # libseccomp
	select LINGMO_PACKAGE_LIBCAP
	select LINGMO_PACKAGE_LIBGLIB2
	select LINGMO_PACKAGE_LIBSECCOMP
	select LINGMO_PACKAGE_SLIRP
	help
	  User-mode networking for unprivileged network namespaces.

	  https://github.com/rootless-containers/slirp4netns

comment "slirp4netns needs a toolchain w/ wchar, threads, headers >= 3.17"
	depends on LINGMO_USE_MMU
	depends on LINGMO_PACKAGE_LIBSECCOMP_ARCH_SUPPORTS
	depends on !LINGMO_USE_WCHAR || !LINGMO_TOOLCHAIN_HAS_THREADS || !LINGMO_TOOLCHAIN_HEADERS_AT_LEAST_3_17
```

## package/smartmontools/Config.in
```kconfig
config LINGMO_PACKAGE_SMARTMONTOOLS
	bool "smartmontools"
	depends on LINGMO_INSTALL_LIBSTDCPP
	depends on LINGMO_USE_MMU # fork()
	help
	  Control and monitor storage systems using S.M.A.R.T.

	  http://smartmontools.sourceforge.net/

comment "smartmontools needs a toolchain w/ C++"
	depends on LINGMO_USE_MMU
	depends on !LINGMO_INSTALL_LIBSTDCPP
```

## package/smstools3/Config.in
```kconfig
config LINGMO_PACKAGE_SMSTOOLS3
	bool "smstools3"
	depends on LINGMO_USE_MMU # fork()
	depends on LINGMO_USE_WCHAR
	depends on LINGMO_TOOLCHAIN_HAS_THREADS
	help
	  The SMS Server Tools 3 is a SMS Gateway software which can
	  send and receive short messages through GSM modems and
	  mobile phones.

	  http://smstools3.kekekasvi.com/

if LINGMO_PACKAGE_SMSTOOLS3

config LINGMO_PACKAGE_SMSTOOLS3_NB_MODEMS
	int "Number of modems to support"
	default 1
	help
	  To reduce memory footprint of SMS Server Tools, you can
	  specify the exact number of modems connected to your
	  board. By default only 1 modem is used.

endif

comment "smstools3 needs a toolchain w/ wchar, threads"
	depends on !LINGMO_USE_WCHAR || !LINGMO_TOOLCHAIN_HAS_THREADS
	depends on LINGMO_USE_MMU
```

## package/snappy/Config.in
```kconfig
config LINGMO_PACKAGE_SNAPPY
	bool "snappy"
	depends on LINGMO_INSTALL_LIBSTDCPP
	help
	  Snappy is a compression/decompression library. It does not
	  aim for maximum compression, or compatibility with any other
	  compression library; instead, it aims for very high speeds
	  and reasonable compression.

	  http://google.github.io/snappy/

comment "snappy needs a toolchain w/ C++"
	depends on !LINGMO_INSTALL_LIBSTDCPP
```

## package/sngrep/Config.in
```kconfig
comment "sngrep needs a toolchain w/ threads"
	depends on !LINGMO_TOOLCHAIN_HAS_THREADS

config LINGMO_PACKAGE_SNGREP
	bool "sngrep"
	depends on LINGMO_TOOLCHAIN_HAS_THREADS
	select LINGMO_PACKAGE_NCURSES
	select LINGMO_PACKAGE_LIBPCAP
	help
	  sngrep is a tool for displaying SIP calls message flows from
	  terminal.  It supports live capture to display realtime SIP
	  packets and can also be used as PCAP viewer.

	  https://github.com/irontec/sngrep
```

## package/snmpclitools/Config.in
```kconfig
config LINGMO_PACKAGE_SNMPCLITOOLS
	bool "snmpclitools"
	depends on LINGMO_PACKAGE_PYTHON3
	select LINGMO_PACKAGE_PYTHON_PYSMI # runtime
	select LINGMO_PACKAGE_PYTHON_PYSNMP # runtime
	help
	  SNMP command-line tools.

	  https://github.com/etingof/snmpclitools
```

## package/snmppp/Config.in
```kconfig
config LINGMO_PACKAGE_SNMPPP
	bool "snmp++"
	depends on LINGMO_INSTALL_LIBSTDCPP
	depends on LINGMO_TOOLCHAIN_HAS_THREADS
	depends on !LINGMO_STATIC_LIBS
	help
	  SNMP++v3.x is a C++ API which supports SNMP v1, v2c, and v3.

	  https://www.agentpp.com/api/cpp/snmp_pp.html

if LINGMO_PACKAGE_SNMPPP

config LINGMO_PACKAGE_SNMPPP_LOGGING
	bool "enable logging"
	help
	  Enable logging output for SNMP++.
	  According to the SNMP++ documentation, disabling logging
	  "increases performance drastically and minimizes memory
	  consumption".

config LINGMO_PACKAGE_SNMPPP_SNMPV3
	bool "enable SNMPv3"
	default y
	depends on LINGMO_TOOLCHAIN_GCC_AT_LEAST_4_8 # C++11
	select LINGMO_PACKAGE_OPENSSL
	select LINGMO_PACKAGE_LIBOPENSSL_ENABLE_DES if LINGMO_PACKAGE_LIBOPENSSL
	help
	  Enable optional support for SNMP++. This selects OpenSSL.

comment "SNMPv3 needs a toolchain w/ gcc >= 4.8"
	depends on !LINGMO_TOOLCHAIN_GCC_AT_LEAST_4_8

endif

comment "snmp++ needs a toolchain w/ threads, C++, dynamic library"
	depends on !LINGMO_INSTALL_LIBSTDCPP || !LINGMO_TOOLCHAIN_HAS_THREADS || \
		LINGMO_STATIC_LIBS
```

## package/snort/Config.in
```kconfig
config LINGMO_PACKAGE_SNORT
	bool "snort"
	depends on LINGMO_USE_WCHAR
	depends on LINGMO_USE_MMU # fork()
	depends on !LINGMO_STATIC_LIBS # daq
	depends on LINGMO_TOOLCHAIN_HAS_NATIVE_RPC || LINGMO_TOOLCHAIN_HAS_THREADS # libtirpc
	select LINGMO_PACKAGE_LIBDNET
	select LINGMO_PACKAGE_LIBPCAP
	select LINGMO_PACKAGE_DAQ
	select LINGMO_PACKAGE_PCRE
	select LINGMO_PACKAGE_LIBTIRPC if !LINGMO_TOOLCHAIN_HAS_NATIVE_RPC
	select LINGMO_PACKAGE_ZLIB
	help
	  Snort is a free and open source network intrusion
	  prevention system (IPS) and network intrusion detection
	  system (IDS). It can perform protocol analysis, content
	  searching/matching, and can be used to detect a variety
	  of attacks and probes, such as buffer overflows, stealth
	  port scans, CGI attacks, SMB probes, OS fingerprinting
	  attempts, and much more.

	  https://www.snort.org

comment "snort needs a toolchain w/ wchar, threads, dynamic library"
	depends on LINGMO_USE_MMU
	depends on !LINGMO_USE_WCHAR || LINGMO_STATIC_LIBS || \
		!(LINGMO_TOOLCHAIN_HAS_THREADS || LINGMO_TOOLCHAIN_HAS_NATIVE_RPC)
```

## package/snort3/Config.in
```kconfig
config LINGMO_PACKAGE_SNORT3
	bool "snort3"
	depends on !LINGMO_PACKAGE_LUA # luajit
	depends on LINGMO_PACKAGE_LUAJIT_ARCH_SUPPORTS # luajit
	depends on !(LINGMO_PACKAGE_DAQ || LINGMO_PACKAGE_SNORT)
	depends on LINGMO_USE_MMU # fork()
	depends on LINGMO_INSTALL_LIBSTDCPP
	depends on !LINGMO_STATIC_LIBS # daq3
	depends on LINGMO_TOOLCHAIN_GCC_AT_LEAST_4_9 # C++11
	depends on LINGMO_TOOLCHAIN_HAS_THREADS # daq3, hwloc
	depends on LINGMO_USE_WCHAR
	select LINGMO_PACKAGE_DAQ3
	select LINGMO_PACKAGE_FLEX
	select LINGMO_PACKAGE_HWLOC
	select LINGMO_PACKAGE_LIBDNET
	select LINGMO_PACKAGE_LIBPCAP
	select LINGMO_PACKAGE_LUAJIT
	select LINGMO_PACKAGE_PCRE
	select LINGMO_PACKAGE_LIBTIRPC if !LINGMO_TOOLCHAIN_HAS_NATIVE_RPC
	select LINGMO_PACKAGE_OPENSSL
	select LINGMO_PACKAGE_ZLIB
	help
	  Snort 3 is the next generation Snort IPS (Intrusion
	  Prevention System).

	  - Support multiple packet processing threads
	  - Shared configuration and attribute table
	  - Use a simple, scriptable configuration
	  - Make key components pluggable
	  - Autodetect services for portless configuration
	  - Support sticky buffers in rules
	  - Autogenerate reference documentation
	  - Provide better cross platform support

	  https://www.snort.org/snort3

comment "snort3 needs a toolchain w/ C++, wchar, threads, dynamic library, gcc >= 4.9"
	depends on !LINGMO_PACKAGE_LUA
	depends on LINGMO_PACKAGE_LUAJIT_ARCH_SUPPORTS
	depends on !(LINGMO_PACKAGE_DAQ || LINGMO_PACKAGE_SNORT)
	depends on LINGMO_USE_MMU
	depends on !LINGMO_INSTALL_LIBSTDCPP || !LINGMO_USE_WCHAR || \
		LINGMO_STATIC_LIBS || !LINGMO_TOOLCHAIN_HAS_THREADS || \
		!LINGMO_TOOLCHAIN_GCC_AT_LEAST_4_9
```

## package/socat/Config.in
```kconfig
config LINGMO_PACKAGE_SOCAT
	bool "socat"
	depends on LINGMO_USE_MMU # fork()
	help
	  Multipurpose socket relay program.

	  http://www.dest-unreach.org/socat/
```

## package/socketcand/Config.in
```kconfig
config LINGMO_PACKAGE_SOCKETCAND
	bool "socketcand"
	depends on LINGMO_TOOLCHAIN_HAS_THREADS
	depends on LINGMO_USE_MMU # fork()
	help
	  Socketcand is a daemon that provides access to CAN interfaces
	  on a machine via a network interface.

	  https://github.com/dschanoeh/socketcand

comment "socketcand needs a toolchain w/ threads"
	depends on LINGMO_USE_MMU
	depends on !LINGMO_TOOLCHAIN_HAS_THREADS
```

## package/softether/Config.in
```kconfig
config LINGMO_PACKAGE_SOFTETHER
	bool "softether"
	depends on LINGMO_TOOLCHAIN_HAS_THREADS
	depends on LINGMO_USE_MMU # fork()
	depends on LINGMO_USE_WCHAR
	select LINGMO_PACKAGE_LIBICONV if !LINGMO_ENABLE_LOCALE
	select LINGMO_PACKAGE_OPENSSL
	select LINGMO_PACKAGE_OPENSSL_FORCE_LIBOPENSSL
	select LINGMO_PACKAGE_LIBOPENSSL_ENABLE_DES
	select LINGMO_PACKAGE_LIBOPENSSL_ENABLE_MD4
	select LINGMO_PACKAGE_LIBOPENSSL_ENABLE_RC4
	select LINGMO_PACKAGE_READLINE
	help
	  The SoftEther Server is a fully integrated implementation of
	  the SSTP, L2TP, L2TPv3, OpenVPN, and IPSec virtual private
	  networking protocols on Linux and several other
	  platforms. It is generally compatible with other
	  implementations by Apple, Cisco, Juniper, Microsoft, et al.

	  Convenient Layer-2 and Layer-3 bridging capabilities can
	  connect several branch offices into a single broadcast or
	  routing domain, even behind a NAT or without a static IPv4
	  address.

	  In addition to supporting most VPN protocols, the SoftEther
	  Client can penetrate hardened firewalls and captured
	  gateways through HTTPS, DNS, and ICMP exfiltration.

	  http://www.softether.org

comment "softether needs a toolchain w/ wchar, threads"
	depends on LINGMO_USE_MMU
	depends on !(LINGMO_USE_WCHAR && LINGMO_TOOLCHAIN_HAS_THREADS)
```

## package/softhsm2/Config.in
```kconfig
config LINGMO_PACKAGE_SOFTHSM2
	bool "softhsm2"
	depends on LINGMO_INSTALL_LIBSTDCPP
	depends on LINGMO_TOOLCHAIN_GCC_AT_LEAST_4_8 # C++11
	depends on LINGMO_TOOLCHAIN_HAS_THREADS
	depends on !LINGMO_STATIC_LIBS # dlopen()
	select LINGMO_PACKAGE_OPENSSL
	select LINGMO_PACKAGE_OPENSSL_FORCE_LIBOPENSSL
	select LINGMO_PACKAGE_LIBOPENSSL_ENABLE_DES
	help
	  SoftHSM is an implementation of a cryptographic store
	  accessible through a PKCS#11 interface. You can use it
	  to explore PKCS#11 without having a Hardware Security
	  Module.

	  https://www.opendnssec.org/softhsm

comment "softhsm2 needs a toolchain w/ C++, threads, gcc >= 4.8 and dynamic library support"
	depends on !LINGMO_INSTALL_LIBSTDCPP || LINGMO_STATIC_LIBS || \
		!LINGMO_TOOLCHAIN_HAS_THREADS || \
		!LINGMO_TOOLCHAIN_GCC_AT_LEAST_4_8
```

## package/solarus/Config.in
```kconfig
config LINGMO_PACKAGE_SOLARUS
	bool "solarus"
	depends on LINGMO_INSTALL_LIBSTDCPP
	depends on LINGMO_PACKAGE_LUAINTERPRETER_ABI_VERSION_5_1
	depends on LINGMO_PACKAGE_OPENAL_ARCH_SUPPORTS
	depends on LINGMO_TOOLCHAIN_GCC_AT_LEAST_4_9 # openal
	depends on LINGMO_TOOLCHAIN_HAS_THREADS_NPTL # openal
	depends on !LINGMO_STATIC_LIBS # SDL2
	depends on LINGMO_PACKAGE_HAS_LIBGL || LINGMO_PACKAGE_HAS_LIBGLES
	select LINGMO_PACKAGE_GLM
	select LINGMO_PACKAGE_LIBMODPLUG
	select LINGMO_PACKAGE_LIBOGG
	select LINGMO_PACKAGE_LIBPNG # runtime
	select LINGMO_PACKAGE_LIBVORBIS
	select LINGMO_PACKAGE_OPENAL
	select LINGMO_PACKAGE_PHYSFS
	select LINGMO_PACKAGE_SDL2
	select LINGMO_PACKAGE_SDL2_IMAGE
	select LINGMO_PACKAGE_SDL2_TTF
	help
	  Solarus is an open-source Zelda-like 2D game engine written
	  in C++. It can run games scripted in Lua. This engine is used
	  by our Zelda fangames. Solarus is licensed under GPL v3.

	  http://www.solarus-games.org
	  https://github.com/solarus-games/solarus

comment "solarus needs OpenGL and a toolchain w/ C++, gcc >= 4.9, NPTL, dynamic library, and luajit or lua 5.1"
	depends on !LINGMO_PACKAGE_LUAINTERPRETER_ABI_VERSION_5_1
	depends on LINGMO_PACKAGE_OPENAL_ARCH_SUPPORTS
	depends on !LINGMO_INSTALL_LIBSTDCPP || !LINGMO_TOOLCHAIN_GCC_AT_LEAST_4_9 \
		|| !LINGMO_TOOLCHAIN_HAS_THREADS_NPTL || LINGMO_STATIC_LIBS \
		|| !LINGMO_PACKAGE_HAS_LIBGL
```

## package/sord/Config.in
```kconfig
config LINGMO_PACKAGE_SORD
	bool "sord"
	select LINGMO_PACKAGE_SERD
	help
	  Sord is a lightweight C library for storing RDF data in
	  memory.

	  https://drobilla.net/software/sord.html
```

## package/spandsp/Config.in
```kconfig
config LINGMO_PACKAGE_SPANDSP
	bool "spandsp"
	select LINGMO_PACKAGE_TIFF
	select LINGMO_PACKAGE_TIFF_JPEG
	help
	  Spandsp is a library of many DSP functions for telephony.
	  These range from simple modules, such as DTMF detection, to
	  a complete software FAX machine.

	  https://github.com/freeswitch/spandsp
```

## package/spdlog/Config.in
```kconfig
config LINGMO_PACKAGE_SPDLOG
	bool "spdlog"
	depends on LINGMO_INSTALL_LIBSTDCPP
	depends on LINGMO_TOOLCHAIN_HAS_THREADS
	depends on LINGMO_USE_WCHAR # fmt
	select LINGMO_PACKAGE_FMT
	help
	  Very fast, header-only/compiled, C++ logging library.

	  https://github.com/gabime/spdlog

comment "spdlog needs a toolchain w/ C++, threads, wchar"
	depends on !LINGMO_INSTALL_LIBSTDCPP || !LINGMO_TOOLCHAIN_HAS_THREADS \
		|| !LINGMO_USE_WCHAR
```

## package/speechd/Config.in
```kconfig
config LINGMO_PACKAGE_SPEECHD
	bool "speechd"
	depends on LINGMO_USE_WCHAR # libglib2
	depends on LINGMO_TOOLCHAIN_HAS_THREADS # libglib2
	depends on LINGMO_USE_MMU # libglib2
	depends on !LINGMO_STATIC_LIBS
	select LINGMO_PACKAGE_DOTCONF
	select LINGMO_PACKAGE_LIBGLIB2
	select LINGMO_PACKAGE_LIBSNDFILE
	help
	  Speech Dispatcher project provides a high-level device
	  independent layer for access to speech synthesis through
	  a simple, stable and well documented interface.

	  https://freebsoft.org/speechd

comment "speechd needs a toolchain w/ wchar, threads, dynamic library"
	depends on LINGMO_USE_MMU
	depends on !LINGMO_USE_WCHAR || !LINGMO_TOOLCHAIN_HAS_THREADS || \
		LINGMO_STATIC_LIBS
```

## package/speex/Config.in
```kconfig
config LINGMO_PACKAGE_SPEEX
	bool "speex"
	select LINGMO_PACKAGE_LIBOGG
	help
	  Speex is an Open Source/Free Software patent-free
	  audio compression format designed for speech.
	  It can be used for Voice over IP

	  http://www.speex.org/

if LINGMO_PACKAGE_SPEEX

config LINGMO_PACKAGE_SPEEX_ARM4
	bool
	default y
	depends on LINGMO_ARM_CPU_ARMV4

config LINGMO_PACKAGE_SPEEX_ARM5E
	bool
	default y
	depends on LINGMO_arm && !LINGMO_PACKAGE_SPEEX_ARM4

endif
```

## package/speexdsp/Config.in
```kconfig
config LINGMO_PACKAGE_SPEEXDSP
	bool "speexdsp"
	help
	  DSP library derived from speex.

	  https://www.speex.org
```
