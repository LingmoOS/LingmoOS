## package/botan/Config.in
```kconfig
config LINGMO_PACKAGE_BOTAN_ARCH_SUPPORTS
	bool
	default y if LINGMO_aarch64 || LINGMO_aarch64_be
	default y if LINGMO_arm || LINGMO_armeb
	default y if LINGMO_i386 || LINGMO_x86_64
	default y if LINGMO_m68k
	default y if LINGMO_mips || LINGMO_mipsel || LINGMO_mips64 || LINGMO_mips64el
	default y if LINGMO_powerpc || LINGMO_powerpc64 || LINGMO_powerpc64le
	default y if LINGMO_riscv
	default y if LINGMO_sparc || LINGMO_sparc64
	default y if LINGMO_s390x
	default y if LINGMO_sh

config LINGMO_PACKAGE_BOTAN
	bool "botan"
	depends on LINGMO_INSTALL_LIBSTDCPP
	depends on LINGMO_TOOLCHAIN_GCC_AT_LEAST_10 # C++20
	depends on LINGMO_PACKAGE_BOTAN_ARCH_SUPPORTS
	select LINGMO_PACKAGE_BOOST_FILESYSTEM if LINGMO_PACKAGE_BOOST && LINGMO_TOOLCHAIN_SUPPORTS_ALWAYS_LOCKFREE_ATOMIC_INTS
	select LINGMO_PACKAGE_BOOST_SYSTEM if LINGMO_PACKAGE_BOOST && LINGMO_TOOLCHAIN_SUPPORTS_ALWAYS_LOCKFREE_ATOMIC_INTS
	help
	  Botan is a crypto library for C++

	  http://botan.randombit.net

comment "botan needs a toolchain w/ C++, gcc >= 10"
	depends on !LINGMO_INSTALL_LIBSTDCPP \
		|| !LINGMO_TOOLCHAIN_GCC_AT_LEAST_10
	depends on LINGMO_PACKAGE_BOTAN_ARCH_SUPPORTS
```

## package/bpftool/Config.in
```kconfig
config LINGMO_PACKAGE_BPFTOOL_ARCH_SUPPORTS
	bool
	# see libbpf/src/bpf.c
	default y if LINGMO_arc
	default y if LINGMO_arm || LINGMO_armeb
	default y if LINGMO_aarch64 || LINGMO_aarch64_be
	default y if LINGMO_i386 || LINGMO_x86_64
	default y if LINGMO_riscv
	default y if LINGMO_sparc || LINGMO_sparc64
	default y if LINGMO_s390x

config LINGMO_PACKAGE_BPFTOOL
	bool "bpftool"
	depends on LINGMO_PACKAGE_BPFTOOL_ARCH_SUPPORTS
	depends on LINGMO_TOOLCHAIN_HAS_SYNC_4
	depends on !LINGMO_nios2 # binutils
	depends on LINGMO_USE_WCHAR # binutils, elfutils
	depends on !LINGMO_STATIC_LIBS # elfutils
	depends on LINGMO_TOOLCHAIN_HAS_THREADS # elfutils
	depends on LINGMO_TOOLCHAIN_HEADERS_AT_LEAST_4_12
	select LINGMO_PACKAGE_BINUTILS
	select LINGMO_PACKAGE_ELFUTILS
	help
	  bpftool is a tool for for inspection and simple manipulation
	  of eBPF programs and maps.

comment "bpftool needs a toolchain w/ wchar, dynamic library, threads, headers >= 4.12"
	depends on LINGMO_PACKAGE_BPFTOOL_ARCH_SUPPORTS
	depends on LINGMO_TOOLCHAIN_HAS_SYNC_4
	depends on !LINGMO_nios2
	depends on !LINGMO_USE_WCHAR || LINGMO_STATIC_LIBS \
		|| !LINGMO_TOOLCHAIN_HAS_THREADS \
		|| !LINGMO_TOOLCHAIN_HEADERS_AT_LEAST_4_12
```

## package/brickd/Config.in
```kconfig
config LINGMO_PACKAGE_BRICKD
	bool "brickd"
	depends on LINGMO_PACKAGE_HAS_UDEV # gudev
	depends on LINGMO_TOOLCHAIN_HAS_THREADS # glib2
	depends on LINGMO_USE_WCHAR # glib2
	depends on LINGMO_USE_MMU # glib2, gudev
	select LINGMO_PACKAGE_LIBGLIB2
	select LINGMO_PACKAGE_LIBGUDEV
	help
	  Brick daemon for LEGO MINDSTORMS EV3 (and other LEGO-
	  compatible devices). This performs tasks like battery
	  management and controls device-specific hardware.

	  https://github.com/ev3dev/brickd

comment "brickd needs udev /dev management, a toolchain w/ threads, wchar"
	depends on LINGMO_USE_MMU
	depends on !LINGMO_PACKAGE_HAS_UDEV || !LINGMO_TOOLCHAIN_HAS_THREADS || \
		!LINGMO_USE_WCHAR
```

## package/brltty/Config.in
```kconfig
config LINGMO_PACKAGE_BRLTTY
	bool "brltty"
	depends on LINGMO_USE_WCHAR
	depends on LINGMO_TOOLCHAIN_HAS_THREADS
	depends on !LINGMO_STATIC_LIBS
	depends on LINGMO_USE_MMU # fork()
	select LINGMO_PACKAGE_BLUEZ5_UTILS_PLUGINS_HID if LINGMO_PACKAGE_BLUEZ5_UTILS && LINGMO_TOOLCHAIN_HEADERS_AT_LEAST_3_18 # runtime
	help
	  A daemon providing access to the Linux console for a blind
	  person using a refreshable braille display.

	  http://brltty.app/

if LINGMO_PACKAGE_BRLTTY

config LINGMO_PACKAGE_BRLTTY_TEXT_TABLE
	string "text-table"

endif

comment "brltty needs a toolchain w/ dynamic lib, threads, wchar"
	depends on LINGMO_USE_MMU
	depends on LINGMO_STATIC_LIBS || !LINGMO_TOOLCHAIN_HAS_THREADS || !LINGMO_USE_WCHAR
```

## package/btrfs-progs/Config.in
```kconfig
config LINGMO_PACKAGE_BTRFS_PROGS
	bool "btrfs-progs"
	depends on LINGMO_USE_MMU # util-linux
	depends on LINGMO_TOOLCHAIN_HAS_THREADS
	select LINGMO_PACKAGE_LZO
	select LINGMO_PACKAGE_UTIL_LINUX
	select LINGMO_PACKAGE_UTIL_LINUX_LIBBLKID
	select LINGMO_PACKAGE_UTIL_LINUX_LIBUUID
	select LINGMO_PACKAGE_ZLIB
	help
	  Btrfs filesystem utilities

	  https://btrfs.wiki.kernel.org/index.php/Main_Page

comment "btrfs-progs needs a toolchain w/ threads"
	depends on LINGMO_USE_MMU
	depends on !LINGMO_TOOLCHAIN_HAS_THREADS
```

## package/bubblewrap/Config.in
```kconfig
config LINGMO_PACKAGE_BUBBLEWRAP
	bool "bubblewrap"
	depends on LINGMO_USE_MMU # fork()
	select LINGMO_PACKAGE_LIBCAP
	help
	  Unprivileged sandbox tool based on Linux namespaces.

	  https://github.com/projectatomic/bubblewrap
```

## package/bullet/Config.in
```kconfig
config LINGMO_PACKAGE_BULLET
	bool "bullet"
	depends on LINGMO_INSTALL_LIBSTDCPP
	depends on !LINGMO_STATIC_LIBS # dlfcn.h
	depends on LINGMO_TOOLCHAIN_HAS_THREADS
	depends on LINGMO_USE_WCHAR
	help
	  Bullet is a Collision Detection and Rigid Body Dynamics
	  Library.

	  http://bulletphysics.org

comment "bullet needs a toolchain w/ C++, dynamic library, threads, wchar"
	depends on !LINGMO_INSTALL_LIBSTDCPP || LINGMO_STATIC_LIBS || \
		!LINGMO_TOOLCHAIN_HAS_THREADS || !LINGMO_USE_WCHAR
```

## package/bustle/Config.in
```kconfig
config LINGMO_PACKAGE_BUSTLE
	bool "bustle"
	depends on LINGMO_USE_WCHAR # libglib2
	depends on LINGMO_TOOLCHAIN_HAS_THREADS # libglib2
	depends on LINGMO_USE_MMU # libglib2
	depends on LINGMO_PACKAGE_DBUS # runtime
	select LINGMO_PACKAGE_LIBPCAP
	select LINGMO_PACKAGE_LIBGLIB2
	help
	  Bustle is a better dbus-monitor! It records and draws
	  sequence diagrams of D-Bus activity, showing signal
	  emissions, method calls and their corresponding returns,
	  with timestamps for each individual event and the duration
	  of each method call. This can help you check for unwanted
	  D-Bus traffic, and pinpoint why your D-Bus-based application
	  isn't performing as well as you like.

	  This only installs the command line bustle-pcap tool, not
	  the graphical viewer.

	  https://gitlab.freedesktop.org/bustle/bustle/

comment "bustle needs a toolchain w/ wchar, threads"
	depends on LINGMO_USE_MMU
	depends on LINGMO_PACKAGE_DBUS
	depends on !LINGMO_USE_WCHAR || !LINGMO_TOOLCHAIN_HAS_THREADS
```

## package/c-capnproto/Config.in
```kconfig
config LINGMO_PACKAGE_C_CAPNPROTO
	bool "c-capnproto"
	depends on LINGMO_USE_MMU # capnproto
	depends on LINGMO_HOST_GCC_AT_LEAST_5 # capnproto
	depends on LINGMO_TOOLCHAIN_GCC_AT_LEAST_5 # capnproto
	depends on LINGMO_INSTALL_LIBSTDCPP # capnproto
	depends on LINGMO_TOOLCHAIN_HAS_THREADS # capnproto
	depends on LINGMO_TOOLCHAIN_HAS_ATOMIC # capnproto
	depends on !LINGMO_TOOLCHAIN_HAS_GCC_BUG_64735 # capnproto
	depends on LINGMO_TOOLCHAIN_HAS_UCONTEXT # capnproto
	select LINGMO_PACKAGE_CAPNPROTO
	help
	  A C plugin for Cap'n Proto. Generates the code generator
	  plugin for C. Requires regular Cap'n Proto and only
	  provides serialization (no RPC).

	  https://github.com/opensourcerouting/c-capnproto

comment "c-capnproto needs host and target gcc >= 5 w/ C++14, threads, atomic, ucontext and not gcc bug 64735"
	depends on LINGMO_USE_MMU
	depends on !LINGMO_HOST_GCC_AT_LEAST_5 || \
		!LINGMO_TOOLCHAIN_GCC_AT_LEAST_5 || \
		!LINGMO_INSTALL_LIBSTDCPP || \
		!LINGMO_TOOLCHAIN_HAS_THREADS || \
		!LINGMO_TOOLCHAIN_HAS_ATOMIC || \
		LINGMO_TOOLCHAIN_HAS_GCC_BUG_64735 || \
		!LINGMO_TOOLCHAIN_HAS_UCONTEXT
```

## package/cage/Config.in
```kconfig
comment "cage needs udev, EGL w/ Wayland backend and OpenGL ES support"
	depends on !LINGMO_PACKAGE_HAS_LIBEGL || \
		!LINGMO_PACKAGE_HAS_LIBEGL_WAYLAND || \
		!LINGMO_PACKAGE_HAS_LIBGLES || \
		!LINGMO_PACKAGE_HAS_UDEV

comment "cage needs a toolchain w/ threads, dynamic library"
	depends on !LINGMO_TOOLCHAIN_HAS_THREADS || \
		LINGMO_STATIC_LIBS

config LINGMO_PACKAGE_CAGE
	bool "cage"
	depends on !LINGMO_STATIC_LIBS # wlroots
	depends on LINGMO_TOOLCHAIN_HAS_THREADS # wlroots
	depends on LINGMO_PACKAGE_HAS_LIBEGL # wlroots
	depends on LINGMO_PACKAGE_HAS_LIBEGL_WAYLAND # wlroots
	depends on LINGMO_PACKAGE_HAS_LIBGLES # wlroots
	depends on LINGMO_PACKAGE_HAS_UDEV # wlroots
	select LINGMO_PACKAGE_WLROOTS
	help
	  Kiosk compositor for Wayland, which displays a single
	  maximized application at a time.

	  https://www.hjdskes.nl/projects/cage/
```

## package/cairo/Config.in
```kconfig
config LINGMO_PACKAGE_CAIRO
	bool "cairo"
	select LINGMO_PACKAGE_PIXMAN
	select LINGMO_PACKAGE_FONTCONFIG
	select LINGMO_PACKAGE_XLIB_LIBX11 if LINGMO_PACKAGE_XORG7
	select LINGMO_PACKAGE_XLIB_LIBXEXT if LINGMO_PACKAGE_XORG7
	help
	  Cairo is a 2D graphics library with support for multiple
	  output devices. Currently supported output targets include
	  the X Window System, Win32, image buffers, and PostScript,
	  PDF, and SVG file output. Experimental backends include
	  OpenGL (through glitz), Quartz, and XCB.

	  http://cairographics.org/

if LINGMO_PACKAGE_CAIRO

config LINGMO_PACKAGE_CAIRO_PS
	bool "postscript support"
	select LINGMO_PACKAGE_ZLIB
	select LINGMO_PACKAGE_CAIRO_PDF

config LINGMO_PACKAGE_CAIRO_PDF
	bool "pdf support"
	select LINGMO_PACKAGE_ZLIB

config LINGMO_PACKAGE_CAIRO_PNG
	bool "png support"
	select LINGMO_PACKAGE_LIBPNG
	select LINGMO_PACKAGE_ZLIB

config LINGMO_PACKAGE_CAIRO_SCRIPT
	bool "script support"
	select LINGMO_PACKAGE_CAIRO_PNG

config LINGMO_PACKAGE_CAIRO_SVG
	bool "svg support"
	select LINGMO_PACKAGE_CAIRO_PNG
	select LINGMO_PACKAGE_CAIRO_PDF

config LINGMO_PACKAGE_CAIRO_TEE
	bool "tee support"

config LINGMO_PACKAGE_CAIRO_XML
	bool "xml support"
	select LINGMO_PACKAGE_CAIRO_PNG

endif
```

## package/cairomm/Config.in
```kconfig
config LINGMO_PACKAGE_CAIROMM
	bool "cairomm (latest)"
	depends on LINGMO_TOOLCHAIN_GCC_AT_LEAST_7 # libsigc
	depends on LINGMO_TOOLCHAIN_HAS_THREADS # libglib2
	depends on LINGMO_USE_WCHAR # libglib2
	depends on LINGMO_USE_MMU # libglib2
	depends on LINGMO_INSTALL_LIBSTDCPP
	select LINGMO_PACKAGE_CAIRO
	select LINGMO_PACKAGE_LIBGLIB2
	select LINGMO_PACKAGE_LIBSIGC
	help
	  The cairomm package is a set of C++ bindings for Cairo.

	  https://www.cairographics.org/cairomm/

comment "cairomm needs a toolchain w/ C++, wchar, threads, gcc >= 7"
	depends on LINGMO_USE_MMU
	depends on !LINGMO_TOOLCHAIN_GCC_AT_LEAST_7 || !LINGMO_USE_WCHAR \
		|| !LINGMO_TOOLCHAIN_HAS_THREADS || !LINGMO_INSTALL_LIBSTDCPP
```

## package/cairomm1_14/Config.in
```kconfig
config LINGMO_PACKAGE_CAIROMM1_14
	bool "cairomm (1.14.x)"
	depends on LINGMO_TOOLCHAIN_GCC_AT_LEAST_4_9 # C++11
	depends on LINGMO_TOOLCHAIN_HAS_THREADS # libglib2
	depends on LINGMO_USE_WCHAR # libglib2
	depends on LINGMO_USE_MMU # libglib2
	depends on LINGMO_INSTALL_LIBSTDCPP
	select LINGMO_PACKAGE_CAIRO
	select LINGMO_PACKAGE_LIBGLIB2
	select LINGMO_PACKAGE_LIBSIGC2
	help
	  The cairomm package is a set of C++ bindings for Cairo.

	  This is the last version before the API and ABI change
	  introduced in 1.16.0 which requires C++17.

	  https://www.cairographics.org/cairomm/

comment "cairomm (1.14.x) needs a toolchain w/ C++, wchar, threads, gcc >= 4.9"
	depends on LINGMO_USE_MMU
	depends on !LINGMO_TOOLCHAIN_GCC_AT_LEAST_4_9 || !LINGMO_USE_WCHAR \
		|| !LINGMO_TOOLCHAIN_HAS_THREADS || !LINGMO_INSTALL_LIBSTDCPP
```

## package/cannelloni/Config.in
```kconfig
config LINGMO_PACKAGE_CANNELLONI
	bool "cannelloni"
	depends on LINGMO_TOOLCHAIN_GCC_AT_LEAST_4_8 # C++11
	depends on LINGMO_INSTALL_LIBSTDCPP
	depends on LINGMO_USE_MMU # lksctp-tools
	depends on LINGMO_TOOLCHAIN_HAS_THREADS # lksctp-tools
	depends on !LINGMO_STATIC_LIBS # lksctp-tools
	help
	  A SocketCAN over Ethernet tunnel. The tunnel supports both
	  UDP and SCTP protocols.

	  https://github.com/mguentner/cannelloni

comment "cannelloni needs a toolchain w/ C++, threads, dynamic library, gcc >= 4.8"
	depends on !LINGMO_INSTALL_LIBSTDCPP || LINGMO_STATIC_LIBS || \
		!LINGMO_TOOLCHAIN_GCC_AT_LEAST_4_8 || !LINGMO_TOOLCHAIN_HAS_THREADS
	depends on LINGMO_USE_MMU
```
