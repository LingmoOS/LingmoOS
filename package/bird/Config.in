## package/bird/Config.in
```kconfig
config LINGMO_PACKAGE_BIRD
	bool "bird"
	depends on !LINGMO_nios2 # relocations don't fit
	depends on LINGMO_USE_MMU # fork()
	help
	  BIRD Internet Routing Daemon

	  The BIRD project aims to develop a dynamic IP routing daemon
	  with full support of all modern routing protocols, easy to
	  use configuration interface and powerful route filtering
	  language

	  http://bird.network.cz/

if LINGMO_PACKAGE_BIRD

config LINGMO_PACKAGE_BIRD_CLIENT
	bool "birdc"
	select LINGMO_PACKAGE_NCURSES
	select LINGMO_PACKAGE_READLINE
	help
	  Enable the BIRD client

comment "protocol support"

config LINGMO_PACKAGE_BIRD_BABEL
	bool "babel"
	help
	  Enable Babel protocol.

config LINGMO_PACKAGE_BIRD_BFD
	bool "bfd"
	depends on LINGMO_TOOLCHAIN_HAS_THREADS_NPTL
	help
	  Enable BFD protocol.

comment "BFD protocol needs a toolchain w/ NPTL"
	depends on !LINGMO_TOOLCHAIN_HAS_THREADS_NPTL

config LINGMO_PACKAGE_BIRD_BGP
	bool "bgp"
	default y
	help
	  Enable BGP protocol.

config LINGMO_PACKAGE_BIRD_MRT
	bool "mrt"
	help
	  Enable MRT protocol.

config LINGMO_PACKAGE_BIRD_OSPF
	bool "ospf"
	help
	  Enable OSPFv2 and OSPFv3 protocol.

config LINGMO_PACKAGE_BIRD_PERF
	bool "perf"
	help
	  Enable Perf protocol.

config LINGMO_PACKAGE_BIRD_PIPE
	bool "pipe"
	help
	  Enable Pipe protocol.

config LINGMO_PACKAGE_BIRD_RADV
	bool "radv"
	help
	  Enable RAdv protocol.

config LINGMO_PACKAGE_BIRD_RIP
	bool "rip"
	help
	  Enable RIP protocol.

config LINGMO_PACKAGE_BIRD_RPKI
	bool "rpki"
	help
	  Enable RPKI protocol.

config LINGMO_PACKAGE_BIRD_STATIC
	bool "static"
	help
	  Enable Static protocol.

endif
```

## package/bitcoin/Config.in
```kconfig
config LINGMO_PACKAGE_BITCOIN_ARCH_SUPPORTS
	bool
	default y if LINGMO_TOOLCHAIN_HAS_ATOMIC
	# bitcoin uses 8-byte __atomic intrinsics, which are not
	# available on ARM noMMU platforms that we
	# support. LINGMO_TOOLCHAIN_HAS_ATOMIC does not provide a
	# size-level granularity to express this dependency.
	depends on !(LINGMO_arm || LINGMO_armeb) || LINGMO_USE_MMU

config LINGMO_PACKAGE_BITCOIN
	bool "bitcoin"
	depends on LINGMO_INSTALL_LIBSTDCPP
	depends on LINGMO_TOOLCHAIN_SUPPORTS_ALWAYS_LOCKFREE_ATOMIC_INTS # boost-thread, boost-filesystem
	depends on LINGMO_PACKAGE_BITCOIN_ARCH_SUPPORTS
	depends on LINGMO_TOOLCHAIN_GCC_AT_LEAST_9
	depends on LINGMO_TOOLCHAIN_HAS_THREADS # boost
	depends on LINGMO_USE_WCHAR
	select LINGMO_PACKAGE_BOOST
	select LINGMO_PACKAGE_BOOST_SYSTEM
	select LINGMO_PACKAGE_BOOST_FILESYSTEM
	select LINGMO_PACKAGE_BOOST_THREAD
	select LINGMO_PACKAGE_LIBEVENT
	help
	  Bitcoin Core is an open source project which maintains and
	  releases Bitcoin client software called “Bitcoin Core”.

	  It is a direct descendant of the original Bitcoin software
	  client released by Satoshi Nakamoto after he published the
	  famous Bitcoin whitepaper.

	  Bitcoin Core consists of both "full-node" software for fully
	  validating the blockchain as well as a bitcoin wallet. The
	  project also currently maintains related software such as
	  the cryptography library libsecp256k1 and others located at
	  GitHub.

	  https://bitcoincore.org

if LINGMO_PACKAGE_BITCOIN

config LINGMO_PACKAGE_BITCOIN_WALLET
	bool "wallet support"
	select LINGMO_PACKAGE_SQLITE
	help
	  Enable bitcoin wallet support.

endif

comment "bitcoin needs a toolchain w/ C++, threads, wchar, gcc >= 9"
	depends on LINGMO_PACKAGE_BITCOIN_ARCH_SUPPORTS
	depends on LINGMO_TOOLCHAIN_SUPPORTS_ALWAYS_LOCKFREE_ATOMIC_INTS
	depends on !LINGMO_INSTALL_LIBSTDCPP || \
		!LINGMO_TOOLCHAIN_HAS_THREADS || !LINGMO_USE_WCHAR || \
		!LINGMO_TOOLCHAIN_GCC_AT_LEAST_9
```

## package/blktrace/Config.in
```kconfig
config LINGMO_PACKAGE_BLKTRACE
	bool "blktrace"
	depends on LINGMO_TOOLCHAIN_HAS_THREADS
	depends on LINGMO_USE_MMU # system()
	select LINGMO_PACKAGE_LIBAIO
	help
	  blktrace is a block layer IO tracing mechanism which provides
	  detailed information about request queue operations
	  up to user space.

	  http://git.kernel.dk/?p=blktrace.git;a=summary

comment "blktrace needs a toolchain w/ threads"
	depends on LINGMO_USE_MMU
	depends on !LINGMO_TOOLCHAIN_HAS_THREADS
```

## package/bluez-alsa/Config.in
```kconfig
config LINGMO_PACKAGE_BLUEZ_ALSA
	bool "bluez-alsa"
	depends on !LINGMO_STATIC_LIBS # bluez5
	depends on LINGMO_TOOLCHAIN_GCC_AT_LEAST_4_9 # C11/stdatomic.h
	depends on LINGMO_TOOLCHAIN_HAS_THREADS_NPTL
	depends on LINGMO_TOOLCHAIN_HEADERS_AT_LEAST_3_4 # bluez5
	depends on LINGMO_TOOLCHAIN_HAS_SYNC_4 # bluez5
	depends on LINGMO_USE_MMU # bluez5 -> dbus
	depends on LINGMO_USE_WCHAR # libglib2
	select LINGMO_PACKAGE_ALSA_LIB
	select LINGMO_PACKAGE_ALSA_LIB_MIXER
	select LINGMO_PACKAGE_BLUEZ5_UTILS
	select LINGMO_PACKAGE_BLUEZ5_UTILS_PLUGINS_AUDIO
	select LINGMO_PACKAGE_LIBGLIB2
	select LINGMO_PACKAGE_SBC
	# samplerate ALSA plugin is needed for proper sample rate
	# conversion with Bluetooth devices
	select LINGMO_PACKAGE_LIBSAMPLERATE if LINGMO_PACKAGE_ALSA_PLUGINS
	help
	  Bluetooth Audio ALSA Backend.

	  https://github.com/Arkq/bluez-alsa

if LINGMO_PACKAGE_BLUEZ_ALSA

config LINGMO_PACKAGE_BLUEZ_ALSA_HCITOP
	bool "hcitop"
	depends on LINGMO_PACKAGE_LIBBSD_ARCH_SUPPORTS
	select LINGMO_PACKAGE_LIBBSD
	select LINGMO_PACKAGE_NCURSES
	help
	  Enable top-like monitoring tool for HCI.

config LINGMO_PACKAGE_BLUEZ_ALSA_RFCOMM
	bool "rfcomm"
	select LINGMO_PACKAGE_READLINE
	help
	  Simple tool for sending RFCOMM commands.

endif

comment "bluez-alsa needs a toolchain w/ wchar, NPTL, headers >= 3.4, dynamic library, gcc >= 4.9"
	depends on !LINGMO_USE_WCHAR || !LINGMO_TOOLCHAIN_HAS_THREADS_NPTL || \
		!LINGMO_TOOLCHAIN_HEADERS_AT_LEAST_3_4 || LINGMO_STATIC_LIBS || \
		!LINGMO_TOOLCHAIN_GCC_AT_LEAST_4_9
	depends on LINGMO_TOOLCHAIN_HAS_SYNC_4
	depends on LINGMO_USE_MMU
```

## package/bluez-tools/Config.in
```kconfig
config LINGMO_PACKAGE_BLUEZ_TOOLS
	bool "bluez-tools"
	depends on LINGMO_PACKAGE_BLUEZ5_UTILS
	depends on LINGMO_USE_MMU # dbus, libglib2
	depends on LINGMO_USE_WCHAR # libglib2
	depends on LINGMO_TOOLCHAIN_HAS_THREADS # dbus, libglib2
	select LINGMO_PACKAGE_DBUS
	select LINGMO_PACKAGE_DBUS_GLIB
	select LINGMO_PACKAGE_LIBGLIB2
	select LINGMO_PACKAGE_READLINE if LINGMO_PACKAGE_BLUEZ5_UTILS
	help
	  A set of tools to manage bluetooth devices for linux

	  https://github.com/khvzak/bluez-tools

comment "bluez-tools needs a toolchain w/ wchar, threads"
	depends on LINGMO_PACKAGE_BLUEZ5_UTILS
	depends on LINGMO_USE_MMU
	depends on !LINGMO_USE_WCHAR || !LINGMO_TOOLCHAIN_HAS_THREADS
```

## package/bluez5_utils/Config.in
```kconfig
config LINGMO_PACKAGE_BLUEZ5_UTILS
	bool "bluez-utils"
	depends on LINGMO_USE_WCHAR # libglib2
	depends on LINGMO_TOOLCHAIN_HAS_THREADS # dbus, libglib2
	depends on LINGMO_USE_MMU # dbus
	depends on !LINGMO_STATIC_LIBS # uses dlfcn
	depends on LINGMO_TOOLCHAIN_HEADERS_AT_LEAST_3_4
	depends on LINGMO_TOOLCHAIN_HAS_SYNC_4
	select LINGMO_PACKAGE_DBUS
	select LINGMO_PACKAGE_LIBGLIB2
	help
	  BlueZ utils

	  Provides Stack, Library and Tooling for Bluetooth Classic
	  and Bluetooth LE.

	  BlueZ utils will use systemd and/or udev if enabled.

	  http://www.bluez.org
	  http://www.kernel.org/pub/linux/bluetooth

if LINGMO_PACKAGE_BLUEZ5_UTILS

config LINGMO_PACKAGE_BLUEZ5_UTILS_OBEX
	bool "build OBEX support"
	depends on LINGMO_INSTALL_LIBSTDCPP
	select LINGMO_PACKAGE_LIBICAL
	help
	  Enable OBEX support.

comment "OBEX support needs a toolchain w/ C++"
	depends on !LINGMO_INSTALL_LIBSTDCPP

config LINGMO_PACKAGE_BLUEZ5_UTILS_CLIENT
	bool "build CLI client"
	select LINGMO_PACKAGE_READLINE
	help
	  Build the command line client "bluetoothctl".

config LINGMO_PACKAGE_BLUEZ5_UTILS_MONITOR
	bool "build monitor utility"
	help
	  Build monitor utility btmon.

config LINGMO_PACKAGE_BLUEZ5_UTILS_TOOLS
	bool "build tools"
	help
	  Build tools like bluemoon, btattach, hex2hcd, l2test,
	  l2ping, mpris-proxy, rctest.

config LINGMO_PACKAGE_BLUEZ5_UTILS_DEPRECATED
	bool "install deprecated tools"
	depends on LINGMO_PACKAGE_BLUEZ5_UTILS_CLIENT || LINGMO_PACKAGE_BLUEZ5_UTILS_TOOLS
	help
	  Build deprecated tools.

	  When "build tools" is selected these tools are installed:
	  hciattach, hciconfig, hcitool, hcidump, rfcomm, sdptool,
	  ciptool.

	  When CLI client is enabled "gatttool" is installed.

config LINGMO_PACKAGE_BLUEZ5_UTILS_EXPERIMENTAL
	bool "build experimental tools"
	help
	  Build experimental tools. This is currently only the
	  "Nokia OBEX PC Suite tool". So, only if OBEX support is
	  enabled this option has an effect.

config LINGMO_PACKAGE_BLUEZ5_UTILS_PLUGINS_AUDIO
	bool "build audio plugins (a2dp and avrcp)"
	help
	  Build plugins for audio profiles (for A2DP and AVRCP).

config LINGMO_PACKAGE_BLUEZ5_UTILS_PLUGINS_HEALTH
	bool "build health plugin"
	help
	  Build plugin for health profiles.

config LINGMO_PACKAGE_BLUEZ5_UTILS_PLUGINS_HID
	bool "build hid plugin"
	depends on LINGMO_TOOLCHAIN_HEADERS_AT_LEAST_3_18
	select LINGMO_PACKAGE_BLUEZ5_UTILS_PLUGINS_HOG
	help
	  Build plugin for HID (input) profiles.

comment "hid plugin needs a toolchain w/ headers >= 3.18"
	depends on !LINGMO_TOOLCHAIN_HEADERS_AT_LEAST_3_18

config LINGMO_PACKAGE_BLUEZ5_UTILS_PLUGINS_HOG
	bool "build hog plugin"
	depends on LINGMO_TOOLCHAIN_HEADERS_AT_LEAST_3_18
	help
	  Build plugin for HoG (input) profiles.

comment "hog plugin needs a toolchain w/ headers >= 3.18"
	depends on !LINGMO_TOOLCHAIN_HEADERS_AT_LEAST_3_18

config LINGMO_PACKAGE_BLUEZ5_UTILS_PLUGINS_MESH
	bool "build mesh plugin"
	depends on LINGMO_TOOLCHAIN_HEADERS_AT_LEAST_4_12 # ell
	select LINGMO_PACKAGE_ELL
	select LINGMO_PACKAGE_JSON_C
	select LINGMO_PACKAGE_READLINE
	help
	  Build plugin for Mesh support.

comment "mesh profile needs a toolchain w/ headers >= 4.12"
	depends on !LINGMO_TOOLCHAIN_HEADERS_AT_LEAST_4_12

config LINGMO_PACKAGE_BLUEZ5_UTILS_PLUGINS_MIDI
	bool "build midi plugin"
	select LINGMO_PACKAGE_ALSA_LIB
	select LINGMO_PACKAGE_ALSA_LIB_SEQ
	help
	  Build MIDI support via ALSA sequencer.

config LINGMO_PACKAGE_BLUEZ5_UTILS_PLUGINS_NETWORK
	bool "build network plugin"
	default y
	help
	  Build plugin for PANU, NAP, GN profiles.

config LINGMO_PACKAGE_BLUEZ5_UTILS_PLUGINS_NFC
	bool "build nfc plugin"
	help
	  Build plugin for NFC pairing.

config LINGMO_PACKAGE_BLUEZ5_UTILS_PLUGINS_SAP
	bool "build sap plugin"
	help
	  Build plugin for SAP profile.

config LINGMO_PACKAGE_BLUEZ5_UTILS_PLUGINS_SIXAXIS
	bool "build sixaxis plugin"
	depends on LINGMO_PACKAGE_HAS_UDEV
	depends on LINGMO_TOOLCHAIN_HEADERS_AT_LEAST_3_18 # hid plugin
	select LINGMO_PACKAGE_BLUEZ5_UTILS_PLUGINS_HID # runtime
	help
	  Build sixaxis plugin (support Sony Dualshock
	  controller)

comment "sixaxis plugin needs a toolchain w/ headers >= 3.18"
	depends on !LINGMO_TOOLCHAIN_HEADERS_AT_LEAST_3_18

comment "sixaxis plugin needs udev /dev management"
	depends on !LINGMO_PACKAGE_HAS_UDEV

config LINGMO_PACKAGE_BLUEZ5_UTILS_TEST
	bool "install test scripts"
	help
	  Install the python test scripts from the "test" directory.

config LINGMO_PACKAGE_BLUEZ5_UTILS_TOOLS_HID2HCI
	bool "build hid2hci tool"
	depends on LINGMO_PACKAGE_HAS_UDEV
	depends on LINGMO_TOOLCHAIN_HEADERS_AT_LEAST_3_18 # hid plugin
	select LINGMO_PACKAGE_BLUEZ5_UTILS_PLUGINS_HID # runtime
	select LINGMO_PACKAGE_BLUEZ5_UTILS_TOOLS
	help
	  Build hid2hci tool

comment "hid2hci tool needs a toolchain w/ headers >= 3.18"
	depends on !LINGMO_TOOLCHAIN_HEADERS_AT_LEAST_3_18

comment "hid2hci tool needs udev /dev management"
	depends on !LINGMO_PACKAGE_HAS_UDEV

endif

comment "bluez5-utils needs a toolchain w/ wchar, threads, headers >= 3.4, dynamic library"
	depends on !LINGMO_USE_WCHAR || !LINGMO_TOOLCHAIN_HAS_THREADS || \
		!LINGMO_TOOLCHAIN_HEADERS_AT_LEAST_3_4 || LINGMO_STATIC_LIBS
	depends on LINGMO_TOOLCHAIN_HAS_SYNC_4
	depends on LINGMO_USE_MMU
```

## package/bmap-tools/Config.in
```kconfig
config LINGMO_PACKAGE_BMAP_TOOLS
	bool "bmap-tools"
	depends on LINGMO_PACKAGE_PYTHON3
	select LINGMO_PACKAGE_PYTHON3_PYEXPAT # runtime
	select LINGMO_PACKAGE_PYTHON_SETUPTOOLS # runtime, pkg_resources
	select LINGMO_PACKAGE_PYTHON_SIX # runtime
	help
	  Tool to flash image files to block devices using the block map
	  bmaptool is a generic tool for creating the block map (bmap)
	  for a file, and copying files using the block map. The idea is
	  that large file containing unused blocks, like raw system
	  image files, can be copied or flashed a lot faster with
	  bmaptool than with traditional tools like "dd" or "cp".

	  Relevant optional dependencies:

	  - Busybox compiled with CONFIG_BZIP2, or LINGMO_PACKAGE_BZIP2,
	    to support bz2 compressed images

	  - LINGMO_PACKAGE_PIGZ for optimized gzip decompression

	  - Busybox compiled with CONFIG_LZOP, or LINGMO_PACKAGE_LZOP, to
	    support lzo compressed images.

	  - LINGMO_PACKAGE_ZIP to support zip compressed images

	  - LINGMO_PACKAGE_LZ4 to support lz4 compressed images

	  - LINGMO_PACKAGE_ZSTD to support zstd compressed images

	  - Busybox compiled CONFIG_FEATURE_SEAMLESS_* or
	    LINGMO_PACKAGE_TAR to support tar compressed images

	  - LINGMO_PACKAGE_OPENSSH to retrieve images over SSH.

	  - LINGMO_PACKAGE_SSHPASS to retrieve images over SSH if
	    password authentication is used.

	  Image signature verification is not supported as
	  python-gpgme is not available. Optimized bzip2 decompression
	  is not supported as pbzip2 is not available.

	  https://github.com/intel/bmap-tools
```

## package/bmon/Config.in
```kconfig
config LINGMO_PACKAGE_BMON
	bool "bmon"
	depends on LINGMO_TOOLCHAIN_HAS_THREADS # libnl
	select LINGMO_PACKAGE_LIBCONFUSE
	select LINGMO_PACKAGE_LIBNL
	select LINGMO_PACKAGE_NCURSES
	help
	  bmon is a bandwidth monitor capable of retrieving statistics
	  from various input modules. It provides various output methods
	  including a curses based interface.

	  https://github.com/tgraf/bmon/

comment "bmon needs a toolchain w/ threads"
	depends on !LINGMO_TOOLCHAIN_HAS_THREADS
```

## package/bmx7/Config.in
```kconfig
config LINGMO_PACKAGE_BMX7
	bool "bmx7"
	depends on !LINGMO_STATIC_LIBS # dlopen()
	select LINGMO_PACKAGE_ZLIB
	select LINGMO_PACKAGE_MBEDTLS
	select LINGMO_PACKAGE_WIRELESS_TOOLS
	select LINGMO_PACKAGE_WIRELESS_TOOLS_LIB
	help
	  BMX7 is a mesh routing protocol for Linux based
	  operating systems.

	  https://github.com/bmx-routing/bmx7

comment "bmx7 needs a toolchain with dynamic library support"
	depends on LINGMO_STATIC_LIBS
```

## package/boinc/Config.in
```kconfig
config LINGMO_PACKAGE_BOINC
	bool "boinc"
	depends on LINGMO_USE_MMU # fork()
	depends on !LINGMO_STATIC_LIBS # dlfcn.h
	depends on LINGMO_TOOLCHAIN_GCC_AT_LEAST_4_8 # C++11
	depends on LINGMO_TOOLCHAIN_HAS_THREADS
	depends on LINGMO_INSTALL_LIBSTDCPP
	select LINGMO_PACKAGE_LIBCURL
	select LINGMO_PACKAGE_OPENSSL
	help
	  Open-source software for volunteer computing and grid
	  computing.

	  Use the idle time on your computer to cure diseases, study
	  global warming, discover pulsars, and do many other types of
	  scientific research.

	  https://boinc.berkeley.edu

comment "boinc needs a toolchain w/ dynamic library, C++, threads, gcc >= 4.8"
	depends on LINGMO_USE_MMU
	depends on LINGMO_STATIC_LIBS || !LINGMO_INSTALL_LIBSTDCPP \
		|| !LINGMO_TOOLCHAIN_GCC_AT_LEAST_4_8 \
		|| !LINGMO_TOOLCHAIN_HAS_THREADS
```

## package/bonnie/Config.in
```kconfig
config LINGMO_PACKAGE_BONNIE
	bool "bonnie++"
	depends on LINGMO_INSTALL_LIBSTDCPP
	depends on LINGMO_USE_MMU # fork()
	help
	  A benchmark suite that is aimed at performing a number of
	  simple tests of hard drive and file system performance.

	  http://www.coker.com.au/bonnie++/

comment "bonnie++ needs a toolchain w/ C++"
	depends on LINGMO_USE_MMU
	depends on !LINGMO_INSTALL_LIBSTDCPP
```
