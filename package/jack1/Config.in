## package/keepalived/Config.in
```kconfig
config LINGMO_PACKAGE_KEEPALIVED
	bool "keepalived"
	depends on LINGMO_USE_MMU
	depends on !LINGMO_STATIC_LIBS # uses libdl
	select LINGMO_PACKAGE_OPENSSL
	help
	  The main goal of the keepalived project is to add a strong &
	  robust keepalive facility to the Linux Virtual Server
	  project. It implements a multilayer TCP/IP stack
	  checks. Keepalived implements a framework based on three
	  family checks: Layer3, Layer4 & Layer5. This framework gives
	  the daemon the ability of checking a LVS server pool
	  states. Keepalived can be sumarize as a LVS driving daemon.

	  http://www.keepalived.org/

comment "keepalived needs a toolchain w/ dynamic library"
	depends on LINGMO_USE_MMU
	depends on LINGMO_STATIC_LIBS
```

## package/kexec-lite/Config.in
```kconfig
config LINGMO_PACKAGE_KEXEC_LITE_ARCH_SUPPORTS
	bool
	default y
	depends on LINGMO_powerpc || LINGMO_powerpc64 || LINGMO_powerpc64le

config LINGMO_PACKAGE_KEXEC_LITE
	bool "kexec-lite"
	depends on LINGMO_PACKAGE_KEXEC_LITE_ARCH_SUPPORTS
	depends on !LINGMO_STATIC_LIBS # dtc, elfutils
	depends on LINGMO_USE_WCHAR # elfutils
	depends on LINGMO_TOOLCHAIN_HAS_THREADS # elfutils
	select LINGMO_PACKAGE_ELFUTILS
	select LINGMO_PACKAGE_DTC
	select LINGMO_PACKAGE_DTC_PROGRAMS
	help
	  Kexec is a user space utiltity for loading another kernel
	  and asking the currently running kernel to do something with
	  it.

	  This package is a tiny implementation of the kexec userspace
	  components, for devicetree-based platforms.

	  https://github.com/antonblanchard/kexec-lite

comment "kexec-lite needs a toolchain w/ wchar, dynamic library, threads"
	depends on LINGMO_PACKAGE_KEXEC_LITE_ARCH_SUPPORTS
	depends on LINGMO_STATIC_LIBS || !LINGMO_USE_WCHAR \
		|| !LINGMO_TOOLCHAIN_HAS_THREADS
```

## package/kexec/Config.in
```kconfig
config LINGMO_PACKAGE_KEXEC_ARCH_SUPPORTS
	bool
	default y
	depends on LINGMO_i386 || LINGMO_x86_64 || LINGMO_arm || LINGMO_armeb || \
		LINGMO_mips || LINGMO_mips64 || LINGMO_mipsel || LINGMO_mips64el || \
		LINGMO_powerpc || LINGMO_powerpc64 || LINGMO_powerpc64le || \
		LINGMO_sh4 || LINGMO_sh4a || LINGMO_aarch64 || LINGMO_s390x || LINGMO_m68k

config LINGMO_PACKAGE_KEXEC
	bool "kexec"
	depends on LINGMO_PACKAGE_KEXEC_ARCH_SUPPORTS
	depends on LINGMO_TOOLCHAIN_HEADERS_AT_LEAST_3_17 # memfd_create()
	help
	  Kexec is a user space utility for loading another kernel
	  and asking the currently running kernel to do something with
	  it.

	  https://www.kernel.org/pub/linux/utils/kernel/kexec/

if LINGMO_PACKAGE_KEXEC

config LINGMO_PACKAGE_KEXEC_ZLIB
	bool "zlib support"
	select LINGMO_PACKAGE_ZLIB
	help
	  Support for compressed kernel images

endif

comment "kexec needs a toolchain w/ headers >= 3.17"
	depends on LINGMO_PACKAGE_KEXEC_ARCH_SUPPORTS
	depends on !LINGMO_TOOLCHAIN_HEADERS_AT_LEAST_3_17
```

## package/keyutils/Config.in
```kconfig
config LINGMO_PACKAGE_KEYUTILS
	bool "keyutils"
	depends on LINGMO_USE_MMU # fork()
	depends on !LINGMO_STATIC_LIBS # dlopen
	help
	  These tools are used to control the key management system
	  built into the Linux kernel.

	  https://git.kernel.org/pub/scm/linux/kernel/git/dhowells/keyutils.git/

comment "keyutils needs a toolchain w/ dynamic library"
	depends on LINGMO_USE_MMU
	depends on LINGMO_STATIC_LIBS
```

## package/kf5/Config.in
```kconfig
menuconfig LINGMO_PACKAGE_KF5
	bool "KF5"
	depends on LINGMO_PACKAGE_QT5
	help
	  This option enables the KF5 KDE Frameworks. Sub-options
	  allow to select which modules should be built.

	  https://techbase.kde.org/KDE_Frameworks

if LINGMO_PACKAGE_KF5
source "package/kf5/kf5-extra-cmake-modules/Config.in"
source "package/kf5/kf5-kcoreaddons/Config.in"
source "package/kf5/kf5-modemmanager-qt/Config.in"
source "package/kf5/kf5-networkmanager-qt/Config.in"
endif
```

## package/kf5/kf5-modemmanager-qt/Config.in
```kconfig
config LINGMO_PACKAGE_KF5_MODEMMANAGER_QT
	bool "kf5-modemmanager-qt"
	depends on LINGMO_USE_MMU # qt5dbus
	depends on LINGMO_TOOLCHAIN_HAS_THREADS # qt5dbus
	depends on LINGMO_PACKAGE_MODEM_MANAGER
	select LINGMO_PACKAGE_QT5BASE_DBUS
	select LINGMO_PACKAGE_KF5_EXTRA_CMAKE_MODULES
	help
	  KF5 is a set of Qt framework addons, extending Qt in various
	  ways, not only restricted in helping integration in KDE.

	  This package contains the ModemManager Qt5 bindings from the
	  KF5 project.

	  https://api.kde.org/frameworks/modemmanager-qt/html/index.html

comment "kf5-modemmanager-qt needs toolchain w/ threads"
	depends on LINGMO_USE_MMU
	depends on LINGMO_PACKAGE_MODEM_MANAGER
	depends on !LINGMO_TOOLCHAIN_HAS_THREADS
```

## package/kismet/Config.in
```kconfig
comment "kismet needs a toolchain w/ threads, C++, gcc >= 5, host gcc >= 7"
	depends on LINGMO_USE_MMU
	depends on !LINGMO_INSTALL_LIBSTDCPP || \
		!LINGMO_TOOLCHAIN_HAS_THREADS || \
		!LINGMO_TOOLCHAIN_GCC_AT_LEAST_5 || \
		!LINGMO_HOST_GCC_AT_LEAST_7
	depends on LINGMO_PACKAGE_HOST_PROTOBUF_ARCH_SUPPORTS

config LINGMO_PACKAGE_KISMET
	bool "kismet"
	depends on LINGMO_INSTALL_LIBSTDCPP
	depends on LINGMO_TOOLCHAIN_HAS_THREADS
	depends on LINGMO_USE_MMU # fork()
	depends on LINGMO_PACKAGE_HOST_PROTOBUF_ARCH_SUPPORTS # protobuf-c
	depends on LINGMO_HOST_GCC_AT_LEAST_7 # protobuf-c
	depends on LINGMO_TOOLCHAIN_GCC_AT_LEAST_5 # C++14
	select LINGMO_PACKAGE_LIBPCAP
	select LINGMO_PACKAGE_PROTOBUF_C
	select LINGMO_PACKAGE_SQLITE
	select LINGMO_PACKAGE_ZLIB
	help
	  Kismet is a wireless network and device detector, sniffer,
	  wardriving tool, and WIDS (wireless intrusion detection)
	  framework.

	  Kismet works with Wi-Fi interfaces, Bluetooth interfaces, some
	  SDR (software defined radio) hardware like the RTLSDR, and
	  other specialized capture hardware.

	  http://www.kismetwireless.net

if LINGMO_PACKAGE_KISMET

config LINGMO_PACKAGE_KISMET_PYTHON_TOOLS
	bool "Install python tools"
	depends on LINGMO_PACKAGE_PROTOBUF_ARCH_SUPPORTS # protobuf
	depends on LINGMO_PACKAGE_PYTHON_NUMPY_ARCH_SUPPORTS # python-numpy
	depends on LINGMO_PACKAGE_PYTHON3
	depends on !LINGMO_STATIC_LIBS # protobuf
	depends on LINGMO_TOOLCHAIN_USES_GLIBC || LINGMO_TOOLCHAIN_USES_MUSL # python-numpy
	select LINGMO_PACKAGE_PROTOBUF
	select LINGMO_PACKAGE_PYTHON_NUMPY # runtime for RTLAMR and RTLADSB
	select LINGMO_PACKAGE_PYTHON_PROTOBUF # runtime
	select LINGMO_PACKAGE_PYTHON_SERIAL # runtime for Freaklabs Zigbee
	select LINGMO_PACKAGE_PYTHON_SETUPTOOLS
	help
	  Enable Python and Python-related tools (RTL_433, RTLAMR,
	  RTLADSB and Freaklabs Zigbee)

comment "python tools needs python3"
	depends on !LINGMO_PACKAGE_PYTHON3
	depends on LINGMO_PACKAGE_PROTOBUF_ARCH_SUPPORTS
	depends on LINGMO_PACKAGE_PYTHON_NUMPY_ARCH_SUPPORTS

comment "python tools needs a glibc or musl toolchain w/ dynamic library"
	depends on LINGMO_STATIC_LIBS
	depends on LINGMO_PACKAGE_PROTOBUF_ARCH_SUPPORTS
	depends on LINGMO_PACKAGE_PYTHON_NUMPY_ARCH_SUPPORTS
	depends on !(LINGMO_TOOLCHAIN_USES_GLIBC || LINGMO_TOOLCHAIN_USES_MUSL)

config LINGMO_PACKAGE_KISMET_SERVER
	bool "Install server"
	default y
	depends on LINGMO_PACKAGE_PROTOBUF_ARCH_SUPPORTS # protobuf
	depends on !LINGMO_STATIC_LIBS # dlfcn.h
	depends on LINGMO_USE_WCHAR
	depends on !LINGMO_TOOLCHAIN_HAS_GCC_BUG_64735 # std::future
	select LINGMO_PACKAGE_OPENSSL
	select LINGMO_PACKAGE_PROTOBUF

comment "server needs a toolchain w/ dynamic library, wchar"
	depends on LINGMO_PACKAGE_PROTOBUF_ARCH_SUPPORTS
	depends on !LINGMO_TOOLCHAIN_HAS_GCC_BUG_64735
	depends on LINGMO_STATIC_LIBS || !LINGMO_USE_WCHAR

comment "server needs a toolchain not affected by GCC bug 64735"
	depends on LINGMO_TOOLCHAIN_HAS_GCC_BUG_64735

endif
```

## package/kmemd/Config.in
```kconfig
config LINGMO_PACKAGE_KMEMD
	bool "kmemd"
	depends on LINGMO_TOOLCHAIN_HAS_SYNC_4 # libbpf
	depends on LINGMO_USE_WCHAR # libbpf
	depends on !LINGMO_STATIC_LIBS # libbpf
	depends on LINGMO_TOOLCHAIN_HAS_THREADS # libbpf
	depends on LINGMO_TOOLCHAIN_HEADERS_AT_LEAST_5_14
	select LINGMO_PACKAGE_LIBBPF
	help
	  Explore a live Linux kernel's memory using GDB

	  https://github.com/wkz/kmemd

comment "kmemd needs a toolchain w/ wchar, dynamic library, threads, headers >= 5.14"
	depends on LINGMO_TOOLCHAIN_HAS_SYNC_4
	depends on !LINGMO_USE_WCHAR || LINGMO_STATIC_LIBS \
		|| !LINGMO_TOOLCHAIN_HAS_THREADS \
		|| !LINGMO_TOOLCHAIN_HEADERS_AT_LEAST_4_13
```

## package/kmod/Config.in
```kconfig
config LINGMO_PACKAGE_KMOD
	bool "kmod"
	depends on !LINGMO_STATIC_LIBS
	help
	  handle kernel modules

	  http://git.kernel.org/?p=utils/kernel/kmod/kmod.git

if LINGMO_PACKAGE_KMOD

config LINGMO_PACKAGE_KMOD_TOOLS
	bool "kmod utilities"
	depends on LINGMO_PACKAGE_BUSYBOX_SHOW_OTHERS
	help
	  Install kmod module utilities (depmod, insmod, lsmod,
	  modinfo, modprobe, rmmod).

endif

comment "kmod needs a toolchain w/ dynamic library"
	depends on LINGMO_STATIC_LIBS
```

## package/kmscube/Config.in
```kconfig
config LINGMO_PACKAGE_KMSCUBE
	bool "kmscube"
	depends on LINGMO_PACKAGE_HAS_LIBEGL
	depends on LINGMO_PACKAGE_HAS_LIBGBM
	depends on LINGMO_PACKAGE_LIBGBM_HAS_FEATURE_FORMAT_MODIFIER_PLANE_COUNT
	depends on LINGMO_PACKAGE_HAS_LIBGLES
	depends on LINGMO_TOOLCHAIN_HAS_THREADS # libdrm
	select LINGMO_PACKAGE_LIBDRM
	help
	  kmscube is an application to test kms/drm drivers.

	  https://cgit.freedesktop.org/mesa/kmscube/

if LINGMO_PACKAGE_KMSCUBE

config LINGMO_PACKAGE_KMSCUBE_GSTREAMER
	bool "Enable gstreamer video support"
	depends on LINGMO_USE_WCHAR # glib2
	depends on LINGMO_TOOLCHAIN_HAS_THREADS # glib2
	depends on LINGMO_USE_MMU # glib2
	select LINGMO_PACKAGE_LIBGLIB2
	select LINGMO_PACKAGE_GST1_PLUGINS_BASE
	select LINGMO_PACKAGE_GST1_PLUGINS_BASE_PLUGIN_APP
	select LINGMO_PACKAGE_GSTREAMER1

endif

comment "kmscube needs EGL, GBM and OpenGL ES, and a toolchain w/ thread support"
	depends on \
		!LINGMO_PACKAGE_HAS_LIBEGL || \
		!LINGMO_PACKAGE_HAS_LIBGBM || \
		!LINGMO_PACKAGE_LIBGBM_HAS_FEATURE_FORMAT_MODIFIER_PLANE_COUNT || \
		!LINGMO_PACKAGE_HAS_LIBGLES || \
		!LINGMO_TOOLCHAIN_HAS_THREADS
```
