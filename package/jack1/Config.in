## package/jack1/Config.in
```kconfig
config LINGMO_PACKAGE_JACK1
	bool "jack1"
	depends on LINGMO_USE_MMU # fork()
	depends on LINGMO_TOOLCHAIN_HAS_THREADS # alsa-lib
	depends on !LINGMO_STATIC_LIBS
	depends on LINGMO_TOOLCHAIN_HAS_SYNC_4
	depends on !LINGMO_PACKAGE_JACK2
	select LINGMO_PACKAGE_ALSA_LIB
	select LINGMO_PACKAGE_ALSA_LIB_HWDEP
	select LINGMO_PACKAGE_ALSA_LIB_RAWMIDI
	select LINGMO_PACKAGE_ALSA_LIB_SEQ
	select LINGMO_PACKAGE_BERKELEYDB
	help
	  JACK Audio Connection Kit (JACK 1 implementation).

	  JACK is a low-latency sound server, allowing multiple
	  applications to connect to one audio device, and to share
	  audio between themselves. This package contains the daemon
	  jackd as well as some example clients.

	  http://jackaudio.org/

	  Another implementation (LINGMO_PACKAGE_JACK2) is also available,
	  please consult the documentation to choose the right one:

	  https://github.com/jackaudio/jackaudio.github.com/wiki/Differences-between-jack1-and-jack2

comment "jack1 needs a toolchain w/ threads, dynamic library"
	depends on LINGMO_USE_MMU
	depends on LINGMO_TOOLCHAIN_HAS_SYNC_4
	depends on !LINGMO_TOOLCHAIN_HAS_THREADS || LINGMO_STATIC_LIBS
```

## package/jack2/Config.in
```kconfig
config LINGMO_PACKAGE_JACK2
	bool "jack2"
	depends on LINGMO_TOOLCHAIN_HAS_THREADS # alsa-lib
	depends on LINGMO_USE_MMU # fork()
	depends on LINGMO_INSTALL_LIBSTDCPP
	depends on !LINGMO_STATIC_LIBS
	depends on LINGMO_TOOLCHAIN_HAS_SYNC_4
	select LINGMO_PACKAGE_ALSA_LIB
	select LINGMO_PACKAGE_ALSA_LIB_HWDEP
	select LINGMO_PACKAGE_ALSA_LIB_SEQ
	select LINGMO_PACKAGE_ALSA_LIB_RAWMIDI
	# Ensure we get at least one:
	select LINGMO_PACKAGE_JACK2_LEGACY if !LINGMO_PACKAGE_JACK2_DBUS
	help
	  JACK Audio Connection Kit (server and example clients).

	  JACK is a low-latency sound server, allowing multiple
	  applications to connect to one audio device, and to share
	  audio between themselves. This package contains the daemon
	  jackd as well as some example clients.

	  http://jackaudio.org/

if LINGMO_PACKAGE_JACK2

config LINGMO_PACKAGE_JACK2_LEGACY
	bool "classic jack2"
	help
	  Build and use jackd.

	  https://github.com/jackaudio/jackaudio.github.com/wiki/JACK-DBus-packaging

config LINGMO_PACKAGE_JACK2_DBUS
	bool "dbus jack2"
	depends on LINGMO_USE_WCHAR # dbus-python, python
	select LINGMO_PACKAGE_DBUS
	select LINGMO_PACKAGE_DBUS_PYTHON
	select LINGMO_PACKAGE_PYTHON3 # runtime
	select LINGMO_PACKAGE_PYTHON3_PYEXPAT # runtime
	help
	  Build and use jackdbus.

	  https://github.com/jackaudio/jackaudio.github.com/wiki/JACK-DBus-packaging

endif

comment "jack2 needs a toolchain w/ threads, C++, dynamic library"
	depends on LINGMO_USE_MMU
	depends on LINGMO_TOOLCHAIN_HAS_SYNC_4
	depends on !LINGMO_TOOLCHAIN_HAS_THREADS || !LINGMO_INSTALL_LIBSTDCPP || \
		LINGMO_STATIC_LIBS
```

## package/janus-gateway/Config.in
```kconfig
menuconfig LINGMO_PACKAGE_JANUS_GATEWAY
	bool "janus-gateway"
	depends on LINGMO_TOOLCHAIN_HAS_THREADS # libglib2
	depends on LINGMO_USE_WCHAR # libnice -> libglib2
	depends on LINGMO_USE_MMU # libnice
	depends on !LINGMO_STATIC_LIBS # dlopen
	select LINGMO_PACKAGE_JANSSON
	select LINGMO_PACKAGE_LIBCONFIG
	select LINGMO_PACKAGE_LIBGLIB2
	select LINGMO_PACKAGE_LIBNICE
	select LINGMO_PACKAGE_LIBSRTP
	select LINGMO_PACKAGE_OPENSSL
	help
	  Janus is an open source, general purpose, WebRTC gateway
	  designed and developed by Meetecho.

	  https://github.com/meetecho/janus-gateway

if LINGMO_PACKAGE_JANUS_GATEWAY

config LINGMO_PACKAGE_JANUS_GATEWAY_DEMOS
	bool "HTML demos"
	help
	  Install the demonstration website, as featured on
	  https://janus.conf.meetecho.com/

comment "plugins"

config LINGMO_PACKAGE_JANUS_GATEWAY_AUDIO_BRIDGE
	bool "audio bridge"
	select LINGMO_PACKAGE_OPUS

config LINGMO_PACKAGE_JANUS_GATEWAY_DUKTAPE
	bool "duktape"
	depends on !LINGMO_OPTIMIZE_FAST # duktape
	select LINGMO_PACKAGE_DUKTAPE

comment "duktape plugin can't be built with optimize for fast"
	depends on LINGMO_OPTIMIZE_FAST

config LINGMO_PACKAGE_JANUS_GATEWAY_ECHO_TEST
	bool "echo test"

config LINGMO_PACKAGE_JANUS_GATEWAY_RECORDPLAY
	bool "record and play"

config LINGMO_PACKAGE_JANUS_GATEWAY_SIP_GATEWAY
	bool "sip gateway"
	select LINGMO_PACKAGE_SOFIA_SIP

config LINGMO_PACKAGE_JANUS_GATEWAY_STREAMING
	bool "streaming"
	# SO_REUSEPORT
	depends on LINGMO_TOOLCHAIN_HEADERS_AT_LEAST_3_9

comment "streaming plugin needs a toolchain w/ headers >= 3.9"
	depends on !LINGMO_TOOLCHAIN_HEADERS_AT_LEAST_3_9

config LINGMO_PACKAGE_JANUS_GATEWAY_TEXT_ROOM
	bool "text room"

config LINGMO_PACKAGE_JANUS_GATEWAY_VIDEO_CALL
	bool "video call"

config LINGMO_PACKAGE_JANUS_GATEWAY_VIDEO_ROOM
	bool "video room"

config LINGMO_PACKAGE_JANUS_GATEWAY_VOICE_MAIL
	bool "voice mail"
	select LINGMO_PACKAGE_LIBOGG

comment "transports"

config LINGMO_PACKAGE_JANUS_GATEWAY_MQTT
	bool "MQTT"
	depends on LINGMO_TOOLCHAIN_HAS_THREADS
	select LINGMO_PACKAGE_PAHO_MQTT_C

comment "MQTT transport needs a toolchain w/ threads"
	depends on !LINGMO_TOOLCHAIN_HAS_THREADS

config LINGMO_PACKAGE_JANUS_GATEWAY_RABBITMQ
	bool "RabbitMQ"
	depends on !LINGMO_STATIC_LIBS
	depends on LINGMO_TOOLCHAIN_HAS_THREADS
	select LINGMO_PACKAGE_RABBITMQ_C

comment "RabbitMQ transport needs a toolchain w/ dynamic library, threads"
	depends on LINGMO_STATIC_LIBS || !LINGMO_TOOLCHAIN_HAS_THREADS

config LINGMO_PACKAGE_JANUS_GATEWAY_REST
	bool "REST (HTTP/HTTPS)"
	select LINGMO_PACKAGE_LIBMICROHTTPD

config LINGMO_PACKAGE_JANUS_GATEWAY_UNIX_SOCKETS
	bool "Unix Sockets"
	default y

config LINGMO_PACKAGE_JANUS_GATEWAY_WEBSOCKETS
	bool "WebSockets"
	select LINGMO_PACKAGE_LIBWEBSOCKETS

endif

comment "janus-gateway needs a toolchain w/ dynamic library, threads, wchar"
	depends on LINGMO_USE_MMU
	depends on LINGMO_STATIC_LIBS || !LINGMO_TOOLCHAIN_HAS_THREADS || !LINGMO_USE_WCHAR
```

## package/jasper/Config.in
```kconfig
config LINGMO_PACKAGE_JASPER
	bool "jasper"
	help
	  JPEG-2000 decoder

	  http://www.ece.uvic.ca/~mdadams/jasper/
```

## package/jemalloc/Config.in
```kconfig
config LINGMO_PACKAGE_JEMALLOC_ARCH_SUPPORTS
	bool
	# see include/jemalloc/internal/quantum.h
	default y if LINGMO_arm || LINGMO_armeb
	default y if LINGMO_aarch64 || LINGMO_aarch64_be
	default y if LINGMO_i386 || LINGMO_x86_64
	default y if LINGMO_m68k
	default y if LINGMO_mips || LINGMO_mipsel || LINGMO_mips64 || LINGMO_mips64el
	default y if LINGMO_nios2
	default y if LINGMO_or1k
	default y if LINGMO_powerpc
	default y if LINGMO_riscv
	default y if LINGMO_sh4 || LINGMOsh4eb || LINGMO_sh4a || LINGMO_sh4aeb
	default y if LINGMO_sparc64

config LINGMO_PACKAGE_JEMALLOC
	bool "jemalloc"
	depends on LINGMO_PACKAGE_JEMALLOC_ARCH_SUPPORTS
	depends on LINGMO_TOOLCHAIN_HAS_THREADS
	help
	  This library providing a malloc(3) implementation that
	  emphasizes fragmentation avoidance and scalable concurrency
	  support.

	  http://jemalloc.net/

comment "jemalloc needs a toolchain w/ threads"
	depends on LINGMO_PACKAGE_JEMALLOC_ARCH_SUPPORTS
	depends on !LINGMO_TOOLCHAIN_HAS_THREADS
```

## package/jhead/Config.in
```kconfig
config LINGMO_PACKAGE_JHEAD
	bool "jhead"
	depends on LINGMO_USE_WCHAR
	help
	  Jhead is a program for manipulating settings and thumbnails
	  in Exif jpeg headers used by most Digital Cameras.

	  http://www.sentex.net/~mwandel/jhead/

comment "jhead needs a toolchain w/ wchar"
	depends on !LINGMO_USE_WCHAR
```

## package/jitterentropy-library/Config.in
```kconfig
config LINGMO_PACKAGE_JITTERENTROPY_LIBRARY
	bool "libjitterentropy"
	depends on LINGMO_TOOLCHAIN_HAS_THREADS
	help
	  Hardware RNG based on CPU timing jitter.

	  https://github.com/smuellerDD/jitterentropy-library

comment "libjitterentropy needs a toolchain w/ threads"
	depends on !LINGMO_TOOLCHAIN_HAS_THREADS
```

## package/jose/Config.in
```kconfig
config LINGMO_PACKAGE_JOSE
	bool "jose"
	depends on LINGMO_TOOLCHAIN_HAS_THREADS
	select LINGMO_PACKAGE_ZLIB
	select LINGMO_PACKAGE_JANSSON
	select LINGMO_PACKAGE_OPENSSL
	help
	  C-language implementation of Javascript Object Signing and
	  Encryption.

	  https://github.com/latchset/jose

comment "jose needs a toolchain w/ threads"
	depends on !LINGMO_TOOLCHAIN_HAS_THREADS
```

## package/jpeg/Config.in
```kconfig
# jpeg-turbo has simd support for some architectures
config LINGMO_PACKAGE_JPEG_SIMD_SUPPORT
	bool
	default y if LINGMO_X86_CPU_HAS_MMX
	default y if LINGMO_ARM_CPU_HAS_NEON
	default y if LINGMO_POWERPC_CPU_HAS_ALTIVEC && !LINGMO_powerpc64le
	default y if LINGMO_POWERPC_CPU_HAS_VSX && LINGMO_powerpc64le
	default y if LINGMO_aarch64 || LINGMO_aarch64_be

config LINGMO_PACKAGE_JPEG
	bool "jpeg support"
	help
	  Select the desired JPEG library provider.

if LINGMO_PACKAGE_JPEG

choice
	prompt "jpeg variant"
	default LINGMO_PACKAGE_JPEG_TURBO if LINGMO_PACKAGE_JPEG_SIMD_SUPPORT
	help
	  Select the normal libjpeg or libjpeg-turbo.

config LINGMO_PACKAGE_LIBJPEG
	bool "jpeg"
	select LINGMO_PACKAGE_HAS_JPEG
	help
	  The ubiquitous C library for manipulating JPEG images.

	  http://www.ijg.org/

config LINGMO_PACKAGE_JPEG_TURBO
	bool "jpeg-turbo"
	select LINGMO_PACKAGE_HAS_JPEG
	help
	  Libjpeg-turbo is a derivative of libjpeg that uses SIMD
	  instructions (MMX, SSE2, NEON) to accelerate baseline JPEG
	  compression and decompression on x86, x86-64, and ARM
	  systems.

	  http://www.libjpeg-turbo.org

# libjpeg from br2-external trees, if any
source "$LINGMO_BASE_DIR/.br2-external.in.jpeg"

endchoice

source "package/jpeg-turbo/Config.in.options"

config LINGMO_PACKAGE_HAS_JPEG
	bool

config LINGMO_PACKAGE_PROVIDES_JPEG
	string
	default "libjpeg"    if LINGMO_PACKAGE_LIBJPEG
	default "jpeg-turbo" if LINGMO_PACKAGE_JPEG_TURBO

endif
```

## package/jq/Config.in
```kconfig
config LINGMO_PACKAGE_JQ
	bool "jq"
	depends on LINGMO_TOOLCHAIN_HAS_THREADS
	help
	  jq is like sed for JSON data - you can use it to slice and
	  filter and map and transform structured data with the same
	  ease that sed, awk, grep and friends let you play with text.

	  https://jqlang.github.io/jq/

comment "jq needs a toolchain w/ threads"
	depends on !LINGMO_TOOLCHAIN_HAS_THREADS
```

## package/jquery-keyboard/Config.in
```kconfig
config LINGMO_PACKAGE_JQUERY_KEYBOARD
	bool "jquery-keyboard"
	select LINGMO_PACKAGE_JQUERY_UI
	help
	  Virtual Keyboard using jQuery UI

	  https://github.com/Mottie/Keyboard
```

## package/jquery-ui-themes/Config.in
```kconfig
config LINGMO_PACKAGE_JQUERY_UI_THEMES
	bool "jquery-ui-themes"
	depends on LINGMO_PACKAGE_JQUERY_UI
	help
	  Themes for jQuery UI.

	  http://jqueryui.com/

if LINGMO_PACKAGE_JQUERY_UI_THEMES

choice
	prompt "theme to install"
	help
	  Specify the jQuery UI theme to install.

config LINGMO_PACKAGE_JQUERY_UI_THEMES_BLACK_TIE
	bool "black-tie"

config LINGMO_PACKAGE_JQUERY_UI_THEMES_BLITZER
	bool "blitzer"

config LINGMO_PACKAGE_JQUERY_UI_THEMES_CUPERTINO
	bool "cupertino"

config LINGMO_PACKAGE_JQUERY_UI_THEMES_DARK_HIVE
	bool "dark-hive"

config LINGMO_PACKAGE_JQUERY_UI_THEMES_DOT_LUV
	bool "dot-luv"

config LINGMO_PACKAGE_JQUERY_UI_THEMES_EGGPLANT
	bool "eggplant"

config LINGMO_PACKAGE_JQUERY_UI_THEMES_EXCITE_BIKE
	bool "excite-bike"

config LINGMO_PACKAGE_JQUERY_UI_THEMES_FLICK
	bool "flick"

config LINGMO_PACKAGE_JQUERY_UI_THEMES_HOT_SNEAKS
	bool "hot-sneaks"

config LINGMO_PACKAGE_JQUERY_UI_THEMES_HUMANITY
	bool "humanity"

config LINGMO_PACKAGE_JQUERY_UI_THEMES_LE_FROG
	bool "le-frog"

config LINGMO_PACKAGE_JQUERY_UI_THEMES_MINT_CHOC
	bool "mint-choc"

config LINGMO_PACKAGE_JQUERY_UI_THEMES_OVERCAST
	bool "overcast"

config LINGMO_PACKAGE_JQUERY_UI_THEMES_PEPPER_GRINDER
	bool "pepper-grinder"

config LINGMO_PACKAGE_JQUERY_UI_THEMES_REDMOND
	bool "redmond"

config LINGMO_PACKAGE_JQUERY_UI_THEMES_SMOOTHNESS
	bool "smoothness"

config LINGMO_PACKAGE_JQUERY_UI_THEMES_SOUTH_STREET
	bool "south-street"

config LINGMO_PACKAGE_JQUERY_UI_THEMES_START
	bool "start"

config LINGMO_PACKAGE_JQUERY_UI_THEMES_SUNNY
	bool "sunny"

config LINGMO_PACKAGE_JQUERY_UI_THEMES_SWANKY_PURSE
	bool "swanky-purse"

config LINGMO_PACKAGE_JQUERY_UI_THEMES_TRONTASTIC
	bool "trontastic"

config LINGMO_PACKAGE_JQUERY_UI_THEMES_UI_DARKNESS
	bool "ui-darkness"

config LINGMO_PACKAGE_JQUERY_UI_THEMES_UI_LIGHTNESS
	bool "ui-lightness"

config LINGMO_PACKAGE_JQUERY_UI_THEMES_VADER
	bool "vader"

endchoice

config LINGMO_PACKAGE_JQUERY_UI_THEMES_THEME
	string
	default "black-tie"		if LINGMO_PACKAGE_JQUERY_UI_THEMES_BLACK_TIE
	default "blitzer"		if LINGMO_PACKAGE_JQUERY_UI_THEMES_BLITZER
	default "cupertino"		if LINGMO_PACKAGE_JQUERY_UI_THEMES_CUPERTINO
	default "dark-hive"		if LINGMO_PACKAGE_JQUERY_UI_THEMES_DARK_HIVE
	default "dot-luv"		if LINGMO_PACKAGE_JQUERY_UI_THEMES_DOT_LUV
	default "eggplant"		if LINGMO_PACKAGE_JQUERY_UI_THEMES_EGGPLANT
	default "excite-bike"		if LINGMO_PACKAGE_JQUERY_UI_THEMES_EXCITE_BIKE
	default "flick"			if LINGMO_PACKAGE_JQUERY_UI_THEMES_FLICK
	default "hot-sneaks"		if LINGMO_PACKAGE_JQUERY_UI_THEMES_HOT_SNEAKS
	default "humanity"		if LINGMO_PACKAGE_JQUERY_UI_THEMES_HUMANITY
	default "le-frog"		if LINGMO_PACKAGE_JQUERY_UI_THEMES_LE_FROG
	default "mint-choc"		if LINGMO_PACKAGE_JQUERY_UI_THEMES_MINT_CHOC
	default "overcast"		if LINGMO_PACKAGE_JQUERY_UI_THEMES_OVERCAST
	default "pepper-grinder"	if LINGMO_PACKAGE_JQUERY_UI_THEMES_PEPPER_GRINDER
	default "redmond"		if LINGMO_PACKAGE_JQUERY_UI_THEMES_REDMOND
	default "smoothness"		if LINGMO_PACKAGE_JQUERY_UI_THEMES_SMOOTHNESS
	default "south-street"		if LINGMO_PACKAGE_JQUERY_UI_THEMES_SOUTH_STREET
	default "start"			if LINGMO_PACKAGE_JQUERY_UI_THEMES_START
	default "sunny"			if LINGMO_PACKAGE_JQUERY_UI_THEMES_SUNNY
	default "swanky-purse"		if LINGMO_PACKAGE_JQUERY_UI_THEMES_SWANKY_PURSE
	default "trontastic"		if LINGMO_PACKAGE_JQUERY_UI_THEMES_TRONTASTIC
	default "ui-darkness"		if LINGMO_PACKAGE_JQUERY_UI_THEMES_UI_DARKNESS
	default "ui-lightness"		if LINGMO_PACKAGE_JQUERY_UI_THEMES_UI_LIGHTNESS
	default "vader"			if LINGMO_PACKAGE_JQUERY_UI_THEMES_VADER

endif
```

## package/json-glib/Config.in
```kconfig
config LINGMO_PACKAGE_JSON_GLIB
	bool "json-glib"
	depends on LINGMO_USE_WCHAR # glib2
	depends on LINGMO_TOOLCHAIN_HAS_THREADS # glib2
	depends on LINGMO_USE_MMU # glib2
	select LINGMO_PACKAGE_LIBGLIB2
	help
	  JSON-GLib is a library providing serialization and
	  deserialization support for the JavaScript Object Notation
	  (JSON) format described by RFC 4627.

	  https://live.gnome.org/JsonGlib/

comment "json-glib needs a toolchain w/ wchar, threads"
	depends on LINGMO_USE_MMU
	depends on !LINGMO_USE_WCHAR || !LINGMO_TOOLCHAIN_HAS_THREADS
```

## package/jsoncpp/Config.in
```kconfig
config LINGMO_PACKAGE_JSONCPP
	bool "jsoncpp"
	depends on LINGMO_TOOLCHAIN_GCC_AT_LEAST_4_7 # C++11
	depends on LINGMO_INSTALL_LIBSTDCPP
	help
	  JsonCpp is a C++ library that allows manipulating JSON
	  values, including serialization and deserialization to and
	  from strings. It can also preserve existing comment in
	  unserialization/serialization steps, making it a convenient
	  format to store user input files.

	  https://github.com/open-source-parsers/jsoncpp

comment "jsoncpp needs a toolchain w/ C++, gcc >= 4.7"
	depends on !LINGMO_INSTALL_LIBSTDCPP || !LINGMO_TOOLCHAIN_GCC_AT_LEAST_4_7
```

## package/kbd/Config.in
```kconfig
config LINGMO_PACKAGE_KBD
	bool "kbd"
	# Uses fork()
	depends on LINGMO_USE_MMU
	depends on LINGMO_TOOLCHAIN_GCC_AT_LEAST_4_9 # _Generic
	help
	  Keytable files and keyboard utilities.

	  http://kernel.org/pub/linux/utils/kbd/

comment "kbd needs a toolchain w/ gcc >= 4.9"
	depends on LINGMO_USE_MMU
	depends on !LINGMO_TOOLCHAIN_GCC_AT_LEAST_4_9
```
