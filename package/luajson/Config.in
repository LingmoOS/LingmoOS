## package/luajson/Config.in
```kconfig
config LINGMO_PACKAGE_LUAJSON
	bool "luajson"
	select LINGMO_PACKAGE_LPEG # runtime
	help
	  LuaJSON is a customizable JSON decoder/encoder
	  using LPEG for parsing.

	  http://github.com/harningt/luajson
```

## package/lualdap/Config.in
```kconfig
config LINGMO_PACKAGE_LUALDAP
	bool "lualdap"
	depends on !LINGMO_STATIC_LIBS
	depends on LINGMO_USE_WCHAR # openldap
	depends on LINGMO_USE_MMU # openldap
	select LINGMO_PACKAGE_OPENLDAP
	help
	  LuaLDAP is a simple interface from Lua to an LDAP client,
	  in fact it is a bind to OpenLDAP client.

	  https://lualdap.github.io/lualdap/

comment "lualdap needs a toolchain w/ wchar, dynamic library"
	depends on LINGMO_USE_MMU
	depends on !LINGMO_USE_WCHAR || LINGMO_STATIC_LIBS
```

## package/luaossl/Config.in
```kconfig
config LINGMO_PACKAGE_LUAOSSL
	bool "luaossl"
	depends on LINGMO_TOOLCHAIN_HAS_THREADS
	select LINGMO_PACKAGE_OPENSSL
	select LINGMO_PACKAGE_LIBOPENSSL_ENABLE_DES if LINGMO_PACKAGE_LIBOPENSSL
	help
	  luaossl is a comprehensive binding to OpenSSL for Lua 5.1,
	  5.2, and later.

	  It includes support for certificate and key management,
	  key generation, signature verification, and deep bindings
	  to the distinguished name, alternative name, and X.509v3
	  extension interfaces. It also binds OpenSSL's bignum, message
	  digest, HMAC, cipher, and CSPRNG interfaces.

	  http://25thandclement.com/~william/projects/luaossl.html

comment "luaossl needs a toolchain w/ threads"
	depends on !LINGMO_TOOLCHAIN_HAS_THREADS
```

## package/luasec/Config.in
```kconfig
config LINGMO_PACKAGE_LUASEC
	bool "luasec"
	select LINGMO_PACKAGE_OPENSSL
	select LINGMO_PACKAGE_LUASOCKET # runtime
	help
	  A binding for OpenSSL library to provide TLS/SSL communication
	  over LuaSocket.

	  https://github.com/brunoos/luasec/wiki
```

## package/luasql-sqlite3/Config.in
```kconfig
config LINGMO_PACKAGE_LUASQL_SQLITE3
	bool "luasql-sqlite3"
	select LINGMO_PACKAGE_SQLITE
	help
	  LuaSQL is a simple interface from Lua to a DBMS.

	  http://keplerproject.github.io/luasql/
```

## package/luasyslog/Config.in
```kconfig
config LINGMO_PACKAGE_LUASYSLOG
	bool "luasyslog"
	select LINGMO_PACKAGE_LUALOGGING # runtime
	help
	  syslog appender for LuaLogging.

	  https://github.com/ntd/luasyslog
```

## package/lugaru/Config.in
```kconfig
config LINGMO_PACKAGE_LUGARU
	bool "lugaru"
	depends on LINGMO_INSTALL_LIBSTDCPP
	depends on LINGMO_PACKAGE_HAS_LIBGL # libglu
	depends on LINGMO_PACKAGE_OPENAL_ARCH_SUPPORTS
	depends on LINGMO_PACKAGE_XORG7 # SDL2 OpenGL (GLX)
	depends on LINGMO_TOOLCHAIN_GCC_AT_LEAST_4_9 # openal
	depends on LINGMO_TOOLCHAIN_HAS_THREADS_NPTL # openal
	depends on LINGMO_USE_MMU # SDL2 OpenGL (GLX)
	depends on !LINGMO_STATIC_LIBS # SDL2
	select LINGMO_PACKAGE_JPEG
	select LINGMO_PACKAGE_LIBGLU # GL/glu.h
	select LINGMO_PACKAGE_LIBPNG
	select LINGMO_PACKAGE_LIBVORBIS
	select LINGMO_PACKAGE_OPENAL
	select LINGMO_PACKAGE_SDL2
	select LINGMO_PACKAGE_SDL2_OPENGL
	select LINGMO_PACKAGE_ZLIB
	help
	  Lugaru (pronounced Loo-GAH-roo) is a cross-platform
	  third-person action game. The main character, Turner, is an
	  anthropomorphic rebel bunny rabbit with impressive combat
	  skills. In his quest to find those responsible for
	  slaughtering his village, he uncovers a far-reaching
	  conspiracy involving the corrupt leaders of the rabbit
	  republic and the starving wolves from a nearby den. Turner
	  takes it upon himself to fight against their plot and save
	  his fellow rabbits from slavery.

	  https://osslugaru.gitlab.io/

comment "lugaru needs X11 and a toolchain w/ C++, OpenGL backend, gcc >= 4.9, NPTL, dynamic library"
	depends on LINGMO_PACKAGE_OPENAL_ARCH_SUPPORTS
	depends on LINGMO_PACKAGE_XORG7
	depends on LINGMO_USE_MMU
	depends on !LINGMO_INSTALL_LIBSTDCPP || !LINGMO_PACKAGE_HAS_LIBGL || \
		!LINGMO_TOOLCHAIN_GCC_AT_LEAST_4_9 || !LINGMO_TOOLCHAIN_HAS_THREADS_NPTL || \
		LINGMO_STATIC_LIBS
```

## package/luksmeta/Config.in
```kconfig
config LINGMO_PACKAGE_LUKSMETA
	bool "luksmeta"
	depends on LINGMO_TOOLCHAIN_HAS_THREADS # cryptsetup -> lvm2
	depends on LINGMO_USE_MMU # cryptsetup -> lvm2
	depends on !LINGMO_STATIC_LIBS # cryptsetup -> lvm2
	depends on LINGMO_TOOLCHAIN_HAS_SYNC_4 # cryptsetup -> json-c
	select LINGMO_PACKAGE_CRYPTSETUP
	help
	  LUKSMeta is a simple library and utility for storing
	  metadata in the LUKSv1 header.

	  https://github.com/latchset/luksmeta

comment "luksmeta needs a toolchain w/ threads, dynamic library"
	depends on LINGMO_USE_MMU
	depends on LINGMO_TOOLCHAIN_HAS_SYNC_4
	depends on LINGMO_STATIC_LIBS || !LINGMO_TOOLCHAIN_HAS_THREADS
```

## package/lutok/Config.in
```kconfig
config LINGMO_PACKAGE_LUTOK
	bool "lutok"
	depends on LINGMO_INSTALL_LIBSTDCPP
	depends on !LINGMO_PACKAGE_LUAJIT
	help
	  Lutok is a lightweight C++ API library for Lua.

	  https://github.com/jmmv/lutok

comment "lutok needs a toolchain w/ C++ and full Lua"
	depends on !LINGMO_INSTALL_LIBSTDCPP || LINGMO_PACKAGE_LUAJIT
```

## package/luv/Config.in
```kconfig
config LINGMO_PACKAGE_LUV
	bool "luv"
	depends on LINGMO_TOOLCHAIN_HAS_THREADS_NPTL # libuv
	depends on LINGMO_USE_MMU # libuv
	depends on !LINGMO_STATIC_LIBS # libuv
	depends on LINGMO_TOOLCHAIN_HAS_SYNC_4 # libuv
	depends on LINGMO_TOOLCHAIN_GCC_AT_LEAST_4_9 # libuv
	select LINGMO_PACKAGE_LIBUV
	help
	  libuv bindings for LuaJIT and Lua.

	  https://github.com/luvit/luv

comment "luv needs a toolchain w/ NPTL, dynamic library, gcc >= 4.9"
	depends on !LINGMO_TOOLCHAIN_HAS_THREADS_NPTL || LINGMO_STATIC_LIBS \
		|| !LINGMO_TOOLCHAIN_GCC_AT_LEAST_4_9
	depends on LINGMO_USE_MMU
	depends on LINGMO_TOOLCHAIN_HAS_SYNC_4
```

## package/luvi/Config.in
```kconfig
config LINGMO_PACKAGE_LUVI
	bool "luvi"
	depends on LINGMO_TOOLCHAIN_HAS_THREADS_NPTL # libuv
	depends on LINGMO_USE_MMU # libuv
	depends on !LINGMO_STATIC_LIBS # libuv
	depends on LINGMO_PACKAGE_LUAJIT
	depends on LINGMO_TOOLCHAIN_HAS_SYNC_4 # libuv
	depends on LINGMO_TOOLCHAIN_GCC_AT_LEAST_4_9 # libuv
	select LINGMO_PACKAGE_LIBUV
	select LINGMO_PACKAGE_LUV
	select LINGMO_PACKAGE_LIBOPENSSL_ENABLE_DES if LINGMO_PACKAGE_LIBOPENSSL
	help
	  A project in-between luv and luvit. The goal of this is to
	  make building luvit and derivatives much easier.

	  luvi extends LuaJIT with asynchronous I/O and several optional
	  modules to run Lua applications and build self-contained
	  binaries on systems that don't have a compiler.

	  The luvi core can be extended with several Lua modules by
	  adding its bundled Lua binding libraries.
	  To get the Lua module...
	    * 'rex' select PCRE (LINGMO_PACKAGE_PCRE)
	    * 'ssl' select OpenSSL (LINGMO_PACKAGE_OPENSSL)
	    * 'zlib' select zlib (LINGMO_PACKAGE_ZLIB)

	  https://github.com/luvit/luvi

comment "luvi needs a toolchain w/ NPTL, dynamic library, gcc >= 4.9"
	depends on !LINGMO_TOOLCHAIN_HAS_THREADS_NPTL || LINGMO_STATIC_LIBS \
		|| !LINGMO_TOOLCHAIN_GCC_AT_LEAST_4_9
	depends on LINGMO_USE_MMU
	depends on LINGMO_TOOLCHAIN_HAS_SYNC_4

comment "luvi needs LuaJIT"
	depends on !LINGMO_PACKAGE_LUAJIT
```

## package/lxc/Config.in
```kconfig
config LINGMO_PACKAGE_LXC
	bool "lxc"
	depends on LINGMO_TOOLCHAIN_HAS_THREADS
	depends on LINGMO_USE_MMU # fork()
	# build system forcefully builds a shared library
	depends on !LINGMO_STATIC_LIBS
	depends on LINGMO_TOOLCHAIN_GCC_AT_LEAST_4_7 # C++11
	depends on LINGMO_TOOLCHAIN_HEADERS_AT_LEAST_3_0 # setns() system call
	depends on !LINGMO_TOOLCHAIN_USES_UCLIBC # no fexecve
	help
	  Linux Containers (LXC), provides the ability to group and
	  isolate of a set of processes in a jail by virtualizing and
	  accounting the kernel resources. It is similar to
	  Linux-Vserver or Openvz.

	  https://linuxcontainers.org/

comment "lxc needs a glibc or musl toolchain w/ threads, headers >= 3.0, dynamic library, gcc >= 4.7"
	depends on LINGMO_USE_MMU
	depends on !LINGMO_TOOLCHAIN_HAS_THREADS \
		|| !LINGMO_TOOLCHAIN_GCC_AT_LEAST_4_7 \
		|| !LINGMO_TOOLCHAIN_HEADERS_AT_LEAST_3_0 \
		|| LINGMO_STATIC_LIBS \
		|| LINGMO_TOOLCHAIN_USES_UCLIBC
```

## package/lynx/Config.in
```kconfig
config LINGMO_PACKAGE_LYNX
	bool "lynx"
	depends on LINGMO_USE_MMU
	select LINGMO_PACKAGE_SLANG if !LINGMO_PACKAGE_NCURSES
	select LINGMO_PACKAGE_OPENSSL if !LINGMO_PACKAGE_GNUTLS
	help
	  The Text Web-Browser.

	  http://lynx.invisible-island.net/
```

## package/lzlib/Config.in
```kconfig
config LINGMO_PACKAGE_LZLIB
	bool "lzlib"
	depends on LINGMO_PACKAGE_LUA
	select LINGMO_PACKAGE_ZLIB
	help
	  This package provides a library to access zlib library
	  functions and also to read/write gzip files using an
	  interface similar to the base io package.

	  https://github.com/LuaDist/lzlib
```

## package/lzo/Config.in
```kconfig
config LINGMO_PACKAGE_LZO
	bool "lzo"
	help
	  Portable lossless data compression library written in ANSI C.

	  http://www.oberhumer.com/opensource/lzo/
```

## package/lzop/Config.in
```kconfig
config LINGMO_PACKAGE_LZOP
	bool "lzop"
	select LINGMO_PACKAGE_LZO
	help
	  lzop is a file compressor which is very similar to gzip.
	  lzop uses the LZO data compression library for compression
	  services.

	  http://www.lzop.org/
```

## package/madplay/Config.in
```kconfig
config LINGMO_PACKAGE_MADPLAY
	bool "madplay"
	select LINGMO_PACKAGE_LIBMAD
	select LINGMO_PACKAGE_LIBID3TAG
	help
	  Command-line front-end to libmad, a high-quality MPEG audio
	  decoder.  It currently supports MPEG-1 and the MPEG-2
	  extension to lower sampling frequencies, as well as the de
	  facto MPEG 2.5 format. All three audio layers - Layer I,
	  Layer II, and Layer III (i.e. MP3) - are fully implemented.

	  http://www.underbit.com/products/mad/

if LINGMO_PACKAGE_MADPLAY

config LINGMO_PACKAGE_MADPLAY_ALSA
	bool
	default y
	depends on LINGMO_PACKAGE_ALSA_LIB

endif
```

## package/makedumpfile/Config.in
```kconfig
config LINGMO_PACKAGE_MAKEDUMPFILE_ARCH_SUPPORTS
	bool
	default y if LINGMO_aarch64 || LINGMO_aarch64_be
	default y if LINGMO_arm || LINGMO_armeb
	default y if LINGMO_i386 || LINGMO_x86_64
	default y if LINGMO_mips64 || LINGMO_mips64el
	default y if LINGMO_powerpc || LINGMO_powerpc64 || LINGMO_powerpc64le
	default y if LINGMO_s390x
	default y if LINGMO_sparc64

comment "makedumpfile needs a uClibc or glibc toolchain w/ wchar, dynamic library, threads"
	depends on LINGMO_PACKAGE_MAKEDUMPFILE_ARCH_SUPPORTS
	depends on !LINGMO_USE_WCHAR || LINGMO_STATIC_LIBS \
		|| !LINGMO_TOOLCHAIN_HAS_THREADS \
		|| !(LINGMO_TOOLCHAIN_USES_UCLIBC || LINGMO_TOOLCHAIN_USES_GLIBC)

config LINGMO_PACKAGE_MAKEDUMPFILE
	bool "makedumpfile"
	depends on LINGMO_PACKAGE_MAKEDUMPFILE_ARCH_SUPPORTS
	depends on LINGMO_TOOLCHAIN_HAS_THREADS
	depends on !LINGMO_STATIC_LIBS # dlopen
	depends on LINGMO_USE_WCHAR
	depends on LINGMO_TOOLCHAIN_USES_UCLIBC || LINGMO_TOOLCHAIN_USES_GLIBC
	select LINGMO_PACKAGE_BZIP2
	select LINGMO_PACKAGE_ELFUTILS
	select LINGMO_PACKAGE_XZ
	select LINGMO_PACKAGE_ZLIB
	help
	  Makes a small dumpfile of kdump.

	  https://github.com/makedumpfile/makedumpfile
```

## package/mali-driver/Config.in
```kconfig
comment "mali-driver needs a Linux kernel to be built"
	depends on !LINGMO_LINUX_KERNEL

config LINGMO_PACKAGE_MALI_DRIVER
	bool "mali-driver"
	depends on LINGMO_aarch64 || LINGMO_arm
	depends on LINGMO_LINUX_KERNEL
	help
	  This package builds and installs the Linux kernel driver for
	  the Mali Midgard/Bifrost GPU, compatible with recent Linux
	  kernels (>= 5.4). Note that it should be installed together
	  with the corresponding userspace OpenGL libraries, which are
	  usually provided as binaries only by hardware vendors.

	  mali-driver requires a Linux kernel >= 5.4.
```

## package/mali-t76x/Config.in
```kconfig
config LINGMO_PACKAGE_MALI_T76X
	bool "mali-t76x"
	depends on LINGMO_TOOLCHAIN_USES_GLIBC
	depends on LINGMO_ARM_EABIHF
	depends on LINGMO_arm
	select LINGMO_PACKAGE_MESA3D_HEADERS
	select LINGMO_PACKAGE_HAS_LIBEGL
	select LINGMO_PACKAGE_HAS_LIBGLES
	help
	  Install the binary user-space components for the ARM Mali
	  Midgard T76X GPU. This package requires a kernel with the
	  ARM Mali Midgard GPU Kernel Drivers enabled.

	  http://malideveloper.arm.com/resources/drivers/

if LINGMO_PACKAGE_MALI_T76X

config LINGMO_PACKAGE_PROVIDES_LIBEGL
	default "mali-t76x"

config LINGMO_PACKAGE_PROVIDES_LIBGLES
	default "mali-t76x"

endif

comment "mali-t76x needs a glibc toolchain with armhf enabled"
	depends on LINGMO_arm
	depends on !LINGMO_TOOLCHAIN_USES_GLIBC || !LINGMO_ARM_EABIHF
```

## package/mariadb/Config.in
```kconfig
config LINGMO_PACKAGE_MARIADB
	bool "mariadb"
	depends on LINGMO_INSTALL_LIBSTDCPP # fmt
	depends on !LINGMO_STATIC_LIBS
	depends on LINGMO_USE_MMU # fork()
	depends on LINGMO_TOOLCHAIN_HAS_THREADS
	depends on LINGMO_TOOLCHAIN_HAS_ATOMIC || LINGMO_TOOLCHAIN_HAS_SYNC_8
	depends on LINGMO_USE_WCHAR # fmt
	select LINGMO_PACKAGE_LIBAIO
	select LINGMO_PACKAGE_LIBXML2
	select LINGMO_PACKAGE_FMT
	select LINGMO_PACKAGE_NCURSES
	select LINGMO_PACKAGE_OPENSSL
	select LINGMO_PACKAGE_LIBOPENSSL_ENABLE_DES if LINGMO_PACKAGE_LIBOPENSSL
	select LINGMO_PACKAGE_PCRE2
	help
	  MariaDB is one of the most popular database servers in the
	  world.  It's made by the original developers of MySQL and
	  guaranteed to stay open source.

	  http://www.mariadb.org/

comment "mariadb needs a toolchain w/ dynamic library, C++, threads, wchar"
	depends on LINGMO_STATIC_LIBS || !LINGMO_INSTALL_LIBSTDCPP \
		|| !LINGMO_TOOLCHAIN_HAS_THREADS || !LINGMO_USE_WCHAR
	depends on LINGMO_TOOLCHAIN_HAS_ATOMIC || LINGMO_TOOLCHAIN_HAS_SYNC_8

if LINGMO_PACKAGE_MARIADB

config LINGMO_PACKAGE_MARIADB_SERVER
	bool "mariadb server"
	help
	  Install the mariadb server on the target.

config LINGMO_PACKAGE_MARIADB_SERVER_EMBEDDED
	bool "mariadb embedded server"
	depends on LINGMO_PACKAGE_MARIADB_SERVER
	help
	  Install the mariadb embedded server on the target.

endif
```

## package/matchbox-common/Config.in
```kconfig
config LINGMO_PACKAGE_MATCHBOX_COMMON
	bool "matchbox-common"
	depends on LINGMO_PACKAGE_MATCHBOX_PANEL || LINGMO_PACKAGE_MATCHBOX_DESKTOP
	select LINGMO_PACKAGE_MATCHBOX_LIB
	help
	  Common desktop folders and matchbox-session script.

	  http://git.yoctoproject.org/cgit/cgit.cgi/matchbox-common/

config LINGMO_PACKAGE_MATCHBOX_COMMON_PDA
	bool "PDA style app folder"
	depends on LINGMO_PACKAGE_MATCHBOX_COMMON
```

## package/matchbox-desktop/Config.in
```kconfig
config LINGMO_PACKAGE_MATCHBOX_DESKTOP
	bool "matchbox-desktop"
	select LINGMO_PACKAGE_MATCHBOX_LIB
	select LINGMO_PACKAGE_ZLIB
	help
	  A PDA style application launcher or 'item browser'.

	  http://git.yoctoproject.org/cgit/cgit.cgi/matchbox-desktop
```

## package/matchbox-fakekey/Config.in
```kconfig
config LINGMO_PACKAGE_MATCHBOX_FAKEKEY
	bool "matchbox-fakekey"
	select LINGMO_PACKAGE_MATCHBOX_LIB
	select LINGMO_PACKAGE_XLIB_LIBXTST
	help
	  Library for simulating key press events under X11.

	  http://git.yoctoproject.org/cgit/cgit.cgi/libfakekey/
```

## package/matchbox-keyboard/Config.in
```kconfig
config LINGMO_PACKAGE_MATCHBOX_KEYBOARD
	bool "matchbox-keyboard"
	select LINGMO_PACKAGE_LIBPNG
	select LINGMO_PACKAGE_XLIB_LIBXTST
	select LINGMO_PACKAGE_XLIB_LIBXRENDER
	select LINGMO_PACKAGE_XLIB_LIBXFT if !LINGMO_PACKAGE_CAIRO
	select LINGMO_PACKAGE_MATCHBOX_FAKEKEY
	select LINGMO_PACKAGE_MATCHBOX_LIB
	help
	  Virtual Keyboard

	  http://git.yoctoproject.org/cgit/cgit.cgi/matchbox-keyboard/
```
