## package/easy-rsa/Config.in
```kconfig
config LINGMO_PACKAGE_EASY_RSA
	bool "easy-rsa"
	select LINGMO_PACKAGE_OPENSSL # runtime
	select LINGMO_PACKAGE_LIBOPENSSL_BIN if LINGMO_PACKAGE_LIBOPENSSL
	select LINGMO_PACKAGE_LIBRESSL_BIN if LINGMO_PACKAGE_LIBRESSL
	help
	  Simple shell based CA utility

	  This package eases the creation of certificates, for example
	  for openvpn clients.

	  This was formerly part of the openvpn package.

	  easy-rsa is a wrapper script around OpenSSL binaries.

	  https://github.com/OpenVPN/easy-rsa
```

## package/easydbus/Config.in
```kconfig
config LINGMO_PACKAGE_EASYDBUS
	bool "easydbus"
	depends on LINGMO_USE_WCHAR # libglib2
	depends on LINGMO_TOOLCHAIN_HAS_THREADS # libglib2
	depends on LINGMO_USE_MMU # libglib2
	depends on !LINGMO_PACKAGE_LUA_5_4
	select LINGMO_PACKAGE_LIBGLIB2
	help
	  Easy to use DBus library for Lua.

	  https://github.com/mniestroj/easydbus

comment "easydbus needs a toolchain w/ wchar, threads, Lua <= 5.3"
	depends on LINGMO_USE_MMU
	depends on !LINGMO_USE_WCHAR || !LINGMO_TOOLCHAIN_HAS_THREADS || LINGMO_PACKAGE_LUA_5_4
```

## package/easyframes/Config.in
```kconfig
config LINGMO_PACKAGE_EASYFRAMES
	bool "easyframes"
	depends on LINGMO_USE_MMU # fork()
	select LINGMO_PACKAGE_LIBPCAP
	help
	  This is a small and simple command-line tool for network
	  testing.  The tool makes it simple to compose a frame,
	  inject and express what and where frames are expected to be
	  received.

	  https://github.com/microchip-ung/easyframes
```

## package/ebtables/Config.in
```kconfig
config LINGMO_PACKAGE_EBTABLES
	bool "ebtables"
	depends on LINGMO_USE_MMU # fork()
	help
	  Ethernet bridge frame table administration

	  http://ebtables.netfilter.org/

if LINGMO_PACKAGE_EBTABLES

config LINGMO_PACKAGE_EBTABLES_UTILS_SAVE
	bool "ebtables save"
	select LINGMO_PACKAGE_BASH # runtime
	select LINGMO_PACKAGE_BUSYBOX_SHOW_OTHERS # bash
	help
	  Install the ebtables-legacy-save tool

config LINGMO_PACKAGE_EBTABLES_UTILS_RESTORE
	bool "ebtables restore"
	help
	  Install the ebtables-legacy-restore tool

endif
```

## package/ecryptfs-utils/Config.in
```kconfig
config LINGMO_PACKAGE_ECRYPTFS_UTILS
	bool "ecryptfs-utils"
	depends on LINGMO_USE_WCHAR # gettext
	depends on LINGMO_USE_MMU # keyutils
	depends on LINGMO_TOOLCHAIN_HAS_THREADS # libnss -> libnspr
	depends on LINGMO_PACKAGE_LIBNSPR_ARCH_SUPPORT # libnss -> libnspr
	depends on !LINGMO_MIPS_NABI32 # libnss
	depends on !LINGMO_STATIC_LIBS # libnss, keyutils
	select LINGMO_PACKAGE_KEYUTILS
	select LINGMO_PACKAGE_LIBNSS
	# runtime dependency only, some scripts are using the
	# 'gettext' program to get translations
	select LINGMO_PACKAGE_GETTEXT
	# runtime dependency only
	select LINGMO_PACKAGE_GETENT
	help
	  eCryptfs is a POSIX-compliant enterprise cryptographic
	  filesystem for Linux. It is stacked on top of any other
	  Linux filesystem, it stores cryptographic metadata in the
	  header of each file written.

	  The eCryptfs kernel module is available in all Linux kernels
	  since version 2.6.19. This package provides userspace
	  utilities needed to mount eCryptfs.

	  Files are encrypted using a passphrase. Consider building
	  openssl for another method.

	  http://ecryptfs.org

comment "ecryptfs-utils needs a toolchain w/ threads, wchar, dynamic library"
	depends on LINGMO_PACKAGE_LIBNSPR_ARCH_SUPPORT
	depends on LINGMO_USE_MMU
	depends on !LINGMO_TOOLCHAIN_HAS_THREADS || !LINGMO_USE_WCHAR || \
		LINGMO_STATIC_LIBS
```

## package/edid-decode/Config.in
```kconfig
config LINGMO_PACKAGE_EDID_DECODE
	bool "edid-decode"
	depends on LINGMO_INSTALL_LIBSTDCPP
	depends on LINGMO_TOOLCHAIN_GCC_AT_LEAST_4_7 # C++11
	help
	  Decode EDID data in human-readable format.

	  https://git.linuxtv.org/edid-decode.git/

comment "edid-decode needs a toolchain w/ C++, gcc >= 4.7"
	depends on !LINGMO_INSTALL_LIBSTDCPP || \
		!LINGMO_TOOLCHAIN_GCC_AT_LEAST_4_7
```

## package/efivar/Config.in
```kconfig
config LINGMO_PACKAGE_EFIVAR_ARCH_SUPPORTS
	bool
	default y
	depends on LINGMO_arm || LINGMO_aarch64 || LINGMO_i386 || LINGMO_x86_64 \
		|| LINGMO_powerpc64le || LINGMO_mipsel || LINGMO_mips64el \
		|| LINGMO_RISCV_64

config LINGMO_PACKAGE_EFIVAR
	bool "efivar"
	depends on LINGMO_PACKAGE_EFIVAR_ARCH_SUPPORTS
	depends on !LINGMO_STATIC_LIBS # dlfcn.h
	depends on LINGMO_TOOLCHAIN_HEADERS_AT_LEAST_3_12 # linux/nvme.h
	depends on LINGMO_TOOLCHAIN_HAS_THREADS
	# linux/nvme.h has been renamed to linux/nvme_ioctl.h since 4.4,
	# and the efivar source handles that situation. However, some
	# Sourcery CodeBench toolchains use 4.4 kernel headers but they
	# don't have that header file renamed, and that is causing build
	# failures. So, prevent this package to be built using those
	# toolchains.
	depends on !LINGMO_TOOLCHAIN_EXTERNAL_CODESOURCERY_MIPS
	depends on LINGMO_TOOLCHAIN_GCC_AT_LEAST_4_9
	help
	  Tools and libraries to manipulate EFI variables

	  https://github.com/rhboot/efivar

comment "efivar needs a toolchain w/ dynamic library, threads, headers >= 3.12, gcc >= 4.9"
	depends on LINGMO_PACKAGE_EFIVAR_ARCH_SUPPORTS
	depends on LINGMO_STATIC_LIBS || !LINGMO_TOOLCHAIN_HAS_THREADS || \
		!LINGMO_TOOLCHAIN_HEADERS_AT_LEAST_3_12 || \
		!LINGMO_TOOLCHAIN_GCC_AT_LEAST_4_9
	depends on !LINGMO_TOOLCHAIN_EXTERNAL_CODESOURCERY_MIPS
```

## package/ejabberd/Config.in
```kconfig
config LINGMO_PACKAGE_EJABBERD
	bool "ejabberd"
	depends on LINGMO_PACKAGE_ERLANG
	depends on LINGMO_INSTALL_LIBSTDCPP # jiffy, stringprep
	select LINGMO_PACKAGE_ERLANG_EIMP
	select LINGMO_PACKAGE_ERLANG_IDNA # runtime
	select LINGMO_PACKAGE_ERLANG_JIFFY # runtime
	select LINGMO_PACKAGE_ERLANG_JOSE # runtime
	select LINGMO_PACKAGE_ERLANG_LAGER
	select LINGMO_PACKAGE_ERLANG_P1_ACME # runtime
	select LINGMO_PACKAGE_ERLANG_P1_CACHE_TAB
	select LINGMO_PACKAGE_ERLANG_P1_MQTREE # runtime
	select LINGMO_PACKAGE_ERLANG_P1_OAUTH2 # runtime
	select LINGMO_PACKAGE_ERLANG_P1_PKIX # runtime
	select LINGMO_PACKAGE_ERLANG_P1_SIP
	select LINGMO_PACKAGE_ERLANG_P1_STRINGPREP
	select LINGMO_PACKAGE_ERLANG_P1_STUN
	select LINGMO_PACKAGE_ERLANG_P1_TLS
	select LINGMO_PACKAGE_ERLANG_P1_UTILS
	select LINGMO_PACKAGE_ERLANG_P1_XML
	select LINGMO_PACKAGE_ERLANG_P1_XMPP
	select LINGMO_PACKAGE_ERLANG_P1_YAML
	select LINGMO_PACKAGE_ERLANG_P1_YCONF # runtime
	select LINGMO_PACKAGE_ERLANG_P1_ZLIB
	select LINGMO_PACKAGE_GETENT
	select LINGMO_PACKAGE_OPENSSL
	help
	  Ejabberd is a Jabber/XMPP instant messaging server, written
	  in Erlang/OTP. Among other features, ejabberd is
	  cross-platform, fault-tolerant, clusterable and modular.

	  http://www.ejabberd.im

comment "ejabberd needs erlang, toolchain w/ C++"
	depends on !LINGMO_PACKAGE_ERLANG || !LINGMO_INSTALL_LIBSTDCPP
```

## package/elfutils/Config.in
```kconfig
comment "elfutils needs a toolchain w/ wchar, dynamic library, threads"
	depends on !LINGMO_USE_WCHAR || LINGMO_STATIC_LIBS \
		|| !LINGMO_TOOLCHAIN_HAS_THREADS

config LINGMO_PACKAGE_ELFUTILS
	bool "elfutils"
	depends on LINGMO_USE_WCHAR
	depends on !LINGMO_STATIC_LIBS
	depends on LINGMO_TOOLCHAIN_HAS_THREADS
	select LINGMO_PACKAGE_ZLIB
	select LINGMO_PACKAGE_ARGP_STANDALONE if !LINGMO_TOOLCHAIN_USES_GLIBC
	select LINGMO_PACKAGE_MUSL_FTS if !LINGMO_TOOLCHAIN_USES_GLIBC
	help
	  Libraries/utilities to handle ELF objects (drop in
	  replacement for libelf).

	  Note that this option only installs the libraries, and not
	  the programs.

	  https://sourceware.org/elfutils/

if LINGMO_PACKAGE_ELFUTILS

config LINGMO_PACKAGE_ELFUTILS_PROGS
	bool "Install programs"
	depends on LINGMO_TOOLCHAIN_USES_GLIBC
	help
	  This option tells elfutils to not only install the libelf
	  libraries, but also the elfutils programs.

endif
```

## package/ell/Config.in
```kconfig
config LINGMO_PACKAGE_ELL
	bool "ell"
	depends on LINGMO_TOOLCHAIN_HAS_SYNC_4
	depends on LINGMO_TOOLCHAIN_HEADERS_AT_LEAST_4_12
	depends on LINGMO_USE_WCHAR
	help
	  Embedded Linux library (ell)

	  https://01.org/ell

comment "ell needs a toolchain w/ wchar, headers >= 4.12"
	depends on LINGMO_TOOLCHAIN_HAS_SYNC_4
	depends on !LINGMO_USE_WCHAR || !LINGMO_TOOLCHAIN_HEADERS_AT_LEAST_4_12
```

## package/embiggen-disk/Config.in
```kconfig
config LINGMO_PACKAGE_EMBIGGEN_DISK
	bool "embiggen-disk"
	depends on LINGMO_PACKAGE_HOST_GO_TARGET_ARCH_SUPPORTS
	depends on LINGMO_PACKAGE_HOST_GO_TARGET_CGO_LINKING_SUPPORTS
	depends on LINGMO_TOOLCHAIN_HAS_THREADS
	depends on !LINGMO_TOOLCHAIN_USES_UCLIBC # no fexecve
	depends on LINGMO_USE_MMU # util-linux
	select LINGMO_PACKAGE_UTIL_LINUX # sfdisk
	select LINGMO_PACKAGE_UTIL_LINUX_BINARIES # sfdisk
	help
	  embiggen-disk is a tool to resize disk partitions at runtime.

	  https://github.com/bradfitz/embiggen-disk

comment "embiggen-disk needs a glibc or musl toolchain w/ threads"
	depends on LINGMO_USE_MMU
	depends on LINGMO_PACKAGE_HOST_GO_TARGET_ARCH_SUPPORTS && \
		LINGMO_PACKAGE_HOST_GO_TARGET_CGO_LINKING_SUPPORTS
	depends on !LINGMO_TOOLCHAIN_HAS_THREADS || LINGMO_TOOLCHAIN_USES_UCLIBC
```

## package/enchant/Config.in
```kconfig
config LINGMO_PACKAGE_ENCHANT
	bool "enchant"
	depends on LINGMO_INSTALL_LIBSTDCPP
	depends on LINGMO_USE_WCHAR # glib2
	depends on LINGMO_TOOLCHAIN_HAS_THREADS # glib2
	depends on LINGMO_USE_MMU # glib2
	select LINGMO_PACKAGE_LIBGLIB2
	help
	  Enchant is a spell-checking library that provides a consistent
	  API across a number of spell-checking system backends.

	  https://abiword.github.io/enchant/

comment "enchant needs a toolchain w/ C++, threads, wchar"
	depends on LINGMO_USE_MMU
	depends on !LINGMO_INSTALL_LIBSTDCPP || !LINGMO_USE_WCHAR || \
		!LINGMO_TOOLCHAIN_HAS_THREADS
```

## package/erlang-eimp/Config.in
```kconfig
config LINGMO_PACKAGE_ERLANG_EIMP
	bool "erlang-eimp"
	select LINGMO_PACKAGE_ERLANG_P1_UTILS
	select LINGMO_PACKAGE_GD
	select LINGMO_PACKAGE_GD_WEBPNG
	select LINGMO_PACKAGE_JPEG
	select LINGMO_PACKAGE_LIBPNG
	select LINGMO_PACKAGE_WEBP
	help
	  Erlang Image Manipulation Process

	  https://github.com/processone/eimp
```

## package/erlang-jiffy/Config.in
```kconfig
comment "erlang-jiffy needs a toolchain w/ C++"
	depends on !LINGMO_INSTALL_LIBSTDCPP

config LINGMO_PACKAGE_ERLANG_JIFFY
	bool "erlang-jiffy"
	depends on LINGMO_INSTALL_LIBSTDCPP
	help
	  JSON NIFs for Erlang.

	  https://github.com/davisp/jiffy
```

## package/erlang-jose/Config.in
```kconfig
config LINGMO_PACKAGE_ERLANG_JOSE
	bool "erlang-jose"
	select LINGMO_PACKAGE_ERLANG_BASE64URL
	help
	  JSON Object Signing and Encryption (JOSE) for Erlang and
	  Elixir.

	  https://github.com/potatosalad/erlang-jose
```

## package/erlang-p1-acme/Config.in
```kconfig
config LINGMO_PACKAGE_ERLANG_P1_ACME
	bool "erlang-p1-acme"
	depends on LINGMO_INSTALL_LIBSTDCPP # erlang-jiffy
	select LINGMO_PACKAGE_ERLANG_IDNA
	select LINGMO_PACKAGE_ERLANG_JIFFY
	select LINGMO_PACKAGE_ERLANG_JOSE
	select LINGMO_PACKAGE_ERLANG_P1_YCONF
	help
	  ACME client library for Erlang.

	  https://github.com/processone/p1_acme

comment "erlang-p1-acme needs a toolchain w/ C++"
	depends on !LINGMO_INSTALL_LIBSTDCPP
```

## package/erlang-p1-cache-tab/Config.in
```kconfig
config LINGMO_PACKAGE_ERLANG_P1_CACHE_TAB
	bool "erlang-p1-cache-tab"
	select LINGMO_PACKAGE_ERLANG_P1_UTILS
	help
	  Erlang library implementing cache tables

	  https://github.com/processone/cache_tab
```

## package/erlang-p1-mqtree/Config.in
```kconfig
config LINGMO_PACKAGE_ERLANG_P1_MQTREE
	bool "erlang-p1-mqtree"
	select LINGMO_PACKAGE_ERLANG_P1_UTILS
	help
	  Index tree for MQTT topic filters.

	  https://github.com/processone/mqtree
```

## package/erlang-p1-sip/Config.in
```kconfig
config LINGMO_PACKAGE_ERLANG_P1_SIP
	bool "erlang-p1-sip"
	select LINGMO_PACKAGE_ERLANG_P1_STUN
	select LINGMO_PACKAGE_ERLANG_P1_TLS
	select LINGMO_PACKAGE_ERLANG_P1_UTILS
	help
	  SIP library for Erlang

	  https://github.com/processone/p1_sip
```

## package/erlang-p1-stringprep/Config.in
```kconfig
comment "erlang-p1-stringprep needs a toolchain w/ C++"
	depends on !LINGMO_INSTALL_LIBSTDCPP

config LINGMO_PACKAGE_ERLANG_P1_STRINGPREP
	bool "erlang-p1-stringprep"
	depends on LINGMO_INSTALL_LIBSTDCPP
	select LINGMO_PACKAGE_ERLANG_P1_UTILS
	help
	  Erlang interface to stringprep

	  https://github.com/processone/stringprep
```

## package/erlang-p1-stun/Config.in
```kconfig
config LINGMO_PACKAGE_ERLANG_P1_STUN
	bool "erlang-p1-stun"
	select LINGMO_PACKAGE_ERLANG_P1_TLS
	select LINGMO_PACKAGE_ERLANG_P1_UTILS
	help
	  STUN library for Erlang

	  https://github.com/processone/stun
```

## package/erlang-p1-xml/Config.in
```kconfig
config LINGMO_PACKAGE_ERLANG_P1_XML
	bool "erlang-p1-xml"
	select LINGMO_PACKAGE_ERLANG_P1_UTILS
	select LINGMO_PACKAGE_EXPAT
	help
	  XML utilities for Erlang

	  https://github.com/processone/xml
```

## package/erlang-p1-xmpp/Config.in
```kconfig
comment "erlang-p1-xmpp needs a toolchain w/ C++"
	depends on !LINGMO_INSTALL_LIBSTDCPP

config LINGMO_PACKAGE_ERLANG_P1_XMPP
	bool "erlang-p1-xmpp"
	depends on LINGMO_INSTALL_LIBSTDCPP # erlang-p1-stringprep
	select LINGMO_PACKAGE_ERLANG_IDNA
	select LINGMO_PACKAGE_ERLANG_P1_XML
	select LINGMO_PACKAGE_ERLANG_P1_STRINGPREP
	select LINGMO_PACKAGE_ERLANG_P1_TLS
	select LINGMO_PACKAGE_ERLANG_P1_UTILS
	select LINGMO_PACKAGE_ERLANG_P1_ZLIB
	help
	  XMPP library for Erlang.

	  https://github.com/processone/xmpp
```

## package/erlang-p1-yaml/Config.in
```kconfig
config LINGMO_PACKAGE_ERLANG_P1_YAML
	bool "erlang-p1-yaml"
	select LINGMO_PACKAGE_ERLANG_P1_UTILS
	select LINGMO_PACKAGE_LIBYAML
	help
	  Erlang wrapper for libyaml C library

	  https://github.com/processone/p1_yaml
```

## package/erlang-p1-yconf/Config.in
```kconfig
config LINGMO_PACKAGE_ERLANG_P1_YCONF
	bool "erlang-p1-yconf"
	select LINGMO_PACKAGE_ERLANG_P1_YAML
	help
	  YAML configuration processor.
```
