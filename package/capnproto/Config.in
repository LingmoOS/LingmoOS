## package/clpeak/Config.in
```kconfig
config LINGMO_PACKAGE_CLPEAK
	bool "clpeak"
	depends on LINGMO_PACKAGE_HAS_LIBOPENCL
	depends on LINGMO_INSTALL_LIBSTDCPP
	depends on LINGMO_TOOLCHAIN_GCC_AT_LEAST_4_8 # C++11
	select LINGMO_PACKAGE_OPENCL_CLHPP
	help
	  clpeak is a tool that profiles OpenCL devices
	  to find their peak capacities

	  https://github.com/krrishnarraj/clpeak

comment "clpeak needs an OpenCL provider, a toolchain w/ C++, gcc >= 4.8"
	depends on !LINGMO_PACKAGE_HAS_LIBOPENCL \
		|| !LINGMO_INSTALL_LIBSTDCPP || !LINGMO_TOOLCHAIN_GCC_AT_LEAST_4_8
```

## package/cmake/Config.in
```kconfig
config LINGMO_PACKAGE_CMAKE_ARCH_SUPPORTS
	bool
	default y
	depends on LINGMO_arm    || LINGMO_armeb       || LINGMO_aarch64  || \
		LINGMO_m68k      || LINGMO_mips        || LINGMO_mips64   || \
		LINGMO_mipsel    || LINGMO_mips64el    || LINGMO_powerpc  || \
		LINGMO_powerpc64 || LINGMO_powerpc64le || LINGMO_sparc    || \
		LINGMO_i386      || LINGMO_x86_64      || LINGMO_xtensa   || \
		LINGMO_s390x     || LINGMO_riscv

config LINGMO_PACKAGE_CMAKE
	bool "cmake"

config LINGMO_PACKAGE_CMAKE_CTEST
	bool "ctest"
	depends on LINGMO_PACKAGE_CMAKE_ARCH_SUPPORTS
	depends on LINGMO_TOOLCHAIN_GCC_AT_LEAST_4_9 # jsoncpp, libuv
	depends on LINGMO_USE_WCHAR # libarchive
	depends on LINGMO_INSTALL_LIBSTDCPP
	depends on !LINGMO_STATIC_LIBS
	depends on LINGMO_TOOLCHAIN_HAS_THREADS_NPTL # libuv
	depends on LINGMO_USE_MMU # libuv
	depends on LINGMO_TOOLCHAIN_HAS_SYNC_4 # libuv
	select LINGMO_PACKAGE_CMAKE
	select LINGMO_PACKAGE_ZLIB
	select LINGMO_PACKAGE_JSONCPP
	select LINGMO_PACKAGE_LIBCURL
	select LINGMO_PACKAGE_LIBARCHIVE
	select LINGMO_PACKAGE_EXPAT
	select LINGMO_PACKAGE_BZIP2
	select LINGMO_PACKAGE_XZ
	select LINGMO_PACKAGE_LIBUV
	select LINGMO_PACKAGE_RHASH
	help
	  CTest is a testing tool distributed as a part of CMake. It
	  can be used to automate updating (using CVS for example),
	  configuring, building, testing, performing memory checking,
	  performing coverage, and submitting results to a CDash or
	  Dart dashboard system.

	  http://www.cmake.org/

comment "ctest needs a toolchain w/ C++, wchar, dynamic library, gcc >= 4.9, NPTL"
	depends on LINGMO_PACKAGE_CMAKE_ARCH_SUPPORTS
	depends on LINGMO_USE_MMU
	depends on LINGMO_TOOLCHAIN_HAS_SYNC_4
	depends on !LINGMO_INSTALL_LIBSTDCPP || !LINGMO_USE_WCHAR || \
		LINGMO_STATIC_LIBS || !LINGMO_TOOLCHAIN_GCC_AT_LEAST_4_9 || \
		!LINGMO_TOOLCHAIN_HAS_THREADS_NPTL
```
