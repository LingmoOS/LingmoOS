## package/capnproto/Config.in
```kconfig
config LINGMO_PACKAGE_CAPNPROTO
	bool "capnproto"
	depends on LINGMO_USE_MMU
	depends on LINGMO_HOST_GCC_AT_LEAST_5 # C++14
	depends on LINGMO_TOOLCHAIN_GCC_AT_LEAST_5 # C++14
	depends on LINGMO_INSTALL_LIBSTDCPP
	depends on LINGMO_TOOLCHAIN_HAS_THREADS
	depends on LINGMO_TOOLCHAIN_HAS_ATOMIC
	depends on !LINGMO_TOOLCHAIN_HAS_GCC_BUG_64735
	depends on LINGMO_TOOLCHAIN_HAS_UCONTEXT
	help
	  Cap'n Proto is an insanely fast data interchange format
	  and capability-based RPC system. Think JSON, except
	  binary. Or think Protocol Buffers, except faster. In
	  fact, in benchmarks, Cap'n Proto is INFINITY TIMES
	  faster than Protocol Buffers.

	  https://capnproto.org/index.html

comment "capnproto needs host and target gcc >= 5 w/ C++14, threads, atomic, ucontext and not gcc bug 64735"
	depends on LINGMO_USE_MMU
	depends on !LINGMO_HOST_GCC_AT_LEAST_5 || \
		!LINGMO_TOOLCHAIN_GCC_AT_LEAST_5 || \
		!LINGMO_INSTALL_LIBSTDCPP || \
		!LINGMO_TOOLCHAIN_HAS_THREADS || \
		!LINGMO_TOOLCHAIN_HAS_ATOMIC || \
		LINGMO_TOOLCHAIN_HAS_GCC_BUG_64735 || \
		!LINGMO_TOOLCHAIN_HAS_UCONTEXT
```

## package/caps/Config.in
```kconfig
config LINGMO_PACKAGE_CAPS
	bool "caps"
	depends on LINGMO_INSTALL_LIBSTDCPP
	depends on !LINGMO_STATIC_LIBS
	help
	  CAPS is a collection of audio plugins comprising virtual
	  guitar amplification and a small range of basic classic
	  effects, signal processors and generators of often
	  elementary and occasionally exotic nature.

	  The plugins aim to satisfy the highest demands in sound
	  quality with maximal computational efficiency and zero
	  latency.

	  http://quitte.de/dsp/caps.html

comment "caps needs a toolchain w/ C++, dynamic library"
	depends on !LINGMO_INSTALL_LIBSTDCPP || LINGMO_STATIC_LIBS
```

## package/casync/Config.in
```kconfig
config LINGMO_PACKAGE_CASYNC
	bool "casync"
	depends on LINGMO_TOOLCHAIN_USES_GLIBC # scandirat() is not implemented by musl and uclibc-ng
	select LINGMO_PACKAGE_ACL
	select LINGMO_PACKAGE_LIBCURL
	select LINGMO_PACKAGE_OPENSSL
	help
	  Content-Addressable Data Synchronization Tool

	  https://github.com/systemd/casync

comment "casync needs a glibc toolchain"
	depends on !LINGMO_TOOLCHAIN_USES_GLIBC
```

## package/catatonit/Config.in
```kconfig
config LINGMO_PACKAGE_CATATONIT
	bool "catatonit"
	depends on LINGMO_USE_MMU
	help
	  catatonit is a simple but valid init binary to act as
	  PID 1 for containers.

	  https://github.com/openSUSE/catatonit
```

## package/cc-tool/Config.in
```kconfig
config LINGMO_PACKAGE_CC_TOOL
	bool "cc-tool"
	depends on LINGMO_INSTALL_LIBSTDCPP
	depends on LINGMO_TOOLCHAIN_HAS_THREADS
	depends on LINGMO_TOOLCHAIN_SUPPORTS_ALWAYS_LOCKFREE_ATOMIC_INTS # boost-filesystem
	depends on LINGMO_USE_WCHAR # boost-filesystem
	depends on LINGMO_TOOLCHAIN_GCC_AT_LEAST_4_9 # libusb
	select LINGMO_PACKAGE_LIBUSB
	select LINGMO_PACKAGE_BOOST
	select LINGMO_PACKAGE_BOOST_PROGRAM_OPTIONS
	select LINGMO_PACKAGE_BOOST_SYSTEM
	select LINGMO_PACKAGE_BOOST_REGEX
	select LINGMO_PACKAGE_BOOST_FILESYSTEM
	help
	  cc-tool provides support for Texas Instruments CC Debugger
	  for Linux OS in order to program 8051-based System-On-Chip
	  devices: CC254x CC253x CC243x CC251x CC111x

	  https://github.com/dashesy/cc-tool/

comment "cc-tool needs a toolchain w/ C++, threads, wchar, gcc >= 4.9 "
	depends on LINGMO_TOOLCHAIN_SUPPORTS_ALWAYS_LOCKFREE_ATOMIC_INTS
	depends on !LINGMO_INSTALL_LIBSTDCPP || \
		!LINGMO_TOOLCHAIN_HAS_THREADS || !LINGMO_USE_WCHAR || \
		!LINGMO_TOOLCHAIN_GCC_AT_LEAST_4_9
```

## package/ccid/Config.in
```kconfig
config LINGMO_PACKAGE_CCID
	bool "ccid"
	depends on LINGMO_TOOLCHAIN_HAS_THREADS # libusb
	depends on LINGMO_TOOLCHAIN_GCC_AT_LEAST_4_9 # libusb, pcsc-lite
	depends on LINGMO_USE_MMU # pcsc-lite
	depends on !LINGMO_STATIC_LIBS # pcsc-lite
	select LINGMO_PACKAGE_PCSC_LITE
	select LINGMO_PACKAGE_LIBUSB
	help
	  PC/SC driver for USB CCID smart card readers

	  https://ccid.apdu.fr/

comment "ccid needs a toolchain w/ threads, dynamic library, gcc >= 4.9"
	depends on LINGMO_USE_MMU
	depends on !LINGMO_TOOLCHAIN_HAS_THREADS || LINGMO_STATIC_LIBS || \
		!LINGMO_TOOLCHAIN_GCC_AT_LEAST_4_9
```

## package/cctz/Config.in
```kconfig
config LINGMO_PACKAGE_CCTZ
	bool "cctz"
	depends on LINGMO_INSTALL_LIBSTDCPP
	depends on LINGMO_TOOLCHAIN_HAS_THREADS
	depends on LINGMO_TOOLCHAIN_GCC_AT_LEAST_4_8 # C++11
	select LINGMO_TARGET_TZ_INFO # runtime dependency
	help
	  CCTZ is a C++ library for translating between absolute
	  and civil times using the rules of a time zone.

	  https://github.com/google/cctz

if LINGMO_PACKAGE_CCTZ

config LINGMO_PACKAGE_CCTZ_INSTALL_TOOLS
	bool "Install tools"
	help
	  This option allows installing CCTZ tools.

config LINGMO_PACKAGE_CCTZ_INSTALL_EXAMPLES
	bool "Install example programs"
	help
	  This option allows installing CCTZ example programs.

endif

comment "cctz needs a toolchain w/ C++, threads, gcc >= 4.8"
	depends on !LINGMO_INSTALL_LIBSTDCPP || \
		!LINGMO_TOOLCHAIN_HAS_THREADS || !LINGMO_TOOLCHAIN_GCC_AT_LEAST_4_8
```

## package/cdrkit/Config.in
```kconfig
config LINGMO_PACKAGE_CDRKIT
	bool "cdrkit"
	depends on LINGMO_USE_MMU # fork
	# Needed for libbz
	select LINGMO_PACKAGE_BZIP2
	select LINGMO_PACKAGE_LIBCAP
	select LINGMO_PACKAGE_ZLIB
	help
	  cdrkit is a suite of programs for recording CDs and DVDs,
	  blanking CD-RW media, creating ISO-9660 filesystem images,
	  extracting audio CD data, and more.

	  http://www.cdrkit.org/
```

## package/cegui/Config.in
```kconfig
comment "cegui needs a toolchain w/ C++, threads, dynamic library, wchar, gcc >= 5"
	depends on !LINGMO_TOOLCHAIN_HAS_THREADS || !LINGMO_INSTALL_LIBSTDCPP \
			|| LINGMO_STATIC_LIBS || !LINGMO_USE_WCHAR \
			|| !LINGMO_TOOLCHAIN_GCC_AT_LEAST_5

config LINGMO_PACKAGE_CEGUI
	bool "cegui"
	depends on LINGMO_INSTALL_LIBSTDCPP
	depends on !LINGMO_STATIC_LIBS
	depends on LINGMO_TOOLCHAIN_GCC_AT_LEAST_5 # C++11 PR59987
	depends on LINGMO_TOOLCHAIN_HAS_THREADS
	depends on LINGMO_USE_WCHAR
	select LINGMO_PACKAGE_GLM
	select LINGMO_PACKAGE_LIBGLFW if LINGMO_PACKAGE_HAS_LIBGL # SampleBrowser dependency
	select LINGMO_PACKAGE_LIBICONV if !LINGMO_ENABLE_LOCALE
	help
	  Crazy Eddie's GUI System is a free library providing windowing
	  and widgets for graphics APIs / engines where such
	  functionality is not natively available, or severely lacking.
	  The library is object orientated, written in C++, and targeted
	  at games developers who should be spending their time creating
	  great games, not building GUI sub-systems!

	  http://www.cegui.org.uk/
```

## package/cereal/Config.in
```kconfig
config LINGMO_PACKAGE_CEREAL
	bool "cereal"
	depends on LINGMO_USE_WCHAR
	depends on LINGMO_INSTALL_LIBSTDCPP
	depends on LINGMO_TOOLCHAIN_HAS_THREADS
	depends on LINGMO_TOOLCHAIN_GCC_AT_LEAST_4_7 # C++11
	help
	  cereal is a header-only C++11 serialization library.
	  cereal takes arbitrary data types and reversibly turns them
	  into different representations, such as compact binary
	  encodings, XML or JSON. cereal was designed to be fast,
	  light-weight, and easy to extend - it has no external
	  dependencies and can be easily bundled with other code or used
	  standalone.

	  https://github.com/USCiLab/cereal

comment "cereal needs a toolchain w/ C++, gcc >= 4.7, threads, wchar"
	depends on !LINGMO_INSTALL_LIBSTDCPP  || !LINGMO_TOOLCHAIN_HAS_THREADS || \
		!LINGMO_USE_WCHAR || !LINGMO_TOOLCHAIN_GCC_AT_LEAST_4_7
```

## package/cgic/Config.in
```kconfig
config LINGMO_PACKAGE_CGIC
	bool "cgic"
	help
	  C CGI library

	  http://www.boutell.com/cgic/
```

## package/cgilua/Config.in
```kconfig
config LINGMO_PACKAGE_CGILUA
	bool "cgilua"
	select LINGMO_PACKAGE_LUAFILESYSTEM # runtime
	help
	  CGILua is a tool for creating dynamic HTML pages
	  and manipulating input data from Web forms.

	  http://keplerproject.github.com/cgilua
```

## package/checkpolicy/Config.in
```kconfig
config LINGMO_PACKAGE_CHECKPOLICY
	bool "checkpolicy"
	depends on LINGMO_TOOLCHAIN_HAS_THREADS # libselinux
	depends on !LINGMO_STATIC_LIBS # libselinux
	depends on LINGMO_TOOLCHAIN_GCC_AT_LEAST_5 # libselinux -> libsepol
	select LINGMO_PACKAGE_LIBSELINUX
	select LINGMO_PACKAGE_FLEX
	help
	  checkpolicy is the SELinux policy compiler. It uses libsepol
	  to generate the binary policy. checkpolicy uses the static
	  libsepol since it deals with low level details of the policy
	  that have not been encapsulated/abstracted by a proper
	  shared library interface.

	  http://selinuxproject.org/page/Main_Page

comment "checkpolicy needs a toolchain w/ threads, dynamic library, gcc >= 5"
	depends on !LINGMO_TOOLCHAIN_HAS_THREADS || LINGMO_STATIC_LIBS || \
		!LINGMO_TOOLCHAIN_GCC_AT_LEAST_5
```

## package/chipmunk/Config.in
```kconfig
comment "chipmunk needs an OpenGL backend"
	depends on !LINGMO_PACKAGE_HAS_LIBGL

config LINGMO_PACKAGE_CHIPMUNK
	bool "chipmunk"
	depends on LINGMO_PACKAGE_HAS_LIBGL
	help
	  Chipmunk2D is a simple, lightweight, fast and portable 2D
	  rigid body physics library written in C.

	  http://chipmunk-physics.net/
```

## package/chocolate-doom/Config.in
```kconfig
config LINGMO_PACKAGE_CHOCOLATE_DOOM
	bool "chocolate-doom"
	depends on LINGMO_USE_MMU # fork()
	depends on !LINGMO_STATIC_LIBS # sdl2
	select LINGMO_PACKAGE_SDL2
	select LINGMO_PACKAGE_SDL2_MIXER
	select LINGMO_PACKAGE_SDL2_NET
	help
	  Chocolate Doom is a set of conservative source ports for Doom,
	  Heretic, Hexen and Strife, with a philosophy of preserving the
	  look, feel, and bugs of the vanilla versions of each.

	  http://www.chocolate-doom.org

comment "chocolate-doom needs a toolchain w/ dynamic library"
	depends on LINGMO_USE_MMU
	depends on LINGMO_STATIC_LIBS
```

## package/chrony/Config.in
```kconfig
config LINGMO_PACKAGE_CHRONY
	bool "chrony"
	depends on LINGMO_USE_MMU # fork()
	select LINGMO_PACKAGE_LIBCAP
	help
	  Chrony is a pair of programs which are used to maintain the
	  accuracy of the system clock.

	  http://chrony.tuxfamily.org/

if LINGMO_PACKAGE_CHRONY

config LINGMO_PACKAGE_CHRONY_DEBUG_LOGGING
	bool "enable debug logging support"
	help
	  Enable support for debug logging output from Chrony when
	  enabled at runtime. If disabled, code for debug logging will
	  not be compiled in.

endif
```

## package/cifs-utils/Config.in
```kconfig
config LINGMO_PACKAGE_CIFS_UTILS
	bool "cifs-utils"
	# uses fork()
	depends on LINGMO_USE_MMU
	help
	  The in-kernel CIFS filesystem is generally the preferred
	  method for mounting SMB/CIFS shares on Linux. The in-kernel
	  CIFS filesystem relies on a set of user-space tools. That
	  package of tools is called cifs-utils. Although not really
	  part of Samba proper, these tools were originally part of
	  the Samba package. For several reasons, shipping these tools
	  as part of Samba was problematic and it was deemed better to
	  split them off into their own package.

	  http://wiki.samba.org/index.php/LinuxCIFS_utils

if LINGMO_PACKAGE_CIFS_UTILS

config LINGMO_PACKAGE_CIFS_UTILS_SMBTOOLS
	bool "smbtools"
	depends on LINGMO_USE_WCHAR # python3
	depends on LINGMO_TOOLCHAIN_HAS_THREADS # python3
	depends on !LINGMO_STATIC_LIBS # python3
	select LINGMO_PACKAGE_PYTHON3 # runtime
	help
	  Install the smb tools smbinfo and smb2-quota (python
	  implementations).

comment "smbtools needs a toolchain w/ wchar, threads, dynamic library"
	depends on !LINGMO_USE_WCHAR || !LINGMO_TOOLCHAIN_HAS_THREADS || \
		LINGMO_STATIC_LIBS

endif
```

## package/circus/Config.in
```kconfig
config LINGMO_PACKAGE_CIRCUS
	bool "circus"
	depends on LINGMO_PACKAGE_PYTHON3 # python-tornado
	depends on LINGMO_INSTALL_LIBSTDCPP # pyzmq -> zeromq
	depends on LINGMO_TOOLCHAIN_HAS_THREADS # pyzmq -> zeromq
	select LINGMO_PACKAGE_PYTHON_IOWAIT # runtime
	select LINGMO_PACKAGE_PYTHON_PSUTIL # runtime
	select LINGMO_PACKAGE_PYTHON_PYZMQ # runtime
	select LINGMO_PACKAGE_PYTHON_TORNADO # runtime
	select LINGMO_PACKAGE_PYTHON_SETUPTOOLS # runtime
	help
	  Circus is a program that will let you run and watch multiple
	  processes and sockets.

	  https://circus.readthedocs.org/en/latest/

comment "circus needs Python 3 and a toolchain w/ C++, threads"
	depends on !LINGMO_INSTALL_LIBSTDCPP || !LINGMO_TOOLCHAIN_HAS_THREADS || \
		!LINGMO_PACKAGE_PYTHON3
```

## package/civetweb/Config.in
```kconfig
config LINGMO_PACKAGE_CIVETWEB
	bool "civetweb"
	depends on LINGMO_TOOLCHAIN_HAS_THREADS
	depends on LINGMO_USE_MMU # fork()
	select LINGMO_PACKAGE_CIVETWEB_SERVER if !LINGMO_PACKAGE_CIVETWEB_LIB
	help
	  Full featured embedded web server with Lua support.

	  https://sourceforge.net/projects/civetweb

if LINGMO_PACKAGE_CIVETWEB

config LINGMO_PACKAGE_CIVETWEB_SERVER
	bool "enable the web server application"
	help
	  Include the web server and its config files.

config LINGMO_PACKAGE_CIVETWEB_LIB
	bool "enable library for embedding"
	help
	  Enable the civetweb library for embedding in another
	  application.

endif

comment "civetweb needs a toolchain w/ threads"
	depends on LINGMO_USE_MMU
	depends on !LINGMO_TOOLCHAIN_HAS_THREADS
```

## package/cjson/Config.in
```kconfig
config LINGMO_PACKAGE_CJSON
	bool "cJSON"
	help
	  An ultra-lightweight, portable, single-file, simple-as-can-be
	  ANSI-C compliant JSON parser, under MIT license.

	  https://github.com/DaveGamble/cJSON

if LINGMO_PACKAGE_CJSON

config LINGMO_PACKAGE_CJSON_UTILS
	bool "cJSON utils"
	help
	  Supplementary library with support for JSON Pointer
	  (RFC-6901), JSON Patch (RFC-6902), JSON Merge Patch
	  (RFC-7386), and more.

endif
```

## package/clamav/Config.in
```kconfig
config LINGMO_PACKAGE_CLAMAV
	bool "clamav"
	depends on LINGMO_INSTALL_LIBSTDCPP
	depends on LINGMO_PACKAGE_HOST_RUSTC_TARGET_ARCH_SUPPORTS
	depends on LINGMO_TOOLCHAIN_HAS_THREADS
	depends on LINGMO_USE_MMU # fork()
	depends on !LINGMO_STATIC_LIBS # dlopen
	depends on LINGMO_USE_WCHAR
	select LINGMO_PACKAGE_BZIP2
	select LINGMO_PACKAGE_HOST_RUSTC
	select LINGMO_PACKAGE_JSON_C
	select LINGMO_PACKAGE_LIBCURL
	select LINGMO_PACKAGE_LIBMSPACK
	select LINGMO_PACKAGE_LIBXML2
	select LINGMO_PACKAGE_MUSL_FTS if !LINGMO_TOOLCHAIN_USES_GLIBC
	select LINGMO_PACKAGE_OPENSSL
	select LINGMO_PACKAGE_PCRE2
	select LINGMO_PACKAGE_ZLIB
	select LINGMO_PACKAGE_ZLIB_FORCE_LIBZLIB
	help
	  ClamAV is an open source antivirus engine for detecting
	  trojans, viruses, malware & other malicious threats.

	  http://www.clamav.net

comment "clamav needs a toolchain w/ C++, dynamic library, threads, wchar"
	depends on !LINGMO_INSTALL_LIBSTDCPP || LINGMO_STATIC_LIBS \
		|| !LINGMO_TOOLCHAIN_HAS_THREADS || !LINGMO_USE_WCHAR
	depends on LINGMO_PACKAGE_HOST_RUSTC_TARGET_ARCH_SUPPORTS
	depends on LINGMO_USE_MMU
```

## package/cli11/Config.in
```kconfig
config LINGMO_PACKAGE_CLI11
	bool "cli11"
	depends on LINGMO_INSTALL_LIBSTDCPP
	depends on LINGMO_TOOLCHAIN_GCC_AT_LEAST_4_8 # C++11
	help
	  CLI11 is a command line parser for C++11 and beyond that
	  provides a rich feature set with a simple and intuitive
	  interface.

	  https://github.com/CLIUtils/CLI11

comment "cli11 needs a toolchain w/ C++, gcc >= 4.8"
	depends on !LINGMO_INSTALL_LIBSTDCPP || !LINGMO_TOOLCHAIN_GCC_AT_LEAST_4_8
```

## package/clinfo/Config.in
```kconfig
config LINGMO_PACKAGE_CLINFO
	bool "clinfo"
	depends on LINGMO_PACKAGE_HAS_LIBOPENCL
	help
	  clinfo is a simple command-line application that enumerates
	  all possible (known) properties of the OpenCL platform and
	  devices available on the system.

	  https://github.com/Oblomov/clinfo

comment "clinfo needs an OpenCL provider"
	depends on !LINGMO_PACKAGE_HAS_LIBOPENCL
```
