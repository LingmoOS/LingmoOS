## package/usbguard/Config.in
```kconfig
config LINGMO_PACKAGE_USBGUARD
	bool "usbguard"
	depends on LINGMO_PACKAGE_PROTOBUF_ARCH_SUPPORTS # protobuf
	depends on LINGMO_INSTALL_LIBSTDCPP # protobuf
	depends on LINGMO_TOOLCHAIN_HAS_THREADS # libqb, protobuf
	depends on LINGMO_TOOLCHAIN_GCC_AT_LEAST_8 # C++17 filesystem
	depends on !LINGMO_STATIC_LIBS # libqb, protobuf
	depends on !LINGMO_TOOLCHAIN_HAS_GCC_BUG_64735 # std::future
	select LINGMO_PACKAGE_PROTOBUF
	select LINGMO_PACKAGE_LIBQB
	select LINGMO_PACKAGE_LIBSODIUM if !LINGMO_PACKAGE_LIBGCRYPT && !LINGMO_PACKAGE_LIBOPENSSL
	help
	  The USBGuard software framework

	  Install a custom accept/deny list in /etc/usbguard/rules.conf
	  (e.g. using an overlay). This file can be generated on the
	  target using "usbguard generate-policy".

	  https://usbguard.github.io/

comment "usbguard needs a toolchain w/ C++, threads, dynamic library, gcc >= 8"
	depends on !LINGMO_INSTALL_LIBSTDCPP || !LINGMO_TOOLCHAIN_HAS_THREADS \
		|| LINGMO_STATIC_LIBS || !LINGMO_TOOLCHAIN_GCC_AT_LEAST_8
	depends on LINGMO_PACKAGE_PROTOBUF_ARCH_SUPPORTS

comment "usbguard needs a toolchain not affected by GCC bug 64735"
	depends on LINGMO_PACKAGE_PROTOBUF_ARCH_SUPPORTS
	depends on LINGMO_TOOLCHAIN_HAS_GCC_BUG_64735
```

## package/usbmount/Config.in
```kconfig
config LINGMO_PACKAGE_USBMOUNT
	bool "usbmount"
	depends on LINGMO_USE_MMU # lockfile-progs -> liblockfile
	depends on LINGMO_PACKAGE_HAS_UDEV
	select LINGMO_PACKAGE_LOCKFILE_PROGS
	help
	  The usbmount package automatically mounts USB mass storage
	  devices when they are plugged in, and unmounts them when
	  they are removed.

	  https://wiki.debian.org/usbmount

comment "usbmount requires udev to be enabled"
	depends on LINGMO_USE_MMU
	depends on !LINGMO_PACKAGE_HAS_UDEV
```

## package/usbredir/Config.in
```kconfig
comment "usbredir needs a toolchain w/ threads, gcc >= 4.9"
	depends on !LINGMO_TOOLCHAIN_HAS_THREADS || \
		!LINGMO_TOOLCHAIN_GCC_AT_LEAST_4_9

config LINGMO_PACKAGE_USBREDIR
	bool "usbredir"
	depends on LINGMO_TOOLCHAIN_HAS_THREADS # libusb
	depends on LINGMO_TOOLCHAIN_GCC_AT_LEAST_4_9 # libusb
	select LINGMO_PACKAGE_LIBUSB
	help
	  usbredir is the name of a network protocol for sending usb
	  device traffic over a network connection. It is also the
	  name of the software package offering a parsing library, a
	  usbredirhost library and several utilities implementing this
	  protocol.

	  Note: only the library is installed, not the utilities. Say
	  'y' below if you want the tools too.

	  http://www.spice-space.org/page/UsbRedir

if LINGMO_PACKAGE_USBREDIR

config LINGMO_PACKAGE_USBREDIR_TOOLS
	bool "enable tools"
	depends on LINGMO_USE_MMU # libglib2
	depends on LINGMO_USE_WCHAR # libglib2
	select LINGMO_PACKAGE_LIBGLIB2
	help
	  If you want to serve usbredir requests on your target, say
	  'y' here to have the tools built and installed on the target
	  (including usbredirect binary).

	  Note: the tools are not required to use the library.

comment "tools needs a toolchain w/ wchar"
	depends on LINGMO_USE_MMU
	depends on !LINGMO_USE_WCHAR

endif
```

## package/usbutils/Config.in
```kconfig
config LINGMO_PACKAGE_USBUTILS
	bool "usbutils"
	depends on LINGMO_TOOLCHAIN_HAS_THREADS # libusb
	depends on LINGMO_TOOLCHAIN_GCC_AT_LEAST_4_9 # libusb
	depends on LINGMO_PACKAGE_HAS_UDEV # needs hwdb
	select LINGMO_PACKAGE_LIBUSB
	help
	  USB enumeration utilities

	  http://linux-usb.sourceforge.net/

comment "usbutils needs udev /dev management and toolchain w/ threads, gcc >= 4.9"
	depends on !LINGMO_TOOLCHAIN_HAS_THREADS || \
		!LINGMO_PACKAGE_HAS_UDEV || \
		!LINGMO_TOOLCHAIN_GCC_AT_LEAST_4_9
```

## package/ushare/Config.in
```kconfig
config LINGMO_PACKAGE_USHARE
	bool "ushare"
	depends on LINGMO_TOOLCHAIN_HAS_THREADS # libupnp
	# ushare has a completely custom configure script that does
	# broken things with library ordering, which breaks static
	# linking.
	depends on !LINGMO_STATIC_LIBS
	select LINGMO_PACKAGE_LIBUPNP
	help
	  uShare is a UPnP (TM) A/V & DLNA Media Server.
	  It implements the server component that provides UPnP media
	  devices with information on available multimedia files.

	  http://ushare.geexbox.org/

comment "ushare needs a toolchain w/ threads, dynamic library"
	depends on !LINGMO_TOOLCHAIN_HAS_THREADS || LINGMO_STATIC_LIBS
```

## package/ussp-push/Config.in
```kconfig
config LINGMO_PACKAGE_USSP_PUSH
	bool "ussp-push"
	depends on !LINGMO_STATIC_LIBS # bluez5_utils
	depends on LINGMO_USE_WCHAR # libglib2
	depends on LINGMO_TOOLCHAIN_HAS_THREADS # dbus, alsa-lib, libglib2
	depends on LINGMO_USE_MMU # dbus
	depends on LINGMO_TOOLCHAIN_HAS_SYNC_4 # bluez5_utils
	depends on LINGMO_TOOLCHAIN_HEADERS_AT_LEAST_3_4 # bluez5_utils
	select LINGMO_PACKAGE_OPENOBEX
	select LINGMO_PACKAGE_BLUEZ5_UTILS
	help
	  ussp-push is an OBEX object pusher for Linux, using the BlueZ
	  BlueTooth stack.

	  http://www.xmailserver.org/ussp-push.html

comment "ussp-push needs a toolchain w/ wchar, threads, dynamic library, headers >= 3.4"
	depends on LINGMO_USE_MMU
	depends on LINGMO_TOOLCHAIN_HAS_SYNC_4
	depends on !LINGMO_USE_WCHAR || !LINGMO_TOOLCHAIN_HAS_THREADS || \
		LINGMO_STATIC_LIBS || !LINGMO_TOOLCHAIN_HEADERS_AT_LEAST_3_4
```
