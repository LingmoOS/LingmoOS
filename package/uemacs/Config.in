## package/uemacs/Config.in
```kconfig
config LINGMO_PACKAGE_UEMACS
	bool "uemacs"
	select LINGMO_PACKAGE_NCURSES
	help
	  A small emacs.

	  https://git.kernel.org/cgit/editors/uemacs/uemacs.git/
```

## package/uftp/Config.in
```kconfig
config LINGMO_PACKAGE_UFTP
	bool "uftp"
	depends on LINGMO_USE_MMU # fork()
	depends on LINGMO_TOOLCHAIN_HAS_THREADS
	depends on LINGMO_USE_WCHAR
	help
	  Encrypted UDP based FTP with multicast.

	  http://uftp-multicast.sourceforge.net/

comment "uftp needs a toolchain w/ threads, wchar"
	depends on LINGMO_USE_MMU
	depends on !LINGMO_TOOLCHAIN_HAS_THREADS || !LINGMO_USE_WCHAR
```

## package/uftrace/Config.in
```kconfig
config LINGMO_PACKAGE_UFTRACE_ARCH_SUPPORTS
	bool
	default y if LINGMO_ARM_CPU_ARMV6 || LINGMO_ARM_CPU_ARMV7A
	default y if LINGMO_aarch64
	default y if LINGMO_i386
	default y if LINGMO_x86_64

config LINGMO_PACKAGE_UFTRACE
	bool "uftrace"
	depends on LINGMO_PACKAGE_UFTRACE_ARCH_SUPPORTS
	depends on LINGMO_TOOLCHAIN_HAS_THREADS_NPTL # pthread_setname_np()
	depends on !LINGMO_STATIC_LIBS
	select LINGMO_PACKAGE_ARGP_STANDALONE if \
	       LINGMO_TOOLCHAIN_USES_UCLIBC || \
	       LINGMO_TOOLCHAIN_USES_MUSL
	help
	  The uftrace tool is to trace and analyze execution of a
	  program written in C/C++. It was heavily inspired by the
	  ftrace framework of the Linux kernel (especially function
	  graph tracer) and supports userspace programs.
	  It supports various kind of commands and filters to help
	  analysis of the program execution and performance.

	  https://github.com/namhyung/uftrace

comment "uftrace needs a toolchain w/ NPTL, dynamic library"
	depends on LINGMO_PACKAGE_UFTRACE_ARCH_SUPPORTS
	depends on !LINGMO_TOOLCHAIN_HAS_THREADS_NPTL || LINGMO_STATIC_LIBS
```

## package/uhd/Config.in
```kconfig
comment "uhd needs a toolchain w/ C++, NPTL, wchar, dynamic library, gcc >= 5"
	depends on LINGMO_USE_MMU
	depends on LINGMO_TOOLCHAIN_SUPPORTS_ALWAYS_LOCKFREE_ATOMIC_INTS
	depends on !LINGMO_INSTALL_LIBSTDCPP || !LINGMO_USE_WCHAR || \
		!LINGMO_TOOLCHAIN_HAS_THREADS_NPTL || LINGMO_STATIC_LIBS || \
		!LINGMO_TOOLCHAIN_GCC_AT_LEAST_5

comment "uhd needs a toolchain not affected by GCC bug 64735"
	depends on LINGMO_TOOLCHAIN_HAS_GCC_BUG_64735

config LINGMO_PACKAGE_UHD
	bool "uhd"
	depends on LINGMO_INSTALL_LIBSTDCPP
	depends on !LINGMO_STATIC_LIBS
	depends on LINGMO_TOOLCHAIN_SUPPORTS_ALWAYS_LOCKFREE_ATOMIC_INTS # boost-atomic, boost-filesystem
	depends on !LINGMO_TOOLCHAIN_HAS_GCC_BUG_64735 # boost-thread
	depends on LINGMO_TOOLCHAIN_HAS_THREADS_NPTL
	depends on LINGMO_USE_MMU # use fork()
	depends on LINGMO_USE_WCHAR # boost
	depends on LINGMO_TOOLCHAIN_GCC_AT_LEAST_5 # boost-math
	select LINGMO_PACKAGE_BOOST
	select LINGMO_PACKAGE_BOOST_ATOMIC
	select LINGMO_PACKAGE_BOOST_CHRONO
	select LINGMO_PACKAGE_BOOST_DATE_TIME
	select LINGMO_PACKAGE_BOOST_FILESYSTEM
	select LINGMO_PACKAGE_BOOST_MATH
	select LINGMO_PACKAGE_BOOST_PROGRAM_OPTIONS
	select LINGMO_PACKAGE_BOOST_SERIALIZATION
	select LINGMO_PACKAGE_BOOST_SYSTEM
	select LINGMO_PACKAGE_BOOST_THREAD
	help
	  Universal Software Radio Peripheral (USRP) Hardware Driver

	  https://kb.etthus.com

if LINGMO_PACKAGE_UHD

config LINGMO_PACKAGE_UHD_B100
	bool "b100 support"
	depends on LINGMO_TOOLCHAIN_GCC_AT_LEAST_4_9 # libusb
	select LINGMO_PACKAGE_UHD_USB
	help
	  enable B100 support

comment "B100 support needs a toolchain w/ gcc >= 4.9"
	depends on !LINGMO_TOOLCHAIN_GCC_AT_LEAST_4_9

config LINGMO_PACKAGE_UHD_B200
	bool "b200 support"
	depends on LINGMO_TOOLCHAIN_GCC_AT_LEAST_4_9 # libusb
	select LINGMO_PACKAGE_UHD_USB
	help
	  enable B200 support

comment "B200 support needs a toolchain w/ gcc >= 4.9"
	depends on !LINGMO_TOOLCHAIN_GCC_AT_LEAST_4_9

config LINGMO_PACKAGE_UHD_E300
	bool "E300 support"
	select LINGMO_PACKAGE_UHD_MPMD
	help
	  enable E300 support

config LINGMO_PACKAGE_UHD_E320
	bool "E320 support"
	select LINGMO_PACKAGE_UHD_MPMD
	help
	  enable E320 support

config LINGMO_PACKAGE_UHD_EXAMPLES
	bool "uhd-examples"
	help
	  Examples

config LINGMO_PACKAGE_UHD_MPMD
	bool "MPMD support"
	help
	  enable MPMD support

config LINGMO_PACKAGE_UHD_N300
	bool "N300 support"
	select LINGMO_PACKAGE_UHD_MPMD
	help
	  enable N300 support

config LINGMO_PACKAGE_UHD_N320
	bool "N320 support"
	select LINGMO_PACKAGE_UHD_MPMD
	help
	  enable N320 support

config LINGMO_PACKAGE_UHD_OCTOCLOCK
	bool "OctoClock support"
	help
	  enable OctoClock support

comment "uhd python API needs python3 and a glibc or musl toolchain w/ gcc >= 9, host gcc >= 9"
	depends on !LINGMO_PACKAGE_PYTHON3
	depends on !LINGMO_PACKAGE_PYTHON_NUMPY_ARCH_SUPPORTS
	depends on !LINGMO_HOST_GCC_AT_LEAST_9 || \
		!LINGMO_TOOLCHAIN_GCC_AT_LEAST_9 || \
		!(LINGMO_TOOLCHAIN_USES_GLIBC && LINGMO_TOOLCHAIN_USES_MUSL) # python-numpy

config LINGMO_PACKAGE_UHD_PYTHON
	bool "python API support"
	depends on LINGMO_PACKAGE_PYTHON3
	depends on LINGMO_PACKAGE_PYTHON_NUMPY_ARCH_SUPPORTS
	depends on LINGMO_TOOLCHAIN_USES_GLIBC || LINGMO_TOOLCHAIN_USES_MUSL # python-numpy
	depends on LINGMO_TOOLCHAIN_GCC_AT_LEAST_9 # python-numpy
	depends on LINGMO_HOST_GCC_AT_LEAST_9 # host-python-numpy
	select LINGMO_PACKAGE_PYTHON_NUMPY
	select LINGMO_PACKAGE_PYTHON_REQUESTS
	help
	  enable python API support

config LINGMO_PACKAGE_UHD_USB
	bool "USB support"
	depends on LINGMO_TOOLCHAIN_GCC_AT_LEAST_4_9 # libusb
	select LINGMO_PACKAGE_LIBUSB
	help
	  enable UHD USB support

comment "USB support needs a toolchain w/ gcc >= 4.9"
	depends on !LINGMO_TOOLCHAIN_GCC_AT_LEAST_4_9

config LINGMO_PACKAGE_UHD_USRP1
	bool "USRP1 support"
	depends on LINGMO_TOOLCHAIN_GCC_AT_LEAST_4_9 # libusb
	select LINGMO_PACKAGE_UHD_USB
	help
	  enable USRP1 support

comment "USRP1 support needs a toolchain w/ gcc >= 4.9"
	depends on !LINGMO_TOOLCHAIN_GCC_AT_LEAST_4_9

config LINGMO_PACKAGE_UHD_USRP2
	bool "USRP2 support"
	help
	  enable USRP2 support

comment "uhd utils depends on python API support"
	depends on !LINGMO_PACKAGE_UHD_PYTHON

config LINGMO_PACKAGE_UHD_UTILS
	bool "uhd-utils"
	depends on LINGMO_PACKAGE_UHD_PYTHON
	select LINGMO_PACKAGE_PYTHON_SIX
	help
	  uhd-utils

config LINGMO_PACKAGE_UHD_X300
	bool "X300 support"
	help
	  enable X300 support

endif
```

## package/uhttpd/Config.in
```kconfig
config LINGMO_PACKAGE_UHTTPD
	bool "uhttpd"
	depends on !LINGMO_STATIC_LIBS # dlopen()
	depends on LINGMO_TOOLCHAIN_HAS_SYNC_4 # json-c
	depends on LINGMO_USE_MMU # fork()
	select LINGMO_PACKAGE_LIBUBOX
	select LINGMO_PACKAGE_JSON_C
	help
	  uHTTPd is a tiny single threaded HTTP server with TLS, CGI
	  and Lua support. It is intended as a drop-in replacement for
	  the Busybox HTTP daemon.

	  https://wiki.openwrt.org/doc/howto/http.uhttpd

comment "uhttpd needs a toolchain w/ dynamic library"
	depends on LINGMO_TOOLCHAIN_HAS_SYNC_4
	depends on LINGMO_USE_MMU
	depends on LINGMO_STATIC_LIBS
```

## package/uhubctl/Config.in
```kconfig
config LINGMO_PACKAGE_UHUBCTL
	bool "uhubctl"
	depends on LINGMO_TOOLCHAIN_HAS_THREADS # libusb
	depends on LINGMO_TOOLCHAIN_GCC_AT_LEAST_4_9 # libusb
	select LINGMO_PACKAGE_LIBUSB
	help
	  Control USB power per-port on smart USB hubs.

	  https://github.com/mvp/uhubctl

comment "uhubctl needs a toolchain w/ threads, gcc >= 4.9"
	depends on !LINGMO_TOOLCHAIN_HAS_THREADS || \
		!LINGMO_TOOLCHAIN_GCC_AT_LEAST_4_9
```

## package/ulog/Config.in
```kconfig
config LINGMO_PACKAGE_ULOG
	bool "ulog"
	depends on LINGMO_INSTALL_LIBSTDCPP
	depends on LINGMO_TOOLCHAIN_HAS_THREADS
	help
	  This is a minimalistic logging library derived from
	  Android logger.

	  https://github.com/Parrot-Developers/ulog

comment "ulog needs a toolchain w/ C++, threads"
	depends on !LINGMO_INSTALL_LIBSTDCPP || !LINGMO_TOOLCHAIN_HAS_THREADS
```

## package/ulogd/Config.in
```kconfig
config LINGMO_PACKAGE_ULOGD
	bool "ulogd"
	depends on !LINGMO_STATIC_LIBS
	depends on LINGMO_USE_MMU
	select LINGMO_PACKAGE_LIBMNL
	select LINGMO_PACKAGE_LIBNETFILTER_ACCT
	select LINGMO_PACKAGE_LIBNETFILTER_CONNTRACK
	select LINGMO_PACKAGE_LIBNETFILTER_LOG
	select LINGMO_PACKAGE_LIBNFNETLINK
	help
	  ulogd is a userspace logging daemon for netfilter/iptables
	  related logging.

	  https://www.netfilter.org/projects/ulogd/

comment "ulogd needs a toolchain w/ dynamic library"
	depends on LINGMO_STATIC_LIBS
	depends on LINGMO_USE_MMU
```

## package/umtprd/Config.in
```kconfig
config LINGMO_PACKAGE_UMTPRD
	bool "umtprd"
	depends on LINGMO_TOOLCHAIN_HAS_THREADS
	depends on LINGMO_TOOLCHAIN_HEADERS_AT_LEAST_3_15
	help
	  Lightweight USB MTP responder daemon for GNU/Linux

	  https://github.com/viveris/uMTP-Responder

comment "umtprd needs a toolchain w/ threads, headers >= 3.15"
	depends on !LINGMO_TOOLCHAIN_HAS_THREADS || !LINGMO_TOOLCHAIN_HEADERS_AT_LEAST_3_15
```

## package/unclutter-xfixes/Config.in
```kconfig
config LINGMO_PACKAGE_UNCLUTTER_XFIXES
	bool "unclutter-xfixes"
	depends on LINGMO_PACKAGE_XORG7
	select LINGMO_PACKAGE_LIBEV
	select LINGMO_PACKAGE_XLIB_LIBX11
	select LINGMO_PACKAGE_XLIB_LIBXFIXES
	select LINGMO_PACKAGE_XLIB_LIBXI
	help
	  Remove idle cursor image from screen.

	  A rewrite of unclutter using the x11-xfixes extension.

	  https://github.com/Airblader/unclutter-xfixes
```

## package/unionfs/Config.in
```kconfig
config LINGMO_PACKAGE_UNIONFS
	bool "unionfs (FUSE)"
	depends on LINGMO_TOOLCHAIN_HAS_THREADS # libfuse
	depends on LINGMO_USE_MMU # libfuse
	depends on !LINGMO_STATIC_LIBS # libfuse
	select LINGMO_PACKAGE_LIBFUSE
	help
	  A userspace unionfs implementation.

	  https://github.com/rpodgorny/unionfs-fuse

comment "unionfs needs a toolchain w/ threads, dynamic library"
	depends on LINGMO_USE_MMU
	depends on !LINGMO_TOOLCHAIN_HAS_THREADS || LINGMO_STATIC_LIBS
```

## package/unrar/Config.in
```kconfig
config LINGMO_PACKAGE_UNRAR
	bool "unrar"
	depends on LINGMO_INSTALL_LIBSTDCPP
	depends on LINGMO_TOOLCHAIN_GCC_AT_LEAST_4_8 # C++11
	depends on LINGMO_TOOLCHAIN_HAS_THREADS
	depends on LINGMO_USE_WCHAR
	help
	  RAR file uncompressor.

	  http://www.rarlab.com/rar_add.htm

comment "unrar needs a toolchain w/ C++, wchar, threads, gcc >= 4.8"
	depends on !LINGMO_USE_WCHAR || !LINGMO_INSTALL_LIBSTDCPP \
		|| !LINGMO_TOOLCHAIN_GCC_AT_LEAST_4_8 \
		|| !LINGMO_TOOLCHAIN_HAS_THREADS
```

## package/upmpdcli/Config.in
```kconfig
config LINGMO_PACKAGE_UPMPDCLI
	bool "upmpdcli"
	depends on LINGMO_USE_MMU # fork()
	depends on LINGMO_INSTALL_LIBSTDCPP
	depends on LINGMO_TOOLCHAIN_HAS_THREADS_NPTL
	depends on LINGMO_TOOLCHAIN_GCC_AT_LEAST_4_9 # C++11, libupnpp
	select LINGMO_PACKAGE_JSONCPP
	select LINGMO_PACKAGE_LIBMICROHTTPD
	select LINGMO_PACKAGE_LIBMPDCLIENT
	select LINGMO_PACKAGE_LIBUPNPP
	help
	  upmpdcli is a UPnP Media Renderer front-end for MPD, the Music
	  Player Daemon. It supports UPnP gapless track transitions and
	  the OpenHome ohMedia services.

	  http://www.lesbonscomptes.com/upmpdcli/

comment "upmpdcli needs a toolchain w/ C++, NPTL, gcc >= 4.9"
	depends on LINGMO_USE_MMU
	depends on !LINGMO_INSTALL_LIBSTDCPP || \
		!LINGMO_TOOLCHAIN_HAS_THREADS_NPTL || \
		!LINGMO_TOOLCHAIN_GCC_AT_LEAST_4_9
```

## package/upower/Config.in
```kconfig
config LINGMO_PACKAGE_UPOWER
	bool "upower"
	depends on LINGMO_PACKAGE_HAS_UDEV
	depends on LINGMO_TOOLCHAIN_HAS_THREADS # libgudev
	depends on LINGMO_USE_MMU # libgudev
	depends on LINGMO_USE_WCHAR # libgudev
	select LINGMO_PACKAGE_LIBGUDEV
	help
	  UPower is an abstraction for enumerating power devices,
	  listening to device events and querying history and
	  statistics. Any application or service on the system can
	  access the org.freedesktop.UPower service via the system
	  message bus.

	  Note: upowerd require CONFIG_TIMER_STATS enabled in the
	  Linux kernel.

	  https://upower.freedesktop.org/

comment "upower needs udev /dev management"
	depends on LINGMO_USE_MMU
	depends on !LINGMO_PACKAGE_HAS_UDEV

comment "upower needs a toolchain w/ threads, wchar"
	depends on LINGMO_USE_MMU
	depends on !LINGMO_USE_WCHAR || !LINGMO_TOOLCHAIN_HAS_THREADS
```

## package/uqmi/Config.in
```kconfig
config LINGMO_PACKAGE_UQMI
	bool "uqmi"
	depends on !LINGMO_STATIC_LIBS # libubox
	depends on LINGMO_TOOLCHAIN_HAS_SYNC_4 # json-c
	select LINGMO_PACKAGE_JSON_C
	select LINGMO_PACKAGE_LIBUBOX
	help
	  This command line tool originates from the OpenWrt project
	  to configure LTE modem in QMI mode for WAN connection.

	  https://git.openwrt.org/project/uqmi.git

comment "uqmi needs a toolchain w/ dynamic library"
	depends on LINGMO_TOOLCHAIN_HAS_SYNC_4
	depends on LINGMO_STATIC_LIBS
```

## package/urandom-scripts/Config.in
```kconfig
config LINGMO_PACKAGE_URANDOM_SCRIPTS
	bool "urandom-initscripts"
	default y if LINGMO_PACKAGE_INITSCRIPTS
	depends on LINGMO_PACKAGE_BUSYBOX
	depends on !LINGMO_PACKAGE_SYSTEMD
	help
	  Initscript to preserve the random seed between reboots.
```

## package/urg/Config.in
```kconfig
config LINGMO_PACKAGE_URG
	bool "urg"
	depends on LINGMO_INSTALL_LIBSTDCPP
	help
	  Library to control Hokuyo's URG series sensors.

	  https://sourceforge.net/p/urgnetwork/wiki/Home/

comment "urg needs a toolchain w/ C++"
	depends on !LINGMO_INSTALL_LIBSTDCPP
```

## package/usb_modeswitch/Config.in
```kconfig
config LINGMO_PACKAGE_USB_MODESWITCH
	bool "usb_modeswitch"
	depends on LINGMO_TOOLCHAIN_HAS_THREADS # libusb
	depends on LINGMO_TOOLCHAIN_GCC_AT_LEAST_4_9 # libusb
	select LINGMO_PACKAGE_JIMTCL if !LINGMO_PACKAGE_TCL || LINGMO_PACKAGE_TCL_SHLIB_ONLY
	select LINGMO_PACKAGE_LIBUSB
	help
	  Some USB devices such as 3G/4G broadband modems power-up
	  in mass storage mode to provide access to drivers
	  for the device's application mode. usb_modeswitch
	  changes the mode of such devices from the initial power-up
	  mode to the application mode.
	  Specific configuration data for each device model is required.

	  usb_modeswitch can be used with the usb_modeswitch_data
	  package and eudev/systemd for automatic mode switching
	  when devices are connected.

	  For more information search the Internet for "Virtual CD-ROM
	  switching utility".

	  http://www.draisberghof.de/usb_modeswitch/

comment "usb_modeswitch needs a toolchain w/ threads, gcc >= 4.9"
	depends on !LINGMO_TOOLCHAIN_HAS_THREADS || \
		!LINGMO_TOOLCHAIN_GCC_AT_LEAST_4_9
```

## package/usb_modeswitch_data/Config.in
```kconfig
config LINGMO_PACKAGE_USB_MODESWITCH_DATA
	bool "usb_modeswitch_data"
	depends on LINGMO_TOOLCHAIN_HAS_THREADS # usb_modeswitch -> libusb
	depends on LINGMO_TOOLCHAIN_GCC_AT_LEAST_4_9 # usb_modeswitch -> libusb
	select LINGMO_PACKAGE_USB_MODESWITCH
	help
	  USB mode switch data
	  Contains udev rules and events to allow usb_modeswitch to
	  function automatically

	  http://www.draisberghof.de/usb_modeswitch/

comment "usb_modeswitch_data needs a toolchain w/ threads, gcc >= 4.9"
	depends on !LINGMO_TOOLCHAIN_HAS_THREADS || \
		!LINGMO_TOOLCHAIN_GCC_AT_LEAST_4_9
```
