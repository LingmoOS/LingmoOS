## package/python-evdev/Config.in
```kconfig
config LINGMO_PACKAGE_PYTHON_EVDEV
	bool "python-evdev"
	depends on LINGMO_TOOLCHAIN_HEADERS_AT_LEAST_4_4
	help
	  Bindings to the Linux input handling subsystem.

	  https://github.com/gvalkov/python-evdev

comment "python-evdev needs a toolchain w/ headers >= 4.4"
	depends on !LINGMO_TOOLCHAIN_HEADERS_AT_LEAST_4_4
```

## package/python-fastapi-sessions/Config.in
```kconfig
config LINGMO_PACKAGE_PYTHON_FASTAPI_SESSIONS
	bool "python-fastapi-sessions"
	depends on LINGMO_PACKAGE_HOST_RUSTC_TARGET_ARCH_SUPPORTS # python-pydantic -> python-pydantic-core
	select LINGMO_PACKAGE_PYTHON_FASTAPI # runtime
	select LINGMO_PACKAGE_PYTHON_ITSDANGEROUS # runtime
	select LINGMO_PACKAGE_PYTHON_PYDANTIC # runtime
	help
	  Ready-to-use session library for FastAPI.

	  https://github.com/jordanisaacs/fastapi-sessions
```

## package/python-flask-cors/Config.in
```kconfig
config LINGMO_PACKAGE_PYTHON_FLASK_CORS
	bool "python-flask-cors"
	select LINGMO_PACKAGE_PYTHON_FLASK # runtime
	help
	  A Flask extension adding a decorator for CORS support.

	  https://github.com/corydolphin/flask-cors
```

## package/python-flask-expects-json/Config.in
```kconfig
config LINGMO_PACKAGE_PYTHON_FLASK_EXPECTS_JSON
	bool "python-flask-expects-json"
	depends on LINGMO_PACKAGE_HOST_RUSTC_TARGET_ARCH_SUPPORTS # python-jsonschema -> python-rpds-py
	select LINGMO_PACKAGE_PYTHON_FLASK # runtime
	select LINGMO_PACKAGE_PYTHON_JSONSCHEMA # runtime
	help
	  Decorator for REST endpoints in flask. Validate JSON request
	  data.

	  https://github.com/fischerfredl/flask-expects-json
```

## package/python-flask-login/Config.in
```kconfig
config LINGMO_PACKAGE_PYTHON_FLASK_LOGIN
	bool "python-flask-login"
	# runtime dependency
	select LINGMO_PACKAGE_PYTHON_FLASK
	help
	  Flask-Login provides user session management for Flask.

	  https://github.com/maxcountryman/flask-login
```

## package/python-flask-smorest/Config.in
```kconfig
config LINGMO_PACKAGE_PYTHON_FLASK_SMOREST
	bool "python-flask-smorest"
	select LINGMO_PACKAGE_PYTHON_APISPEC # runtime
	select LINGMO_PACKAGE_PYTHON_FLASK # runtime
	select LINGMO_PACKAGE_PYTHON_MARSHMALLOW # runtime
	select LINGMO_PACKAGE_PYTHON_WEBARGS # runtime
	select LINGMO_PACKAGE_PYTHON_WERKZEUG # runtime
	help
	  Flask/Marshmallow-based REST API framework.

	  https://github.com/marshmallow-code/flask-smorest
```

## package/python-flask-sqlalchemy/Config.in
```kconfig
config LINGMO_PACKAGE_PYTHON_FLASK_SQLALCHEMY
	bool "python-flask-sqlalchemy"
	select LINGMO_PACKAGE_PYTHON_FLASK # runtime
	select LINGMO_PACKAGE_PYTHON_SQLALCHEMY # runtime
	help
	  Flask-SQLAlchemy is a Flask microframework extension which
	  adds support for the SQLAlchemy SQL toolkit/ORM.

	  http://github.com/mitsuhiko/flask-sqlalchemy
```

## package/python-flask-wtf/Config.in
```kconfig
config LINGMO_PACKAGE_PYTHON_FLASK_WTF
	bool "python-flask-wtf"
	select LINGMO_PACKAGE_PYTHON_FLASK # runtime
	select LINGMO_PACKAGE_PYTHON_ITSDANGEROUS # runtime
	select LINGMO_PACKAGE_PYTHON_WTFORMS # runtime
	help
	  Simple integration of Flask and WTForms.

	  https://github.com/wtforms/flask-wtf
```

## package/python-flask/Config.in
```kconfig
config LINGMO_PACKAGE_PYTHON_FLASK
	bool "python-flask"
	select LINGMO_PACKAGE_PYTHON_BLINKER # runtime
	select LINGMO_PACKAGE_PYTHON_CLICK # runtime
	select LINGMO_PACKAGE_PYTHON_JINJA2 # runtime
	select LINGMO_PACKAGE_PYTHON_WERKZEUG # runtime
	select LINGMO_PACKAGE_PYTHON_ITSDANGEROUS # runtime
	select LINGMO_PACKAGE_PYTHON3_SSL
	select LINGMO_PACKAGE_PYTHON3_ZLIB
	help
	  Flask is a microframework for Python based on Werkzeug,
	  Jinja 2 and good intentions.

	  https://palletsprojects.com/p/flask
```

## package/python-git/Config.in
```kconfig
config LINGMO_PACKAGE_PYTHON_GIT
	bool "python-git"
	depends on LINGMO_USE_MMU # git
	select LINGMO_PACKAGE_GIT # runtime
	select LINGMO_PACKAGE_PYTHON_GITDB2 # runtime
	help
	  GitPython is a python library used to interact with git
	  repositories, high-level like git-porcelain, or low-level
	  like git-plumbing.

	  https://github.com/gitpython-developers/GitPython
```

## package/python-gnupg/Config.in
```kconfig
config LINGMO_PACKAGE_PYTHON_GNUPG
	bool "python-gnupg"
	select LINGMO_PACKAGE_GNUPG2 if LINGMO_PACKAGE_GNUPG2_DEPENDS && !LINGMO_PACKAGE_GNUPG # runtime
	select LINGMO_PACKAGE_GNUPG if !LINGMO_PACKAGE_GNUPG2_DEPENDS # runtime
	help
	  A wrapper for the Gnu Privacy Guard (GPG or GnuPG).

	  The gnupg module allows Python programs to make use of the
	  functionality provided by the GNU Privacy Guard (abbreviated
	  GPG or GnuPG). Using this module, Python programs can
	  encrypt and decrypt data, digitally sign documents and
	  verify digital signatures, manage (generate, list and
	  delete) encryption keys, using Public Key Infrastructure
	  (PKI) encryption technology based on OpenPGP.

	  https://docs.red-dove.com/python-gnupg/
```

## package/python-gobject/Config.in
```kconfig
config LINGMO_PACKAGE_PYTHON_GOBJECT
	bool "python-gobject"
	depends on LINGMO_USE_MMU # libglib2, gobject-introspection
	depends on LINGMO_PACKAGE_GOBJECT_INTROSPECTION_ARCH_SUPPORTS # gobject-introspection
	depends on LINGMO_TOOLCHAIN_GCC_AT_LEAST_4_9 # gobject-introspection
	depends on LINGMO_HOST_GCC_AT_LEAST_8 # gobject-introspection -> host-qemu
	depends on LINGMO_TOOLCHAIN_USES_GLIBC # gobject-introspection
	select LINGMO_PACKAGE_GOBJECT_INTROSPECTION
	select LINGMO_PACKAGE_LIBGLIB2
	help
	  Python bindings for the GLib/GObject library

	  https://wiki.gnome.org/action/show/Projects/PyGObject

comment "python-gobject needs a glibc toolchain, gcc >= 4.9, host gcc >= 8"
	depends on LINGMO_USE_MMU
	depends on LINGMO_PACKAGE_GOBJECT_INTROSPECTION_ARCH_SUPPORTS
	depends on !LINGMO_TOOLCHAIN_USES_GLIBC || \
		!LINGMO_TOOLCHAIN_GCC_AT_LEAST_4_9 || \
		!LINGMO_HOST_GCC_AT_LEAST_8
```

## package/python-google-api-core/Config.in
```kconfig
config LINGMO_PACKAGE_PYTHON_GOOGLE_API_CORE
	bool "python-google-api-core"
	select LINGMO_PACKAGE_PYTHON_GOOGLE_AUTH # runtime
	select LINGMO_PACKAGE_PYTHON_GOOGLEAPIS_COMMON_PROTOS # runtime
	select LINGMO_PACKAGE_PYTHON_PROTOBUF # runtime
	select LINGMO_PACKAGE_PYTHON_REQUESTS # runtime
	help
	  Google API client core library.

	  https://github.com/googleapis/python-api-core
```

## package/python-google-auth/Config.in
```kconfig
config LINGMO_PACKAGE_PYTHON_GOOGLE_AUTH
	bool "python-google-auth"
	select LINGMO_PACKAGE_PYTHON_CACHETOOLS # runtime
	select LINGMO_PACKAGE_PYTHON_PYASN1_MODULES # runtime
	select LINGMO_PACKAGE_PYTHON_RSA # runtime
	help
	  Google Authentication Library.

	  https://github.com/googleapis/google-auth-library-python
```

## package/python-googleapis-common-protos/Config.in
```kconfig
config LINGMO_PACKAGE_PYTHON_GOOGLEAPIS_COMMON_PROTOS
	bool "python-googleapis-common-protos"
	select LINGMO_PACKAGE_PYTHON_PROTOBUF # runtime
	help
	  Common protobufs used in Google APIs.

	  https://github.com/googleapis/python-api-common-protos
```

## package/python-gpiozero/Config.in
```kconfig
config LINGMO_PACKAGE_PYTHON_GPIOZERO
	bool "python-gpiozero"
	depends on LINGMO_arm
	select LINGMO_PACKAGE_PYTHON_COLORZERO # runtime
	select LINGMO_PACKAGE_PYTHON_RPI_GPIO # runtime
	select LINGMO_PACKAGE_PYTHON_SETUPTOOLS # runtime
	help
	  A simple interface to GPIO devices with Raspberry Pi.

	  https://github.com/gpiozero/gpiozero
```

## package/python-greenlet/Config.in
```kconfig
config LINGMO_PACKAGE_PYTHON_GREENLET_ARCH_SUPPORTS
	bool
	default y if LINGMO_arm || LINGMO_armeb
	default y if LINGMO_aarch64
	default y if LINGMO_m68k
	default y if LINGMO_mips || LINGMO_mipsel || LINGMO_mips64 || LINGMO_mips64el
	default y if LINGMO_powerpc || LINGMO_powerpc64 || LINGMO_powerpc64le
	default y if LINGMO_riscv
	default y if LINGMO_sparc || LINGMO_sparc64
	default y if LINGMO_i386 || LINGMO_x86_64

config LINGMO_PACKAGE_PYTHON_GREENLET
	bool "python-greenlet"
	depends on LINGMO_PACKAGE_PYTHON_GREENLET_ARCH_SUPPORTS
	depends on LINGMO_INSTALL_LIBSTDCPP
	help
	  Lightweight in-process concurrent programming.

	  https://github.com/python-greenlet/greenlet

comment "python-greenlet needs a toolchain w/ C++"
	depends on LINGMO_PACKAGE_PYTHON_GREENLET_ARCH_SUPPORTS
	depends on !LINGMO_INSTALL_LIBSTDCPP
```

## package/python-grpc-requests/Config.in
```kconfig
config LINGMO_PACKAGE_PYTHON_GRPC_REQUESTS
	bool "python-grpc-requests"
	depends on LINGMO_PACKAGE_HOST_RUSTC_TARGET_ARCH_SUPPORTS # python-cryptography
	depends on LINGMO_PACKAGE_PYTHON_GRPCIO_ARCH_SUPPORTS # python-grpcio
	depends on LINGMO_INSTALL_LIBSTDCPP # python-grpcio
	select LINGMO_PACKAGE_PYTHON_CRYPTOGRAPHY # runtime
	select LINGMO_PACKAGE_PYTHON_GOOGLE_API_CORE # runtime
	select LINGMO_PACKAGE_PYTHON_GRPCIO # runtime
	select LINGMO_PACKAGE_PYTHON_GRPCIO_REFLECTION # runtime
	help
	  grpc for Humans. grpc reflection support client.

	  https://github.com/wesky93/grpc_requests

comment "python-grpcio-requests needs a toolchain w/ C++"
	depends on LINGMO_PACKAGE_HOST_RUSTC_TARGET_ARCH_SUPPORTS
	depends on LINGMO_PACKAGE_PYTHON_GRPCIO_ARCH_SUPPORTS
	depends on !LINGMO_INSTALL_LIBSTDCPP
```

## package/python-grpcio-reflection/Config.in
```kconfig
config LINGMO_PACKAGE_PYTHON_GRPCIO_REFLECTION
	bool "python-grpcio-reflection"
	depends on LINGMO_PACKAGE_PYTHON_GRPCIO_ARCH_SUPPORTS # python-grpcio
	depends on LINGMO_INSTALL_LIBSTDCPP # python-grpcio
	select LINGMO_PACKAGE_PYTHON_GRPCIO # runtime
	select LINGMO_PACKAGE_PYTHON_PROTOBUF # runtime
	help
	  Standard Protobuf Reflection Service for gRPC.

	  https://grpc.io

comment "python-grpcio-reflection needs a toolchain w/ C++"
	depends on LINGMO_PACKAGE_PYTHON_GRPCIO_ARCH_SUPPORTS
	depends on !LINGMO_INSTALL_LIBSTDCPP
```

## package/python-grpcio/Config.in
```kconfig
config LINGMO_PACKAGE_PYTHON_GRPCIO_ARCH_SUPPORTS
	bool
	# see third_party/boringssl-with-bazel/src/include/openssl/target.h
	default y if LINGMO_aarch64 || LINGMO_aarch64_be
	default y if LINGMO_arm || LINGMO_armeb
	default y if LINGMO_i386 || LINGMO_x86_64
	default y if LINGMO_mips || LINGMO_mipsel || LINGMO_mips64 || LINGMO_mips64el
	default y if LINGMO_riscv

config LINGMO_PACKAGE_PYTHON_GRPCIO
	bool "python-grpcio"
	depends on LINGMO_PACKAGE_PYTHON_GRPCIO_ARCH_SUPPORTS
	depends on LINGMO_INSTALL_LIBSTDCPP
	help
	  HTTP/2-based RPC framework.

	  https://grpc.io

comment "python-grpcio needs a toolchain w/ C++"
	depends on LINGMO_PACKAGE_PYTHON_GRPCIO_ARCH_SUPPORTS
	depends on !LINGMO_INSTALL_LIBSTDCPP
```

## package/python-gunicorn/Config.in
```kconfig
config LINGMO_PACKAGE_PYTHON_GUNICORN
	bool "python-gunicorn"
	select LINGMO_PACKAGE_PYTHON_PACKAGING # runtime
	select LINGMO_PACKAGE_PYTHON3_SSL # runtime
	help
	  Gunicorn 'Green Unicorn' is a Python WSGI HTTP Server for
	  UNIX. It's a pre-fork worker model ported from Ruby's
	  Unicorn project. The Gunicorn server is broadly compatible
	  with various web frameworks, simply implemented, light on
	  server resource usage, and fairly speedy.

	  http://gunicorn.org/
```

## package/python-h2/Config.in
```kconfig
config LINGMO_PACKAGE_PYTHON_H2
	bool "python-h2"
	select LINGMO_PACKAGE_PYTHON_HPACK # runtime
	select LINGMO_PACKAGE_PYTHON_HYPERFRAME # runtime
	help
	  HTTP/2 State-Machine based protocol implementation.

	  https://github.com/python-hyper/h2
```

## package/python-hiredis/Config.in
```kconfig
config LINGMO_PACKAGE_PYTHON_HIREDIS
	bool "python-hiredis"
	help
	  Python wrapper for hiredis.

	  https://github.com/redis/hiredis-py
```

## package/python-httpcore/Config.in
```kconfig
config LINGMO_PACKAGE_PYTHON_HTTPCORE
	bool "python-httpcore"
	select LINGMO_PACKAGE_PYTHON_CERTIFI # runtime
	select LINGMO_PACKAGE_PYTHON_H11 # runtime
	help
	  A minimal low-level HTTP client.

	  https://www.encode.io/httpcore/
```

## package/python-httplib2/Config.in
```kconfig
config LINGMO_PACKAGE_PYTHON_HTTPLIB2
	bool "python-httplib2"
	select LINGMO_PACKAGE_PYTHON3_ZLIB
	select LINGMO_PACKAGE_PYTHON3_SSL
	select LINGMO_PACKAGE_PYTHON_PYPARSING # runtime
	help
	  httplib2 is a comprehensive HTTP client library, httplib2.py
	  supports many features left out of other HTTP libraries.

	  https://pypi.python.org/pypi/httplib2
```
